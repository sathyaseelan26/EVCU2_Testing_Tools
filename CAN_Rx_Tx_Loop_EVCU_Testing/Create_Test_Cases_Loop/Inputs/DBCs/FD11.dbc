VERSION ""

NS_ :

BS_:

BU_: SGW PBWM IDCM EVCU2 ECM DMPI BPCM AGSM

BO_ 1031 HV_CHARGER1: 64 IDCM
 SG_ InputCurrentAvailable : 96|9@0+ (1,0) [0|300] "Amp"  EVCU2
 SG_ AC_Side_Volt3 : 164|13@0+ (0.1,0) [0|819] "Volts"  EVCU2,SGW
 SG_ AC_Side_Volt2 : 145|13@0+ (0.1,0) [0|819] "Volts"  EVCU2,SGW
 SG_ AC_Side_Volt1 : 142|13@0+ (0.1,0) [0|819] "Volts"  EVCU2,SGW
 SG_ AC_Side_Curr3 : 121|11@0+ (0.1,-100) [-100|104.6] "Amp"  EVCU2,SGW
 SG_ AC_Side_Curr2 : 65|11@0+ (0.1,-100) [-100|104.6] "Amp"  EVCU2,SGW
 SG_ AC_Side_Curr1 : 19|11@0+ (0.1,-100) [-100|104.6] "Amp"  EVCU2,SGW
 SG_ ProximitySts : 39|3@0+ (1,0) [0|7] "-"  EVCU2
 SG_ OBCM_SlacSts : 54|2@0+ (1,0) [0|3] "-"  EVCU2
 SG_ OBCM_SdpSts : 102|2@0+ (1,0) [0|3] "" EVCU2
 SG_ OBCInterlockSts : 86|2@0+ (1,0) [0|3] "" EVCU2
 SG_ OBC_DeratingReason : 7|4@0+ (1,0) [0|15] "-"  EVCU2
 SG_ J1772_State : 22|3@0+ (1,0) [0|7] "-"  EVCU2
 SG_ J1772_S2_Sts : 23|1@0+ (1,0) [0|1] "-"  EVCU2
 SG_ InputVoltage_isAC : 82|1@0+ (1,0) [0|1] "-"  EVCU2
 SG_ InputVoltage_is60Hz : 71|1@0+ (1,0) [0|1] "-"  EVCU2
 SG_ HV_Overvoltage : 69|1@0+ (1,0) [0|1] "-"  EVCU2
 SG_ HV_Overcurrent : 68|1@0+ (1,0) [0|1] "-"  EVCU2
 SG_ ControlPilotSts : 36|3@0+ (1,0) [0|7] "-"  EVCU2
 SG_ ChargeEnableSts : 181|2@0+ (1,0) [0|2] "-"  EVCU2
 SG_ ChargeCurrentAvailable : 49|10@0+ (0.1,0) [0|102.3] "Amp"  EVCU2
 SG_ ChargeCurrent : 33|10@0+ (0.1,0) [0|102.3] "Amp"  EVCU2
 SG_ BatterySideCurrent : 81|11@0+ (0.1,-50) [-50|154.7] "Amp"  EVCU2
 SG_ AC_Present : 70|1@0+ (1,0) [0|1] "-"  EVCU2
 SG_ AC_HighLoadWarning : 51|1@0+ (1,0) [0|1] "-"  EVCU2
 SG_ Supported_VerNumberMinor : 264|3@0+ (1,0) [0|7] "" EVCU2
 SG_ Supported_VerNumberMajor : 267|3@0+ (1,0) [0|7] "" EVCU2
 SG_ Supported_SchemaID : 270|3@0+ (1,0) [0|7] "" EVCU2
 SG_ Supported_ProtocolName : 257|3@0+ (1,0) [0|7] "" EVCU2
 SG_ MessageCounter_HV_CHARGER1 : 179|4@0+ (1,0) [0|15] "-"  EVCU2
 SG_ EVCC_FailureReason : 263|6@0+ (1,0) [0|63] "" EVCU2
 SG_ CRC_HV_CHARGER1 : 191|8@0+ (1,0) [0|255] "-"  EVCU2
 SG_ BatterySideVoltage : 119|14@0+ (0.1,0) [0|1638.3] "Volts"  EVCU2
 SG_ AC_LnLow : 50|1@0+ (1,0) [0|1] "" EVCU2
 SG_ AC_LnHi : 183|1@0+ (1,0) [0|1] "" EVCU2
 SG_ Plug_And_Charge_Contract_Sts : 67|2@0+ (1,0) [0|3] "" SGW
 SG_ RCD : 274|1@0+ (1,0) [0|1] "-"  EVCU2
 SG_ EVSENominalVoltage : 273|10@0+ (1,0) [0|1023] "V"  EVCU2
 SG_ EVSEMaxCurrent : 288|9@0+ (1,0) [0|511] "A"  EVCU2

BO_ 2564486468 DIAGNOSTIC_RESPONSE_FOTA_BPCM: 64 BPCM
 SG_ N_PDU : 7|64@0+ (1,0) [0|0] "" SGW

BO_ 1063 MCPB_DATA2: 64 DMPI
 SG_ MCPB_Temp : 6|8@0+ (1,-40) [-40|215] "°C"  EVCU2,SGW
 SG_ MCPB_Rotor_Temperature : 30|8@0+ (1,-40) [-40|215] "°C"  EVCU2
 SG_ MCPB_Inverter_Temp : 14|8@0+ (1,-40) [-40|215] "°C"  EVCU2
 SG_ CLrDiagInfo_MCPB : 7|1@0+ (1,0) [0|1] "" EVCU2
 SG_ MessageCounter_MCPB_DATA2 : 435|4@0+ (1,0) [0|15] "" EVCU2
 SG_ MCPB_ROL_STATUS : 37|3@0+ (1,0) [0|7] "" EVCU2
 SG_ MAC_MCPB_DATA2 : 471|48@0+ (1,0) [0|0] "" EVCU2
 SG_ CRC_MCPB_DATA2 : 447|8@0+ (1,0) [0|255] "" EVCU2
 SG_ Cntr_MCPB_DATA2 : 455|16@0+ (1,0) [0|65535] "" EVCU2
 SG_ MCPB_ROL_Request : 38|1@0+ (1,0) [0|1] "" EVCU2

BO_ 2564486421 DIAGNOSTIC_RESPONSE_FOTA_MCPB: 64 EVCU2
 SG_ N_PDU : 7|64@0+ (1,0) [0|0] "" SGW

BO_ 2564486420 DIAGNOSTIC_RESPONSE_FOTA_MCPA: 64 EVCU2
 SG_ N_PDU : 7|64@0+ (1,0) [0|0] "" SGW

BO_ 2564429301 DIAGNOSTIC_REQUEST_FOTA_MCPB: 64 SGW
 SG_ N_PDU : 7|64@0+ (1,0) [0|0] "" EVCU2

BO_ 2564429045 DIAGNOSTIC_REQUEST_FOTA_MCPA: 64 SGW
 SG_ N_PDU : 7|64@0+ (1,0) [0|0] "" EVCU2

BO_ 2564441333 DIAGNOSTIC_REQUEST_FOTA_BPCM: 64 SGW
 SG_ N_PDU : 455|64@0+ (1,0) [0|0] "" BPCM

BO_ 2564554485 DIAGNOSTIC_REQUEST_FUNC_FOTA: 64 SGW
 SG_ N_PDU : 7|64@0+ (1,0) [0|0] "" DMPI,PBWM,IDCM,BPCM

BO_ 292 BATTERY_HV_STATUS1: 64 BPCM
 SG_ MessageCounter_BATT_HV_STATUS1 : 435|4@0+ (1,0) [0|15] "-"  DMPI,EVCU2,IDCM
 SG_ CRC_BATT_HV_STATUS1 : 447|8@0+ (1,0) [0|255] "-"  DMPI,EVCU2,IDCM
 SG_ HVBatContactorWeldCheck : 302|1@0+ (1,0) [0|1] "" EVCU2
 SG_ HVBatReady : 268|1@0+ (1,0) [0|1] "" EVCU2
 SG_ BPCM_DC_CntctrsMidTrmOpeningWarn : 267|1@0+ (1,0) [0|1] "" EVCU2
 SG_ BPCM_DC_CntctrsShtTrmOpeningWarn : 266|1@0+ (1,0) [0|1] "" EVCU2
 SG_ BPCM_ImpactHardwireV : 188|1@0+ (1,0) [0|1] "" DMPI,EVCU2
 SG_ BPCM_ImpactHardwire : 187|1@0+ (1,0) [0|1] "" DMPI,EVCU2
 SG_ BPCM_HV_Char_Main_Contac_Sts : 178|3@0+ (1,0) [0|7] "" EVCU2
 SG_ BPCM_HV_Trac_Main_Contac_Sts : 181|3@0+ (1,0) [0|7] "" DMPI,EVCU2,IDCM
 SG_ BPCM_HV_BalancingMode : 164|2@0+ (1,0) [0|3] "" EVCU2
 SG_ BPCM_HV_ChargingBusVoltage : 162|11@0+ (1,0) [0|2047] "V"  EVCU2
 SG_ BPCM_HV_TractionBusVoltage : 146|11@0+ (1,0) [0|2047] "V"  DMPI,EVCU2,IDCM
 SG_ BPCM_Pwr_Limp_Home_On : 55|1@0+ (1,0) [0|1] "" EVCU2
 SG_ BPCM_HV_Trac_Bus_Sts : 36|3@0+ (1,0) [0|7] "" EVCU2,IDCM
 SG_ BPCM_HV_Char_Bus_Sts : 39|3@0+ (1,0) [0|7] "" EVCU2
 SG_ BPCM_HV_SOH_Low : 30|7@0+ (1,0) [0|127] "" EVCU2
 SG_ BPCM_HV_SOH : 22|7@0+ (1,0) [0|127] "" EVCU2,SGW
 SG_ HVBatContactorOpenTime : 15|8@0+ (0.2,0) [0|51] "Hours"  EVCU2
 SG_ HVBatLastSlept : 7|8@0+ (0.2,0) [0|51] "Days"  EVCU2
 SG_ BPCMInterlockSts : 54|3@0+ (1,0) [0|4] "" EVCU2
 SG_ BPCM_HV_BatIntrlk_InternalStat : 271|3@0+ (1,0) [0|3] "" EVCU2
 SG_ BPCM_HV_Temperature_Min : 218|11@0+ (0.1,-40) [-40|164.7] "°C"  EVCU2
 SG_ BPCM_HV_Temperature_Max : 202|11@0+ (0.1,-40) [-40|164.7] "°C"  EVCU2
 SG_ BPCM_HV_Temperature_Avg : 186|11@0+ (0.1,-40) [-40|164.7] "°C"  EVCU2
 SG_ BPCM_HV_SOC : 33|10@0+ (0.1,0) [0|102.3] "%"  DMPI,EVCU2,SGW
 SG_ BPCM_HV_Outlet_Temp : 250|11@0+ (0.1,-40) [-40|164.7] "°C"  EVCU2
 SG_ BPCM_HV_InternalVoltage : 133|14@0+ (0.1,90.9) [90.9|1729.2] "V"  DMPI,EVCU2
 SG_ BPCM_HV_Inlet_Temp : 234|11@0+ (0.1,-40) [-40|164.7] "°C"  EVCU2
 SG_ BPCM_HV_Current : 71|16@0+ (0.1,-3276.7) [-3276.7|3276.8] "A"  DMPI,EVCU2
 SG_ BPCM_HV_Capacity : 51|12@0+ (0.15,0) [0|614.25] "Ah"  EVCU2
 SG_ BPCM_HV_Battery_GFD_Sts : 149|3@0+ (1,0) [0|4] "" EVCU2
 SG_ BPCM_Wakeup_Request : 23|1@0+ (1,0) [0|1] "" EVCU2
 SG_ BPCM_HV_ThermalRunaway : 135|2@0+ (1,0) [0|3] "" EVCU2
 SG_ BPCM_MILRequest : 31|1@0+ (1,0) [0|1] "" EVCU2,ECM
 SG_ HVBP_Busbar_Temp : 423|8@0+ (1,-40) [-40|215] "°C"  EVCU2
 SG_ HVBP_BDU_Busbar_Temp : 415|8@0+ (1,-40) [-40|215] "°C"  EVCU2
 SG_ BPCM_HV_DCFC_Isolation_Sts : 167|3@0+ (1,0) [0|7] "" EVCU2
 SG_ BPCM_HV_Trac_PreCha_Contac_Sts : 354|3@0+ (1,0) [0|7] "" EVCU2

BO_ 485 BATTERY_HV_VLIMITS: 64 BPCM
 SG_ MessageCounter_BATT_HV_VLIMITS : 435|4@0+ (1,0) [0|15] "-"  EVCU2
 SG_ CRC_BATT_HV_VLIMITS : 447|8@0+ (1,0) [0|255] "-"  EVCU2
 SG_ BPCM_HV_NumCellMinTemp : 224|9@0+ (1,0) [0|511] "" EVCU2
 SG_ BPCM_HV_NumCellMaxTemp : 192|9@0+ (1,0) [0|511] "" EVCU2
 SG_ BPCM_HV_NumCellMinVolt : 80|9@0+ (1,0) [0|511] "" EVCU2
 SG_ BPCM_HV_NumCellMaxVolt : 64|9@0+ (1,0) [0|511] "" EVCU2
 SG_ BPCM_Min_Pk_Volt_Allowed : 50|11@0+ (1,0) [0|2047] "V"  EVCU2
 SG_ BPCM_Max_Pk_Volt_Allowed : 18|11@0+ (1,0) [0|2047] "V"  EVCU2
 SG_ BPCM_OCV_Min_Cell_Volt : 180|13@0+ (0.001,0) [0|8.191] "V"  EVCU2
 SG_ BPCM_OCV_Max_Cell_Volt : 164|13@0+ (0.001,0) [0|8.191] "V"  EVCU2
 SG_ BPCM_OCV_Avg_Cell_Volt : 148|13@0+ (0.001,0) [0|8.191] "V"  EVCU2
 SG_ BPCM_Min_Cell_Volt_Allowed : 36|13@0+ (0.001,0) [0|8.191] "V"  EVCU2
 SG_ BPCM_Max_Cell_Volt_Allowed : 132|13@0+ (0.001,0) [0|8.191] "V"  EVCU2
 SG_ BPCM_HV_Insulation_Resistance : 215|16@0+ (1,0) [0|65535] "kOhm"  EVCU2
 SG_ BPCM_Cell_Volt_Min : 116|13@0+ (0.001,0) [0|8.191] "V"  EVCU2
 SG_ BPCM_Cell_Volt_Max : 100|13@0+ (0.001,0) [0|8.191] "V"  EVCU2
 SG_ BPCM_Cell_Volt_Avg : 4|13@0+ (0.001,0) [0|8.191] "V"  EVCU2

BO_ 288 BATTERY_HV_POWERLIMITS: 64 BPCM
 SG_ BPCM_HV_HVBatChargeStat : 215|3@0+ (1,0) [0|7] "" EVCU2
 SG_ BPCM_HV_PwrLmtInstDschg : 245|14@0+ (0.1,0) [0|1638.3] "" EVCU2
 SG_ BPCM_HV_PwrLmtInstChrg : 309|14@0+ (0.1,0) [0|1638.3] "" EVCU2
 SG_ BPCM_HV_Pwr_MaxDischrg_ShrTrm : 69|14@0+ (0.1,0) [0|1638.3] "kW"  DMPI,EVCU2
 SG_ BPCM_HV_Power_MaxDischarge_MdTrm : 133|14@0+ (0.1,0) [0|1638.3] "kW"  EVCU2
 SG_ BPCM_HV_Power_MaxDischarge_LgTrm : 197|14@0+ (0.1,0) [0|1638.3] "kW"  EVCU2
 SG_ BPCM_HV_Power_MaxCharge_ShrTrm : 53|14@0+ (0.1,0) [0|1638.3] "kW"  EVCU2
 SG_ BPCM_HV_Power_MaxCharge_MdTrm : 117|14@0+ (0.1,0) [0|1638.3] "kW"  EVCU2
 SG_ BPCM_HV_Power_MaxCharge_LgTrm : 181|14@0+ (0.1,0) [0|1638.3] "kW"  EVCU2
 SG_ BPCM_HV_CrntLmtInstDschg : 374|15@0+ (0.1,0) [0|3276.7] "A"  EVCU2
 SG_ BPCM_HV_CrntLmtInstChrg : 390|15@0+ (0.1,0) [0|3276.7] "A"  EVCU2
 SG_ BPCM_HV_ChargingCurrentProfile : 6|15@0+ (0.1,0) [0|3276.7] "A"  EVCU2
 SG_ BPCM_HV_Cell_MinDischrg_Imped : 228|13@0+ (0.01,0) [0|81.91] "Ohm"  EVCU2
 SG_ BPCM_HV_Cell_MaxDischrg_Imped : 212|13@0+ (0.01,0) [0|81.91] "Ohm"  EVCU2
 SG_ BPCM_CntctrsShtTrmOpeningWarn : 417|1@0+ (1,0) [0|1] "" DMPI,EVCU2,IDCM
 SG_ BPCM_CntctrsMidTrmOpeningWarn : 416|1@0+ (1,0) [0|1] "" EVCU2
 SG_ MessageCounter_BATT_HV_POWERLIMS : 435|4@0+ (1,0) [0|15] "-"  EVCU2
 SG_ CRC_BATT_HV_POWERLIMS : 447|8@0+ (1,0) [0|255] "-"  EVCU2

BO_ 2564485698 DIAGNOSTIC_RESPONSE_FD_EVCU2: 64 EVCU2
 SG_ N_PDU : 7|64@0+ (1,0) [0|0] "" SGW

BO_ 2564440818 DIAGNOSTIC_REQUEST_FD_EVCU2: 64 SGW
 SG_ N_PDU : 455|64@0+ (1,0) [0|0] "" EVCU2

BO_ 1965 HVBATTERY_RM_CELLS9: 64 BPCM
 SG_ HVBatCellVoltage_Cell232 : 244|13@0+ (0.001,0) [0|5] "V"  SGW
 SG_ HVBatCellVoltage_Cell231 : 228|13@0+ (0.001,0) [0|5] "V"  SGW
 SG_ HVBatCellVoltage_Cell230 : 212|13@0+ (0.001,0) [0|5] "V"  SGW
 SG_ HVBatCellVoltage_Cell229 : 196|13@0+ (0.001,0) [0|5] "V"  SGW
 SG_ HVBatCellVoltage_Cell228 : 180|13@0+ (0.001,0) [0|5] "V"  SGW
 SG_ HVBatCellVoltage_Cell227 : 164|13@0+ (0.001,0) [0|5] "V"  SGW
 SG_ HVBatCellVoltage_Cell226 : 148|13@0+ (0.001,0) [0|5] "V"  SGW
 SG_ HVBatCellVoltage_Cell225 : 132|13@0+ (0.001,0) [0|5] "V"  SGW
 SG_ HVBatCellVoltage_Cell224 : 116|13@0+ (0.001,0) [0|5] "V"  SGW
 SG_ HVBatCellVoltage_Cell223 : 100|13@0+ (0.001,0) [0|5] "V"  SGW
 SG_ HVBatCellVoltage_Cell222 : 84|13@0+ (0.001,0) [0|5] "V"  SGW
 SG_ HVBatCellVoltage_Cell221 : 68|13@0+ (0.001,0) [0|5] "V"  SGW
 SG_ HVBatCellVoltage_Cell220 : 52|13@0+ (0.001,0) [0|5] "V"  SGW
 SG_ HVBatCellVoltage_Cell219 : 36|13@0+ (0.001,0) [0|5] "V"  SGW
 SG_ HVBatCellVoltage_Cell218 : 20|13@0+ (0.001,0) [0|5] "V"  SGW
 SG_ HVBatCellVoltage_Cell217 : 4|13@0+ (0.001,0) [0|5] "V"  SGW

BO_ 1963 HVBATTERY_RM_CELLS15: 64 BPCM
 SG_ HVBatCellVoltage_Cell400 : 92|13@0+ (0.001,0) [0|5] "V"  SGW
 SG_ HVBatCellVoltage_Cell399 : 73|13@0+ (0.001,0) [0|5] "V"  SGW
 SG_ HVBatCellVoltage_Cell398 : 70|13@0+ (0.001,0) [0|5] "V"  SGW
 SG_ HVBatCellVoltage_Cell397 : 51|13@0+ (0.001,0) [0|5] "V"  SGW
 SG_ HVBatCellVoltage_Cell396 : 32|13@0+ (0.001,0) [0|5] "V"  SGW
 SG_ HVBatCellVoltage_Cell395 : 29|13@0+ (0.001,0) [0|5] "V"  SGW
 SG_ HVBatCellVoltage_Cell394 : 10|13@0+ (0.001,0) [0|5] "V"  SGW
 SG_ HVBatCellVoltage_Cell393 : 7|13@0+ (0.001,0) [0|5] "V"  SGW

BO_ 1962 HVBATTERY_RM_CELLS14: 64 BPCM
 SG_ HVBatCellVoltage_Cell392 : 404|13@0+ (0.001,0) [0|5] "V"  SGW
 SG_ HVBatCellVoltage_Cell391 : 385|13@0+ (0.001,0) [0|5] "V"  SGW
 SG_ HVBatCellVoltage_Cell390 : 382|13@0+ (0.001,0) [0|5] "V"  SGW
 SG_ HVBatCellVoltage_Cell389 : 363|13@0+ (0.001,0) [0|5] "V"  SGW
 SG_ HVBatCellVoltage_Cell388 : 344|13@0+ (0.001,0) [0|5] "V"  SGW
 SG_ HVBatCellVoltage_Cell387 : 341|13@0+ (0.001,0) [0|5] "V"  SGW
 SG_ HVBatCellVoltage_Cell386 : 322|13@0+ (0.001,0) [0|5] "V"  SGW
 SG_ HVBatCellVoltage_Cell385 : 319|13@0+ (0.001,0) [0|5] "V"  SGW
 SG_ HVBatCellVoltage_Cell384 : 300|13@0+ (0.001,0) [0|5] "V"  SGW
 SG_ HVBatCellVoltage_Cell383 : 281|13@0+ (0.001,0) [0|5] "V"  SGW
 SG_ HVBatCellVoltage_Cell382 : 278|13@0+ (0.001,0) [0|5] "V"  SGW
 SG_ HVBatCellVoltage_Cell381 : 259|13@0+ (0.001,0) [0|5] "V"  SGW
 SG_ HVBatCellVoltage_Cell380 : 240|13@0+ (0.001,0) [0|5] "V"  SGW
 SG_ HVBatCellVoltage_Cell379 : 237|13@0+ (0.001,0) [0|5] "V"  SGW
 SG_ HVBatCellVoltage_Cell378 : 218|13@0+ (0.001,0) [0|5] "V"  SGW
 SG_ HVBatCellVoltage_Cell377 : 215|13@0+ (0.001,0) [0|5] "V"  SGW
 SG_ HVBatCellVoltage_Cell376 : 196|13@0+ (0.001,0) [0|5] "V"  SGW
 SG_ HVBatCellVoltage_Cell375 : 177|13@0+ (0.001,0) [0|5] "V"  SGW
 SG_ HVBatCellVoltage_Cell374 : 174|13@0+ (0.001,0) [0|5] "V"  SGW
 SG_ HVBatCellVoltage_Cell373 : 155|13@0+ (0.001,0) [0|5] "V"  SGW
 SG_ HVBatCellVoltage_Cell372 : 136|13@0+ (0.001,0) [0|5] "V"  SGW
 SG_ HVBatCellVoltage_Cell371 : 133|13@0+ (0.001,0) [0|5] "V"  SGW
 SG_ HVBatCellVoltage_Cell370 : 114|13@0+ (0.001,0) [0|5] "V"  SGW
 SG_ HVBatCellVoltage_Cell369 : 111|13@0+ (0.001,0) [0|5] "V"  SGW
 SG_ HVBatCellVoltage_Cell368 : 92|13@0+ (0.001,0) [0|5] "V"  SGW
 SG_ HVBatCellVoltage_Cell367 : 73|13@0+ (0.001,0) [0|5] "V"  SGW
 SG_ HVBatCellVoltage_Cell366 : 70|13@0+ (0.001,0) [0|5] "V"  SGW
 SG_ HVBatCellVoltage_Cell365 : 51|13@0+ (0.001,0) [0|5] "V"  SGW
 SG_ HVBatCellVoltage_Cell364 : 32|13@0+ (0.001,0) [0|5] "V"  SGW
 SG_ HVBatCellVoltage_Cell363 : 29|13@0+ (0.001,0) [0|5] "V"  SGW
 SG_ HVBatCellVoltage_Cell362 : 10|13@0+ (0.001,0) [0|5] "V"  SGW
 SG_ HVBatCellVoltage_Cell361 : 7|13@0+ (0.001,0) [0|5] "V"  SGW

BO_ 1961 HVBATTERY_RM_CELLS13: 64 BPCM
 SG_ HVBatCellVoltage_Cell360 : 404|13@0+ (0.001,0) [0|5] "V"  SGW
 SG_ HVBatCellVoltage_Cell359 : 385|13@0+ (0.001,0) [0|5] "V"  SGW
 SG_ HVBatCellVoltage_Cell358 : 382|13@0+ (0.001,0) [0|5] "V"  SGW
 SG_ HVBatCellVoltage_Cell357 : 363|13@0+ (0.001,0) [0|5] "V"  SGW
 SG_ HVBatCellVoltage_Cell356 : 344|13@0+ (0.001,0) [0|5] "V"  SGW
 SG_ HVBatCellVoltage_Cell355 : 341|13@0+ (0.001,0) [0|5] "V"  SGW
 SG_ HVBatCellVoltage_Cell354 : 322|13@0+ (0.001,0) [0|5] "V"  SGW
 SG_ HVBatCellVoltage_Cell353 : 319|13@0+ (0.001,0) [0|5] "V"  SGW
 SG_ HVBatCellVoltage_Cell352 : 300|13@0+ (0.001,0) [0|5] "V"  SGW
 SG_ HVBatCellVoltage_Cell351 : 281|13@0+ (0.001,0) [0|5] "V"  SGW
 SG_ HVBatCellVoltage_Cell350 : 278|13@0+ (0.001,0) [0|5] "V"  SGW
 SG_ HVBatCellVoltage_Cell349 : 259|13@0+ (0.001,0) [0|5] "V"  SGW
 SG_ HVBatCellVoltage_Cell348 : 240|13@0+ (0.001,0) [0|5] "V"  SGW
 SG_ HVBatCellVoltage_Cell347 : 237|13@0+ (0.001,0) [0|5] "V"  SGW
 SG_ HVBatCellVoltage_Cell346 : 218|13@0+ (0.001,0) [0|5] "V"  SGW
 SG_ HVBatCellVoltage_Cell345 : 215|13@0+ (0.001,0) [0|5] "V"  SGW
 SG_ HVBatCellVoltage_Cell344 : 196|13@0+ (0.001,0) [0|5] "V"  SGW
 SG_ HVBatCellVoltage_Cell343 : 177|13@0+ (0.001,0) [0|5] "V"  SGW
 SG_ HVBatCellVoltage_Cell342 : 174|13@0+ (0.001,0) [0|5] "V"  SGW
 SG_ HVBatCellVoltage_Cell341 : 155|13@0+ (0.001,0) [0|5] "V"  SGW
 SG_ HVBatCellVoltage_Cell340 : 136|13@0+ (0.001,0) [0|5] "V"  SGW
 SG_ HVBatCellVoltage_Cell339 : 133|13@0+ (0.001,0) [0|5] "V"  SGW
 SG_ HVBatCellVoltage_Cell338 : 114|13@0+ (0.001,0) [0|5] "V"  SGW
 SG_ HVBatCellVoltage_Cell337 : 111|13@0+ (0.001,0) [0|5] "V"  SGW
 SG_ HVBatCellVoltage_Cell336 : 92|13@0+ (0.001,0) [0|5] "V"  SGW
 SG_ HVBatCellVoltage_Cell335 : 73|13@0+ (0.001,0) [0|5] "V"  SGW
 SG_ HVBatCellVoltage_Cell334 : 70|13@0+ (0.001,0) [0|5] "V"  SGW
 SG_ HVBatCellVoltage_Cell333 : 51|13@0+ (0.001,0) [0|5] "V"  SGW
 SG_ HVBatCellVoltage_Cell332 : 32|13@0+ (0.001,0) [0|5] "V"  SGW
 SG_ HVBatCellVoltage_Cell331 : 29|13@0+ (0.001,0) [0|5] "V"  SGW
 SG_ HVBatCellVoltage_Cell330 : 10|13@0+ (0.001,0) [0|5] "V"  SGW
 SG_ HVBatCellVoltage_Cell329 : 7|13@0+ (0.001,0) [0|5] "V"  SGW

BO_ 1960 HVBATTERY_RM_CELLS12: 64 BPCM
 SG_ HVBatCellVoltage_Cell328 : 404|13@0+ (0.001,0) [0|5] "V"  SGW
 SG_ HVBatCellVoltage_Cell327 : 385|13@0+ (0.001,0) [0|5] "V"  SGW
 SG_ HVBatCellVoltage_Cell326 : 382|13@0+ (0.001,0) [0|5] "V"  SGW
 SG_ HVBatCellVoltage_Cell325 : 363|13@0+ (0.001,0) [0|5] "V"  SGW
 SG_ HVBatCellVoltage_Cell324 : 344|13@0+ (0.001,0) [0|5] "V"  SGW
 SG_ HVBatCellVoltage_Cell323 : 341|13@0+ (0.001,0) [0|5] "V"  SGW
 SG_ HVBatCellVoltage_Cell322 : 322|13@0+ (0.001,0) [0|5] "V"  SGW
 SG_ HVBatCellVoltage_Cell321 : 319|13@0+ (0.001,0) [0|5] "V"  SGW
 SG_ HVBatCellVoltage_Cell320 : 300|13@0+ (0.001,0) [0|5] "V"  SGW
 SG_ HVBatCellVoltage_Cell319 : 281|13@0+ (0.001,0) [0|5] "V"  SGW
 SG_ HVBatCellVoltage_Cell318 : 278|13@0+ (0.001,0) [0|5] "V"  SGW
 SG_ HVBatCellVoltage_Cell317 : 259|13@0+ (0.001,0) [0|5] "V"  SGW
 SG_ HVBatCellVoltage_Cell316 : 240|13@0+ (0.001,0) [0|5] "V"  SGW
 SG_ HVBatCellVoltage_Cell315 : 237|13@0+ (0.001,0) [0|5] "V"  SGW
 SG_ HVBatCellVoltage_Cell314 : 218|13@0+ (0.001,0) [0|5] "V"  SGW
 SG_ HVBatCellVoltage_Cell313 : 215|13@0+ (0.001,0) [0|5] "V"  SGW
 SG_ HVBatCellVoltage_Cell312 : 196|13@0+ (0.001,0) [0|5] "V"  SGW
 SG_ HVBatCellVoltage_Cell311 : 177|13@0+ (0.001,0) [0|5] "V"  SGW
 SG_ HVBatCellVoltage_Cell310 : 174|13@0+ (0.001,0) [0|5] "V"  SGW
 SG_ HVBatCellVoltage_Cell309 : 155|13@0+ (0.001,0) [0|5] "V"  SGW
 SG_ HVBatCellVoltage_Cell308 : 136|13@0+ (0.001,0) [0|5] "V"  SGW
 SG_ HVBatCellVoltage_Cell307 : 133|13@0+ (0.001,0) [0|5] "V"  SGW
 SG_ HVBatCellVoltage_Cell306 : 114|13@0+ (0.001,0) [0|5] "V"  SGW
 SG_ HVBatCellVoltage_Cell305 : 111|13@0+ (0.001,0) [0|5] "V"  SGW
 SG_ HVBatCellVoltage_Cell304 : 92|13@0+ (0.001,0) [0|5] "V"  SGW
 SG_ HVBatCellVoltage_Cell303 : 73|13@0+ (0.001,0) [0|5] "V"  SGW
 SG_ HVBatCellVoltage_Cell302 : 70|13@0+ (0.001,0) [0|5] "V"  SGW
 SG_ HVBatCellVoltage_Cell301 : 51|13@0+ (0.001,0) [0|5] "V"  SGW
 SG_ HVBatCellVoltage_Cell300 : 32|13@0+ (0.001,0) [0|5] "V"  SGW
 SG_ HVBatCellVoltage_Cell299 : 29|13@0+ (0.001,0) [0|5] "V"  SGW
 SG_ HVBatCellVoltage_Cell298 : 10|13@0+ (0.001,0) [0|5] "V"  SGW
 SG_ HVBatCellVoltage_Cell297 : 7|13@0+ (0.001,0) [0|5] "V"  SGW

CM_ SG_ 1031 Supported_VerNumberMajor "Version Number Major accepted by  EVCC to support";
CM_ SG_ 1031 Supported_SchemaID "SchemaID accepted by  EVCC to support";
CM_ SG_ 1031 Supported_ProtocolName "Protocol accepted by  EVCC to support";
CM_ SG_ 1031 RCD "Used to Indicate the current status of the Residual Current Device (RCD)";
CM_ SG_ 1031 ProximitySts "Proximity status based on the voltage level";
CM_ SG_ 1031 Plug_And_Charge_Contract_Sts "HU Plug and Charge Contract status";
CM_ SG_ 1031 OBCM_SlacSts "Communication PLC protocol status, SLAC process";
CM_ SG_ 1031 OBCM_SdpSts "Network protocol implementation status";
CM_ SG_ 1031 OBCInterlockSts "OBCM interlock state";
CM_ SG_ 1031 OBC_DeratingReason "OBCM recovery action";
CM_ SG_ 1031 MessageCounter_HV_CHARGER1 "This signal is a counter used for safety checks strategies. This counter is incremented of 1 (one) unit at each frame transmission.";
CM_ SG_ 1031 J1772_State "J1772 status";
CM_ SG_ 1031 InputVoltage_isAC "Input voltage is a/c (dc - [0], ac - [1])";
CM_ SG_ 1031 InputVoltage_is60Hz "Input voltage frrequency is 60 hz (50 hz - [0], 60 hz - [1])";
CM_ SG_ 1031 InputCurrentAvailable "J1772 input curent available";
CM_ SG_ 1031 HV_Overvoltage "High voltage - over voltage";
CM_ SG_ 1031 HV_Overcurrent "High voltage over current";
CM_ SG_ 1031 EVSENominalVoltage "RMS of the maximum voltage vehicle can accept";
CM_ SG_ 1031 EVSEMaxCurrent "EV Maximum current supported per Phase";
CM_ SG_ 1031 EVCC_FailureReason "EVCC failure reason";
CM_ SG_ 1031 CRC_HV_CHARGER1 "CRC according to SAE J1850 standard at each frame transmission.";
CM_ SG_ 1031 ControlPilotSts "EVSE pilot status";
CM_ SG_ 1031 ChargeEnableSts "OBCM Feedback status.";
CM_ SG_ 1031 ChargeCurrentAvailable ".";
CM_ SG_ 1031 ChargeCurrent ".";
CM_ SG_ 1031 BatterySideVoltage "Battery side voltage";
CM_ SG_ 1031 BatterySideCurrent "Battery side current";
CM_ SG_ 1031 AC_Side_Volt3 "AC line voltage3p, p3";
CM_ SG_ 1031 AC_Side_Volt2 "AC line voltage3p, p2";
CM_ SG_ 1031 AC_Side_Volt1 "AC line voltage3p, p1";
CM_ SG_ 1031 AC_Side_Curr3 "AC line current3p, p3";
CM_ SG_ 1031 AC_Side_Curr2 "AC line current3p, p2";
CM_ SG_ 1031 AC_Side_Curr1 "AC line current3p, p1";
CM_ SG_ 1031 AC_Present "AC line detection";
CM_ SG_ 1031 AC_LnLow "AC line voltage too low";
CM_ SG_ 1031 AC_LnHi "AC line voltage too High";
CM_ SG_ 1031 AC_HighLoadWarning "Infrastructure overload";
CM_ SG_ 2564486468 N_PDU "This signal is used for diagnostic purposes";
CM_ SG_ 1063 MessageCounter_MCPB_DATA2 "This signal is a counter used for safety checks strategies. This counter is incremented of 1 (one) unit at each frame transmission.";
CM_ SG_ 1063 MCPB_Temp "Motor B temperature";
CM_ SG_ 1063 MCPB_Rotor_Temperature "Rotor Temperature from Motor";
CM_ SG_ 1063 MCPB_ROL_STATUS "MCPB Resolver Offset Learn Status";
CM_ SG_ 1063 MCPB_ROL_Request "MCPB Resolver Offset Learn Request";
CM_ SG_ 1063 MCPB_Inverter_Temp "Inverter B Temperature";
CM_ SG_ 1063 MAC_MCPB_DATA2 "MAC";
CM_ SG_ 1063 CRC_MCPB_DATA2 "CRC according to SAE J1850 standard at each frame transmission.";
CM_ SG_ 1063 Cntr_MCPB_DATA2 "Cnrt";
CM_ SG_ 1063 CLrDiagInfo_MCPB "Legislative Diagnostic Clear information for MCPB";
CM_ SG_ 2564486421 N_PDU "This signal is used for diagnostic purposes";
CM_ SG_ 2564486420 N_PDU "This signal is used for diagnostic purposes";
CM_ SG_ 2564429301 N_PDU "This signal is used for diagnostic purposes";
CM_ SG_ 2564429045 N_PDU "This signal is used for diagnostic purposes";
CM_ SG_ 2564441333 N_PDU "This signal is used for diagnostic purposes";
CM_ SG_ 2564554485 N_PDU "This signal is used for diagnostic purposes";
CM_ SG_ 292 MessageCounter_BATT_HV_STATUS1 "This signal is a counter used for safety checks strategies. This counter is incremented of 1 (one) unit at each frame transmission.";
CM_ SG_ 292 HVBP_Busbar_Temp "HVBP Busbar temp";
CM_ SG_ 292 HVBP_BDU_Busbar_Temp "HVBP BDU Busbar temp";
CM_ SG_ 292 HVBatReady "High Voltage Battery Ready";
CM_ SG_ 292 HVBatLastSlept "Time since BPCM last went to sleep.";
CM_ SG_ 292 HVBatContactorWeldCheck "Contactor weld check report from BPCM for DC charging.";
CM_ SG_ 292 HVBatContactorOpenTime "Time Since Bat contactors last transitioned to Open.";
CM_ SG_ 292 CRC_BATT_HV_STATUS1 "CRC according to SAE J1850 standard at each frame transmission.";
CM_ SG_ 292 BPCMInterlockSts "BPCM interlock state";
CM_ SG_ 292 BPCM_Wakeup_Request "BPCM Wakeup event";
CM_ SG_ 292 BPCM_Pwr_Limp_Home_On "Traction Battery Limp Home mode flag.";
CM_ SG_ 292 BPCM_MILRequest "BPCM MIL Request 0 = False 1 = True";
CM_ SG_ 292 BPCM_ImpactHardwireV "This signal is used to indicate a Valid serial line comunication";
CM_ SG_ 292 BPCM_ImpactHardwire "This signal is used to indicate that a crash happened";
CM_ SG_ 292 BPCM_HV_TractionBusVoltage "Battery link traction bus voltage.";
CM_ SG_ 292 BPCM_HV_Trac_PreCha_Contac_Sts "Status of DC Circuit isolation failure";
CM_ SG_ 292 BPCM_HV_Trac_Main_Contac_Sts "Traction main contactor physical relay status";
CM_ SG_ 292 BPCM_HV_ThermalRunaway "Thermal runaway status";
CM_ SG_ 292 BPCM_HV_Temperature_Min "Battery Minimum Temperature22/06/2020 Allegra Giordano - changes: Value, Max (previous values: 164,7 - 164,6) (Daniele Zaharia's request)";
CM_ SG_ 292 BPCM_HV_Temperature_Max "Battery Max Temperature22/06/2020 Allegra Giordano - changes: Value, Max (previous values: 164,7 - 164,6) (Daniele Zaharia's request)";
CM_ SG_ 292 BPCM_HV_Temperature_Avg "Battery Average Temperature22/06/2020 Allegra Giordano - changes: Value, Max (previous values: 164,7 - 164,6) (Daniele Zaharia' request)";
CM_ SG_ 292 BPCM_HV_SOH_Low "State of Health calculated at low SOC.";
CM_ SG_ 292 BPCM_HV_SOH "Status of Healt";
CM_ SG_ 292 BPCM_HV_SOC "State of Charge";
CM_ SG_ 292 BPCM_HV_Outlet_Temp "Outlet Temperature";
CM_ SG_ 292 BPCM_HV_InternalVoltage "Battery internal voltage.";
CM_ SG_ 292 BPCM_HV_Inlet_Temp "Inlet temperature";
CM_ SG_ 292 BPCM_HV_DCFC_Isolation_Sts "Status of DC Circuit isolation failure";
CM_ SG_ 292 BPCM_HV_Current "Battery Current";
CM_ SG_ 292 BPCM_HV_ChargingBusVoltage "Voltage measurement between positive main bus (after contactor) and negative charging branch.";
CM_ SG_ 292 BPCM_HV_Char_Main_Contac_Sts "DC Charging main contactor physical relay status.";
CM_ SG_ 292 BPCM_HV_Capacity "Battery Capacity";
CM_ SG_ 292 BPCM_HV_Battery_GFD_Sts "HV Battery ground fault detection(Isolation).";
CM_ SG_ 292 BPCM_HV_BatIntrlk_InternalStat "HVIL Status internal";
CM_ SG_ 292 BPCM_HV_BalancingMode "Balancing Mode";
CM_ SG_ 485 BPCM_HV_NumCellMinTemp "This signal indicates the Numner of the battery cell with the lowest temperature.";
CM_ SG_ 485 BPCM_HV_NumCellMaxVolt "This signal indicates the ID No. of cell with max. voltage";
CM_ SG_ 485 BPCM_HV_NumCellMaxTemp "This signal indicates the Number of the battery cell with the highest temperature.";
CM_ SG_ 485 BPCM_HV_Insulation_Resistance "This signal indicates the Insulation resistance.";
CM_ SG_ 485 BPCM_Cell_Volt_Min "This signal indicates the Min cell voltage.";
CM_ SG_ 485 BPCM_Cell_Volt_Max "This signal indicates the Max cell voltage.";
CM_ SG_ 485 BPCM_Cell_Volt_Avg "This signal indicates the Cell average voltage.";
CM_ SG_ 485 BPCM_Max_Cell_Volt_Allowed "This signal indicates the Max cell voltage allowed.";
CM_ SG_ 485 BPCM_HV_NumCellMinVolt "This signal indicates the ID No. of cell with min. voltage";
CM_ SG_ 485 BPCM_OCV_Avg_Cell_Volt "This signal indicates the Cell open circuit average voltage .";
CM_ SG_ 485 BPCM_Min_Pk_Volt_Allowed "This signal indicates the Minimum battery peak pack voltage.";
CM_ SG_ 485 BPCM_Min_Cell_Volt_Allowed "This signal indicates the Minimum battery pack voltage.";
CM_ SG_ 485 BPCM_Max_Pk_Volt_Allowed "This signal indicates the Maximum battery pack voltage allowed.";
CM_ SG_ 485 MessageCounter_BATT_HV_VLIMITS "This signal is a counter used for safety checks strategies. This counter is incremented of 1 (one) unit at each frame transmission.";
CM_ SG_ 485 CRC_BATT_HV_VLIMITS "CRC according to SAE J1850 standard at each frame transmission.";
CM_ SG_ 485 BPCM_OCV_Min_Cell_Volt "This signal indicates the Cell open circuit minimum voltage.";
CM_ SG_ 485 BPCM_OCV_Max_Cell_Volt "This signal indicates the Cell open circuit  maximum voltage.";
CM_ SG_ 288 MessageCounter_BATT_HV_POWERLIMS "This signal is a counter used for safety checks strategies. This counter is incremented of 1 (one) unit at each frame transmission.";
CM_ SG_ 288 CRC_BATT_HV_POWERLIMS "CRC according to SAE J1850 standard at each frame transmission.";
CM_ SG_ 288 BPCM_HV_PwrLmtInstDschg "Instantaneous power prediction limit in discharge";
CM_ SG_ 288 BPCM_HV_PwrLmtInstChrg "Instantaneous power prediction limit in charge";
CM_ SG_ 288 BPCM_HV_Pwr_MaxDischrg_ShrTrm "This signal indicates the Maximum discharge power available for the next short term.";
CM_ SG_ 288 BPCM_HV_Power_MaxDischarge_MdTrm "This signal indicates the Maximum discharge power available for the next mid term.";
CM_ SG_ 288 BPCM_HV_Power_MaxDischarge_LgTrm "This signal indicates the Maximum discharge power available for the next long term.";
CM_ SG_ 288 BPCM_HV_Power_MaxCharge_ShrTrm "This signal indicates the Maximum charge power available for the next short term.";
CM_ SG_ 288 BPCM_HV_Power_MaxCharge_MdTrm "This signal indicates the Maximum charge power available for the next mid term.";
CM_ SG_ 288 BPCM_HV_Power_MaxCharge_LgTrm "This signal indicates the Maximum charge power available for the next long term.";
CM_ SG_ 288 BPCM_HV_CrntLmtInstDschg "BPCM_HV_CrntLmtInstDschg";
CM_ SG_ 288 BPCM_HV_CrntLmtInstChrg "BPCM_HV_CrntLmtInstChrg";
CM_ SG_ 288 BPCM_HV_ChargingCurrentProfile "This signal indicates the Charging current profile.";
CM_ SG_ 288 BPCM_HV_Cell_MinDischrg_Imped "This signal indicates the Maximum cell discharge impedance.";
CM_ SG_ 288 BPCM_HV_Cell_MaxDischrg_Imped "This signal indicates the Maximum cell discharge impedance.";
CM_ SG_ 288 BPCM_CntctrsShtTrmOpeningWarn "This signal indicates the Battery warning imminent emergency contactors opening.";
CM_ SG_ 288 BPCM_CntctrsMidTrmOpeningWarn "This signal indicates the Battery warning mid term emergency contactors opening.";
CM_ SG_ 2564485698 N_PDU "This signal is used for diagnostic purposes";
CM_ SG_ 2564440818 N_PDU "This signal is used for diagnostic purposes";
CM_ SG_ 1965 HVBatCellVoltage_Cell232 "High voltage battery cell voltage for Cell 205";
CM_ SG_ 1965 HVBatCellVoltage_Cell231 "High voltage battery cell voltage for Cell 204";
CM_ SG_ 1965 HVBatCellVoltage_Cell230 "High voltage battery cell voltage for Cell 203";
CM_ SG_ 1965 HVBatCellVoltage_Cell229 "High voltage battery cell voltage for Cell 202";
CM_ SG_ 1965 HVBatCellVoltage_Cell228 "High voltage battery cell voltage for Cell 201";
CM_ SG_ 1965 HVBatCellVoltage_Cell227 "High voltage battery cell voltage for Cell 200";
CM_ SG_ 1965 HVBatCellVoltage_Cell226 "High voltage battery cell voltage for Cell 199";
CM_ SG_ 1965 HVBatCellVoltage_Cell225 "High voltage battery cell voltage for Cell 198";
CM_ SG_ 1965 HVBatCellVoltage_Cell224 "High voltage battery cell voltage for Cell 197";
CM_ SG_ 1965 HVBatCellVoltage_Cell223 "High voltage battery cell voltage for Cell 196";
CM_ SG_ 1965 HVBatCellVoltage_Cell222 "High voltage battery cell voltage for Cell 195";
CM_ SG_ 1965 HVBatCellVoltage_Cell221 "High voltage battery cell voltage for Cell 194";
CM_ SG_ 1965 HVBatCellVoltage_Cell220 "High voltage battery cell voltage for Cell 193";
CM_ SG_ 1965 HVBatCellVoltage_Cell219 "High voltage battery cell voltage for Cell 192";
CM_ SG_ 1965 HVBatCellVoltage_Cell218 "High voltage battery cell voltage for Cell 191";
CM_ SG_ 1965 HVBatCellVoltage_Cell217 "High voltage battery cell voltage for Cell 190";
CM_ SG_ 1963 HVBatCellVoltage_Cell395 "High voltage battery cell voltage for Cell 395";
CM_ SG_ 1963 HVBatCellVoltage_Cell394 "High voltage battery cell voltage for Cell 394";
CM_ SG_ 1963 HVBatCellVoltage_Cell393 "High voltage battery cell voltage for Cell 393";
CM_ SG_ 1963 HVBatCellVoltage_Cell400 "High voltage battery cell voltage for Cell 400";
CM_ SG_ 1963 HVBatCellVoltage_Cell399 "High voltage battery cell voltage for Cell 399";
CM_ SG_ 1963 HVBatCellVoltage_Cell398 "High voltage battery cell voltage for Cell 398";
CM_ SG_ 1963 HVBatCellVoltage_Cell397 "High voltage battery cell voltage for Cell 397";
CM_ SG_ 1963 HVBatCellVoltage_Cell396 "High voltage battery cell voltage for Cell 396";
CM_ SG_ 1962 HVBatCellVoltage_Cell376 "High voltage battery cell voltage for Cell 376";
CM_ SG_ 1962 HVBatCellVoltage_Cell375 "High voltage battery cell voltage for Cell 375";
CM_ SG_ 1962 HVBatCellVoltage_Cell374 "High voltage battery cell voltage for Cell 374";
CM_ SG_ 1962 HVBatCellVoltage_Cell373 "High voltage battery cell voltage for Cell 373";
CM_ SG_ 1962 HVBatCellVoltage_Cell372 "High voltage battery cell voltage for Cell 372";
CM_ SG_ 1962 HVBatCellVoltage_Cell371 "High voltage battery cell voltage for Cell 371";
CM_ SG_ 1962 HVBatCellVoltage_Cell370 "High voltage battery cell voltage for Cell 370";
CM_ SG_ 1962 HVBatCellVoltage_Cell369 "High voltage battery cell voltage for Cell 369";
CM_ SG_ 1962 HVBatCellVoltage_Cell368 "High voltage battery cell voltage for Cell 368";
CM_ SG_ 1962 HVBatCellVoltage_Cell367 "High voltage battery cell voltage for Cell 367";
CM_ SG_ 1962 HVBatCellVoltage_Cell366 "High voltage battery cell voltage for Cell 366";
CM_ SG_ 1962 HVBatCellVoltage_Cell365 "High voltage battery cell voltage for Cell 365";
CM_ SG_ 1962 HVBatCellVoltage_Cell364 "High voltage battery cell voltage for Cell 364";
CM_ SG_ 1962 HVBatCellVoltage_Cell363 "High voltage battery cell voltage for Cell 363";
CM_ SG_ 1962 HVBatCellVoltage_Cell362 "High voltage battery cell voltage for Cell 362";
CM_ SG_ 1962 HVBatCellVoltage_Cell361 "High voltage battery cell voltage for Cell 361";
CM_ SG_ 1962 HVBatCellVoltage_Cell392 "High voltage battery cell voltage for Cell 392";
CM_ SG_ 1962 HVBatCellVoltage_Cell391 "High voltage battery cell voltage for Cell 391";
CM_ SG_ 1962 HVBatCellVoltage_Cell390 "High voltage battery cell voltage for Cell 390";
CM_ SG_ 1962 HVBatCellVoltage_Cell389 "High voltage battery cell voltage for Cell 389";
CM_ SG_ 1962 HVBatCellVoltage_Cell388 "High voltage battery cell voltage for Cell 388";
CM_ SG_ 1962 HVBatCellVoltage_Cell387 "High voltage battery cell voltage for Cell 387";
CM_ SG_ 1962 HVBatCellVoltage_Cell386 "High voltage battery cell voltage for Cell 386";
CM_ SG_ 1962 HVBatCellVoltage_Cell385 "High voltage battery cell voltage for Cell 385";
CM_ SG_ 1962 HVBatCellVoltage_Cell384 "High voltage battery cell voltage for Cell 384";
CM_ SG_ 1962 HVBatCellVoltage_Cell383 "High voltage battery cell voltage for Cell 383";
CM_ SG_ 1962 HVBatCellVoltage_Cell382 "High voltage battery cell voltage for Cell 382";
CM_ SG_ 1962 HVBatCellVoltage_Cell381 "High voltage battery cell voltage for Cell 381";
CM_ SG_ 1962 HVBatCellVoltage_Cell380 "High voltage battery cell voltage for Cell 380";
CM_ SG_ 1962 HVBatCellVoltage_Cell379 "High voltage battery cell voltage for Cell 379";
CM_ SG_ 1962 HVBatCellVoltage_Cell378 "High voltage battery cell voltage for Cell 378";
CM_ SG_ 1962 HVBatCellVoltage_Cell377 "High voltage battery cell voltage for Cell 377";
CM_ SG_ 1961 HVBatCellVoltage_Cell360 "High voltage battery cell voltage for Cell 360";
CM_ SG_ 1961 HVBatCellVoltage_Cell359 "High voltage battery cell voltage for Cell 359";
CM_ SG_ 1961 HVBatCellVoltage_Cell358 "High voltage battery cell voltage for Cell 358";
CM_ SG_ 1961 HVBatCellVoltage_Cell357 "High voltage battery cell voltage for Cell 357";
CM_ SG_ 1961 HVBatCellVoltage_Cell356 "High voltage battery cell voltage for Cell 356";
CM_ SG_ 1961 HVBatCellVoltage_Cell355 "High voltage battery cell voltage for Cell 355";
CM_ SG_ 1961 HVBatCellVoltage_Cell354 "High voltage battery cell voltage for Cell 354";
CM_ SG_ 1961 HVBatCellVoltage_Cell353 "High voltage battery cell voltage for Cell 353";
CM_ SG_ 1961 HVBatCellVoltage_Cell352 "High voltage battery cell voltage for Cell 352";
CM_ SG_ 1961 HVBatCellVoltage_Cell351 "High voltage battery cell voltage for Cell 351";
CM_ SG_ 1961 HVBatCellVoltage_Cell350 "High voltage battery cell voltage for Cell 350";
CM_ SG_ 1961 HVBatCellVoltage_Cell349 "High voltage battery cell voltage for Cell 349";
CM_ SG_ 1961 HVBatCellVoltage_Cell348 "High voltage battery cell voltage for Cell 348";
CM_ SG_ 1961 HVBatCellVoltage_Cell347 "High voltage battery cell voltage for Cell 347";
CM_ SG_ 1961 HVBatCellVoltage_Cell346 "High voltage battery cell voltage for Cell 346";
CM_ SG_ 1961 HVBatCellVoltage_Cell345 "High voltage battery cell voltage for Cell 345";
CM_ SG_ 1961 HVBatCellVoltage_Cell344 "High voltage battery cell voltage for Cell 344";
CM_ SG_ 1961 HVBatCellVoltage_Cell343 "High voltage battery cell voltage for Cell 343";
CM_ SG_ 1961 HVBatCellVoltage_Cell342 "High voltage battery cell voltage for Cell 342";
CM_ SG_ 1961 HVBatCellVoltage_Cell341 "High voltage battery cell voltage for Cell 341";
CM_ SG_ 1961 HVBatCellVoltage_Cell340 "High voltage battery cell voltage for Cell 340";
CM_ SG_ 1961 HVBatCellVoltage_Cell339 "High voltage battery cell voltage for Cell 339";
CM_ SG_ 1961 HVBatCellVoltage_Cell338 "High voltage battery cell voltage for Cell 338";
CM_ SG_ 1961 HVBatCellVoltage_Cell337 "High voltage battery cell voltage for Cell 337";
CM_ SG_ 1961 HVBatCellVoltage_Cell336 "High voltage battery cell voltage for Cell 336";
CM_ SG_ 1961 HVBatCellVoltage_Cell335 "High voltage battery cell voltage for Cell 335";
CM_ SG_ 1961 HVBatCellVoltage_Cell334 "High voltage battery cell voltage for Cell 334";
CM_ SG_ 1961 HVBatCellVoltage_Cell333 "High voltage battery cell voltage for Cell 333";
CM_ SG_ 1961 HVBatCellVoltage_Cell332 "High voltage battery cell voltage for Cell 332";
CM_ SG_ 1961 HVBatCellVoltage_Cell331 "High voltage battery cell voltage for Cell 331";
CM_ SG_ 1961 HVBatCellVoltage_Cell330 "High voltage battery cell voltage for Cell 330";
CM_ SG_ 1961 HVBatCellVoltage_Cell329 "High voltage battery cell voltage for Cell 329";
CM_ SG_ 1960 HVBatCellVoltage_Cell328 "High voltage battery cell voltage for Cell 328";
CM_ SG_ 1960 HVBatCellVoltage_Cell327 "High voltage battery cell voltage for Cell 327";
CM_ SG_ 1960 HVBatCellVoltage_Cell326 "High voltage battery cell voltage for Cell 326";
CM_ SG_ 1960 HVBatCellVoltage_Cell325 "High voltage battery cell voltage for Cell 325";
CM_ SG_ 1960 HVBatCellVoltage_Cell324 "High voltage battery cell voltage for Cell 324";
CM_ SG_ 1960 HVBatCellVoltage_Cell323 "High voltage battery cell voltage for Cell 323";
CM_ SG_ 1960 HVBatCellVoltage_Cell322 "High voltage battery cell voltage for Cell 322";
CM_ SG_ 1960 HVBatCellVoltage_Cell321 "High voltage battery cell voltage for Cell 321";
CM_ SG_ 1960 HVBatCellVoltage_Cell320 "High voltage battery cell voltage for Cell 320";
CM_ SG_ 1960 HVBatCellVoltage_Cell319 "High voltage battery cell voltage for Cell 319";
CM_ SG_ 1960 HVBatCellVoltage_Cell318 "High voltage battery cell voltage for Cell 318";
CM_ SG_ 1960 HVBatCellVoltage_Cell317 "High voltage battery cell voltage for Cell 317";
CM_ SG_ 1960 HVBatCellVoltage_Cell316 "High voltage battery cell voltage for Cell 316";
CM_ SG_ 1960 HVBatCellVoltage_Cell315 "High voltage battery cell voltage for Cell 315";
CM_ SG_ 1960 HVBatCellVoltage_Cell314 "High voltage battery cell voltage for Cell 314";
CM_ SG_ 1960 HVBatCellVoltage_Cell313 "High voltage battery cell voltage for Cell 313";
CM_ SG_ 1960 HVBatCellVoltage_Cell312 "High voltage battery cell voltage for Cell 312";
CM_ SG_ 1960 HVBatCellVoltage_Cell311 "High voltage battery cell voltage for Cell 311";
CM_ SG_ 1960 HVBatCellVoltage_Cell310 "High voltage battery cell voltage for Cell 310";
CM_ SG_ 1960 HVBatCellVoltage_Cell309 "High voltage battery cell voltage for Cell 309";
CM_ SG_ 1960 HVBatCellVoltage_Cell308 "High voltage battery cell voltage for Cell 308";
CM_ SG_ 1960 HVBatCellVoltage_Cell307 "High voltage battery cell voltage for Cell 307";
CM_ SG_ 1960 HVBatCellVoltage_Cell306 "High voltage battery cell voltage for Cell 306";
CM_ SG_ 1960 HVBatCellVoltage_Cell305 "High voltage battery cell voltage for Cell 305";
CM_ SG_ 1960 HVBatCellVoltage_Cell304 "High voltage battery cell voltage for Cell 304";
CM_ SG_ 1960 HVBatCellVoltage_Cell303 "High voltage battery cell voltage for Cell 303";
CM_ SG_ 1960 HVBatCellVoltage_Cell302 "High voltage battery cell voltage for Cell 302";
CM_ SG_ 1960 HVBatCellVoltage_Cell301 "High voltage battery cell voltage for Cell 301";
CM_ SG_ 1960 HVBatCellVoltage_Cell300 "High voltage battery cell voltage for Cell 300";
CM_ SG_ 1960 HVBatCellVoltage_Cell299 "High voltage battery cell voltage for Cell 299";
CM_ SG_ 1960 HVBatCellVoltage_Cell298 "High voltage battery cell voltage for Cell 298";
CM_ SG_ 1960 HVBatCellVoltage_Cell297 "High voltage battery cell voltage for Cell 297";
BA_DEF_ BO_ "CANFD_BRS" ENUM "0","1";
BA_DEF_ BO_ "VFrameFormat" ENUM "StandardCAN","ExtendedCAN","reserved","reserved","reserved","reserved","reserved","reserved","reserved","reserved","reserved","reserved","reserved","reserved","StandardCAN_FD","ExtendedCAN_FD";
BA_DEF_ BO_ "CanTpFcFrameId" HEX 0 2147483647;
BA_DEF_ BO_ "DiagConnection" HEX 0 65535;
BA_DEF_ BO_ "DiagState" ENUM "No","Yes";
BA_DEF_ BO_ "NmAsrMessage" ENUM "No","Yes";
BA_DEF_ BO_ "GenMsgDelayTime" INT 0 65535;
BA_DEF_ BO_ "GenMsgCycleTime" INT 0 65535;
BA_DEF_ BO_ "GenMsgCycleTimeFast" INT 0 65535;
BA_DEF_ BO_ "GenMsgStartDelayTime" INT 0 65535;
BA_DEF_ BO_ "GenMsgILSupport" ENUM "No","Yes";
BA_DEF_ BO_ "GenMsgNrOfRepetition" INT 0 255;
BA_DEF_ BO_ "GenMsgSendType" ENUM "Cyclic","NotUsed","NotUsed","NotUsed","NotUsed","NotUsed","NotUsed","NotUsed","NoMsgSendType";
BA_DEF_ BO_ "NmMessage" ENUM "No","Yes";
BA_DEF_ BO_ "DiagResponse" ENUM "No","Yes";
BA_DEF_ BO_ "Type" ENUM "P","C","PE","COC","PE_Cntrl","E","E_Cntrl","OC","S","BAF","DC","EM","MM","ISO-TP","-";
BA_DEF_ BO_ "DiagRequest" ENUM "No","Yes";
BA_DEF_ SG_ "GenSigTimeoutTime_SGW" INT 0 65535;
BA_DEF_ SG_ "GenSigTimeoutTime_PBWM" INT 0 65535;
BA_DEF_ SG_ "GenSigTimeoutTime_IDCM" INT 0 65535;
BA_DEF_ SG_ "GenSigTimeoutTime_EVCU2" INT 0 65535;
BA_DEF_ SG_ "GenSigTimeoutTime_ECM" INT 0 65535;
BA_DEF_ SG_ "GenSigTimeoutTime_DMPI" INT 0 65535;
BA_DEF_ SG_ "GenSigTimeoutTime_BPCM" INT 0 65535;
BA_DEF_ SG_ "GenSigTimeoutTime_AGSM" INT 0 65535;
BA_DEF_ SG_ "SystemSignalLongSymbol" STRING ;
BA_DEF_ SG_ "GenSigSendType" ENUM "NotUsed","OnWrite","OnWriteWithRepetition","OnChange","OnChangeWithRepetition","IfActive","IfActiveWithRepetition","NoSigSendType";
BA_DEF_ SG_ "GenSigInactiveValue" INT 0 2147483647;
BA_DEF_ SG_ "GenSigStartValue" INT 0 2147483647;
BA_DEF_DEF_ "CANFD_BRS" "0";
BA_DEF_DEF_ "VFrameFormat" "StandardCAN_FD";
BA_DEF_DEF_ "CanTpFcFrameId" 2147483647;
BA_DEF_DEF_ "DiagConnection" 0;
BA_DEF_DEF_ "DiagState" "No";
BA_DEF_DEF_ "NmAsrMessage" "No";
BA_DEF_DEF_ "GenMsgDelayTime" 0;
BA_DEF_DEF_ "GenMsgCycleTime" 0;
BA_DEF_DEF_ "GenMsgCycleTimeFast" 0;
BA_DEF_DEF_ "GenMsgStartDelayTime" 0;
BA_DEF_DEF_ "GenMsgILSupport" "No";
BA_DEF_DEF_ "GenMsgNrOfRepetition" 0;
BA_DEF_DEF_ "GenMsgSendType" "NoMsgSendType";
BA_DEF_DEF_ "NmMessage" "No";
BA_DEF_DEF_ "DiagResponse" "No";
BA_DEF_DEF_ "Type" "-";
BA_DEF_DEF_ "DiagRequest" "No";
BA_DEF_DEF_ "GenSigTimeoutTime_SGW" 2500;
BA_DEF_DEF_ "GenSigTimeoutTime_PBWM" 2500;
BA_DEF_DEF_ "GenSigTimeoutTime_IDCM" 2500;
BA_DEF_DEF_ "GenSigTimeoutTime_EVCU2" 2500;
BA_DEF_DEF_ "GenSigTimeoutTime_ECM" 2500;
BA_DEF_DEF_ "GenSigTimeoutTime_DMPI" 2500;
BA_DEF_DEF_ "GenSigTimeoutTime_BPCM" 2500;
BA_DEF_DEF_ "GenSigTimeoutTime_AGSM" 2500;
BA_DEF_DEF_ "SystemSignalLongSymbol" "";
BA_DEF_DEF_ "GenSigSendType" "NoSigSendType";
BA_DEF_DEF_ "GenSigInactiveValue" 0;
BA_DEF_DEF_ "GenSigStartValue" 0;
BA_ "CANFD_BRS" BO_ 1031 1;
BA_ "GenMsgCycleTime" BO_ 1031 100;
BA_ "GenMsgILSupport" BO_ 1031 1;
BA_ "GenMsgSendType" BO_ 1031 0;
BA_ "Type" BO_ 1031 1;
BA_ "CANFD_BRS" BO_ 2564486468 1;
BA_ "VFrameFormat" BO_ 2564486468 15;
BA_ "DiagConnection" BO_ 2564486468 62788;
BA_ "DiagResponse" BO_ 2564486468 1;
BA_ "Type" BO_ 2564486468 8;
BA_ "CANFD_BRS" BO_ 1063 1;
BA_ "GenMsgCycleTime" BO_ 1063 100;
BA_ "GenMsgILSupport" BO_ 1063 1;
BA_ "GenMsgSendType" BO_ 1063 0;
BA_ "Type" BO_ 1063 1;
BA_ "CANFD_BRS" BO_ 2564486421 1;
BA_ "VFrameFormat" BO_ 2564486421 15;
BA_ "DiagConnection" BO_ 2564486421 62741;
BA_ "DiagResponse" BO_ 2564486421 1;
BA_ "Type" BO_ 2564486421 8;
BA_ "CANFD_BRS" BO_ 2564486420 1;
BA_ "VFrameFormat" BO_ 2564486420 15;
BA_ "DiagConnection" BO_ 2564486420 62740;
BA_ "DiagResponse" BO_ 2564486420 1;
BA_ "Type" BO_ 2564486420 8;
BA_ "CANFD_BRS" BO_ 2564429301 1;
BA_ "VFrameFormat" BO_ 2564429301 15;
BA_ "DiagConnection" BO_ 2564429301 62741;
BA_ "Type" BO_ 2564429301 8;
BA_ "DiagRequest" BO_ 2564429301 1;
BA_ "CANFD_BRS" BO_ 2564429045 1;
BA_ "VFrameFormat" BO_ 2564429045 15;
BA_ "DiagConnection" BO_ 2564429045 62740;
BA_ "Type" BO_ 2564429045 8;
BA_ "DiagRequest" BO_ 2564429045 1;
BA_ "CANFD_BRS" BO_ 2564441333 1;
BA_ "VFrameFormat" BO_ 2564441333 15;
BA_ "DiagConnection" BO_ 2564441333 62788;
BA_ "Type" BO_ 2564441333 8;
BA_ "DiagRequest" BO_ 2564441333 1;
BA_ "CANFD_BRS" BO_ 2564554485 1;
BA_ "VFrameFormat" BO_ 2564554485 15;
BA_ "DiagConnection" BO_ 2564554485 62974;
BA_ "DiagState" BO_ 2564554485 1;
BA_ "Type" BO_ 2564554485 8;
BA_ "CANFD_BRS" BO_ 292 1;
BA_ "GenMsgCycleTime" BO_ 292 10;
BA_ "GenMsgILSupport" BO_ 292 1;
BA_ "GenMsgSendType" BO_ 292 0;
BA_ "Type" BO_ 292 1;
BA_ "CANFD_BRS" BO_ 485 1;
BA_ "GenMsgCycleTime" BO_ 485 20;
BA_ "GenMsgILSupport" BO_ 485 1;
BA_ "GenMsgSendType" BO_ 485 0;
BA_ "Type" BO_ 485 1;
BA_ "CANFD_BRS" BO_ 288 1;
BA_ "GenMsgCycleTime" BO_ 288 10;
BA_ "GenMsgILSupport" BO_ 288 1;
BA_ "GenMsgSendType" BO_ 288 0;
BA_ "Type" BO_ 288 1;
BA_ "CANFD_BRS" BO_ 2564485698 1;
BA_ "VFrameFormat" BO_ 2564485698 15;
BA_ "DiagConnection" BO_ 2564485698 62018;
BA_ "DiagResponse" BO_ 2564485698 1;
BA_ "Type" BO_ 2564485698 8;
BA_ "CANFD_BRS" BO_ 2564440818 1;
BA_ "VFrameFormat" BO_ 2564440818 15;
BA_ "DiagConnection" BO_ 2564440818 62018;
BA_ "Type" BO_ 2564440818 8;
BA_ "DiagRequest" BO_ 2564440818 1;
BA_ "CANFD_BRS" BO_ 1965 1;
BA_ "GenMsgCycleTime" BO_ 1965 1000;
BA_ "GenMsgILSupport" BO_ 1965 1;
BA_ "GenMsgSendType" BO_ 1965 0;
BA_ "Type" BO_ 1965 1;
BA_ "CANFD_BRS" BO_ 1963 1;
BA_ "GenMsgCycleTime" BO_ 1963 1000;
BA_ "GenMsgILSupport" BO_ 1963 1;
BA_ "GenMsgSendType" BO_ 1963 0;
BA_ "Type" BO_ 1963 1;
BA_ "CANFD_BRS" BO_ 1962 1;
BA_ "GenMsgCycleTime" BO_ 1962 1000;
BA_ "GenMsgILSupport" BO_ 1962 1;
BA_ "GenMsgSendType" BO_ 1962 0;
BA_ "Type" BO_ 1962 1;
BA_ "CANFD_BRS" BO_ 1961 1;
BA_ "GenMsgCycleTime" BO_ 1961 1000;
BA_ "GenMsgILSupport" BO_ 1961 1;
BA_ "GenMsgSendType" BO_ 1961 0;
BA_ "Type" BO_ 1961 1;
BA_ "CANFD_BRS" BO_ 1960 1;
BA_ "GenMsgCycleTime" BO_ 1960 1000;
BA_ "GenMsgILSupport" BO_ 1960 1;
BA_ "GenMsgSendType" BO_ 1960 0;
BA_ "Type" BO_ 1960 1;
BA_ "GenSigTimeoutTime_PBWM" SG_ 1962 HVBatCellVoltage_Cell381 0;
BA_ "GenSigTimeoutTime_IDCM" SG_ 1962 HVBatCellVoltage_Cell381 0;
BA_ "GenSigTimeoutTime_EVCU2" SG_ 1962 HVBatCellVoltage_Cell381 0;
BA_ "GenSigTimeoutTime_ECM" SG_ 1962 HVBatCellVoltage_Cell381 0;
BA_ "GenSigTimeoutTime_DMPI" SG_ 1962 HVBatCellVoltage_Cell381 0;
BA_ "GenSigTimeoutTime_BPCM" SG_ 1962 HVBatCellVoltage_Cell381 0;
BA_ "GenSigTimeoutTime_AGSM" SG_ 1962 HVBatCellVoltage_Cell381 0;
BA_ "GenSigTimeoutTime_PBWM" SG_ 1962 HVBatCellVoltage_Cell382 0;
BA_ "GenSigTimeoutTime_IDCM" SG_ 1962 HVBatCellVoltage_Cell382 0;
BA_ "GenSigTimeoutTime_EVCU2" SG_ 1962 HVBatCellVoltage_Cell382 0;
BA_ "GenSigTimeoutTime_ECM" SG_ 1962 HVBatCellVoltage_Cell382 0;
BA_ "GenSigTimeoutTime_DMPI" SG_ 1962 HVBatCellVoltage_Cell382 0;
BA_ "GenSigTimeoutTime_BPCM" SG_ 1962 HVBatCellVoltage_Cell382 0;
BA_ "GenSigTimeoutTime_AGSM" SG_ 1962 HVBatCellVoltage_Cell382 0;
BA_ "GenSigTimeoutTime_PBWM" SG_ 1962 HVBatCellVoltage_Cell363 0;
BA_ "GenSigTimeoutTime_IDCM" SG_ 1962 HVBatCellVoltage_Cell363 0;
BA_ "GenSigTimeoutTime_EVCU2" SG_ 1962 HVBatCellVoltage_Cell363 0;
BA_ "GenSigTimeoutTime_ECM" SG_ 1962 HVBatCellVoltage_Cell363 0;
BA_ "GenSigTimeoutTime_DMPI" SG_ 1962 HVBatCellVoltage_Cell363 0;
BA_ "GenSigTimeoutTime_BPCM" SG_ 1962 HVBatCellVoltage_Cell363 0;
BA_ "GenSigTimeoutTime_AGSM" SG_ 1962 HVBatCellVoltage_Cell363 0;
BA_ "GenSigTimeoutTime_PBWM" SG_ 1962 HVBatCellVoltage_Cell364 0;
BA_ "GenSigTimeoutTime_IDCM" SG_ 1962 HVBatCellVoltage_Cell364 0;
BA_ "GenSigTimeoutTime_EVCU2" SG_ 1962 HVBatCellVoltage_Cell364 0;
BA_ "GenSigTimeoutTime_ECM" SG_ 1962 HVBatCellVoltage_Cell364 0;
BA_ "GenSigTimeoutTime_DMPI" SG_ 1962 HVBatCellVoltage_Cell364 0;
BA_ "GenSigTimeoutTime_BPCM" SG_ 1962 HVBatCellVoltage_Cell364 0;
BA_ "GenSigTimeoutTime_AGSM" SG_ 1962 HVBatCellVoltage_Cell364 0;
BA_ "GenSigTimeoutTime_PBWM" SG_ 1962 HVBatCellVoltage_Cell365 0;
BA_ "GenSigTimeoutTime_IDCM" SG_ 1962 HVBatCellVoltage_Cell365 0;
BA_ "GenSigTimeoutTime_EVCU2" SG_ 1962 HVBatCellVoltage_Cell365 0;
BA_ "GenSigTimeoutTime_ECM" SG_ 1962 HVBatCellVoltage_Cell365 0;
BA_ "GenSigTimeoutTime_DMPI" SG_ 1962 HVBatCellVoltage_Cell365 0;
BA_ "GenSigTimeoutTime_BPCM" SG_ 1962 HVBatCellVoltage_Cell365 0;
BA_ "GenSigTimeoutTime_AGSM" SG_ 1962 HVBatCellVoltage_Cell365 0;
BA_ "GenSigTimeoutTime_PBWM" SG_ 1962 HVBatCellVoltage_Cell366 0;
BA_ "GenSigTimeoutTime_IDCM" SG_ 1962 HVBatCellVoltage_Cell366 0;
BA_ "GenSigTimeoutTime_EVCU2" SG_ 1962 HVBatCellVoltage_Cell366 0;
BA_ "GenSigTimeoutTime_ECM" SG_ 1962 HVBatCellVoltage_Cell366 0;
BA_ "GenSigTimeoutTime_DMPI" SG_ 1962 HVBatCellVoltage_Cell366 0;
BA_ "GenSigTimeoutTime_BPCM" SG_ 1962 HVBatCellVoltage_Cell366 0;
BA_ "GenSigTimeoutTime_AGSM" SG_ 1962 HVBatCellVoltage_Cell366 0;
BA_ "GenSigTimeoutTime_PBWM" SG_ 1962 HVBatCellVoltage_Cell367 0;
BA_ "GenSigTimeoutTime_IDCM" SG_ 1962 HVBatCellVoltage_Cell367 0;
BA_ "GenSigTimeoutTime_EVCU2" SG_ 1962 HVBatCellVoltage_Cell367 0;
BA_ "GenSigTimeoutTime_ECM" SG_ 1962 HVBatCellVoltage_Cell367 0;
BA_ "GenSigTimeoutTime_DMPI" SG_ 1962 HVBatCellVoltage_Cell367 0;
BA_ "GenSigTimeoutTime_BPCM" SG_ 1962 HVBatCellVoltage_Cell367 0;
BA_ "GenSigTimeoutTime_AGSM" SG_ 1962 HVBatCellVoltage_Cell367 0;
BA_ "GenSigTimeoutTime_PBWM" SG_ 1962 HVBatCellVoltage_Cell368 0;
BA_ "GenSigTimeoutTime_IDCM" SG_ 1962 HVBatCellVoltage_Cell368 0;
BA_ "GenSigTimeoutTime_EVCU2" SG_ 1962 HVBatCellVoltage_Cell368 0;
BA_ "GenSigTimeoutTime_ECM" SG_ 1962 HVBatCellVoltage_Cell368 0;
BA_ "GenSigTimeoutTime_DMPI" SG_ 1962 HVBatCellVoltage_Cell368 0;
BA_ "GenSigTimeoutTime_BPCM" SG_ 1962 HVBatCellVoltage_Cell368 0;
BA_ "GenSigTimeoutTime_AGSM" SG_ 1962 HVBatCellVoltage_Cell368 0;
BA_ "GenSigTimeoutTime_PBWM" SG_ 1962 HVBatCellVoltage_Cell369 0;
BA_ "GenSigTimeoutTime_IDCM" SG_ 1962 HVBatCellVoltage_Cell369 0;
BA_ "GenSigTimeoutTime_EVCU2" SG_ 1962 HVBatCellVoltage_Cell369 0;
BA_ "GenSigTimeoutTime_ECM" SG_ 1962 HVBatCellVoltage_Cell369 0;
BA_ "GenSigTimeoutTime_DMPI" SG_ 1962 HVBatCellVoltage_Cell369 0;
BA_ "GenSigTimeoutTime_BPCM" SG_ 1962 HVBatCellVoltage_Cell369 0;
BA_ "GenSigTimeoutTime_AGSM" SG_ 1962 HVBatCellVoltage_Cell369 0;
BA_ "GenSigTimeoutTime_PBWM" SG_ 1962 HVBatCellVoltage_Cell370 0;
BA_ "GenSigTimeoutTime_IDCM" SG_ 1962 HVBatCellVoltage_Cell370 0;
BA_ "GenSigTimeoutTime_EVCU2" SG_ 1962 HVBatCellVoltage_Cell370 0;
BA_ "GenSigTimeoutTime_ECM" SG_ 1962 HVBatCellVoltage_Cell370 0;
BA_ "GenSigTimeoutTime_DMPI" SG_ 1962 HVBatCellVoltage_Cell370 0;
BA_ "GenSigTimeoutTime_BPCM" SG_ 1962 HVBatCellVoltage_Cell370 0;
BA_ "GenSigTimeoutTime_AGSM" SG_ 1962 HVBatCellVoltage_Cell370 0;
BA_ "GenSigTimeoutTime_PBWM" SG_ 1962 HVBatCellVoltage_Cell371 0;
BA_ "GenSigTimeoutTime_IDCM" SG_ 1962 HVBatCellVoltage_Cell371 0;
BA_ "GenSigTimeoutTime_EVCU2" SG_ 1962 HVBatCellVoltage_Cell371 0;
BA_ "GenSigTimeoutTime_ECM" SG_ 1962 HVBatCellVoltage_Cell371 0;
BA_ "GenSigTimeoutTime_DMPI" SG_ 1962 HVBatCellVoltage_Cell371 0;
BA_ "GenSigTimeoutTime_BPCM" SG_ 1962 HVBatCellVoltage_Cell371 0;
BA_ "GenSigTimeoutTime_AGSM" SG_ 1962 HVBatCellVoltage_Cell371 0;
BA_ "GenSigTimeoutTime_PBWM" SG_ 1962 HVBatCellVoltage_Cell372 0;
BA_ "GenSigTimeoutTime_IDCM" SG_ 1962 HVBatCellVoltage_Cell372 0;
BA_ "GenSigTimeoutTime_EVCU2" SG_ 1962 HVBatCellVoltage_Cell372 0;
BA_ "GenSigTimeoutTime_ECM" SG_ 1962 HVBatCellVoltage_Cell372 0;
BA_ "GenSigTimeoutTime_DMPI" SG_ 1962 HVBatCellVoltage_Cell372 0;
BA_ "GenSigTimeoutTime_BPCM" SG_ 1962 HVBatCellVoltage_Cell372 0;
BA_ "GenSigTimeoutTime_AGSM" SG_ 1962 HVBatCellVoltage_Cell372 0;
BA_ "GenSigTimeoutTime_PBWM" SG_ 1962 HVBatCellVoltage_Cell373 0;
BA_ "GenSigTimeoutTime_IDCM" SG_ 1962 HVBatCellVoltage_Cell373 0;
BA_ "GenSigTimeoutTime_EVCU2" SG_ 1962 HVBatCellVoltage_Cell373 0;
BA_ "GenSigTimeoutTime_ECM" SG_ 1962 HVBatCellVoltage_Cell373 0;
BA_ "GenSigTimeoutTime_DMPI" SG_ 1962 HVBatCellVoltage_Cell373 0;
BA_ "GenSigTimeoutTime_BPCM" SG_ 1962 HVBatCellVoltage_Cell373 0;
BA_ "GenSigTimeoutTime_AGSM" SG_ 1962 HVBatCellVoltage_Cell373 0;
BA_ "GenSigTimeoutTime_PBWM" SG_ 1962 HVBatCellVoltage_Cell374 0;
BA_ "GenSigTimeoutTime_IDCM" SG_ 1962 HVBatCellVoltage_Cell374 0;
BA_ "GenSigTimeoutTime_EVCU2" SG_ 1962 HVBatCellVoltage_Cell374 0;
BA_ "GenSigTimeoutTime_ECM" SG_ 1962 HVBatCellVoltage_Cell374 0;
BA_ "GenSigTimeoutTime_DMPI" SG_ 1962 HVBatCellVoltage_Cell374 0;
BA_ "GenSigTimeoutTime_BPCM" SG_ 1962 HVBatCellVoltage_Cell374 0;
BA_ "GenSigTimeoutTime_AGSM" SG_ 1962 HVBatCellVoltage_Cell374 0;
BA_ "GenSigTimeoutTime_PBWM" SG_ 1962 HVBatCellVoltage_Cell375 0;
BA_ "GenSigTimeoutTime_IDCM" SG_ 1962 HVBatCellVoltage_Cell375 0;
BA_ "GenSigTimeoutTime_EVCU2" SG_ 1962 HVBatCellVoltage_Cell375 0;
BA_ "GenSigTimeoutTime_ECM" SG_ 1962 HVBatCellVoltage_Cell375 0;
BA_ "GenSigTimeoutTime_DMPI" SG_ 1962 HVBatCellVoltage_Cell375 0;
BA_ "GenSigTimeoutTime_BPCM" SG_ 1962 HVBatCellVoltage_Cell375 0;
BA_ "GenSigTimeoutTime_AGSM" SG_ 1962 HVBatCellVoltage_Cell375 0;
BA_ "GenSigTimeoutTime_PBWM" SG_ 1962 HVBatCellVoltage_Cell376 0;
BA_ "GenSigTimeoutTime_IDCM" SG_ 1962 HVBatCellVoltage_Cell376 0;
BA_ "GenSigTimeoutTime_EVCU2" SG_ 1962 HVBatCellVoltage_Cell376 0;
BA_ "GenSigTimeoutTime_ECM" SG_ 1962 HVBatCellVoltage_Cell376 0;
BA_ "GenSigTimeoutTime_DMPI" SG_ 1962 HVBatCellVoltage_Cell376 0;
BA_ "GenSigTimeoutTime_BPCM" SG_ 1962 HVBatCellVoltage_Cell376 0;
BA_ "GenSigTimeoutTime_AGSM" SG_ 1962 HVBatCellVoltage_Cell376 0;
BA_ "GenSigTimeoutTime_PBWM" SG_ 1962 HVBatCellVoltage_Cell377 0;
BA_ "GenSigTimeoutTime_IDCM" SG_ 1962 HVBatCellVoltage_Cell377 0;
BA_ "GenSigTimeoutTime_EVCU2" SG_ 1962 HVBatCellVoltage_Cell377 0;
BA_ "GenSigTimeoutTime_ECM" SG_ 1962 HVBatCellVoltage_Cell377 0;
BA_ "GenSigTimeoutTime_DMPI" SG_ 1962 HVBatCellVoltage_Cell377 0;
BA_ "GenSigTimeoutTime_BPCM" SG_ 1962 HVBatCellVoltage_Cell377 0;
BA_ "GenSigTimeoutTime_AGSM" SG_ 1962 HVBatCellVoltage_Cell377 0;
BA_ "GenSigTimeoutTime_PBWM" SG_ 1962 HVBatCellVoltage_Cell378 0;
BA_ "GenSigTimeoutTime_IDCM" SG_ 1962 HVBatCellVoltage_Cell378 0;
BA_ "GenSigTimeoutTime_EVCU2" SG_ 1962 HVBatCellVoltage_Cell378 0;
BA_ "GenSigTimeoutTime_ECM" SG_ 1962 HVBatCellVoltage_Cell378 0;
BA_ "GenSigTimeoutTime_DMPI" SG_ 1962 HVBatCellVoltage_Cell378 0;
BA_ "GenSigTimeoutTime_BPCM" SG_ 1962 HVBatCellVoltage_Cell378 0;
BA_ "GenSigTimeoutTime_AGSM" SG_ 1962 HVBatCellVoltage_Cell378 0;
BA_ "GenSigTimeoutTime_PBWM" SG_ 1961 HVBatCellVoltage_Cell355 0;
BA_ "GenSigTimeoutTime_IDCM" SG_ 1961 HVBatCellVoltage_Cell355 0;
BA_ "GenSigTimeoutTime_EVCU2" SG_ 1961 HVBatCellVoltage_Cell355 0;
BA_ "GenSigTimeoutTime_ECM" SG_ 1961 HVBatCellVoltage_Cell355 0;
BA_ "GenSigTimeoutTime_DMPI" SG_ 1961 HVBatCellVoltage_Cell355 0;
BA_ "GenSigTimeoutTime_BPCM" SG_ 1961 HVBatCellVoltage_Cell355 0;
BA_ "GenSigTimeoutTime_AGSM" SG_ 1961 HVBatCellVoltage_Cell355 0;
BA_ "GenSigTimeoutTime_PBWM" SG_ 1961 HVBatCellVoltage_Cell356 0;
BA_ "GenSigTimeoutTime_IDCM" SG_ 1961 HVBatCellVoltage_Cell356 0;
BA_ "GenSigTimeoutTime_EVCU2" SG_ 1961 HVBatCellVoltage_Cell356 0;
BA_ "GenSigTimeoutTime_ECM" SG_ 1961 HVBatCellVoltage_Cell356 0;
BA_ "GenSigTimeoutTime_DMPI" SG_ 1961 HVBatCellVoltage_Cell356 0;
BA_ "GenSigTimeoutTime_BPCM" SG_ 1961 HVBatCellVoltage_Cell356 0;
BA_ "GenSigTimeoutTime_AGSM" SG_ 1961 HVBatCellVoltage_Cell356 0;
BA_ "GenSigTimeoutTime_PBWM" SG_ 1961 HVBatCellVoltage_Cell357 0;
BA_ "GenSigTimeoutTime_IDCM" SG_ 1961 HVBatCellVoltage_Cell357 0;
BA_ "GenSigTimeoutTime_EVCU2" SG_ 1961 HVBatCellVoltage_Cell357 0;
BA_ "GenSigTimeoutTime_ECM" SG_ 1961 HVBatCellVoltage_Cell357 0;
BA_ "GenSigTimeoutTime_DMPI" SG_ 1961 HVBatCellVoltage_Cell357 0;
BA_ "GenSigTimeoutTime_BPCM" SG_ 1961 HVBatCellVoltage_Cell357 0;
BA_ "GenSigTimeoutTime_AGSM" SG_ 1961 HVBatCellVoltage_Cell357 0;
BA_ "GenSigTimeoutTime_PBWM" SG_ 1961 HVBatCellVoltage_Cell358 0;
BA_ "GenSigTimeoutTime_IDCM" SG_ 1961 HVBatCellVoltage_Cell358 0;
BA_ "GenSigTimeoutTime_EVCU2" SG_ 1961 HVBatCellVoltage_Cell358 0;
BA_ "GenSigTimeoutTime_ECM" SG_ 1961 HVBatCellVoltage_Cell358 0;
BA_ "GenSigTimeoutTime_DMPI" SG_ 1961 HVBatCellVoltage_Cell358 0;
BA_ "GenSigTimeoutTime_BPCM" SG_ 1961 HVBatCellVoltage_Cell358 0;
BA_ "GenSigTimeoutTime_AGSM" SG_ 1961 HVBatCellVoltage_Cell358 0;
BA_ "GenSigTimeoutTime_PBWM" SG_ 1961 HVBatCellVoltage_Cell359 0;
BA_ "GenSigTimeoutTime_IDCM" SG_ 1961 HVBatCellVoltage_Cell359 0;
BA_ "GenSigTimeoutTime_EVCU2" SG_ 1961 HVBatCellVoltage_Cell359 0;
BA_ "GenSigTimeoutTime_ECM" SG_ 1961 HVBatCellVoltage_Cell359 0;
BA_ "GenSigTimeoutTime_DMPI" SG_ 1961 HVBatCellVoltage_Cell359 0;
BA_ "GenSigTimeoutTime_BPCM" SG_ 1961 HVBatCellVoltage_Cell359 0;
BA_ "GenSigTimeoutTime_AGSM" SG_ 1961 HVBatCellVoltage_Cell359 0;
BA_ "GenSigTimeoutTime_PBWM" SG_ 1961 HVBatCellVoltage_Cell360 0;
BA_ "GenSigTimeoutTime_IDCM" SG_ 1961 HVBatCellVoltage_Cell360 0;
BA_ "GenSigTimeoutTime_EVCU2" SG_ 1961 HVBatCellVoltage_Cell360 0;
BA_ "GenSigTimeoutTime_ECM" SG_ 1961 HVBatCellVoltage_Cell360 0;
BA_ "GenSigTimeoutTime_DMPI" SG_ 1961 HVBatCellVoltage_Cell360 0;
BA_ "GenSigTimeoutTime_BPCM" SG_ 1961 HVBatCellVoltage_Cell360 0;
BA_ "GenSigTimeoutTime_AGSM" SG_ 1961 HVBatCellVoltage_Cell360 0;
BA_ "GenSigTimeoutTime_PBWM" SG_ 1962 HVBatCellVoltage_Cell361 0;
BA_ "GenSigTimeoutTime_IDCM" SG_ 1962 HVBatCellVoltage_Cell361 0;
BA_ "GenSigTimeoutTime_EVCU2" SG_ 1962 HVBatCellVoltage_Cell361 0;
BA_ "GenSigTimeoutTime_ECM" SG_ 1962 HVBatCellVoltage_Cell361 0;
BA_ "GenSigTimeoutTime_DMPI" SG_ 1962 HVBatCellVoltage_Cell361 0;
BA_ "GenSigTimeoutTime_BPCM" SG_ 1962 HVBatCellVoltage_Cell361 0;
BA_ "GenSigTimeoutTime_AGSM" SG_ 1962 HVBatCellVoltage_Cell361 0;
BA_ "GenSigTimeoutTime_PBWM" SG_ 1962 HVBatCellVoltage_Cell362 0;
BA_ "GenSigTimeoutTime_IDCM" SG_ 1962 HVBatCellVoltage_Cell362 0;
BA_ "GenSigTimeoutTime_EVCU2" SG_ 1962 HVBatCellVoltage_Cell362 0;
BA_ "GenSigTimeoutTime_ECM" SG_ 1962 HVBatCellVoltage_Cell362 0;
BA_ "GenSigTimeoutTime_DMPI" SG_ 1962 HVBatCellVoltage_Cell362 0;
BA_ "GenSigTimeoutTime_BPCM" SG_ 1962 HVBatCellVoltage_Cell362 0;
BA_ "GenSigTimeoutTime_AGSM" SG_ 1962 HVBatCellVoltage_Cell362 0;
BA_ "GenSigTimeoutTime_PBWM" SG_ 1961 HVBatCellVoltage_Cell347 0;
BA_ "GenSigTimeoutTime_IDCM" SG_ 1961 HVBatCellVoltage_Cell347 0;
BA_ "GenSigTimeoutTime_EVCU2" SG_ 1961 HVBatCellVoltage_Cell347 0;
BA_ "GenSigTimeoutTime_ECM" SG_ 1961 HVBatCellVoltage_Cell347 0;
BA_ "GenSigTimeoutTime_DMPI" SG_ 1961 HVBatCellVoltage_Cell347 0;
BA_ "GenSigTimeoutTime_BPCM" SG_ 1961 HVBatCellVoltage_Cell347 0;
BA_ "GenSigTimeoutTime_AGSM" SG_ 1961 HVBatCellVoltage_Cell347 0;
BA_ "GenSigTimeoutTime_PBWM" SG_ 1961 HVBatCellVoltage_Cell348 0;
BA_ "GenSigTimeoutTime_IDCM" SG_ 1961 HVBatCellVoltage_Cell348 0;
BA_ "GenSigTimeoutTime_EVCU2" SG_ 1961 HVBatCellVoltage_Cell348 0;
BA_ "GenSigTimeoutTime_ECM" SG_ 1961 HVBatCellVoltage_Cell348 0;
BA_ "GenSigTimeoutTime_DMPI" SG_ 1961 HVBatCellVoltage_Cell348 0;
BA_ "GenSigTimeoutTime_BPCM" SG_ 1961 HVBatCellVoltage_Cell348 0;
BA_ "GenSigTimeoutTime_AGSM" SG_ 1961 HVBatCellVoltage_Cell348 0;
BA_ "GenSigTimeoutTime_PBWM" SG_ 1961 HVBatCellVoltage_Cell349 0;
BA_ "GenSigTimeoutTime_IDCM" SG_ 1961 HVBatCellVoltage_Cell349 0;
BA_ "GenSigTimeoutTime_EVCU2" SG_ 1961 HVBatCellVoltage_Cell349 0;
BA_ "GenSigTimeoutTime_ECM" SG_ 1961 HVBatCellVoltage_Cell349 0;
BA_ "GenSigTimeoutTime_DMPI" SG_ 1961 HVBatCellVoltage_Cell349 0;
BA_ "GenSigTimeoutTime_BPCM" SG_ 1961 HVBatCellVoltage_Cell349 0;
BA_ "GenSigTimeoutTime_AGSM" SG_ 1961 HVBatCellVoltage_Cell349 0;
BA_ "GenSigTimeoutTime_PBWM" SG_ 1961 HVBatCellVoltage_Cell350 0;
BA_ "GenSigTimeoutTime_IDCM" SG_ 1961 HVBatCellVoltage_Cell350 0;
BA_ "GenSigTimeoutTime_EVCU2" SG_ 1961 HVBatCellVoltage_Cell350 0;
BA_ "GenSigTimeoutTime_ECM" SG_ 1961 HVBatCellVoltage_Cell350 0;
BA_ "GenSigTimeoutTime_DMPI" SG_ 1961 HVBatCellVoltage_Cell350 0;
BA_ "GenSigTimeoutTime_BPCM" SG_ 1961 HVBatCellVoltage_Cell350 0;
BA_ "GenSigTimeoutTime_AGSM" SG_ 1961 HVBatCellVoltage_Cell350 0;
BA_ "GenSigTimeoutTime_PBWM" SG_ 1961 HVBatCellVoltage_Cell351 0;
BA_ "GenSigTimeoutTime_IDCM" SG_ 1961 HVBatCellVoltage_Cell351 0;
BA_ "GenSigTimeoutTime_EVCU2" SG_ 1961 HVBatCellVoltage_Cell351 0;
BA_ "GenSigTimeoutTime_ECM" SG_ 1961 HVBatCellVoltage_Cell351 0;
BA_ "GenSigTimeoutTime_DMPI" SG_ 1961 HVBatCellVoltage_Cell351 0;
BA_ "GenSigTimeoutTime_BPCM" SG_ 1961 HVBatCellVoltage_Cell351 0;
BA_ "GenSigTimeoutTime_AGSM" SG_ 1961 HVBatCellVoltage_Cell351 0;
BA_ "GenSigTimeoutTime_PBWM" SG_ 1961 HVBatCellVoltage_Cell352 0;
BA_ "GenSigTimeoutTime_IDCM" SG_ 1961 HVBatCellVoltage_Cell352 0;
BA_ "GenSigTimeoutTime_EVCU2" SG_ 1961 HVBatCellVoltage_Cell352 0;
BA_ "GenSigTimeoutTime_ECM" SG_ 1961 HVBatCellVoltage_Cell352 0;
BA_ "GenSigTimeoutTime_DMPI" SG_ 1961 HVBatCellVoltage_Cell352 0;
BA_ "GenSigTimeoutTime_BPCM" SG_ 1961 HVBatCellVoltage_Cell352 0;
BA_ "GenSigTimeoutTime_AGSM" SG_ 1961 HVBatCellVoltage_Cell352 0;
BA_ "GenSigTimeoutTime_PBWM" SG_ 1961 HVBatCellVoltage_Cell353 0;
BA_ "GenSigTimeoutTime_IDCM" SG_ 1961 HVBatCellVoltage_Cell353 0;
BA_ "GenSigTimeoutTime_EVCU2" SG_ 1961 HVBatCellVoltage_Cell353 0;
BA_ "GenSigTimeoutTime_ECM" SG_ 1961 HVBatCellVoltage_Cell353 0;
BA_ "GenSigTimeoutTime_DMPI" SG_ 1961 HVBatCellVoltage_Cell353 0;
BA_ "GenSigTimeoutTime_BPCM" SG_ 1961 HVBatCellVoltage_Cell353 0;
BA_ "GenSigTimeoutTime_AGSM" SG_ 1961 HVBatCellVoltage_Cell353 0;
BA_ "GenSigTimeoutTime_PBWM" SG_ 1961 HVBatCellVoltage_Cell354 0;
BA_ "GenSigTimeoutTime_IDCM" SG_ 1961 HVBatCellVoltage_Cell354 0;
BA_ "GenSigTimeoutTime_EVCU2" SG_ 1961 HVBatCellVoltage_Cell354 0;
BA_ "GenSigTimeoutTime_ECM" SG_ 1961 HVBatCellVoltage_Cell354 0;
BA_ "GenSigTimeoutTime_DMPI" SG_ 1961 HVBatCellVoltage_Cell354 0;
BA_ "GenSigTimeoutTime_BPCM" SG_ 1961 HVBatCellVoltage_Cell354 0;
BA_ "GenSigTimeoutTime_AGSM" SG_ 1961 HVBatCellVoltage_Cell354 0;
BA_ "GenSigTimeoutTime_PBWM" SG_ 1961 HVBatCellVoltage_Cell331 0;
BA_ "GenSigTimeoutTime_IDCM" SG_ 1961 HVBatCellVoltage_Cell331 0;
BA_ "GenSigTimeoutTime_EVCU2" SG_ 1961 HVBatCellVoltage_Cell331 0;
BA_ "GenSigTimeoutTime_ECM" SG_ 1961 HVBatCellVoltage_Cell331 0;
BA_ "GenSigTimeoutTime_DMPI" SG_ 1961 HVBatCellVoltage_Cell331 0;
BA_ "GenSigTimeoutTime_BPCM" SG_ 1961 HVBatCellVoltage_Cell331 0;
BA_ "GenSigTimeoutTime_AGSM" SG_ 1961 HVBatCellVoltage_Cell331 0;
BA_ "GenSigTimeoutTime_PBWM" SG_ 1961 HVBatCellVoltage_Cell332 0;
BA_ "GenSigTimeoutTime_IDCM" SG_ 1961 HVBatCellVoltage_Cell332 0;
BA_ "GenSigTimeoutTime_EVCU2" SG_ 1961 HVBatCellVoltage_Cell332 0;
BA_ "GenSigTimeoutTime_ECM" SG_ 1961 HVBatCellVoltage_Cell332 0;
BA_ "GenSigTimeoutTime_DMPI" SG_ 1961 HVBatCellVoltage_Cell332 0;
BA_ "GenSigTimeoutTime_BPCM" SG_ 1961 HVBatCellVoltage_Cell332 0;
BA_ "GenSigTimeoutTime_AGSM" SG_ 1961 HVBatCellVoltage_Cell332 0;
BA_ "GenSigTimeoutTime_PBWM" SG_ 1961 HVBatCellVoltage_Cell333 0;
BA_ "GenSigTimeoutTime_IDCM" SG_ 1961 HVBatCellVoltage_Cell333 0;
BA_ "GenSigTimeoutTime_EVCU2" SG_ 1961 HVBatCellVoltage_Cell333 0;
BA_ "GenSigTimeoutTime_ECM" SG_ 1961 HVBatCellVoltage_Cell333 0;
BA_ "GenSigTimeoutTime_DMPI" SG_ 1961 HVBatCellVoltage_Cell333 0;
BA_ "GenSigTimeoutTime_BPCM" SG_ 1961 HVBatCellVoltage_Cell333 0;
BA_ "GenSigTimeoutTime_AGSM" SG_ 1961 HVBatCellVoltage_Cell333 0;
BA_ "GenSigTimeoutTime_PBWM" SG_ 1961 HVBatCellVoltage_Cell334 0;
BA_ "GenSigTimeoutTime_IDCM" SG_ 1961 HVBatCellVoltage_Cell334 0;
BA_ "GenSigTimeoutTime_EVCU2" SG_ 1961 HVBatCellVoltage_Cell334 0;
BA_ "GenSigTimeoutTime_ECM" SG_ 1961 HVBatCellVoltage_Cell334 0;
BA_ "GenSigTimeoutTime_DMPI" SG_ 1961 HVBatCellVoltage_Cell334 0;
BA_ "GenSigTimeoutTime_BPCM" SG_ 1961 HVBatCellVoltage_Cell334 0;
BA_ "GenSigTimeoutTime_AGSM" SG_ 1961 HVBatCellVoltage_Cell334 0;
BA_ "GenSigTimeoutTime_PBWM" SG_ 1961 HVBatCellVoltage_Cell335 0;
BA_ "GenSigTimeoutTime_IDCM" SG_ 1961 HVBatCellVoltage_Cell335 0;
BA_ "GenSigTimeoutTime_EVCU2" SG_ 1961 HVBatCellVoltage_Cell335 0;
BA_ "GenSigTimeoutTime_ECM" SG_ 1961 HVBatCellVoltage_Cell335 0;
BA_ "GenSigTimeoutTime_DMPI" SG_ 1961 HVBatCellVoltage_Cell335 0;
BA_ "GenSigTimeoutTime_BPCM" SG_ 1961 HVBatCellVoltage_Cell335 0;
BA_ "GenSigTimeoutTime_AGSM" SG_ 1961 HVBatCellVoltage_Cell335 0;
BA_ "GenSigTimeoutTime_PBWM" SG_ 1961 HVBatCellVoltage_Cell336 0;
BA_ "GenSigTimeoutTime_IDCM" SG_ 1961 HVBatCellVoltage_Cell336 0;
BA_ "GenSigTimeoutTime_EVCU2" SG_ 1961 HVBatCellVoltage_Cell336 0;
BA_ "GenSigTimeoutTime_ECM" SG_ 1961 HVBatCellVoltage_Cell336 0;
BA_ "GenSigTimeoutTime_DMPI" SG_ 1961 HVBatCellVoltage_Cell336 0;
BA_ "GenSigTimeoutTime_BPCM" SG_ 1961 HVBatCellVoltage_Cell336 0;
BA_ "GenSigTimeoutTime_AGSM" SG_ 1961 HVBatCellVoltage_Cell336 0;
BA_ "GenSigTimeoutTime_PBWM" SG_ 1961 HVBatCellVoltage_Cell337 0;
BA_ "GenSigTimeoutTime_IDCM" SG_ 1961 HVBatCellVoltage_Cell337 0;
BA_ "GenSigTimeoutTime_EVCU2" SG_ 1961 HVBatCellVoltage_Cell337 0;
BA_ "GenSigTimeoutTime_ECM" SG_ 1961 HVBatCellVoltage_Cell337 0;
BA_ "GenSigTimeoutTime_DMPI" SG_ 1961 HVBatCellVoltage_Cell337 0;
BA_ "GenSigTimeoutTime_BPCM" SG_ 1961 HVBatCellVoltage_Cell337 0;
BA_ "GenSigTimeoutTime_AGSM" SG_ 1961 HVBatCellVoltage_Cell337 0;
BA_ "GenSigTimeoutTime_PBWM" SG_ 1961 HVBatCellVoltage_Cell338 0;
BA_ "GenSigTimeoutTime_IDCM" SG_ 1961 HVBatCellVoltage_Cell338 0;
BA_ "GenSigTimeoutTime_EVCU2" SG_ 1961 HVBatCellVoltage_Cell338 0;
BA_ "GenSigTimeoutTime_ECM" SG_ 1961 HVBatCellVoltage_Cell338 0;
BA_ "GenSigTimeoutTime_DMPI" SG_ 1961 HVBatCellVoltage_Cell338 0;
BA_ "GenSigTimeoutTime_BPCM" SG_ 1961 HVBatCellVoltage_Cell338 0;
BA_ "GenSigTimeoutTime_AGSM" SG_ 1961 HVBatCellVoltage_Cell338 0;
BA_ "GenSigTimeoutTime_PBWM" SG_ 1961 HVBatCellVoltage_Cell339 0;
BA_ "GenSigTimeoutTime_IDCM" SG_ 1961 HVBatCellVoltage_Cell339 0;
BA_ "GenSigTimeoutTime_EVCU2" SG_ 1961 HVBatCellVoltage_Cell339 0;
BA_ "GenSigTimeoutTime_ECM" SG_ 1961 HVBatCellVoltage_Cell339 0;
BA_ "GenSigTimeoutTime_DMPI" SG_ 1961 HVBatCellVoltage_Cell339 0;
BA_ "GenSigTimeoutTime_BPCM" SG_ 1961 HVBatCellVoltage_Cell339 0;
BA_ "GenSigTimeoutTime_AGSM" SG_ 1961 HVBatCellVoltage_Cell339 0;
BA_ "GenSigTimeoutTime_PBWM" SG_ 1961 HVBatCellVoltage_Cell340 0;
BA_ "GenSigTimeoutTime_IDCM" SG_ 1961 HVBatCellVoltage_Cell340 0;
BA_ "GenSigTimeoutTime_EVCU2" SG_ 1961 HVBatCellVoltage_Cell340 0;
BA_ "GenSigTimeoutTime_ECM" SG_ 1961 HVBatCellVoltage_Cell340 0;
BA_ "GenSigTimeoutTime_DMPI" SG_ 1961 HVBatCellVoltage_Cell340 0;
BA_ "GenSigTimeoutTime_BPCM" SG_ 1961 HVBatCellVoltage_Cell340 0;
BA_ "GenSigTimeoutTime_AGSM" SG_ 1961 HVBatCellVoltage_Cell340 0;
BA_ "GenSigTimeoutTime_PBWM" SG_ 1961 HVBatCellVoltage_Cell341 0;
BA_ "GenSigTimeoutTime_IDCM" SG_ 1961 HVBatCellVoltage_Cell341 0;
BA_ "GenSigTimeoutTime_EVCU2" SG_ 1961 HVBatCellVoltage_Cell341 0;
BA_ "GenSigTimeoutTime_ECM" SG_ 1961 HVBatCellVoltage_Cell341 0;
BA_ "GenSigTimeoutTime_DMPI" SG_ 1961 HVBatCellVoltage_Cell341 0;
BA_ "GenSigTimeoutTime_BPCM" SG_ 1961 HVBatCellVoltage_Cell341 0;
BA_ "GenSigTimeoutTime_AGSM" SG_ 1961 HVBatCellVoltage_Cell341 0;
BA_ "GenSigTimeoutTime_PBWM" SG_ 1961 HVBatCellVoltage_Cell342 0;
BA_ "GenSigTimeoutTime_IDCM" SG_ 1961 HVBatCellVoltage_Cell342 0;
BA_ "GenSigTimeoutTime_EVCU2" SG_ 1961 HVBatCellVoltage_Cell342 0;
BA_ "GenSigTimeoutTime_ECM" SG_ 1961 HVBatCellVoltage_Cell342 0;
BA_ "GenSigTimeoutTime_DMPI" SG_ 1961 HVBatCellVoltage_Cell342 0;
BA_ "GenSigTimeoutTime_BPCM" SG_ 1961 HVBatCellVoltage_Cell342 0;
BA_ "GenSigTimeoutTime_AGSM" SG_ 1961 HVBatCellVoltage_Cell342 0;
BA_ "GenSigTimeoutTime_PBWM" SG_ 1961 HVBatCellVoltage_Cell343 0;
BA_ "GenSigTimeoutTime_IDCM" SG_ 1961 HVBatCellVoltage_Cell343 0;
BA_ "GenSigTimeoutTime_EVCU2" SG_ 1961 HVBatCellVoltage_Cell343 0;
BA_ "GenSigTimeoutTime_ECM" SG_ 1961 HVBatCellVoltage_Cell343 0;
BA_ "GenSigTimeoutTime_DMPI" SG_ 1961 HVBatCellVoltage_Cell343 0;
BA_ "GenSigTimeoutTime_BPCM" SG_ 1961 HVBatCellVoltage_Cell343 0;
BA_ "GenSigTimeoutTime_AGSM" SG_ 1961 HVBatCellVoltage_Cell343 0;
BA_ "GenSigTimeoutTime_PBWM" SG_ 1961 HVBatCellVoltage_Cell344 0;
BA_ "GenSigTimeoutTime_IDCM" SG_ 1961 HVBatCellVoltage_Cell344 0;
BA_ "GenSigTimeoutTime_EVCU2" SG_ 1961 HVBatCellVoltage_Cell344 0;
BA_ "GenSigTimeoutTime_ECM" SG_ 1961 HVBatCellVoltage_Cell344 0;
BA_ "GenSigTimeoutTime_DMPI" SG_ 1961 HVBatCellVoltage_Cell344 0;
BA_ "GenSigTimeoutTime_BPCM" SG_ 1961 HVBatCellVoltage_Cell344 0;
BA_ "GenSigTimeoutTime_AGSM" SG_ 1961 HVBatCellVoltage_Cell344 0;
BA_ "GenSigTimeoutTime_PBWM" SG_ 1961 HVBatCellVoltage_Cell345 0;
BA_ "GenSigTimeoutTime_IDCM" SG_ 1961 HVBatCellVoltage_Cell345 0;
BA_ "GenSigTimeoutTime_EVCU2" SG_ 1961 HVBatCellVoltage_Cell345 0;
BA_ "GenSigTimeoutTime_ECM" SG_ 1961 HVBatCellVoltage_Cell345 0;
BA_ "GenSigTimeoutTime_DMPI" SG_ 1961 HVBatCellVoltage_Cell345 0;
BA_ "GenSigTimeoutTime_BPCM" SG_ 1961 HVBatCellVoltage_Cell345 0;
BA_ "GenSigTimeoutTime_AGSM" SG_ 1961 HVBatCellVoltage_Cell345 0;
BA_ "GenSigTimeoutTime_PBWM" SG_ 1961 HVBatCellVoltage_Cell346 0;
BA_ "GenSigTimeoutTime_IDCM" SG_ 1961 HVBatCellVoltage_Cell346 0;
BA_ "GenSigTimeoutTime_EVCU2" SG_ 1961 HVBatCellVoltage_Cell346 0;
BA_ "GenSigTimeoutTime_ECM" SG_ 1961 HVBatCellVoltage_Cell346 0;
BA_ "GenSigTimeoutTime_DMPI" SG_ 1961 HVBatCellVoltage_Cell346 0;
BA_ "GenSigTimeoutTime_BPCM" SG_ 1961 HVBatCellVoltage_Cell346 0;
BA_ "GenSigTimeoutTime_AGSM" SG_ 1961 HVBatCellVoltage_Cell346 0;
BA_ "GenSigTimeoutTime_PBWM" SG_ 1960 HVBatCellVoltage_Cell325 0;
BA_ "GenSigTimeoutTime_IDCM" SG_ 1960 HVBatCellVoltage_Cell325 0;
BA_ "GenSigTimeoutTime_EVCU2" SG_ 1960 HVBatCellVoltage_Cell325 0;
BA_ "GenSigTimeoutTime_ECM" SG_ 1960 HVBatCellVoltage_Cell325 0;
BA_ "GenSigTimeoutTime_DMPI" SG_ 1960 HVBatCellVoltage_Cell325 0;
BA_ "GenSigTimeoutTime_PBWM" SG_ 1960 HVBatCellVoltage_Cell326 0;
BA_ "GenSigTimeoutTime_IDCM" SG_ 1960 HVBatCellVoltage_Cell326 0;
BA_ "GenSigTimeoutTime_EVCU2" SG_ 1960 HVBatCellVoltage_Cell326 0;
BA_ "GenSigTimeoutTime_ECM" SG_ 1960 HVBatCellVoltage_Cell326 0;
BA_ "GenSigTimeoutTime_DMPI" SG_ 1960 HVBatCellVoltage_Cell326 0;
BA_ "GenSigTimeoutTime_BPCM" SG_ 1960 HVBatCellVoltage_Cell326 0;
BA_ "GenSigTimeoutTime_AGSM" SG_ 1960 HVBatCellVoltage_Cell326 0;
BA_ "GenSigTimeoutTime_PBWM" SG_ 1960 HVBatCellVoltage_Cell327 0;
BA_ "GenSigTimeoutTime_IDCM" SG_ 1960 HVBatCellVoltage_Cell327 0;
BA_ "GenSigTimeoutTime_EVCU2" SG_ 1960 HVBatCellVoltage_Cell327 0;
BA_ "GenSigTimeoutTime_ECM" SG_ 1960 HVBatCellVoltage_Cell327 0;
BA_ "GenSigTimeoutTime_DMPI" SG_ 1960 HVBatCellVoltage_Cell327 0;
BA_ "GenSigTimeoutTime_BPCM" SG_ 1960 HVBatCellVoltage_Cell327 0;
BA_ "GenSigTimeoutTime_AGSM" SG_ 1960 HVBatCellVoltage_Cell327 0;
BA_ "GenSigTimeoutTime_PBWM" SG_ 1960 HVBatCellVoltage_Cell328 0;
BA_ "GenSigTimeoutTime_IDCM" SG_ 1960 HVBatCellVoltage_Cell328 0;
BA_ "GenSigTimeoutTime_EVCU2" SG_ 1960 HVBatCellVoltage_Cell328 0;
BA_ "GenSigTimeoutTime_ECM" SG_ 1960 HVBatCellVoltage_Cell328 0;
BA_ "GenSigTimeoutTime_DMPI" SG_ 1960 HVBatCellVoltage_Cell328 0;
BA_ "GenSigTimeoutTime_BPCM" SG_ 1960 HVBatCellVoltage_Cell328 0;
BA_ "GenSigTimeoutTime_AGSM" SG_ 1960 HVBatCellVoltage_Cell328 0;
BA_ "GenSigTimeoutTime_BPCM" SG_ 1961 HVBatCellVoltage_Cell329 0;
BA_ "GenSigTimeoutTime_AGSM" SG_ 1961 HVBatCellVoltage_Cell329 0;
BA_ "GenSigTimeoutTime_PBWM" SG_ 1961 HVBatCellVoltage_Cell329 0;
BA_ "GenSigTimeoutTime_IDCM" SG_ 1961 HVBatCellVoltage_Cell329 0;
BA_ "GenSigTimeoutTime_EVCU2" SG_ 1961 HVBatCellVoltage_Cell329 0;
BA_ "GenSigTimeoutTime_ECM" SG_ 1961 HVBatCellVoltage_Cell329 0;
BA_ "GenSigTimeoutTime_DMPI" SG_ 1961 HVBatCellVoltage_Cell329 0;
BA_ "GenSigTimeoutTime_PBWM" SG_ 1961 HVBatCellVoltage_Cell330 0;
BA_ "GenSigTimeoutTime_IDCM" SG_ 1961 HVBatCellVoltage_Cell330 0;
BA_ "GenSigTimeoutTime_EVCU2" SG_ 1961 HVBatCellVoltage_Cell330 0;
BA_ "GenSigTimeoutTime_ECM" SG_ 1961 HVBatCellVoltage_Cell330 0;
BA_ "GenSigTimeoutTime_DMPI" SG_ 1961 HVBatCellVoltage_Cell330 0;
BA_ "GenSigTimeoutTime_BPCM" SG_ 1961 HVBatCellVoltage_Cell330 0;
BA_ "GenSigTimeoutTime_AGSM" SG_ 1961 HVBatCellVoltage_Cell330 0;
BA_ "GenSigTimeoutTime_BPCM" SG_ 1960 HVBatCellVoltage_Cell325 0;
BA_ "GenSigTimeoutTime_AGSM" SG_ 1960 HVBatCellVoltage_Cell325 0;
BA_ "GenSigTimeoutTime_PBWM" SG_ 1960 HVBatCellVoltage_Cell323 0;
BA_ "GenSigTimeoutTime_IDCM" SG_ 1960 HVBatCellVoltage_Cell323 0;
BA_ "GenSigTimeoutTime_EVCU2" SG_ 1960 HVBatCellVoltage_Cell323 0;
BA_ "GenSigTimeoutTime_ECM" SG_ 1960 HVBatCellVoltage_Cell323 0;
BA_ "GenSigTimeoutTime_DMPI" SG_ 1960 HVBatCellVoltage_Cell323 0;
BA_ "GenSigTimeoutTime_BPCM" SG_ 1960 HVBatCellVoltage_Cell323 0;
BA_ "GenSigTimeoutTime_AGSM" SG_ 1960 HVBatCellVoltage_Cell323 0;
BA_ "GenSigTimeoutTime_PBWM" SG_ 1960 HVBatCellVoltage_Cell324 0;
BA_ "GenSigTimeoutTime_IDCM" SG_ 1960 HVBatCellVoltage_Cell324 0;
BA_ "GenSigTimeoutTime_EVCU2" SG_ 1960 HVBatCellVoltage_Cell324 0;
BA_ "GenSigTimeoutTime_ECM" SG_ 1960 HVBatCellVoltage_Cell324 0;
BA_ "GenSigTimeoutTime_DMPI" SG_ 1960 HVBatCellVoltage_Cell324 0;
BA_ "GenSigTimeoutTime_BPCM" SG_ 1960 HVBatCellVoltage_Cell324 0;
BA_ "GenSigTimeoutTime_AGSM" SG_ 1960 HVBatCellVoltage_Cell324 0;
BA_ "GenSigTimeoutTime_PBWM" SG_ 1960 HVBatCellVoltage_Cell315 0;
BA_ "GenSigTimeoutTime_IDCM" SG_ 1960 HVBatCellVoltage_Cell315 0;
BA_ "GenSigTimeoutTime_EVCU2" SG_ 1960 HVBatCellVoltage_Cell315 0;
BA_ "GenSigTimeoutTime_ECM" SG_ 1960 HVBatCellVoltage_Cell315 0;
BA_ "GenSigTimeoutTime_DMPI" SG_ 1960 HVBatCellVoltage_Cell315 0;
BA_ "GenSigTimeoutTime_BPCM" SG_ 1960 HVBatCellVoltage_Cell315 0;
BA_ "GenSigTimeoutTime_AGSM" SG_ 1960 HVBatCellVoltage_Cell315 0;
BA_ "GenSigTimeoutTime_PBWM" SG_ 1960 HVBatCellVoltage_Cell316 0;
BA_ "GenSigTimeoutTime_IDCM" SG_ 1960 HVBatCellVoltage_Cell316 0;
BA_ "GenSigTimeoutTime_EVCU2" SG_ 1960 HVBatCellVoltage_Cell316 0;
BA_ "GenSigTimeoutTime_ECM" SG_ 1960 HVBatCellVoltage_Cell316 0;
BA_ "GenSigTimeoutTime_DMPI" SG_ 1960 HVBatCellVoltage_Cell316 0;
BA_ "GenSigTimeoutTime_BPCM" SG_ 1960 HVBatCellVoltage_Cell316 0;
BA_ "GenSigTimeoutTime_AGSM" SG_ 1960 HVBatCellVoltage_Cell316 0;
BA_ "GenSigTimeoutTime_PBWM" SG_ 1960 HVBatCellVoltage_Cell317 0;
BA_ "GenSigTimeoutTime_IDCM" SG_ 1960 HVBatCellVoltage_Cell317 0;
BA_ "GenSigTimeoutTime_EVCU2" SG_ 1960 HVBatCellVoltage_Cell317 0;
BA_ "GenSigTimeoutTime_ECM" SG_ 1960 HVBatCellVoltage_Cell317 0;
BA_ "GenSigTimeoutTime_DMPI" SG_ 1960 HVBatCellVoltage_Cell317 0;
BA_ "GenSigTimeoutTime_BPCM" SG_ 1960 HVBatCellVoltage_Cell317 0;
BA_ "GenSigTimeoutTime_AGSM" SG_ 1960 HVBatCellVoltage_Cell317 0;
BA_ "GenSigTimeoutTime_PBWM" SG_ 1960 HVBatCellVoltage_Cell318 0;
BA_ "GenSigTimeoutTime_IDCM" SG_ 1960 HVBatCellVoltage_Cell318 0;
BA_ "GenSigTimeoutTime_EVCU2" SG_ 1960 HVBatCellVoltage_Cell318 0;
BA_ "GenSigTimeoutTime_ECM" SG_ 1960 HVBatCellVoltage_Cell318 0;
BA_ "GenSigTimeoutTime_DMPI" SG_ 1960 HVBatCellVoltage_Cell318 0;
BA_ "GenSigTimeoutTime_BPCM" SG_ 1960 HVBatCellVoltage_Cell318 0;
BA_ "GenSigTimeoutTime_AGSM" SG_ 1960 HVBatCellVoltage_Cell318 0;
BA_ "GenSigTimeoutTime_PBWM" SG_ 1960 HVBatCellVoltage_Cell319 0;
BA_ "GenSigTimeoutTime_IDCM" SG_ 1960 HVBatCellVoltage_Cell319 0;
BA_ "GenSigTimeoutTime_EVCU2" SG_ 1960 HVBatCellVoltage_Cell319 0;
BA_ "GenSigTimeoutTime_ECM" SG_ 1960 HVBatCellVoltage_Cell319 0;
BA_ "GenSigTimeoutTime_DMPI" SG_ 1960 HVBatCellVoltage_Cell319 0;
BA_ "GenSigTimeoutTime_BPCM" SG_ 1960 HVBatCellVoltage_Cell319 0;
BA_ "GenSigTimeoutTime_AGSM" SG_ 1960 HVBatCellVoltage_Cell319 0;
BA_ "GenSigTimeoutTime_PBWM" SG_ 1960 HVBatCellVoltage_Cell320 0;
BA_ "GenSigTimeoutTime_IDCM" SG_ 1960 HVBatCellVoltage_Cell320 0;
BA_ "GenSigTimeoutTime_EVCU2" SG_ 1960 HVBatCellVoltage_Cell320 0;
BA_ "GenSigTimeoutTime_ECM" SG_ 1960 HVBatCellVoltage_Cell320 0;
BA_ "GenSigTimeoutTime_DMPI" SG_ 1960 HVBatCellVoltage_Cell320 0;
BA_ "GenSigTimeoutTime_BPCM" SG_ 1960 HVBatCellVoltage_Cell320 0;
BA_ "GenSigTimeoutTime_AGSM" SG_ 1960 HVBatCellVoltage_Cell320 0;
BA_ "GenSigTimeoutTime_PBWM" SG_ 1960 HVBatCellVoltage_Cell321 0;
BA_ "GenSigTimeoutTime_IDCM" SG_ 1960 HVBatCellVoltage_Cell321 0;
BA_ "GenSigTimeoutTime_EVCU2" SG_ 1960 HVBatCellVoltage_Cell321 0;
BA_ "GenSigTimeoutTime_ECM" SG_ 1960 HVBatCellVoltage_Cell321 0;
BA_ "GenSigTimeoutTime_DMPI" SG_ 1960 HVBatCellVoltage_Cell321 0;
BA_ "GenSigTimeoutTime_BPCM" SG_ 1960 HVBatCellVoltage_Cell321 0;
BA_ "GenSigTimeoutTime_AGSM" SG_ 1960 HVBatCellVoltage_Cell321 0;
BA_ "GenSigTimeoutTime_PBWM" SG_ 1960 HVBatCellVoltage_Cell322 0;
BA_ "GenSigTimeoutTime_IDCM" SG_ 1960 HVBatCellVoltage_Cell322 0;
BA_ "GenSigTimeoutTime_EVCU2" SG_ 1960 HVBatCellVoltage_Cell322 0;
BA_ "GenSigTimeoutTime_ECM" SG_ 1960 HVBatCellVoltage_Cell322 0;
BA_ "GenSigTimeoutTime_DMPI" SG_ 1960 HVBatCellVoltage_Cell322 0;
BA_ "GenSigTimeoutTime_BPCM" SG_ 1960 HVBatCellVoltage_Cell322 0;
BA_ "GenSigTimeoutTime_AGSM" SG_ 1960 HVBatCellVoltage_Cell322 0;
BA_ "GenSigTimeoutTime_IDCM" SG_ 1960 HVBatCellVoltage_Cell299 0;
BA_ "GenSigTimeoutTime_EVCU2" SG_ 1960 HVBatCellVoltage_Cell299 0;
BA_ "GenSigTimeoutTime_ECM" SG_ 1960 HVBatCellVoltage_Cell299 0;
BA_ "GenSigTimeoutTime_DMPI" SG_ 1960 HVBatCellVoltage_Cell299 0;
BA_ "GenSigTimeoutTime_BPCM" SG_ 1960 HVBatCellVoltage_Cell299 0;
BA_ "GenSigTimeoutTime_AGSM" SG_ 1960 HVBatCellVoltage_Cell299 0;
BA_ "GenSigTimeoutTime_PBWM" SG_ 1960 HVBatCellVoltage_Cell299 0;
BA_ "GenSigTimeoutTime_PBWM" SG_ 1960 HVBatCellVoltage_Cell300 0;
BA_ "GenSigTimeoutTime_IDCM" SG_ 1960 HVBatCellVoltage_Cell300 0;
BA_ "GenSigTimeoutTime_EVCU2" SG_ 1960 HVBatCellVoltage_Cell300 0;
BA_ "GenSigTimeoutTime_ECM" SG_ 1960 HVBatCellVoltage_Cell300 0;
BA_ "GenSigTimeoutTime_DMPI" SG_ 1960 HVBatCellVoltage_Cell300 0;
BA_ "GenSigTimeoutTime_BPCM" SG_ 1960 HVBatCellVoltage_Cell300 0;
BA_ "GenSigTimeoutTime_AGSM" SG_ 1960 HVBatCellVoltage_Cell300 0;
BA_ "GenSigTimeoutTime_PBWM" SG_ 1960 HVBatCellVoltage_Cell301 0;
BA_ "GenSigTimeoutTime_IDCM" SG_ 1960 HVBatCellVoltage_Cell301 0;
BA_ "GenSigTimeoutTime_EVCU2" SG_ 1960 HVBatCellVoltage_Cell301 0;
BA_ "GenSigTimeoutTime_ECM" SG_ 1960 HVBatCellVoltage_Cell301 0;
BA_ "GenSigTimeoutTime_DMPI" SG_ 1960 HVBatCellVoltage_Cell301 0;
BA_ "GenSigTimeoutTime_BPCM" SG_ 1960 HVBatCellVoltage_Cell301 0;
BA_ "GenSigTimeoutTime_AGSM" SG_ 1960 HVBatCellVoltage_Cell301 0;
BA_ "GenSigTimeoutTime_PBWM" SG_ 1960 HVBatCellVoltage_Cell302 0;
BA_ "GenSigTimeoutTime_IDCM" SG_ 1960 HVBatCellVoltage_Cell302 0;
BA_ "GenSigTimeoutTime_EVCU2" SG_ 1960 HVBatCellVoltage_Cell302 0;
BA_ "GenSigTimeoutTime_ECM" SG_ 1960 HVBatCellVoltage_Cell302 0;
BA_ "GenSigTimeoutTime_DMPI" SG_ 1960 HVBatCellVoltage_Cell302 0;
BA_ "GenSigTimeoutTime_BPCM" SG_ 1960 HVBatCellVoltage_Cell302 0;
BA_ "GenSigTimeoutTime_AGSM" SG_ 1960 HVBatCellVoltage_Cell302 0;
BA_ "GenSigTimeoutTime_PBWM" SG_ 1960 HVBatCellVoltage_Cell303 0;
BA_ "GenSigTimeoutTime_IDCM" SG_ 1960 HVBatCellVoltage_Cell303 0;
BA_ "GenSigTimeoutTime_EVCU2" SG_ 1960 HVBatCellVoltage_Cell303 0;
BA_ "GenSigTimeoutTime_ECM" SG_ 1960 HVBatCellVoltage_Cell303 0;
BA_ "GenSigTimeoutTime_DMPI" SG_ 1960 HVBatCellVoltage_Cell303 0;
BA_ "GenSigTimeoutTime_BPCM" SG_ 1960 HVBatCellVoltage_Cell303 0;
BA_ "GenSigTimeoutTime_AGSM" SG_ 1960 HVBatCellVoltage_Cell303 0;
BA_ "GenSigTimeoutTime_PBWM" SG_ 1960 HVBatCellVoltage_Cell304 0;
BA_ "GenSigTimeoutTime_IDCM" SG_ 1960 HVBatCellVoltage_Cell304 0;
BA_ "GenSigTimeoutTime_EVCU2" SG_ 1960 HVBatCellVoltage_Cell304 0;
BA_ "GenSigTimeoutTime_ECM" SG_ 1960 HVBatCellVoltage_Cell304 0;
BA_ "GenSigTimeoutTime_DMPI" SG_ 1960 HVBatCellVoltage_Cell304 0;
BA_ "GenSigTimeoutTime_BPCM" SG_ 1960 HVBatCellVoltage_Cell304 0;
BA_ "GenSigTimeoutTime_AGSM" SG_ 1960 HVBatCellVoltage_Cell304 0;
BA_ "GenSigTimeoutTime_PBWM" SG_ 1960 HVBatCellVoltage_Cell305 0;
BA_ "GenSigTimeoutTime_IDCM" SG_ 1960 HVBatCellVoltage_Cell305 0;
BA_ "GenSigTimeoutTime_EVCU2" SG_ 1960 HVBatCellVoltage_Cell305 0;
BA_ "GenSigTimeoutTime_ECM" SG_ 1960 HVBatCellVoltage_Cell305 0;
BA_ "GenSigTimeoutTime_DMPI" SG_ 1960 HVBatCellVoltage_Cell305 0;
BA_ "GenSigTimeoutTime_BPCM" SG_ 1960 HVBatCellVoltage_Cell305 0;
BA_ "GenSigTimeoutTime_AGSM" SG_ 1960 HVBatCellVoltage_Cell305 0;
BA_ "GenSigTimeoutTime_PBWM" SG_ 1960 HVBatCellVoltage_Cell306 0;
BA_ "GenSigTimeoutTime_IDCM" SG_ 1960 HVBatCellVoltage_Cell306 0;
BA_ "GenSigTimeoutTime_EVCU2" SG_ 1960 HVBatCellVoltage_Cell306 0;
BA_ "GenSigTimeoutTime_ECM" SG_ 1960 HVBatCellVoltage_Cell306 0;
BA_ "GenSigTimeoutTime_DMPI" SG_ 1960 HVBatCellVoltage_Cell306 0;
BA_ "GenSigTimeoutTime_PBWM" SG_ 1965 HVBatCellVoltage_Cell217 0;
BA_ "GenSigTimeoutTime_IDCM" SG_ 1965 HVBatCellVoltage_Cell217 0;
BA_ "GenSigTimeoutTime_EVCU2" SG_ 1965 HVBatCellVoltage_Cell217 0;
BA_ "GenSigTimeoutTime_ECM" SG_ 1965 HVBatCellVoltage_Cell217 0;
BA_ "GenSigTimeoutTime_DMPI" SG_ 1965 HVBatCellVoltage_Cell217 0;
BA_ "GenSigTimeoutTime_BPCM" SG_ 1965 HVBatCellVoltage_Cell217 0;
BA_ "GenSigTimeoutTime_AGSM" SG_ 1965 HVBatCellVoltage_Cell217 0;
BA_ "GenSigTimeoutTime_PBWM" SG_ 1965 HVBatCellVoltage_Cell218 0;
BA_ "GenSigTimeoutTime_IDCM" SG_ 1965 HVBatCellVoltage_Cell218 0;
BA_ "GenSigTimeoutTime_EVCU2" SG_ 1965 HVBatCellVoltage_Cell218 0;
BA_ "GenSigTimeoutTime_ECM" SG_ 1965 HVBatCellVoltage_Cell218 0;
BA_ "GenSigTimeoutTime_DMPI" SG_ 1965 HVBatCellVoltage_Cell218 0;
BA_ "GenSigTimeoutTime_BPCM" SG_ 1965 HVBatCellVoltage_Cell218 0;
BA_ "GenSigTimeoutTime_AGSM" SG_ 1965 HVBatCellVoltage_Cell218 0;
BA_ "GenSigTimeoutTime_PBWM" SG_ 1965 HVBatCellVoltage_Cell219 0;
BA_ "GenSigTimeoutTime_IDCM" SG_ 1965 HVBatCellVoltage_Cell219 0;
BA_ "GenSigTimeoutTime_EVCU2" SG_ 1965 HVBatCellVoltage_Cell219 0;
BA_ "GenSigTimeoutTime_ECM" SG_ 1965 HVBatCellVoltage_Cell219 0;
BA_ "GenSigTimeoutTime_DMPI" SG_ 1965 HVBatCellVoltage_Cell219 0;
BA_ "GenSigTimeoutTime_BPCM" SG_ 1965 HVBatCellVoltage_Cell219 0;
BA_ "GenSigTimeoutTime_AGSM" SG_ 1965 HVBatCellVoltage_Cell219 0;
BA_ "GenSigTimeoutTime_EVCU2" SG_ 1965 HVBatCellVoltage_Cell220 0;
BA_ "GenSigTimeoutTime_ECM" SG_ 1965 HVBatCellVoltage_Cell220 0;
BA_ "GenSigTimeoutTime_DMPI" SG_ 1965 HVBatCellVoltage_Cell220 0;
BA_ "GenSigTimeoutTime_BPCM" SG_ 1965 HVBatCellVoltage_Cell220 0;
BA_ "GenSigTimeoutTime_AGSM" SG_ 1965 HVBatCellVoltage_Cell220 0;
BA_ "GenSigTimeoutTime_PBWM" SG_ 1965 HVBatCellVoltage_Cell220 0;
BA_ "GenSigTimeoutTime_IDCM" SG_ 1965 HVBatCellVoltage_Cell220 0;
BA_ "GenSigTimeoutTime_PBWM" SG_ 1965 HVBatCellVoltage_Cell221 0;
BA_ "GenSigTimeoutTime_IDCM" SG_ 1965 HVBatCellVoltage_Cell221 0;
BA_ "GenSigTimeoutTime_EVCU2" SG_ 1965 HVBatCellVoltage_Cell221 0;
BA_ "GenSigTimeoutTime_ECM" SG_ 1965 HVBatCellVoltage_Cell221 0;
BA_ "GenSigTimeoutTime_DMPI" SG_ 1965 HVBatCellVoltage_Cell221 0;
BA_ "GenSigTimeoutTime_BPCM" SG_ 1965 HVBatCellVoltage_Cell221 0;
BA_ "GenSigTimeoutTime_AGSM" SG_ 1965 HVBatCellVoltage_Cell221 0;
BA_ "GenSigTimeoutTime_PBWM" SG_ 1965 HVBatCellVoltage_Cell222 0;
BA_ "GenSigTimeoutTime_IDCM" SG_ 1965 HVBatCellVoltage_Cell222 0;
BA_ "GenSigTimeoutTime_EVCU2" SG_ 1965 HVBatCellVoltage_Cell222 0;
BA_ "GenSigTimeoutTime_ECM" SG_ 1965 HVBatCellVoltage_Cell222 0;
BA_ "GenSigTimeoutTime_DMPI" SG_ 1965 HVBatCellVoltage_Cell222 0;
BA_ "GenSigTimeoutTime_BPCM" SG_ 1965 HVBatCellVoltage_Cell222 0;
BA_ "GenSigTimeoutTime_AGSM" SG_ 1965 HVBatCellVoltage_Cell222 0;
BA_ "GenSigTimeoutTime_PBWM" SG_ 1965 HVBatCellVoltage_Cell223 0;
BA_ "GenSigTimeoutTime_IDCM" SG_ 1965 HVBatCellVoltage_Cell223 0;
BA_ "GenSigTimeoutTime_EVCU2" SG_ 1965 HVBatCellVoltage_Cell223 0;
BA_ "GenSigTimeoutTime_ECM" SG_ 1965 HVBatCellVoltage_Cell223 0;
BA_ "GenSigTimeoutTime_DMPI" SG_ 1965 HVBatCellVoltage_Cell223 0;
BA_ "GenSigTimeoutTime_BPCM" SG_ 1965 HVBatCellVoltage_Cell223 0;
BA_ "GenSigTimeoutTime_AGSM" SG_ 1965 HVBatCellVoltage_Cell223 0;
BA_ "GenSigTimeoutTime_PBWM" SG_ 1965 HVBatCellVoltage_Cell224 0;
BA_ "GenSigTimeoutTime_IDCM" SG_ 1965 HVBatCellVoltage_Cell224 0;
BA_ "GenSigTimeoutTime_EVCU2" SG_ 1965 HVBatCellVoltage_Cell224 0;
BA_ "GenSigTimeoutTime_ECM" SG_ 1965 HVBatCellVoltage_Cell224 0;
BA_ "GenSigTimeoutTime_DMPI" SG_ 1965 HVBatCellVoltage_Cell224 0;
BA_ "GenSigTimeoutTime_BPCM" SG_ 1965 HVBatCellVoltage_Cell224 0;
BA_ "GenSigTimeoutTime_AGSM" SG_ 1965 HVBatCellVoltage_Cell224 0;
BA_ "GenSigTimeoutTime_PBWM" SG_ 1965 HVBatCellVoltage_Cell225 0;
BA_ "GenSigTimeoutTime_IDCM" SG_ 1965 HVBatCellVoltage_Cell225 0;
BA_ "GenSigTimeoutTime_EVCU2" SG_ 1965 HVBatCellVoltage_Cell225 0;
BA_ "GenSigTimeoutTime_ECM" SG_ 1965 HVBatCellVoltage_Cell225 0;
BA_ "GenSigTimeoutTime_DMPI" SG_ 1965 HVBatCellVoltage_Cell225 0;
BA_ "GenSigTimeoutTime_BPCM" SG_ 1965 HVBatCellVoltage_Cell225 0;
BA_ "GenSigTimeoutTime_AGSM" SG_ 1965 HVBatCellVoltage_Cell225 0;
BA_ "GenSigTimeoutTime_PBWM" SG_ 1965 HVBatCellVoltage_Cell226 0;
BA_ "GenSigTimeoutTime_IDCM" SG_ 1965 HVBatCellVoltage_Cell226 0;
BA_ "GenSigTimeoutTime_EVCU2" SG_ 1965 HVBatCellVoltage_Cell226 0;
BA_ "GenSigTimeoutTime_ECM" SG_ 1965 HVBatCellVoltage_Cell226 0;
BA_ "GenSigTimeoutTime_DMPI" SG_ 1965 HVBatCellVoltage_Cell226 0;
BA_ "GenSigTimeoutTime_BPCM" SG_ 1965 HVBatCellVoltage_Cell226 0;
BA_ "GenSigTimeoutTime_AGSM" SG_ 1965 HVBatCellVoltage_Cell226 0;
BA_ "GenSigTimeoutTime_PBWM" SG_ 1965 HVBatCellVoltage_Cell227 0;
BA_ "GenSigTimeoutTime_IDCM" SG_ 1965 HVBatCellVoltage_Cell227 0;
BA_ "GenSigTimeoutTime_EVCU2" SG_ 1965 HVBatCellVoltage_Cell227 0;
BA_ "GenSigTimeoutTime_ECM" SG_ 1965 HVBatCellVoltage_Cell227 0;
BA_ "GenSigTimeoutTime_DMPI" SG_ 1965 HVBatCellVoltage_Cell227 0;
BA_ "GenSigTimeoutTime_BPCM" SG_ 1965 HVBatCellVoltage_Cell227 0;
BA_ "GenSigTimeoutTime_AGSM" SG_ 1965 HVBatCellVoltage_Cell227 0;
BA_ "GenSigTimeoutTime_PBWM" SG_ 1965 HVBatCellVoltage_Cell228 0;
BA_ "GenSigTimeoutTime_IDCM" SG_ 1965 HVBatCellVoltage_Cell228 0;
BA_ "GenSigTimeoutTime_EVCU2" SG_ 1965 HVBatCellVoltage_Cell228 0;
BA_ "GenSigTimeoutTime_ECM" SG_ 1965 HVBatCellVoltage_Cell228 0;
BA_ "GenSigTimeoutTime_DMPI" SG_ 1965 HVBatCellVoltage_Cell228 0;
BA_ "GenSigTimeoutTime_BPCM" SG_ 1965 HVBatCellVoltage_Cell228 0;
BA_ "GenSigTimeoutTime_AGSM" SG_ 1965 HVBatCellVoltage_Cell228 0;
BA_ "GenSigTimeoutTime_PBWM" SG_ 1965 HVBatCellVoltage_Cell229 0;
BA_ "GenSigTimeoutTime_IDCM" SG_ 1965 HVBatCellVoltage_Cell229 0;
BA_ "GenSigTimeoutTime_EVCU2" SG_ 1965 HVBatCellVoltage_Cell229 0;
BA_ "GenSigTimeoutTime_ECM" SG_ 1965 HVBatCellVoltage_Cell229 0;
BA_ "GenSigTimeoutTime_DMPI" SG_ 1965 HVBatCellVoltage_Cell229 0;
BA_ "GenSigTimeoutTime_BPCM" SG_ 1965 HVBatCellVoltage_Cell229 0;
BA_ "GenSigTimeoutTime_AGSM" SG_ 1965 HVBatCellVoltage_Cell229 0;
BA_ "GenSigTimeoutTime_PBWM" SG_ 1965 HVBatCellVoltage_Cell230 0;
BA_ "GenSigTimeoutTime_IDCM" SG_ 1965 HVBatCellVoltage_Cell230 0;
BA_ "GenSigTimeoutTime_EVCU2" SG_ 1965 HVBatCellVoltage_Cell230 0;
BA_ "GenSigTimeoutTime_ECM" SG_ 1965 HVBatCellVoltage_Cell230 0;
BA_ "GenSigTimeoutTime_DMPI" SG_ 1965 HVBatCellVoltage_Cell230 0;
BA_ "GenSigTimeoutTime_BPCM" SG_ 1965 HVBatCellVoltage_Cell230 0;
BA_ "GenSigTimeoutTime_AGSM" SG_ 1965 HVBatCellVoltage_Cell230 0;
BA_ "GenSigTimeoutTime_PBWM" SG_ 1965 HVBatCellVoltage_Cell231 0;
BA_ "GenSigTimeoutTime_IDCM" SG_ 1965 HVBatCellVoltage_Cell231 0;
BA_ "GenSigTimeoutTime_EVCU2" SG_ 1965 HVBatCellVoltage_Cell231 0;
BA_ "GenSigTimeoutTime_ECM" SG_ 1965 HVBatCellVoltage_Cell231 0;
BA_ "GenSigTimeoutTime_DMPI" SG_ 1965 HVBatCellVoltage_Cell231 0;
BA_ "GenSigTimeoutTime_BPCM" SG_ 1965 HVBatCellVoltage_Cell231 0;
BA_ "GenSigTimeoutTime_AGSM" SG_ 1965 HVBatCellVoltage_Cell231 0;
BA_ "GenSigTimeoutTime_PBWM" SG_ 1965 HVBatCellVoltage_Cell232 0;
BA_ "GenSigTimeoutTime_IDCM" SG_ 1965 HVBatCellVoltage_Cell232 0;
BA_ "GenSigTimeoutTime_EVCU2" SG_ 1965 HVBatCellVoltage_Cell232 0;
BA_ "GenSigTimeoutTime_ECM" SG_ 1965 HVBatCellVoltage_Cell232 0;
BA_ "GenSigTimeoutTime_DMPI" SG_ 1965 HVBatCellVoltage_Cell232 0;
BA_ "GenSigTimeoutTime_BPCM" SG_ 1965 HVBatCellVoltage_Cell232 0;
BA_ "GenSigTimeoutTime_AGSM" SG_ 1965 HVBatCellVoltage_Cell232 0;
BA_ "GenSigTimeoutTime_SGW" SG_ 1063 CRC_MCPB_DATA2 0;
BA_ "GenSigTimeoutTime_PBWM" SG_ 1063 CRC_MCPB_DATA2 0;
BA_ "GenSigTimeoutTime_IDCM" SG_ 1063 CRC_MCPB_DATA2 0;
BA_ "GenSigTimeoutTime_ECM" SG_ 1063 CRC_MCPB_DATA2 0;
BA_ "GenSigTimeoutTime_DMPI" SG_ 1063 CRC_MCPB_DATA2 0;
BA_ "GenSigTimeoutTime_BPCM" SG_ 1063 CRC_MCPB_DATA2 0;
BA_ "GenSigTimeoutTime_AGSM" SG_ 1063 CRC_MCPB_DATA2 0;
BA_ "GenSigTimeoutTime_SGW" SG_ 1063 MAC_MCPB_DATA2 0;
BA_ "GenSigTimeoutTime_PBWM" SG_ 1063 MAC_MCPB_DATA2 0;
BA_ "GenSigTimeoutTime_IDCM" SG_ 1063 MAC_MCPB_DATA2 0;
BA_ "GenSigTimeoutTime_ECM" SG_ 1063 MAC_MCPB_DATA2 0;
BA_ "GenSigTimeoutTime_DMPI" SG_ 1063 MAC_MCPB_DATA2 0;
BA_ "GenSigTimeoutTime_BPCM" SG_ 1063 MAC_MCPB_DATA2 0;
BA_ "GenSigTimeoutTime_AGSM" SG_ 1063 MAC_MCPB_DATA2 0;
BA_ "GenSigTimeoutTime_SGW" SG_ 1063 MCPB_ROL_STATUS 0;
BA_ "GenSigTimeoutTime_PBWM" SG_ 1063 MCPB_ROL_STATUS 0;
BA_ "GenSigTimeoutTime_IDCM" SG_ 1063 MCPB_ROL_STATUS 0;
BA_ "GenSigTimeoutTime_ECM" SG_ 1063 MCPB_ROL_STATUS 0;
BA_ "GenSigTimeoutTime_DMPI" SG_ 1063 MCPB_ROL_STATUS 0;
BA_ "GenSigTimeoutTime_BPCM" SG_ 1063 MCPB_ROL_STATUS 0;
BA_ "GenSigTimeoutTime_AGSM" SG_ 1063 MCPB_ROL_STATUS 0;
BA_ "GenSigTimeoutTime_SGW" SG_ 1063 MessageCounter_MCPB_DATA2 0;
BA_ "GenSigTimeoutTime_PBWM" SG_ 1063 MessageCounter_MCPB_DATA2 0;
BA_ "GenSigTimeoutTime_IDCM" SG_ 1063 MessageCounter_MCPB_DATA2 0;
BA_ "GenSigTimeoutTime_ECM" SG_ 1063 MessageCounter_MCPB_DATA2 0;
BA_ "GenSigTimeoutTime_DMPI" SG_ 1063 MessageCounter_MCPB_DATA2 0;
BA_ "GenSigTimeoutTime_BPCM" SG_ 1063 MessageCounter_MCPB_DATA2 0;
BA_ "GenSigTimeoutTime_AGSM" SG_ 1063 MessageCounter_MCPB_DATA2 0;
BA_ "GenSigTimeoutTime_SGW" SG_ 1063 Cntr_MCPB_DATA2 0;
BA_ "GenSigTimeoutTime_PBWM" SG_ 1063 Cntr_MCPB_DATA2 0;
BA_ "GenSigTimeoutTime_IDCM" SG_ 1063 Cntr_MCPB_DATA2 0;
BA_ "GenSigTimeoutTime_ECM" SG_ 1063 Cntr_MCPB_DATA2 0;
BA_ "GenSigTimeoutTime_DMPI" SG_ 1063 Cntr_MCPB_DATA2 0;
BA_ "GenSigTimeoutTime_BPCM" SG_ 1063 Cntr_MCPB_DATA2 0;
BA_ "GenSigTimeoutTime_AGSM" SG_ 1063 Cntr_MCPB_DATA2 0;
BA_ "GenSigTimeoutTime_SGW" SG_ 1031 RCD 0;
BA_ "GenSigTimeoutTime_PBWM" SG_ 1031 RCD 0;
BA_ "GenSigTimeoutTime_IDCM" SG_ 1031 RCD 0;
BA_ "GenSigTimeoutTime_ECM" SG_ 1031 RCD 0;
BA_ "GenSigTimeoutTime_DMPI" SG_ 1031 RCD 0;
BA_ "GenSigTimeoutTime_BPCM" SG_ 1031 RCD 0;
BA_ "GenSigTimeoutTime_AGSM" SG_ 1031 RCD 0;
BA_ "GenSigTimeoutTime_SGW" SG_ 1031 ProximitySts 0;
BA_ "GenSigTimeoutTime_PBWM" SG_ 1031 ProximitySts 0;
BA_ "GenSigTimeoutTime_IDCM" SG_ 1031 ProximitySts 0;
BA_ "GenSigTimeoutTime_ECM" SG_ 1031 ProximitySts 0;
BA_ "GenSigTimeoutTime_DMPI" SG_ 1031 ProximitySts 0;
BA_ "GenSigTimeoutTime_SGW" SG_ 1031 Supported_ProtocolName 0;
BA_ "GenSigTimeoutTime_PBWM" SG_ 1031 Supported_ProtocolName 0;
BA_ "GenSigTimeoutTime_IDCM" SG_ 1031 Supported_ProtocolName 0;
BA_ "GenSigTimeoutTime_ECM" SG_ 1031 Supported_ProtocolName 0;
BA_ "GenSigTimeoutTime_DMPI" SG_ 1031 Supported_ProtocolName 0;
BA_ "GenSigTimeoutTime_BPCM" SG_ 1031 Supported_ProtocolName 0;
BA_ "GenSigTimeoutTime_AGSM" SG_ 1031 Supported_ProtocolName 0;
BA_ "GenSigTimeoutTime_SGW" SG_ 1031 Supported_SchemaID 0;
BA_ "GenSigTimeoutTime_PBWM" SG_ 1031 Supported_SchemaID 0;
BA_ "GenSigTimeoutTime_IDCM" SG_ 1031 Supported_SchemaID 0;
BA_ "GenSigTimeoutTime_ECM" SG_ 1031 Supported_SchemaID 0;
BA_ "GenSigTimeoutTime_DMPI" SG_ 1031 Supported_SchemaID 0;
BA_ "GenSigTimeoutTime_BPCM" SG_ 1031 Supported_SchemaID 0;
BA_ "GenSigTimeoutTime_AGSM" SG_ 1031 Supported_SchemaID 0;
BA_ "GenSigTimeoutTime_BPCM" SG_ 1031 Supported_VerNumberMajor 0;
BA_ "GenSigTimeoutTime_AGSM" SG_ 1031 Supported_VerNumberMajor 0;
BA_ "GenSigTimeoutTime_SGW" SG_ 1031 Supported_VerNumberMajor 0;
BA_ "GenSigTimeoutTime_PBWM" SG_ 1031 Supported_VerNumberMajor 0;
BA_ "GenSigTimeoutTime_IDCM" SG_ 1031 Supported_VerNumberMajor 0;
BA_ "GenSigTimeoutTime_ECM" SG_ 1031 Supported_VerNumberMajor 0;
BA_ "GenSigTimeoutTime_DMPI" SG_ 1031 Supported_VerNumberMajor 0;
BA_ "GenSigTimeoutTime_SGW" SG_ 1031 Supported_VerNumberMinor 0;
BA_ "GenSigTimeoutTime_PBWM" SG_ 1031 Supported_VerNumberMinor 0;
BA_ "GenSigTimeoutTime_IDCM" SG_ 1031 Supported_VerNumberMinor 0;
BA_ "GenSigTimeoutTime_ECM" SG_ 1031 Supported_VerNumberMinor 0;
BA_ "GenSigTimeoutTime_DMPI" SG_ 1031 Supported_VerNumberMinor 0;
BA_ "GenSigTimeoutTime_BPCM" SG_ 1031 Supported_VerNumberMinor 0;
BA_ "GenSigTimeoutTime_AGSM" SG_ 1031 Supported_VerNumberMinor 0;
BA_ "GenSigTimeoutTime_PBWM" SG_ 1963 HVBatCellVoltage_Cell399 0;
BA_ "GenSigTimeoutTime_IDCM" SG_ 1963 HVBatCellVoltage_Cell399 0;
BA_ "GenSigTimeoutTime_EVCU2" SG_ 1963 HVBatCellVoltage_Cell399 0;
BA_ "GenSigTimeoutTime_ECM" SG_ 1963 HVBatCellVoltage_Cell399 0;
BA_ "GenSigTimeoutTime_DMPI" SG_ 1963 HVBatCellVoltage_Cell399 0;
BA_ "GenSigTimeoutTime_BPCM" SG_ 1963 HVBatCellVoltage_Cell399 0;
BA_ "GenSigTimeoutTime_AGSM" SG_ 1963 HVBatCellVoltage_Cell399 0;
BA_ "GenSigTimeoutTime_PBWM" SG_ 1963 HVBatCellVoltage_Cell400 0;
BA_ "GenSigTimeoutTime_IDCM" SG_ 1963 HVBatCellVoltage_Cell400 0;
BA_ "GenSigTimeoutTime_EVCU2" SG_ 1963 HVBatCellVoltage_Cell400 0;
BA_ "GenSigTimeoutTime_ECM" SG_ 1963 HVBatCellVoltage_Cell400 0;
BA_ "GenSigTimeoutTime_DMPI" SG_ 1963 HVBatCellVoltage_Cell400 0;
BA_ "GenSigTimeoutTime_BPCM" SG_ 1963 HVBatCellVoltage_Cell400 0;
BA_ "GenSigTimeoutTime_AGSM" SG_ 1963 HVBatCellVoltage_Cell400 0;
BA_ "GenSigTimeoutTime_PBWM" SG_ 1963 HVBatCellVoltage_Cell395 0;
BA_ "GenSigTimeoutTime_IDCM" SG_ 1963 HVBatCellVoltage_Cell395 0;
BA_ "GenSigTimeoutTime_EVCU2" SG_ 1963 HVBatCellVoltage_Cell395 0;
BA_ "GenSigTimeoutTime_ECM" SG_ 1963 HVBatCellVoltage_Cell395 0;
BA_ "GenSigTimeoutTime_DMPI" SG_ 1963 HVBatCellVoltage_Cell395 0;
BA_ "GenSigTimeoutTime_BPCM" SG_ 1963 HVBatCellVoltage_Cell395 0;
BA_ "GenSigTimeoutTime_AGSM" SG_ 1963 HVBatCellVoltage_Cell395 0;
BA_ "GenSigTimeoutTime_PBWM" SG_ 1963 HVBatCellVoltage_Cell396 0;
BA_ "GenSigTimeoutTime_IDCM" SG_ 1963 HVBatCellVoltage_Cell396 0;
BA_ "GenSigTimeoutTime_EVCU2" SG_ 1963 HVBatCellVoltage_Cell396 0;
BA_ "GenSigTimeoutTime_ECM" SG_ 1963 HVBatCellVoltage_Cell396 0;
BA_ "GenSigTimeoutTime_DMPI" SG_ 1963 HVBatCellVoltage_Cell396 0;
BA_ "GenSigTimeoutTime_BPCM" SG_ 1963 HVBatCellVoltage_Cell396 0;
BA_ "GenSigTimeoutTime_AGSM" SG_ 1963 HVBatCellVoltage_Cell396 0;
BA_ "GenSigTimeoutTime_PBWM" SG_ 1963 HVBatCellVoltage_Cell397 0;
BA_ "GenSigTimeoutTime_IDCM" SG_ 1963 HVBatCellVoltage_Cell397 0;
BA_ "GenSigTimeoutTime_EVCU2" SG_ 1963 HVBatCellVoltage_Cell397 0;
BA_ "GenSigTimeoutTime_ECM" SG_ 1963 HVBatCellVoltage_Cell397 0;
BA_ "GenSigTimeoutTime_DMPI" SG_ 1963 HVBatCellVoltage_Cell397 0;
BA_ "GenSigTimeoutTime_BPCM" SG_ 1963 HVBatCellVoltage_Cell397 0;
BA_ "GenSigTimeoutTime_AGSM" SG_ 1963 HVBatCellVoltage_Cell397 0;
BA_ "GenSigTimeoutTime_PBWM" SG_ 1963 HVBatCellVoltage_Cell398 0;
BA_ "GenSigTimeoutTime_IDCM" SG_ 1963 HVBatCellVoltage_Cell398 0;
BA_ "GenSigTimeoutTime_EVCU2" SG_ 1963 HVBatCellVoltage_Cell398 0;
BA_ "GenSigTimeoutTime_ECM" SG_ 1963 HVBatCellVoltage_Cell398 0;
BA_ "GenSigTimeoutTime_DMPI" SG_ 1963 HVBatCellVoltage_Cell398 0;
BA_ "GenSigTimeoutTime_BPCM" SG_ 1963 HVBatCellVoltage_Cell398 0;
BA_ "GenSigTimeoutTime_AGSM" SG_ 1963 HVBatCellVoltage_Cell398 0;
BA_ "GenSigTimeoutTime_PBWM" SG_ 1962 HVBatCellVoltage_Cell384 0;
BA_ "GenSigTimeoutTime_IDCM" SG_ 1962 HVBatCellVoltage_Cell384 0;
BA_ "GenSigTimeoutTime_EVCU2" SG_ 1962 HVBatCellVoltage_Cell384 0;
BA_ "GenSigTimeoutTime_PBWM" SG_ 1962 HVBatCellVoltage_Cell385 0;
BA_ "GenSigTimeoutTime_IDCM" SG_ 1962 HVBatCellVoltage_Cell385 0;
BA_ "GenSigTimeoutTime_EVCU2" SG_ 1962 HVBatCellVoltage_Cell385 0;
BA_ "GenSigTimeoutTime_ECM" SG_ 1962 HVBatCellVoltage_Cell385 0;
BA_ "GenSigTimeoutTime_DMPI" SG_ 1962 HVBatCellVoltage_Cell385 0;
BA_ "GenSigTimeoutTime_BPCM" SG_ 1962 HVBatCellVoltage_Cell385 0;
BA_ "GenSigTimeoutTime_AGSM" SG_ 1962 HVBatCellVoltage_Cell385 0;
BA_ "GenSigTimeoutTime_PBWM" SG_ 1962 HVBatCellVoltage_Cell386 0;
BA_ "GenSigTimeoutTime_IDCM" SG_ 1962 HVBatCellVoltage_Cell386 0;
BA_ "GenSigTimeoutTime_EVCU2" SG_ 1962 HVBatCellVoltage_Cell386 0;
BA_ "GenSigTimeoutTime_ECM" SG_ 1962 HVBatCellVoltage_Cell386 0;
BA_ "GenSigTimeoutTime_DMPI" SG_ 1962 HVBatCellVoltage_Cell386 0;
BA_ "GenSigTimeoutTime_BPCM" SG_ 1962 HVBatCellVoltage_Cell386 0;
BA_ "GenSigTimeoutTime_AGSM" SG_ 1962 HVBatCellVoltage_Cell386 0;
BA_ "GenSigTimeoutTime_PBWM" SG_ 1962 HVBatCellVoltage_Cell387 0;
BA_ "GenSigTimeoutTime_IDCM" SG_ 1962 HVBatCellVoltage_Cell387 0;
BA_ "GenSigTimeoutTime_EVCU2" SG_ 1962 HVBatCellVoltage_Cell387 0;
BA_ "GenSigTimeoutTime_ECM" SG_ 1962 HVBatCellVoltage_Cell387 0;
BA_ "GenSigTimeoutTime_DMPI" SG_ 1962 HVBatCellVoltage_Cell387 0;
BA_ "GenSigTimeoutTime_BPCM" SG_ 1962 HVBatCellVoltage_Cell387 0;
BA_ "GenSigTimeoutTime_AGSM" SG_ 1962 HVBatCellVoltage_Cell387 0;
BA_ "GenSigTimeoutTime_ECM" SG_ 1962 HVBatCellVoltage_Cell388 0;
BA_ "GenSigTimeoutTime_DMPI" SG_ 1962 HVBatCellVoltage_Cell388 0;
BA_ "GenSigTimeoutTime_BPCM" SG_ 1962 HVBatCellVoltage_Cell388 0;
BA_ "GenSigTimeoutTime_AGSM" SG_ 1962 HVBatCellVoltage_Cell388 0;
BA_ "GenSigTimeoutTime_PBWM" SG_ 1962 HVBatCellVoltage_Cell388 0;
BA_ "GenSigTimeoutTime_IDCM" SG_ 1962 HVBatCellVoltage_Cell388 0;
BA_ "GenSigTimeoutTime_EVCU2" SG_ 1962 HVBatCellVoltage_Cell388 0;
BA_ "GenSigTimeoutTime_PBWM" SG_ 1962 HVBatCellVoltage_Cell389 0;
BA_ "GenSigTimeoutTime_IDCM" SG_ 1962 HVBatCellVoltage_Cell389 0;
BA_ "GenSigTimeoutTime_EVCU2" SG_ 1962 HVBatCellVoltage_Cell389 0;
BA_ "GenSigTimeoutTime_ECM" SG_ 1962 HVBatCellVoltage_Cell389 0;
BA_ "GenSigTimeoutTime_DMPI" SG_ 1962 HVBatCellVoltage_Cell389 0;
BA_ "GenSigTimeoutTime_BPCM" SG_ 1962 HVBatCellVoltage_Cell389 0;
BA_ "GenSigTimeoutTime_AGSM" SG_ 1962 HVBatCellVoltage_Cell389 0;
BA_ "GenSigTimeoutTime_PBWM" SG_ 1962 HVBatCellVoltage_Cell390 0;
BA_ "GenSigTimeoutTime_IDCM" SG_ 1962 HVBatCellVoltage_Cell390 0;
BA_ "GenSigTimeoutTime_EVCU2" SG_ 1962 HVBatCellVoltage_Cell390 0;
BA_ "GenSigTimeoutTime_ECM" SG_ 1962 HVBatCellVoltage_Cell390 0;
BA_ "GenSigTimeoutTime_DMPI" SG_ 1962 HVBatCellVoltage_Cell390 0;
BA_ "GenSigTimeoutTime_BPCM" SG_ 1962 HVBatCellVoltage_Cell390 0;
BA_ "GenSigTimeoutTime_AGSM" SG_ 1962 HVBatCellVoltage_Cell390 0;
BA_ "GenSigTimeoutTime_PBWM" SG_ 1962 HVBatCellVoltage_Cell391 0;
BA_ "GenSigTimeoutTime_IDCM" SG_ 1962 HVBatCellVoltage_Cell391 0;
BA_ "GenSigTimeoutTime_EVCU2" SG_ 1962 HVBatCellVoltage_Cell391 0;
BA_ "GenSigTimeoutTime_ECM" SG_ 1962 HVBatCellVoltage_Cell391 0;
BA_ "GenSigTimeoutTime_DMPI" SG_ 1962 HVBatCellVoltage_Cell391 0;
BA_ "GenSigTimeoutTime_BPCM" SG_ 1962 HVBatCellVoltage_Cell391 0;
BA_ "GenSigTimeoutTime_AGSM" SG_ 1962 HVBatCellVoltage_Cell391 0;
BA_ "GenSigTimeoutTime_PBWM" SG_ 1962 HVBatCellVoltage_Cell392 0;
BA_ "GenSigTimeoutTime_IDCM" SG_ 1962 HVBatCellVoltage_Cell392 0;
BA_ "GenSigTimeoutTime_EVCU2" SG_ 1962 HVBatCellVoltage_Cell392 0;
BA_ "GenSigTimeoutTime_ECM" SG_ 1962 HVBatCellVoltage_Cell392 0;
BA_ "GenSigTimeoutTime_DMPI" SG_ 1962 HVBatCellVoltage_Cell392 0;
BA_ "GenSigTimeoutTime_BPCM" SG_ 1962 HVBatCellVoltage_Cell392 0;
BA_ "GenSigTimeoutTime_AGSM" SG_ 1962 HVBatCellVoltage_Cell392 0;
BA_ "GenSigTimeoutTime_PBWM" SG_ 1963 HVBatCellVoltage_Cell393 0;
BA_ "GenSigTimeoutTime_IDCM" SG_ 1963 HVBatCellVoltage_Cell393 0;
BA_ "GenSigTimeoutTime_EVCU2" SG_ 1963 HVBatCellVoltage_Cell393 0;
BA_ "GenSigTimeoutTime_ECM" SG_ 1963 HVBatCellVoltage_Cell393 0;
BA_ "GenSigTimeoutTime_DMPI" SG_ 1963 HVBatCellVoltage_Cell393 0;
BA_ "GenSigTimeoutTime_BPCM" SG_ 1963 HVBatCellVoltage_Cell393 0;
BA_ "GenSigTimeoutTime_AGSM" SG_ 1963 HVBatCellVoltage_Cell393 0;
BA_ "GenSigTimeoutTime_PBWM" SG_ 1963 HVBatCellVoltage_Cell394 0;
BA_ "GenSigTimeoutTime_IDCM" SG_ 1963 HVBatCellVoltage_Cell394 0;
BA_ "GenSigTimeoutTime_EVCU2" SG_ 1963 HVBatCellVoltage_Cell394 0;
BA_ "GenSigTimeoutTime_ECM" SG_ 1963 HVBatCellVoltage_Cell394 0;
BA_ "GenSigTimeoutTime_DMPI" SG_ 1963 HVBatCellVoltage_Cell394 0;
BA_ "GenSigTimeoutTime_BPCM" SG_ 1963 HVBatCellVoltage_Cell394 0;
BA_ "GenSigTimeoutTime_AGSM" SG_ 1963 HVBatCellVoltage_Cell394 0;
BA_ "GenSigTimeoutTime_ECM" SG_ 1962 HVBatCellVoltage_Cell384 0;
BA_ "GenSigTimeoutTime_DMPI" SG_ 1962 HVBatCellVoltage_Cell384 0;
BA_ "GenSigTimeoutTime_BPCM" SG_ 1962 HVBatCellVoltage_Cell384 0;
BA_ "GenSigTimeoutTime_AGSM" SG_ 1962 HVBatCellVoltage_Cell384 0;
BA_ "GenSigTimeoutTime_PBWM" SG_ 1962 HVBatCellVoltage_Cell383 0;
BA_ "GenSigTimeoutTime_IDCM" SG_ 1962 HVBatCellVoltage_Cell383 0;
BA_ "GenSigTimeoutTime_EVCU2" SG_ 1962 HVBatCellVoltage_Cell383 0;
BA_ "GenSigTimeoutTime_ECM" SG_ 1962 HVBatCellVoltage_Cell383 0;
BA_ "GenSigTimeoutTime_DMPI" SG_ 1962 HVBatCellVoltage_Cell383 0;
BA_ "GenSigTimeoutTime_BPCM" SG_ 1962 HVBatCellVoltage_Cell383 0;
BA_ "GenSigTimeoutTime_AGSM" SG_ 1962 HVBatCellVoltage_Cell383 0;
BA_ "GenSigTimeoutTime_PBWM" SG_ 1962 HVBatCellVoltage_Cell379 0;
BA_ "GenSigTimeoutTime_IDCM" SG_ 1962 HVBatCellVoltage_Cell379 0;
BA_ "GenSigTimeoutTime_EVCU2" SG_ 1962 HVBatCellVoltage_Cell379 0;
BA_ "GenSigTimeoutTime_ECM" SG_ 1962 HVBatCellVoltage_Cell379 0;
BA_ "GenSigTimeoutTime_DMPI" SG_ 1962 HVBatCellVoltage_Cell379 0;
BA_ "GenSigTimeoutTime_BPCM" SG_ 1962 HVBatCellVoltage_Cell379 0;
BA_ "GenSigTimeoutTime_AGSM" SG_ 1962 HVBatCellVoltage_Cell379 0;
BA_ "GenSigTimeoutTime_PBWM" SG_ 1962 HVBatCellVoltage_Cell380 0;
BA_ "GenSigTimeoutTime_IDCM" SG_ 1962 HVBatCellVoltage_Cell380 0;
BA_ "GenSigTimeoutTime_EVCU2" SG_ 1962 HVBatCellVoltage_Cell380 0;
BA_ "GenSigTimeoutTime_ECM" SG_ 1962 HVBatCellVoltage_Cell380 0;
BA_ "GenSigTimeoutTime_DMPI" SG_ 1962 HVBatCellVoltage_Cell380 0;
BA_ "GenSigTimeoutTime_BPCM" SG_ 1962 HVBatCellVoltage_Cell380 0;
BA_ "GenSigTimeoutTime_AGSM" SG_ 1962 HVBatCellVoltage_Cell380 0;
BA_ "GenSigTimeoutTime_DMPI" SG_ 1031 AC_Side_Volt3 0;
BA_ "GenSigTimeoutTime_BPCM" SG_ 1031 AC_Side_Volt3 0;
BA_ "GenSigTimeoutTime_AGSM" SG_ 1031 AC_Side_Volt3 0;
BA_ "GenSigTimeoutTime_PBWM" SG_ 1031 AC_Side_Volt2 0;
BA_ "GenSigTimeoutTime_IDCM" SG_ 1031 AC_Side_Volt2 0;
BA_ "GenSigTimeoutTime_ECM" SG_ 1031 AC_Side_Volt2 0;
BA_ "GenSigTimeoutTime_DMPI" SG_ 1031 AC_Side_Volt2 0;
BA_ "GenSigTimeoutTime_BPCM" SG_ 1031 AC_Side_Volt2 0;
BA_ "GenSigTimeoutTime_AGSM" SG_ 1031 AC_Side_Volt2 0;
BA_ "GenSigTimeoutTime_PBWM" SG_ 1031 AC_Side_Curr1 0;
BA_ "GenSigTimeoutTime_IDCM" SG_ 1031 AC_Side_Curr1 0;
BA_ "GenSigTimeoutTime_ECM" SG_ 1031 AC_Side_Curr1 0;
BA_ "GenSigTimeoutTime_DMPI" SG_ 1031 AC_Side_Curr1 0;
BA_ "GenSigTimeoutTime_BPCM" SG_ 1031 AC_Side_Curr1 0;
BA_ "GenSigTimeoutTime_AGSM" SG_ 1031 AC_Side_Curr1 0;
BA_ "GenSigStartValue" SG_ 1031 AC_Side_Curr1 1000;
BA_ "GenSigTimeoutTime_PBWM" SG_ 1031 AC_Side_Curr2 0;
BA_ "GenSigTimeoutTime_IDCM" SG_ 1031 AC_Side_Curr2 0;
BA_ "GenSigTimeoutTime_ECM" SG_ 1031 AC_Side_Curr2 0;
BA_ "GenSigTimeoutTime_DMPI" SG_ 1031 AC_Side_Curr2 0;
BA_ "GenSigTimeoutTime_BPCM" SG_ 1031 AC_Side_Curr2 0;
BA_ "GenSigTimeoutTime_AGSM" SG_ 1031 AC_Side_Curr2 0;
BA_ "GenSigStartValue" SG_ 1031 AC_Side_Curr2 1000;
BA_ "GenSigTimeoutTime_BPCM" SG_ 1031 ProximitySts 0;
BA_ "GenSigTimeoutTime_AGSM" SG_ 1031 ProximitySts 0;
BA_ "GenSigStartValue" SG_ 1031 ProximitySts 1;
BA_ "GenSigTimeoutTime_SGW" SG_ 1031 BatterySideCurrent 0;
BA_ "GenSigTimeoutTime_PBWM" SG_ 1031 BatterySideCurrent 0;
BA_ "GenSigTimeoutTime_IDCM" SG_ 1031 BatterySideCurrent 0;
BA_ "GenSigTimeoutTime_ECM" SG_ 1031 BatterySideCurrent 0;
BA_ "GenSigTimeoutTime_DMPI" SG_ 1031 BatterySideCurrent 0;
BA_ "GenSigTimeoutTime_BPCM" SG_ 1031 BatterySideCurrent 0;
BA_ "GenSigTimeoutTime_AGSM" SG_ 1031 BatterySideCurrent 0;
BA_ "GenSigTimeoutTime_SGW" SG_ 1031 AC_Present 0;
BA_ "GenSigTimeoutTime_PBWM" SG_ 1031 AC_Present 0;
BA_ "GenSigTimeoutTime_IDCM" SG_ 1031 AC_Present 0;
BA_ "GenSigTimeoutTime_ECM" SG_ 1031 AC_Present 0;
BA_ "GenSigTimeoutTime_DMPI" SG_ 1031 AC_Present 0;
BA_ "GenSigTimeoutTime_BPCM" SG_ 1031 AC_Present 0;
BA_ "GenSigTimeoutTime_AGSM" SG_ 1031 AC_Present 0;
BA_ "GenSigTimeoutTime_SGW" SG_ 1031 ChargeCurrent 0;
BA_ "GenSigTimeoutTime_PBWM" SG_ 1031 ChargeCurrent 0;
BA_ "GenSigTimeoutTime_IDCM" SG_ 1031 ChargeCurrent 0;
BA_ "GenSigTimeoutTime_ECM" SG_ 1031 ChargeCurrent 0;
BA_ "GenSigTimeoutTime_DMPI" SG_ 1031 ChargeCurrent 0;
BA_ "GenSigTimeoutTime_BPCM" SG_ 1031 ChargeCurrent 0;
BA_ "GenSigTimeoutTime_AGSM" SG_ 1031 ChargeCurrent 0;
BA_ "GenSigTimeoutTime_SGW" SG_ 1031 ChargeCurrentAvailable 0;
BA_ "GenSigTimeoutTime_PBWM" SG_ 1031 ChargeCurrentAvailable 0;
BA_ "GenSigTimeoutTime_IDCM" SG_ 1031 ChargeCurrentAvailable 0;
BA_ "GenSigTimeoutTime_ECM" SG_ 1031 ChargeCurrentAvailable 0;
BA_ "GenSigTimeoutTime_DMPI" SG_ 1031 ChargeCurrentAvailable 0;
BA_ "GenSigTimeoutTime_BPCM" SG_ 1031 ChargeCurrentAvailable 0;
BA_ "GenSigTimeoutTime_AGSM" SG_ 1031 ChargeCurrentAvailable 0;
BA_ "GenSigTimeoutTime_SGW" SG_ 1031 ChargeEnableSts 0;
BA_ "GenSigTimeoutTime_PBWM" SG_ 1031 ChargeEnableSts 0;
BA_ "GenSigTimeoutTime_IDCM" SG_ 1031 ChargeEnableSts 0;
BA_ "GenSigTimeoutTime_ECM" SG_ 1031 ChargeEnableSts 0;
BA_ "GenSigTimeoutTime_DMPI" SG_ 1031 ChargeEnableSts 0;
BA_ "GenSigTimeoutTime_BPCM" SG_ 1031 ChargeEnableSts 0;
BA_ "GenSigTimeoutTime_AGSM" SG_ 1031 ChargeEnableSts 0;
BA_ "GenSigTimeoutTime_SGW" SG_ 1031 ControlPilotSts 0;
BA_ "GenSigTimeoutTime_PBWM" SG_ 1031 ControlPilotSts 0;
BA_ "GenSigTimeoutTime_IDCM" SG_ 1031 ControlPilotSts 0;
BA_ "GenSigTimeoutTime_ECM" SG_ 1031 ControlPilotSts 0;
BA_ "GenSigTimeoutTime_DMPI" SG_ 1031 ControlPilotSts 0;
BA_ "GenSigTimeoutTime_BPCM" SG_ 1031 ControlPilotSts 0;
BA_ "GenSigTimeoutTime_AGSM" SG_ 1031 ControlPilotSts 0;
BA_ "GenSigTimeoutTime_SGW" SG_ 1031 HV_Overcurrent 0;
BA_ "GenSigTimeoutTime_PBWM" SG_ 1031 HV_Overcurrent 0;
BA_ "GenSigTimeoutTime_IDCM" SG_ 1031 HV_Overcurrent 0;
BA_ "GenSigTimeoutTime_ECM" SG_ 1031 HV_Overcurrent 0;
BA_ "GenSigTimeoutTime_DMPI" SG_ 1031 HV_Overcurrent 0;
BA_ "GenSigTimeoutTime_BPCM" SG_ 1031 HV_Overcurrent 0;
BA_ "GenSigTimeoutTime_AGSM" SG_ 1031 HV_Overcurrent 0;
BA_ "GenSigTimeoutTime_SGW" SG_ 1031 HV_Overvoltage 0;
BA_ "GenSigTimeoutTime_PBWM" SG_ 1031 HV_Overvoltage 0;
BA_ "GenSigTimeoutTime_IDCM" SG_ 1031 HV_Overvoltage 0;
BA_ "GenSigTimeoutTime_ECM" SG_ 1031 HV_Overvoltage 0;
BA_ "GenSigTimeoutTime_DMPI" SG_ 1031 HV_Overvoltage 0;
BA_ "GenSigTimeoutTime_BPCM" SG_ 1031 HV_Overvoltage 0;
BA_ "GenSigTimeoutTime_AGSM" SG_ 1031 HV_Overvoltage 0;
BA_ "GenSigTimeoutTime_SGW" SG_ 1031 InputVoltage_is60Hz 0;
BA_ "GenSigTimeoutTime_PBWM" SG_ 1031 InputVoltage_is60Hz 0;
BA_ "GenSigTimeoutTime_IDCM" SG_ 1031 InputVoltage_is60Hz 0;
BA_ "GenSigTimeoutTime_ECM" SG_ 1031 InputVoltage_is60Hz 0;
BA_ "GenSigTimeoutTime_DMPI" SG_ 1031 InputVoltage_is60Hz 0;
BA_ "GenSigTimeoutTime_BPCM" SG_ 1031 InputVoltage_is60Hz 0;
BA_ "GenSigTimeoutTime_AGSM" SG_ 1031 InputVoltage_is60Hz 0;
BA_ "GenSigStartValue" SG_ 1031 InputVoltage_is60Hz 1;
BA_ "GenSigTimeoutTime_SGW" SG_ 1031 InputVoltage_isAC 0;
BA_ "GenSigTimeoutTime_PBWM" SG_ 1031 InputVoltage_isAC 0;
BA_ "GenSigTimeoutTime_IDCM" SG_ 1031 InputVoltage_isAC 0;
BA_ "GenSigTimeoutTime_ECM" SG_ 1031 InputVoltage_isAC 0;
BA_ "GenSigTimeoutTime_DMPI" SG_ 1031 InputVoltage_isAC 0;
BA_ "GenSigTimeoutTime_BPCM" SG_ 1031 InputVoltage_isAC 0;
BA_ "GenSigTimeoutTime_AGSM" SG_ 1031 InputVoltage_isAC 0;
BA_ "GenSigStartValue" SG_ 1031 InputVoltage_isAC 1;
BA_ "GenSigTimeoutTime_SGW" SG_ 1031 J1772_S2_Sts 0;
BA_ "GenSigTimeoutTime_PBWM" SG_ 1031 J1772_S2_Sts 0;
BA_ "GenSigTimeoutTime_IDCM" SG_ 1031 J1772_S2_Sts 0;
BA_ "GenSigTimeoutTime_ECM" SG_ 1031 J1772_S2_Sts 0;
BA_ "GenSigTimeoutTime_DMPI" SG_ 1031 J1772_S2_Sts 0;
BA_ "GenSigTimeoutTime_BPCM" SG_ 1031 J1772_S2_Sts 0;
BA_ "GenSigTimeoutTime_AGSM" SG_ 1031 J1772_S2_Sts 0;
BA_ "GenSigTimeoutTime_SGW" SG_ 1031 J1772_State 0;
BA_ "GenSigTimeoutTime_PBWM" SG_ 1031 J1772_State 0;
BA_ "GenSigTimeoutTime_IDCM" SG_ 1031 J1772_State 0;
BA_ "GenSigTimeoutTime_ECM" SG_ 1031 J1772_State 0;
BA_ "GenSigTimeoutTime_DMPI" SG_ 1031 J1772_State 0;
BA_ "GenSigTimeoutTime_BPCM" SG_ 1031 J1772_State 0;
BA_ "GenSigTimeoutTime_AGSM" SG_ 1031 J1772_State 0;
BA_ "GenSigTimeoutTime_SGW" SG_ 1031 OBC_DeratingReason 0;
BA_ "GenSigTimeoutTime_PBWM" SG_ 1031 OBC_DeratingReason 0;
BA_ "GenSigTimeoutTime_IDCM" SG_ 1031 OBC_DeratingReason 0;
BA_ "GenSigTimeoutTime_ECM" SG_ 1031 OBC_DeratingReason 0;
BA_ "GenSigTimeoutTime_DMPI" SG_ 1031 OBC_DeratingReason 0;
BA_ "GenSigTimeoutTime_BPCM" SG_ 1031 OBC_DeratingReason 0;
BA_ "GenSigTimeoutTime_AGSM" SG_ 1031 OBC_DeratingReason 0;
BA_ "GenSigTimeoutTime_SGW" SG_ 1031 OBCInterlockSts 0;
BA_ "GenSigTimeoutTime_PBWM" SG_ 1031 OBCInterlockSts 0;
BA_ "GenSigTimeoutTime_IDCM" SG_ 1031 OBCInterlockSts 0;
BA_ "GenSigTimeoutTime_ECM" SG_ 1031 OBCInterlockSts 0;
BA_ "GenSigTimeoutTime_DMPI" SG_ 1031 OBCInterlockSts 0;
BA_ "GenSigTimeoutTime_BPCM" SG_ 1031 OBCInterlockSts 0;
BA_ "GenSigTimeoutTime_AGSM" SG_ 1031 OBCInterlockSts 0;
BA_ "GenSigTimeoutTime_SGW" SG_ 1031 OBCM_SdpSts 0;
BA_ "GenSigTimeoutTime_PBWM" SG_ 1031 OBCM_SdpSts 0;
BA_ "GenSigTimeoutTime_IDCM" SG_ 1031 OBCM_SdpSts 0;
BA_ "GenSigTimeoutTime_ECM" SG_ 1031 OBCM_SdpSts 0;
BA_ "GenSigTimeoutTime_DMPI" SG_ 1031 OBCM_SdpSts 0;
BA_ "GenSigTimeoutTime_BPCM" SG_ 1031 OBCM_SdpSts 0;
BA_ "GenSigTimeoutTime_AGSM" SG_ 1031 OBCM_SdpSts 0;
BA_ "GenSigTimeoutTime_SGW" SG_ 1031 OBCM_SlacSts 0;
BA_ "GenSigTimeoutTime_PBWM" SG_ 1031 OBCM_SlacSts 0;
BA_ "GenSigTimeoutTime_IDCM" SG_ 1031 OBCM_SlacSts 0;
BA_ "GenSigTimeoutTime_ECM" SG_ 1031 OBCM_SlacSts 0;
BA_ "GenSigTimeoutTime_DMPI" SG_ 1031 OBCM_SlacSts 0;
BA_ "GenSigTimeoutTime_BPCM" SG_ 1031 OBCM_SlacSts 0;
BA_ "GenSigTimeoutTime_AGSM" SG_ 1031 OBCM_SlacSts 0;
BA_ "GenSigTimeoutTime_SGW" SG_ 1031 EVCC_FailureReason 0;
BA_ "GenSigTimeoutTime_PBWM" SG_ 1031 EVCC_FailureReason 0;
BA_ "GenSigTimeoutTime_IDCM" SG_ 1031 EVCC_FailureReason 0;
BA_ "GenSigTimeoutTime_ECM" SG_ 1031 EVCC_FailureReason 0;
BA_ "GenSigTimeoutTime_DMPI" SG_ 1031 EVCC_FailureReason 0;
BA_ "GenSigTimeoutTime_BPCM" SG_ 1031 EVCC_FailureReason 0;
BA_ "GenSigTimeoutTime_AGSM" SG_ 1031 EVCC_FailureReason 0;
BA_ "GenSigTimeoutTime_SGW" SG_ 1031 MessageCounter_HV_CHARGER1 0;
BA_ "GenSigTimeoutTime_PBWM" SG_ 1031 MessageCounter_HV_CHARGER1 0;
BA_ "GenSigTimeoutTime_IDCM" SG_ 1031 MessageCounter_HV_CHARGER1 0;
BA_ "GenSigTimeoutTime_ECM" SG_ 1031 MessageCounter_HV_CHARGER1 0;
BA_ "GenSigTimeoutTime_DMPI" SG_ 1031 MessageCounter_HV_CHARGER1 0;
BA_ "GenSigTimeoutTime_BPCM" SG_ 1031 MessageCounter_HV_CHARGER1 0;
BA_ "GenSigTimeoutTime_AGSM" SG_ 1031 MessageCounter_HV_CHARGER1 0;
BA_ "GenSigTimeoutTime_SGW" SG_ 1031 CRC_HV_CHARGER1 0;
BA_ "GenSigTimeoutTime_PBWM" SG_ 1031 CRC_HV_CHARGER1 0;
BA_ "GenSigTimeoutTime_IDCM" SG_ 1031 CRC_HV_CHARGER1 0;
BA_ "GenSigTimeoutTime_ECM" SG_ 1031 CRC_HV_CHARGER1 0;
BA_ "GenSigTimeoutTime_DMPI" SG_ 1031 CRC_HV_CHARGER1 0;
BA_ "GenSigTimeoutTime_BPCM" SG_ 1031 CRC_HV_CHARGER1 0;
BA_ "GenSigTimeoutTime_AGSM" SG_ 1031 CRC_HV_CHARGER1 0;
BA_ "GenSigTimeoutTime_SGW" SG_ 1031 BatterySideVoltage 0;
BA_ "GenSigTimeoutTime_PBWM" SG_ 1031 BatterySideVoltage 0;
BA_ "GenSigTimeoutTime_IDCM" SG_ 1031 BatterySideVoltage 0;
BA_ "GenSigTimeoutTime_ECM" SG_ 1031 BatterySideVoltage 0;
BA_ "GenSigTimeoutTime_DMPI" SG_ 1031 BatterySideVoltage 0;
BA_ "GenSigTimeoutTime_BPCM" SG_ 1031 BatterySideVoltage 0;
BA_ "GenSigTimeoutTime_AGSM" SG_ 1031 BatterySideVoltage 0;
BA_ "GenSigTimeoutTime_PBWM" SG_ 1031 Plug_And_Charge_Contract_Sts 0;
BA_ "GenSigTimeoutTime_IDCM" SG_ 1031 Plug_And_Charge_Contract_Sts 0;
BA_ "GenSigTimeoutTime_EVCU2" SG_ 1031 Plug_And_Charge_Contract_Sts 0;
BA_ "GenSigTimeoutTime_ECM" SG_ 1031 Plug_And_Charge_Contract_Sts 0;
BA_ "GenSigTimeoutTime_DMPI" SG_ 1031 Plug_And_Charge_Contract_Sts 0;
BA_ "GenSigTimeoutTime_BPCM" SG_ 1031 Plug_And_Charge_Contract_Sts 0;
BA_ "GenSigTimeoutTime_AGSM" SG_ 1031 Plug_And_Charge_Contract_Sts 0;
BA_ "GenSigTimeoutTime_SGW" SG_ 1031 EVSENominalVoltage 0;
BA_ "GenSigTimeoutTime_PBWM" SG_ 1031 EVSENominalVoltage 0;
BA_ "GenSigTimeoutTime_IDCM" SG_ 1031 EVSENominalVoltage 0;
BA_ "GenSigTimeoutTime_ECM" SG_ 1031 EVSENominalVoltage 0;
BA_ "GenSigTimeoutTime_DMPI" SG_ 1031 EVSENominalVoltage 0;
BA_ "GenSigTimeoutTime_BPCM" SG_ 1031 EVSENominalVoltage 0;
BA_ "GenSigTimeoutTime_AGSM" SG_ 1031 EVSENominalVoltage 0;
BA_ "GenSigTimeoutTime_SGW" SG_ 1031 EVSEMaxCurrent 0;
BA_ "GenSigTimeoutTime_PBWM" SG_ 1031 EVSEMaxCurrent 0;
BA_ "GenSigTimeoutTime_IDCM" SG_ 1031 EVSEMaxCurrent 0;
BA_ "GenSigTimeoutTime_ECM" SG_ 1031 EVSEMaxCurrent 0;
BA_ "GenSigTimeoutTime_DMPI" SG_ 1031 EVSEMaxCurrent 0;
BA_ "GenSigTimeoutTime_BPCM" SG_ 1031 EVSEMaxCurrent 0;
BA_ "GenSigTimeoutTime_AGSM" SG_ 1031 EVSEMaxCurrent 0;
BA_ "GenSigTimeoutTime_SGW" SG_ 1031 AC_LnLow 0;
BA_ "GenSigTimeoutTime_PBWM" SG_ 1031 AC_LnLow 0;
BA_ "GenSigTimeoutTime_IDCM" SG_ 1031 AC_LnLow 0;
BA_ "GenSigTimeoutTime_ECM" SG_ 1031 AC_LnLow 0;
BA_ "GenSigTimeoutTime_DMPI" SG_ 1031 AC_LnLow 0;
BA_ "GenSigTimeoutTime_BPCM" SG_ 1031 AC_LnLow 0;
BA_ "GenSigTimeoutTime_AGSM" SG_ 1031 AC_LnLow 0;
BA_ "GenSigTimeoutTime_SGW" SG_ 1031 AC_LnHi 0;
BA_ "GenSigTimeoutTime_PBWM" SG_ 1031 AC_LnHi 0;
BA_ "GenSigTimeoutTime_IDCM" SG_ 1031 AC_LnHi 0;
BA_ "GenSigTimeoutTime_ECM" SG_ 1031 AC_LnHi 0;
BA_ "GenSigTimeoutTime_DMPI" SG_ 1031 AC_LnHi 0;
BA_ "GenSigTimeoutTime_BPCM" SG_ 1031 AC_LnHi 0;
BA_ "GenSigTimeoutTime_AGSM" SG_ 1031 AC_LnHi 0;
BA_ "GenSigTimeoutTime_SGW" SG_ 1031 AC_HighLoadWarning 0;
BA_ "GenSigTimeoutTime_PBWM" SG_ 1031 AC_HighLoadWarning 0;
BA_ "GenSigTimeoutTime_IDCM" SG_ 1031 AC_HighLoadWarning 0;
BA_ "GenSigTimeoutTime_ECM" SG_ 1031 AC_HighLoadWarning 0;
BA_ "GenSigTimeoutTime_DMPI" SG_ 1031 AC_HighLoadWarning 0;
BA_ "GenSigTimeoutTime_BPCM" SG_ 1031 AC_HighLoadWarning 0;
BA_ "GenSigTimeoutTime_AGSM" SG_ 1031 AC_HighLoadWarning 0;
BA_ "GenSigTimeoutTime_SGW" SG_ 2564429045 N_PDU 0;
BA_ "GenSigTimeoutTime_PBWM" SG_ 2564429045 N_PDU 0;
BA_ "GenSigTimeoutTime_IDCM" SG_ 2564429045 N_PDU 0;
BA_ "GenSigTimeoutTime_EVCU2" SG_ 2564429045 N_PDU 0;
BA_ "GenSigTimeoutTime_ECM" SG_ 2564429045 N_PDU 0;
BA_ "GenSigTimeoutTime_DMPI" SG_ 2564429045 N_PDU 0;
BA_ "GenSigTimeoutTime_BPCM" SG_ 2564429045 N_PDU 0;
BA_ "GenSigTimeoutTime_AGSM" SG_ 2564429045 N_PDU 0;
BA_ "GenSigTimeoutTime_SGW" SG_ 2564429301 N_PDU 0;
BA_ "GenSigTimeoutTime_PBWM" SG_ 2564429301 N_PDU 0;
BA_ "GenSigTimeoutTime_IDCM" SG_ 2564429301 N_PDU 0;
BA_ "GenSigTimeoutTime_EVCU2" SG_ 2564429301 N_PDU 0;
BA_ "GenSigTimeoutTime_ECM" SG_ 2564429301 N_PDU 0;
BA_ "GenSigTimeoutTime_DMPI" SG_ 2564429301 N_PDU 0;
BA_ "GenSigTimeoutTime_BPCM" SG_ 2564429301 N_PDU 0;
BA_ "GenSigTimeoutTime_AGSM" SG_ 2564429301 N_PDU 0;
BA_ "GenSigTimeoutTime_SGW" SG_ 2564554485 N_PDU 0;
BA_ "GenSigTimeoutTime_PBWM" SG_ 2564554485 N_PDU 0;
BA_ "GenSigTimeoutTime_IDCM" SG_ 2564554485 N_PDU 0;
BA_ "GenSigTimeoutTime_EVCU2" SG_ 2564554485 N_PDU 0;
BA_ "GenSigTimeoutTime_ECM" SG_ 2564554485 N_PDU 0;
BA_ "GenSigTimeoutTime_DMPI" SG_ 2564554485 N_PDU 0;
BA_ "GenSigTimeoutTime_BPCM" SG_ 2564554485 N_PDU 0;
BA_ "GenSigTimeoutTime_AGSM" SG_ 2564554485 N_PDU 0;
BA_ "GenSigTimeoutTime_IDCM" SG_ 2564485698 N_PDU 0;
BA_ "GenSigTimeoutTime_EVCU2" SG_ 2564485698 N_PDU 0;
BA_ "GenSigTimeoutTime_ECM" SG_ 2564485698 N_PDU 0;
BA_ "GenSigTimeoutTime_DMPI" SG_ 2564485698 N_PDU 0;
BA_ "GenSigTimeoutTime_BPCM" SG_ 2564485698 N_PDU 0;
BA_ "GenSigTimeoutTime_AGSM" SG_ 2564485698 N_PDU 0;
BA_ "GenSigTimeoutTime_SGW" SG_ 2564440818 N_PDU 0;
BA_ "GenSigTimeoutTime_PBWM" SG_ 2564440818 N_PDU 0;
BA_ "GenSigTimeoutTime_IDCM" SG_ 2564440818 N_PDU 0;
BA_ "GenSigTimeoutTime_EVCU2" SG_ 2564440818 N_PDU 0;
BA_ "GenSigTimeoutTime_ECM" SG_ 2564440818 N_PDU 0;
BA_ "GenSigTimeoutTime_DMPI" SG_ 2564440818 N_PDU 0;
BA_ "GenSigTimeoutTime_BPCM" SG_ 2564440818 N_PDU 0;
BA_ "GenSigTimeoutTime_AGSM" SG_ 2564440818 N_PDU 0;
BA_ "GenSigTimeoutTime_SGW" SG_ 2564441333 N_PDU 0;
BA_ "GenSigTimeoutTime_PBWM" SG_ 2564441333 N_PDU 0;
BA_ "GenSigTimeoutTime_IDCM" SG_ 2564441333 N_PDU 0;
BA_ "GenSigTimeoutTime_EVCU2" SG_ 2564441333 N_PDU 0;
BA_ "GenSigTimeoutTime_ECM" SG_ 2564441333 N_PDU 0;
BA_ "GenSigTimeoutTime_DMPI" SG_ 2564441333 N_PDU 0;
BA_ "GenSigTimeoutTime_BPCM" SG_ 2564441333 N_PDU 0;
BA_ "GenSigTimeoutTime_AGSM" SG_ 2564441333 N_PDU 0;
BA_ "GenSigTimeoutTime_SGW" SG_ 292 MessageCounter_BATT_HV_STATUS1 0;
BA_ "GenSigTimeoutTime_PBWM" SG_ 292 MessageCounter_BATT_HV_STATUS1 0;
BA_ "GenSigTimeoutTime_ECM" SG_ 292 MessageCounter_BATT_HV_STATUS1 0;
BA_ "GenSigTimeoutTime_SGW" SG_ 485 CRC_BATT_HV_VLIMITS 0;
BA_ "GenSigTimeoutTime_PBWM" SG_ 485 CRC_BATT_HV_VLIMITS 0;
BA_ "GenSigTimeoutTime_IDCM" SG_ 485 CRC_BATT_HV_VLIMITS 0;
BA_ "GenSigTimeoutTime_ECM" SG_ 485 CRC_BATT_HV_VLIMITS 0;
BA_ "GenSigTimeoutTime_DMPI" SG_ 485 CRC_BATT_HV_VLIMITS 0;
BA_ "GenSigTimeoutTime_BPCM" SG_ 485 CRC_BATT_HV_VLIMITS 0;
BA_ "GenSigTimeoutTime_AGSM" SG_ 485 CRC_BATT_HV_VLIMITS 0;
BA_ "GenSigTimeoutTime_SGW" SG_ 485 MessageCounter_BATT_HV_VLIMITS 0;
BA_ "GenSigTimeoutTime_PBWM" SG_ 485 MessageCounter_BATT_HV_VLIMITS 0;
BA_ "GenSigTimeoutTime_IDCM" SG_ 485 MessageCounter_BATT_HV_VLIMITS 0;
BA_ "GenSigTimeoutTime_ECM" SG_ 485 MessageCounter_BATT_HV_VLIMITS 0;
BA_ "GenSigTimeoutTime_DMPI" SG_ 485 MessageCounter_BATT_HV_VLIMITS 0;
BA_ "GenSigTimeoutTime_BPCM" SG_ 485 MessageCounter_BATT_HV_VLIMITS 0;
BA_ "GenSigTimeoutTime_AGSM" SG_ 485 MessageCounter_BATT_HV_VLIMITS 0;
BA_ "GenSigTimeoutTime_SGW" SG_ 485 BPCM_HV_NumCellMinTemp 0;
BA_ "GenSigTimeoutTime_PBWM" SG_ 485 BPCM_HV_NumCellMinTemp 0;
BA_ "GenSigTimeoutTime_IDCM" SG_ 485 BPCM_HV_NumCellMinTemp 0;
BA_ "GenSigTimeoutTime_ECM" SG_ 485 BPCM_HV_NumCellMinTemp 0;
BA_ "GenSigTimeoutTime_DMPI" SG_ 485 BPCM_HV_NumCellMinTemp 0;
BA_ "GenSigTimeoutTime_BPCM" SG_ 485 BPCM_HV_NumCellMinTemp 0;
BA_ "GenSigTimeoutTime_AGSM" SG_ 485 BPCM_HV_NumCellMinTemp 0;
BA_ "GenSigTimeoutTime_SGW" SG_ 485 BPCM_HV_NumCellMaxTemp 0;
BA_ "GenSigTimeoutTime_PBWM" SG_ 485 BPCM_HV_NumCellMaxTemp 0;
BA_ "GenSigTimeoutTime_IDCM" SG_ 485 BPCM_HV_NumCellMaxTemp 0;
BA_ "GenSigTimeoutTime_ECM" SG_ 485 BPCM_HV_NumCellMaxTemp 0;
BA_ "GenSigTimeoutTime_DMPI" SG_ 485 BPCM_HV_NumCellMaxTemp 0;
BA_ "GenSigTimeoutTime_BPCM" SG_ 485 BPCM_HV_NumCellMaxTemp 0;
BA_ "GenSigTimeoutTime_AGSM" SG_ 485 BPCM_HV_NumCellMaxTemp 0;
BA_ "GenSigTimeoutTime_SGW" SG_ 485 BPCM_HV_NumCellMaxVolt 0;
BA_ "GenSigTimeoutTime_PBWM" SG_ 485 BPCM_HV_NumCellMaxVolt 0;
BA_ "GenSigTimeoutTime_IDCM" SG_ 485 BPCM_HV_NumCellMaxVolt 0;
BA_ "GenSigTimeoutTime_ECM" SG_ 485 BPCM_HV_NumCellMaxVolt 0;
BA_ "GenSigTimeoutTime_DMPI" SG_ 485 BPCM_HV_NumCellMaxVolt 0;
BA_ "GenSigTimeoutTime_BPCM" SG_ 485 BPCM_HV_NumCellMaxVolt 0;
BA_ "GenSigTimeoutTime_AGSM" SG_ 485 BPCM_HV_NumCellMaxVolt 0;
BA_ "GenSigTimeoutTime_SGW" SG_ 485 BPCM_HV_NumCellMinVolt 0;
BA_ "GenSigTimeoutTime_PBWM" SG_ 485 BPCM_HV_NumCellMinVolt 0;
BA_ "GenSigTimeoutTime_IDCM" SG_ 485 BPCM_HV_NumCellMinVolt 0;
BA_ "GenSigTimeoutTime_ECM" SG_ 485 BPCM_HV_NumCellMinVolt 0;
BA_ "GenSigTimeoutTime_DMPI" SG_ 485 BPCM_HV_NumCellMinVolt 0;
BA_ "GenSigTimeoutTime_BPCM" SG_ 485 BPCM_HV_NumCellMinVolt 0;
BA_ "GenSigTimeoutTime_AGSM" SG_ 485 BPCM_HV_NumCellMinVolt 0;
BA_ "GenSigTimeoutTime_SGW" SG_ 485 BPCM_Max_Pk_Volt_Allowed 0;
BA_ "GenSigTimeoutTime_PBWM" SG_ 485 BPCM_Max_Pk_Volt_Allowed 0;
BA_ "GenSigTimeoutTime_IDCM" SG_ 485 BPCM_Max_Pk_Volt_Allowed 0;
BA_ "GenSigTimeoutTime_ECM" SG_ 485 BPCM_Max_Pk_Volt_Allowed 0;
BA_ "GenSigTimeoutTime_DMPI" SG_ 485 BPCM_Max_Pk_Volt_Allowed 0;
BA_ "GenSigTimeoutTime_BPCM" SG_ 485 BPCM_Max_Pk_Volt_Allowed 0;
BA_ "GenSigTimeoutTime_AGSM" SG_ 485 BPCM_Max_Pk_Volt_Allowed 0;
BA_ "GenSigTimeoutTime_SGW" SG_ 485 BPCM_Min_Pk_Volt_Allowed 0;
BA_ "GenSigTimeoutTime_PBWM" SG_ 485 BPCM_Min_Pk_Volt_Allowed 0;
BA_ "GenSigTimeoutTime_IDCM" SG_ 485 BPCM_Min_Pk_Volt_Allowed 0;
BA_ "GenSigTimeoutTime_ECM" SG_ 485 BPCM_Min_Pk_Volt_Allowed 0;
BA_ "GenSigTimeoutTime_DMPI" SG_ 485 BPCM_Min_Pk_Volt_Allowed 0;
BA_ "GenSigTimeoutTime_BPCM" SG_ 485 BPCM_Min_Pk_Volt_Allowed 0;
BA_ "GenSigTimeoutTime_AGSM" SG_ 485 BPCM_Min_Pk_Volt_Allowed 0;
BA_ "GenSigTimeoutTime_SGW" SG_ 485 BPCM_OCV_Avg_Cell_Volt 0;
BA_ "GenSigTimeoutTime_PBWM" SG_ 485 BPCM_OCV_Avg_Cell_Volt 0;
BA_ "GenSigTimeoutTime_IDCM" SG_ 485 BPCM_OCV_Avg_Cell_Volt 0;
BA_ "GenSigTimeoutTime_ECM" SG_ 485 BPCM_OCV_Avg_Cell_Volt 0;
BA_ "GenSigTimeoutTime_DMPI" SG_ 485 BPCM_OCV_Avg_Cell_Volt 0;
BA_ "GenSigTimeoutTime_BPCM" SG_ 485 BPCM_OCV_Avg_Cell_Volt 0;
BA_ "GenSigTimeoutTime_AGSM" SG_ 485 BPCM_OCV_Avg_Cell_Volt 0;
BA_ "GenSigTimeoutTime_SGW" SG_ 485 BPCM_OCV_Max_Cell_Volt 0;
BA_ "GenSigTimeoutTime_PBWM" SG_ 485 BPCM_OCV_Max_Cell_Volt 0;
BA_ "GenSigTimeoutTime_IDCM" SG_ 485 BPCM_OCV_Max_Cell_Volt 0;
BA_ "GenSigTimeoutTime_ECM" SG_ 485 BPCM_OCV_Max_Cell_Volt 0;
BA_ "GenSigTimeoutTime_DMPI" SG_ 485 BPCM_OCV_Max_Cell_Volt 0;
BA_ "GenSigTimeoutTime_BPCM" SG_ 485 BPCM_OCV_Max_Cell_Volt 0;
BA_ "GenSigTimeoutTime_AGSM" SG_ 485 BPCM_OCV_Max_Cell_Volt 0;
BA_ "GenSigTimeoutTime_SGW" SG_ 485 BPCM_OCV_Min_Cell_Volt 0;
BA_ "GenSigTimeoutTime_PBWM" SG_ 485 BPCM_OCV_Min_Cell_Volt 0;
BA_ "GenSigTimeoutTime_IDCM" SG_ 485 BPCM_OCV_Min_Cell_Volt 0;
BA_ "GenSigTimeoutTime_ECM" SG_ 485 BPCM_OCV_Min_Cell_Volt 0;
BA_ "GenSigTimeoutTime_DMPI" SG_ 485 BPCM_OCV_Min_Cell_Volt 0;
BA_ "GenSigTimeoutTime_BPCM" SG_ 485 BPCM_OCV_Min_Cell_Volt 0;
BA_ "GenSigTimeoutTime_AGSM" SG_ 485 BPCM_OCV_Min_Cell_Volt 0;
BA_ "GenSigTimeoutTime_SGW" SG_ 485 BPCM_Max_Cell_Volt_Allowed 0;
BA_ "GenSigTimeoutTime_PBWM" SG_ 485 BPCM_Max_Cell_Volt_Allowed 0;
BA_ "GenSigTimeoutTime_IDCM" SG_ 485 BPCM_Max_Cell_Volt_Allowed 0;
BA_ "GenSigTimeoutTime_ECM" SG_ 485 BPCM_Max_Cell_Volt_Allowed 0;
BA_ "GenSigTimeoutTime_DMPI" SG_ 485 BPCM_Max_Cell_Volt_Allowed 0;
BA_ "GenSigTimeoutTime_BPCM" SG_ 485 BPCM_Max_Cell_Volt_Allowed 0;
BA_ "GenSigTimeoutTime_AGSM" SG_ 485 BPCM_Max_Cell_Volt_Allowed 0;
BA_ "GenSigTimeoutTime_SGW" SG_ 485 BPCM_Min_Cell_Volt_Allowed 0;
BA_ "GenSigTimeoutTime_PBWM" SG_ 485 BPCM_Min_Cell_Volt_Allowed 0;
BA_ "GenSigTimeoutTime_IDCM" SG_ 485 BPCM_Min_Cell_Volt_Allowed 0;
BA_ "GenSigTimeoutTime_ECM" SG_ 485 BPCM_Min_Cell_Volt_Allowed 0;
BA_ "GenSigTimeoutTime_DMPI" SG_ 485 BPCM_Min_Cell_Volt_Allowed 0;
BA_ "GenSigTimeoutTime_BPCM" SG_ 485 BPCM_Min_Cell_Volt_Allowed 0;
BA_ "GenSigTimeoutTime_AGSM" SG_ 485 BPCM_Min_Cell_Volt_Allowed 0;
BA_ "GenSigTimeoutTime_ECM" SG_ 485 BPCM_HV_Insulation_Resistance 0;
BA_ "GenSigTimeoutTime_DMPI" SG_ 485 BPCM_HV_Insulation_Resistance 0;
BA_ "GenSigTimeoutTime_BPCM" SG_ 485 BPCM_HV_Insulation_Resistance 0;
BA_ "GenSigTimeoutTime_AGSM" SG_ 485 BPCM_HV_Insulation_Resistance 0;
BA_ "GenSigTimeoutTime_SGW" SG_ 485 BPCM_HV_Insulation_Resistance 0;
BA_ "GenSigTimeoutTime_PBWM" SG_ 485 BPCM_HV_Insulation_Resistance 0;
BA_ "GenSigTimeoutTime_IDCM" SG_ 485 BPCM_HV_Insulation_Resistance 0;
BA_ "GenSigTimeoutTime_SGW" SG_ 485 BPCM_Cell_Volt_Min 0;
BA_ "GenSigTimeoutTime_PBWM" SG_ 485 BPCM_Cell_Volt_Min 0;
BA_ "GenSigTimeoutTime_IDCM" SG_ 485 BPCM_Cell_Volt_Min 0;
BA_ "GenSigTimeoutTime_ECM" SG_ 485 BPCM_Cell_Volt_Min 0;
BA_ "GenSigTimeoutTime_DMPI" SG_ 485 BPCM_Cell_Volt_Min 0;
BA_ "GenSigTimeoutTime_BPCM" SG_ 485 BPCM_Cell_Volt_Min 0;
BA_ "GenSigTimeoutTime_AGSM" SG_ 485 BPCM_Cell_Volt_Min 0;
BA_ "GenSigTimeoutTime_SGW" SG_ 485 BPCM_Cell_Volt_Avg 0;
BA_ "GenSigTimeoutTime_PBWM" SG_ 485 BPCM_Cell_Volt_Avg 0;
BA_ "GenSigTimeoutTime_IDCM" SG_ 485 BPCM_Cell_Volt_Avg 0;
BA_ "GenSigTimeoutTime_ECM" SG_ 485 BPCM_Cell_Volt_Avg 0;
BA_ "GenSigTimeoutTime_DMPI" SG_ 485 BPCM_Cell_Volt_Avg 0;
BA_ "GenSigTimeoutTime_BPCM" SG_ 485 BPCM_Cell_Volt_Avg 0;
BA_ "GenSigTimeoutTime_AGSM" SG_ 485 BPCM_Cell_Volt_Avg 0;
BA_ "GenSigTimeoutTime_SGW" SG_ 485 BPCM_Cell_Volt_Max 0;
BA_ "GenSigTimeoutTime_PBWM" SG_ 485 BPCM_Cell_Volt_Max 0;
BA_ "GenSigTimeoutTime_IDCM" SG_ 485 BPCM_Cell_Volt_Max 0;
BA_ "GenSigTimeoutTime_ECM" SG_ 485 BPCM_Cell_Volt_Max 0;
BA_ "GenSigTimeoutTime_DMPI" SG_ 485 BPCM_Cell_Volt_Max 0;
BA_ "GenSigTimeoutTime_BPCM" SG_ 485 BPCM_Cell_Volt_Max 0;
BA_ "GenSigTimeoutTime_AGSM" SG_ 485 BPCM_Cell_Volt_Max 0;
BA_ "GenSigTimeoutTime_SGW" SG_ 292 BPCM_HV_Temperature_Max 0;
BA_ "GenSigTimeoutTime_PBWM" SG_ 292 BPCM_HV_Temperature_Max 0;
BA_ "GenSigTimeoutTime_IDCM" SG_ 292 BPCM_HV_Temperature_Max 0;
BA_ "GenSigTimeoutTime_ECM" SG_ 292 BPCM_HV_Temperature_Max 0;
BA_ "GenSigTimeoutTime_DMPI" SG_ 292 BPCM_HV_Temperature_Max 0;
BA_ "GenSigTimeoutTime_BPCM" SG_ 292 BPCM_HV_Temperature_Max 0;
BA_ "GenSigTimeoutTime_AGSM" SG_ 292 BPCM_HV_Temperature_Max 0;
BA_ "GenSigTimeoutTime_SGW" SG_ 292 BPCM_HV_Temperature_Min 0;
BA_ "GenSigTimeoutTime_PBWM" SG_ 292 BPCM_HV_Temperature_Min 0;
BA_ "GenSigTimeoutTime_IDCM" SG_ 292 BPCM_HV_Temperature_Min 0;
BA_ "GenSigTimeoutTime_ECM" SG_ 292 BPCM_HV_Temperature_Min 0;
BA_ "GenSigTimeoutTime_DMPI" SG_ 292 BPCM_HV_Temperature_Min 0;
BA_ "GenSigTimeoutTime_BPCM" SG_ 292 BPCM_HV_Temperature_Min 0;
BA_ "GenSigTimeoutTime_AGSM" SG_ 292 BPCM_HV_Temperature_Min 0;
BA_ "GenSigTimeoutTime_SGW" SG_ 292 BPCM_HV_InternalVoltage 0;
BA_ "GenSigTimeoutTime_PBWM" SG_ 292 BPCM_HV_InternalVoltage 0;
BA_ "GenSigTimeoutTime_IDCM" SG_ 292 BPCM_HV_InternalVoltage 0;
BA_ "GenSigTimeoutTime_ECM" SG_ 292 BPCM_HV_InternalVoltage 0;
BA_ "GenSigTimeoutTime_BPCM" SG_ 292 BPCM_HV_InternalVoltage 0;
BA_ "GenSigTimeoutTime_AGSM" SG_ 292 BPCM_HV_InternalVoltage 0;
BA_ "GenSigTimeoutTime_SGW" SG_ 292 BPCM_HV_Outlet_Temp 0;
BA_ "GenSigTimeoutTime_PBWM" SG_ 292 BPCM_HV_Outlet_Temp 0;
BA_ "GenSigTimeoutTime_IDCM" SG_ 292 BPCM_HV_Outlet_Temp 0;
BA_ "GenSigTimeoutTime_ECM" SG_ 292 BPCM_HV_Outlet_Temp 0;
BA_ "GenSigTimeoutTime_DMPI" SG_ 292 BPCM_HV_Outlet_Temp 0;
BA_ "GenSigTimeoutTime_BPCM" SG_ 292 BPCM_HV_Outlet_Temp 0;
BA_ "GenSigTimeoutTime_AGSM" SG_ 292 BPCM_HV_Outlet_Temp 0;
BA_ "GenSigStartValue" SG_ 292 BPCM_HV_Outlet_Temp 40;
BA_ "GenSigTimeoutTime_PBWM" SG_ 292 BPCM_HV_SOC 0;
BA_ "GenSigTimeoutTime_IDCM" SG_ 292 BPCM_HV_SOC 0;
BA_ "GenSigTimeoutTime_ECM" SG_ 292 BPCM_HV_SOC 0;
BA_ "GenSigTimeoutTime_BPCM" SG_ 292 BPCM_HV_SOC 0;
BA_ "GenSigTimeoutTime_AGSM" SG_ 292 BPCM_HV_SOC 0;
BA_ "GenSigTimeoutTime_SGW" SG_ 292 BPCM_HV_Temperature_Avg 0;
BA_ "GenSigTimeoutTime_PBWM" SG_ 292 BPCM_HV_Temperature_Avg 0;
BA_ "GenSigTimeoutTime_IDCM" SG_ 292 BPCM_HV_Temperature_Avg 0;
BA_ "GenSigTimeoutTime_ECM" SG_ 292 BPCM_HV_Temperature_Avg 0;
BA_ "GenSigTimeoutTime_DMPI" SG_ 292 BPCM_HV_Temperature_Avg 0;
BA_ "GenSigTimeoutTime_BPCM" SG_ 292 BPCM_HV_Temperature_Avg 0;
BA_ "GenSigTimeoutTime_AGSM" SG_ 292 BPCM_HV_Temperature_Avg 0;
BA_ "GenSigTimeoutTime_SGW" SG_ 292 BPCMInterlockSts 0;
BA_ "GenSigTimeoutTime_PBWM" SG_ 292 BPCMInterlockSts 0;
BA_ "GenSigTimeoutTime_IDCM" SG_ 292 BPCMInterlockSts 0;
BA_ "GenSigTimeoutTime_ECM" SG_ 292 BPCMInterlockSts 0;
BA_ "GenSigTimeoutTime_DMPI" SG_ 292 BPCMInterlockSts 0;
BA_ "GenSigTimeoutTime_BPCM" SG_ 292 BPCMInterlockSts 0;
BA_ "GenSigTimeoutTime_AGSM" SG_ 292 BPCMInterlockSts 0;
BA_ "GenSigTimeoutTime_SGW" SG_ 292 HVBatLastSlept 0;
BA_ "GenSigTimeoutTime_PBWM" SG_ 292 HVBatLastSlept 0;
BA_ "GenSigTimeoutTime_IDCM" SG_ 292 HVBatLastSlept 0;
BA_ "GenSigTimeoutTime_ECM" SG_ 292 HVBatLastSlept 0;
BA_ "GenSigTimeoutTime_DMPI" SG_ 292 HVBatLastSlept 0;
BA_ "GenSigTimeoutTime_BPCM" SG_ 292 HVBatLastSlept 0;
BA_ "GenSigTimeoutTime_AGSM" SG_ 292 HVBatLastSlept 0;
BA_ "GenSigTimeoutTime_SGW" SG_ 292 HVBatContactorOpenTime 0;
BA_ "GenSigTimeoutTime_PBWM" SG_ 292 HVBatContactorOpenTime 0;
BA_ "GenSigTimeoutTime_IDCM" SG_ 292 HVBatContactorOpenTime 0;
BA_ "GenSigTimeoutTime_ECM" SG_ 292 HVBatContactorOpenTime 0;
BA_ "GenSigTimeoutTime_DMPI" SG_ 292 HVBatContactorOpenTime 0;
BA_ "GenSigTimeoutTime_BPCM" SG_ 292 HVBatContactorOpenTime 0;
BA_ "GenSigTimeoutTime_AGSM" SG_ 292 HVBatContactorOpenTime 0;
BA_ "GenSigTimeoutTime_PBWM" SG_ 292 BPCM_HV_SOH 0;
BA_ "GenSigTimeoutTime_IDCM" SG_ 292 BPCM_HV_SOH 0;
BA_ "GenSigTimeoutTime_ECM" SG_ 292 BPCM_HV_SOH 0;
BA_ "GenSigTimeoutTime_DMPI" SG_ 292 BPCM_HV_SOH 0;
BA_ "GenSigTimeoutTime_BPCM" SG_ 292 BPCM_HV_SOH 0;
BA_ "GenSigTimeoutTime_AGSM" SG_ 292 BPCM_HV_SOH 0;
BA_ "GenSigTimeoutTime_SGW" SG_ 292 BPCM_HV_SOH_Low 0;
BA_ "GenSigTimeoutTime_PBWM" SG_ 292 BPCM_HV_SOH_Low 0;
BA_ "GenSigTimeoutTime_IDCM" SG_ 292 BPCM_HV_SOH_Low 0;
BA_ "GenSigTimeoutTime_ECM" SG_ 292 BPCM_HV_SOH_Low 0;
BA_ "GenSigTimeoutTime_DMPI" SG_ 292 BPCM_HV_SOH_Low 0;
BA_ "GenSigTimeoutTime_BPCM" SG_ 292 BPCM_HV_SOH_Low 0;
BA_ "GenSigTimeoutTime_AGSM" SG_ 292 BPCM_HV_SOH_Low 0;
BA_ "GenSigTimeoutTime_SGW" SG_ 292 BPCM_HV_Trac_Bus_Sts 0;
BA_ "GenSigTimeoutTime_PBWM" SG_ 292 BPCM_HV_Trac_Bus_Sts 0;
BA_ "GenSigTimeoutTime_ECM" SG_ 292 BPCM_HV_Trac_Bus_Sts 0;
BA_ "GenSigTimeoutTime_DMPI" SG_ 292 BPCM_HV_Trac_Bus_Sts 0;
BA_ "GenSigTimeoutTime_BPCM" SG_ 292 BPCM_HV_Trac_Bus_Sts 0;
BA_ "GenSigTimeoutTime_AGSM" SG_ 292 BPCM_HV_Trac_Bus_Sts 0;
BA_ "GenSigTimeoutTime_BPCM" SG_ 292 MessageCounter_BATT_HV_STATUS1 0;
BA_ "GenSigTimeoutTime_AGSM" SG_ 292 MessageCounter_BATT_HV_STATUS1 0;
BA_ "GenSigTimeoutTime_SGW" SG_ 292 CRC_BATT_HV_STATUS1 0;
BA_ "GenSigTimeoutTime_PBWM" SG_ 292 CRC_BATT_HV_STATUS1 0;
BA_ "GenSigTimeoutTime_ECM" SG_ 292 CRC_BATT_HV_STATUS1 0;
BA_ "GenSigTimeoutTime_BPCM" SG_ 292 CRC_BATT_HV_STATUS1 0;
BA_ "GenSigTimeoutTime_AGSM" SG_ 292 CRC_BATT_HV_STATUS1 0;
BA_ "GenSigTimeoutTime_SGW" SG_ 292 HVBatReady 0;
BA_ "GenSigTimeoutTime_PBWM" SG_ 292 HVBatReady 0;
BA_ "GenSigTimeoutTime_IDCM" SG_ 292 HVBatReady 0;
BA_ "GenSigTimeoutTime_ECM" SG_ 292 HVBatReady 0;
BA_ "GenSigTimeoutTime_DMPI" SG_ 292 HVBatReady 0;
BA_ "GenSigTimeoutTime_BPCM" SG_ 292 HVBatReady 0;
BA_ "GenSigTimeoutTime_AGSM" SG_ 292 HVBatReady 0;
BA_ "GenSigTimeoutTime_SGW" SG_ 292 HVBatContactorWeldCheck 0;
BA_ "GenSigTimeoutTime_PBWM" SG_ 292 HVBatContactorWeldCheck 0;
BA_ "GenSigTimeoutTime_IDCM" SG_ 292 HVBatContactorWeldCheck 0;
BA_ "GenSigTimeoutTime_ECM" SG_ 292 HVBatContactorWeldCheck 0;
BA_ "GenSigTimeoutTime_DMPI" SG_ 292 HVBatContactorWeldCheck 0;
BA_ "GenSigTimeoutTime_BPCM" SG_ 292 HVBatContactorWeldCheck 0;
BA_ "GenSigTimeoutTime_AGSM" SG_ 292 HVBatContactorWeldCheck 0;
BA_ "GenSigTimeoutTime_SGW" SG_ 292 BPCM_Pwr_Limp_Home_On 0;
BA_ "GenSigTimeoutTime_PBWM" SG_ 292 BPCM_Pwr_Limp_Home_On 0;
BA_ "GenSigTimeoutTime_IDCM" SG_ 292 BPCM_Pwr_Limp_Home_On 0;
BA_ "GenSigTimeoutTime_ECM" SG_ 292 BPCM_Pwr_Limp_Home_On 0;
BA_ "GenSigTimeoutTime_DMPI" SG_ 292 BPCM_Pwr_Limp_Home_On 0;
BA_ "GenSigTimeoutTime_BPCM" SG_ 292 BPCM_Pwr_Limp_Home_On 0;
BA_ "GenSigTimeoutTime_AGSM" SG_ 292 BPCM_Pwr_Limp_Home_On 0;
BA_ "GenSigTimeoutTime_SGW" SG_ 292 BPCM_HV_TractionBusVoltage 0;
BA_ "GenSigTimeoutTime_PBWM" SG_ 292 BPCM_HV_TractionBusVoltage 0;
BA_ "GenSigTimeoutTime_ECM" SG_ 292 BPCM_HV_TractionBusVoltage 0;
BA_ "GenSigTimeoutTime_BPCM" SG_ 292 BPCM_HV_TractionBusVoltage 0;
BA_ "GenSigTimeoutTime_AGSM" SG_ 292 BPCM_HV_TractionBusVoltage 0;
BA_ "GenSigTimeoutTime_SGW" SG_ 292 BPCM_HV_ChargingBusVoltage 0;
BA_ "GenSigTimeoutTime_PBWM" SG_ 292 BPCM_HV_ChargingBusVoltage 0;
BA_ "GenSigTimeoutTime_IDCM" SG_ 292 BPCM_HV_ChargingBusVoltage 0;
BA_ "GenSigTimeoutTime_ECM" SG_ 292 BPCM_HV_ChargingBusVoltage 0;
BA_ "GenSigTimeoutTime_DMPI" SG_ 292 BPCM_HV_ChargingBusVoltage 0;
BA_ "GenSigTimeoutTime_BPCM" SG_ 292 BPCM_HV_ChargingBusVoltage 0;
BA_ "GenSigTimeoutTime_AGSM" SG_ 292 BPCM_HV_ChargingBusVoltage 0;
BA_ "GenSigTimeoutTime_SGW" SG_ 292 BPCM_HV_Trac_Main_Contac_Sts 0;
BA_ "GenSigTimeoutTime_PBWM" SG_ 292 BPCM_HV_Trac_Main_Contac_Sts 0;
BA_ "GenSigTimeoutTime_ECM" SG_ 292 BPCM_HV_Trac_Main_Contac_Sts 0;
BA_ "GenSigTimeoutTime_BPCM" SG_ 292 BPCM_HV_Trac_Main_Contac_Sts 0;
BA_ "GenSigTimeoutTime_AGSM" SG_ 292 BPCM_HV_Trac_Main_Contac_Sts 0;
BA_ "GenSigTimeoutTime_SGW" SG_ 292 BPCM_HV_Char_Main_Contac_Sts 0;
BA_ "GenSigTimeoutTime_PBWM" SG_ 292 BPCM_HV_Char_Main_Contac_Sts 0;
BA_ "GenSigTimeoutTime_IDCM" SG_ 292 BPCM_HV_Char_Main_Contac_Sts 0;
BA_ "GenSigTimeoutTime_ECM" SG_ 292 BPCM_HV_Char_Main_Contac_Sts 0;
BA_ "GenSigTimeoutTime_DMPI" SG_ 292 BPCM_HV_Char_Main_Contac_Sts 0;
BA_ "GenSigTimeoutTime_BPCM" SG_ 292 BPCM_HV_Char_Main_Contac_Sts 0;
BA_ "GenSigTimeoutTime_SGW" SG_ 292 BPCM_ImpactHardwire 0;
BA_ "GenSigTimeoutTime_PBWM" SG_ 292 BPCM_ImpactHardwire 0;
BA_ "GenSigTimeoutTime_IDCM" SG_ 292 BPCM_ImpactHardwire 0;
BA_ "GenSigTimeoutTime_ECM" SG_ 292 BPCM_ImpactHardwire 0;
BA_ "GenSigTimeoutTime_BPCM" SG_ 292 BPCM_ImpactHardwire 0;
BA_ "GenSigTimeoutTime_AGSM" SG_ 292 BPCM_ImpactHardwire 0;
BA_ "GenSigTimeoutTime_SGW" SG_ 292 BPCM_ImpactHardwireV 0;
BA_ "GenSigTimeoutTime_PBWM" SG_ 292 BPCM_ImpactHardwireV 0;
BA_ "GenSigTimeoutTime_IDCM" SG_ 292 BPCM_ImpactHardwireV 0;
BA_ "GenSigTimeoutTime_ECM" SG_ 292 BPCM_ImpactHardwireV 0;
BA_ "GenSigTimeoutTime_BPCM" SG_ 292 BPCM_ImpactHardwireV 0;
BA_ "GenSigTimeoutTime_AGSM" SG_ 292 BPCM_ImpactHardwireV 0;
BA_ "GenSigTimeoutTime_SGW" SG_ 292 BPCM_HV_Current 0;
BA_ "GenSigTimeoutTime_PBWM" SG_ 292 BPCM_HV_Current 0;
BA_ "GenSigTimeoutTime_IDCM" SG_ 292 BPCM_HV_Current 0;
BA_ "GenSigTimeoutTime_ECM" SG_ 292 BPCM_HV_Current 0;
BA_ "GenSigTimeoutTime_BPCM" SG_ 292 BPCM_HV_Current 0;
BA_ "GenSigTimeoutTime_AGSM" SG_ 292 BPCM_HV_Current 0;
BA_ "GenSigTimeoutTime_BPCM" SG_ 292 BPCM_HV_Inlet_Temp 0;
BA_ "GenSigTimeoutTime_AGSM" SG_ 292 BPCM_HV_Inlet_Temp 0;
BA_ "GenSigStartValue" SG_ 292 BPCM_HV_Inlet_Temp 40;
BA_ "GenSigTimeoutTime_SGW" SG_ 292 BPCM_HV_Inlet_Temp 0;
BA_ "GenSigTimeoutTime_PBWM" SG_ 292 BPCM_HV_Inlet_Temp 0;
BA_ "GenSigTimeoutTime_IDCM" SG_ 292 BPCM_HV_Inlet_Temp 0;
BA_ "GenSigTimeoutTime_ECM" SG_ 292 BPCM_HV_Inlet_Temp 0;
BA_ "GenSigTimeoutTime_DMPI" SG_ 292 BPCM_HV_Inlet_Temp 0;
BA_ "GenSigTimeoutTime_SGW" SG_ 292 BPCM_MILRequest 0;
BA_ "GenSigTimeoutTime_PBWM" SG_ 292 BPCM_MILRequest 0;
BA_ "GenSigTimeoutTime_IDCM" SG_ 292 BPCM_MILRequest 0;
BA_ "GenSigTimeoutTime_DMPI" SG_ 292 BPCM_MILRequest 0;
BA_ "GenSigTimeoutTime_BPCM" SG_ 292 BPCM_MILRequest 0;
BA_ "GenSigTimeoutTime_AGSM" SG_ 292 BPCM_MILRequest 0;
BA_ "GenSigTimeoutTime_SGW" SG_ 292 HVBP_Busbar_Temp 0;
BA_ "GenSigTimeoutTime_PBWM" SG_ 292 HVBP_Busbar_Temp 0;
BA_ "GenSigTimeoutTime_IDCM" SG_ 292 HVBP_Busbar_Temp 0;
BA_ "GenSigTimeoutTime_ECM" SG_ 292 HVBP_Busbar_Temp 0;
BA_ "GenSigTimeoutTime_DMPI" SG_ 292 HVBP_Busbar_Temp 0;
BA_ "GenSigTimeoutTime_BPCM" SG_ 292 HVBP_Busbar_Temp 0;
BA_ "GenSigTimeoutTime_AGSM" SG_ 292 HVBP_Busbar_Temp 0;
BA_ "GenSigTimeoutTime_SGW" SG_ 292 HVBP_BDU_Busbar_Temp 0;
BA_ "GenSigTimeoutTime_PBWM" SG_ 292 HVBP_BDU_Busbar_Temp 0;
BA_ "GenSigTimeoutTime_IDCM" SG_ 292 HVBP_BDU_Busbar_Temp 0;
BA_ "GenSigTimeoutTime_ECM" SG_ 292 HVBP_BDU_Busbar_Temp 0;
BA_ "GenSigTimeoutTime_DMPI" SG_ 292 HVBP_BDU_Busbar_Temp 0;
BA_ "GenSigTimeoutTime_BPCM" SG_ 292 HVBP_BDU_Busbar_Temp 0;
BA_ "GenSigTimeoutTime_AGSM" SG_ 292 HVBP_BDU_Busbar_Temp 0;
BA_ "GenSigTimeoutTime_SGW" SG_ 292 BPCM_HV_DCFC_Isolation_Sts 0;
BA_ "GenSigTimeoutTime_PBWM" SG_ 292 BPCM_HV_DCFC_Isolation_Sts 0;
BA_ "GenSigTimeoutTime_IDCM" SG_ 292 BPCM_HV_DCFC_Isolation_Sts 0;
BA_ "GenSigTimeoutTime_ECM" SG_ 292 BPCM_HV_DCFC_Isolation_Sts 0;
BA_ "GenSigTimeoutTime_DMPI" SG_ 292 BPCM_HV_DCFC_Isolation_Sts 0;
BA_ "GenSigTimeoutTime_BPCM" SG_ 292 BPCM_HV_DCFC_Isolation_Sts 0;
BA_ "GenSigTimeoutTime_AGSM" SG_ 292 BPCM_HV_DCFC_Isolation_Sts 0;
BA_ "GenSigTimeoutTime_SGW" SG_ 292 BPCM_HV_Trac_PreCha_Contac_Sts 0;
BA_ "GenSigTimeoutTime_PBWM" SG_ 292 BPCM_HV_Trac_PreCha_Contac_Sts 0;
BA_ "GenSigTimeoutTime_IDCM" SG_ 292 BPCM_HV_Trac_PreCha_Contac_Sts 0;
BA_ "GenSigTimeoutTime_ECM" SG_ 292 BPCM_HV_Trac_PreCha_Contac_Sts 0;
BA_ "GenSigTimeoutTime_DMPI" SG_ 292 BPCM_HV_Trac_PreCha_Contac_Sts 0;
BA_ "GenSigTimeoutTime_BPCM" SG_ 292 BPCM_HV_Trac_PreCha_Contac_Sts 0;
BA_ "GenSigTimeoutTime_AGSM" SG_ 292 BPCM_HV_Trac_PreCha_Contac_Sts 0;
BA_ "GenSigTimeoutTime_SGW" SG_ 292 BPCM_Wakeup_Request 0;
BA_ "GenSigTimeoutTime_PBWM" SG_ 292 BPCM_Wakeup_Request 0;
BA_ "GenSigTimeoutTime_IDCM" SG_ 292 BPCM_Wakeup_Request 0;
BA_ "GenSigTimeoutTime_ECM" SG_ 292 BPCM_Wakeup_Request 0;
BA_ "GenSigTimeoutTime_DMPI" SG_ 292 BPCM_Wakeup_Request 0;
BA_ "GenSigTimeoutTime_BPCM" SG_ 292 BPCM_Wakeup_Request 0;
BA_ "GenSigTimeoutTime_AGSM" SG_ 292 BPCM_Wakeup_Request 0;
BA_ "GenSigSendType" SG_ 292 BPCM_Wakeup_Request 3;
BA_ "GenSigTimeoutTime_SGW" SG_ 292 BPCM_HV_ThermalRunaway 0;
BA_ "GenSigTimeoutTime_PBWM" SG_ 292 BPCM_HV_ThermalRunaway 0;
BA_ "GenSigTimeoutTime_IDCM" SG_ 292 BPCM_HV_ThermalRunaway 0;
BA_ "GenSigTimeoutTime_ECM" SG_ 292 BPCM_HV_ThermalRunaway 0;
BA_ "GenSigTimeoutTime_DMPI" SG_ 292 BPCM_HV_ThermalRunaway 0;
BA_ "GenSigTimeoutTime_BPCM" SG_ 292 BPCM_HV_ThermalRunaway 0;
BA_ "GenSigTimeoutTime_AGSM" SG_ 292 BPCM_HV_ThermalRunaway 0;
BA_ "GenSigSendType" SG_ 292 BPCM_HV_ThermalRunaway 3;
BA_ "GenSigTimeoutTime_SGW" SG_ 288 CRC_BATT_HV_POWERLIMS 0;
BA_ "GenSigTimeoutTime_PBWM" SG_ 288 CRC_BATT_HV_POWERLIMS 0;
BA_ "GenSigTimeoutTime_IDCM" SG_ 288 CRC_BATT_HV_POWERLIMS 0;
BA_ "GenSigTimeoutTime_ECM" SG_ 288 CRC_BATT_HV_POWERLIMS 0;
BA_ "GenSigTimeoutTime_DMPI" SG_ 288 CRC_BATT_HV_POWERLIMS 0;
BA_ "GenSigTimeoutTime_BPCM" SG_ 288 CRC_BATT_HV_POWERLIMS 0;
BA_ "GenSigTimeoutTime_AGSM" SG_ 288 CRC_BATT_HV_POWERLIMS 0;
BA_ "GenSigTimeoutTime_SGW" SG_ 288 MessageCounter_BATT_HV_POWERLIMS 0;
BA_ "GenSigTimeoutTime_PBWM" SG_ 288 MessageCounter_BATT_HV_POWERLIMS 0;
BA_ "GenSigTimeoutTime_IDCM" SG_ 288 MessageCounter_BATT_HV_POWERLIMS 0;
BA_ "GenSigTimeoutTime_ECM" SG_ 288 MessageCounter_BATT_HV_POWERLIMS 0;
BA_ "GenSigTimeoutTime_DMPI" SG_ 288 MessageCounter_BATT_HV_POWERLIMS 0;
BA_ "GenSigTimeoutTime_BPCM" SG_ 288 MessageCounter_BATT_HV_POWERLIMS 0;
BA_ "GenSigTimeoutTime_AGSM" SG_ 288 MessageCounter_BATT_HV_POWERLIMS 0;
BA_ "GenSigTimeoutTime_SGW" SG_ 292 BPCM_HV_Battery_GFD_Sts 0;
BA_ "GenSigTimeoutTime_PBWM" SG_ 292 BPCM_HV_Battery_GFD_Sts 0;
BA_ "GenSigTimeoutTime_IDCM" SG_ 292 BPCM_HV_Battery_GFD_Sts 0;
BA_ "GenSigTimeoutTime_ECM" SG_ 292 BPCM_HV_Battery_GFD_Sts 0;
BA_ "GenSigTimeoutTime_DMPI" SG_ 292 BPCM_HV_Battery_GFD_Sts 0;
BA_ "GenSigTimeoutTime_BPCM" SG_ 292 BPCM_HV_Battery_GFD_Sts 0;
BA_ "GenSigTimeoutTime_AGSM" SG_ 292 BPCM_HV_Battery_GFD_Sts 0;
BA_ "GenSigTimeoutTime_SGW" SG_ 292 BPCM_HV_Capacity 0;
BA_ "GenSigTimeoutTime_PBWM" SG_ 292 BPCM_HV_Capacity 0;
BA_ "GenSigTimeoutTime_IDCM" SG_ 292 BPCM_HV_Capacity 0;
BA_ "GenSigTimeoutTime_ECM" SG_ 292 BPCM_HV_Capacity 0;
BA_ "GenSigTimeoutTime_DMPI" SG_ 292 BPCM_HV_Capacity 0;
BA_ "GenSigTimeoutTime_BPCM" SG_ 292 BPCM_HV_Capacity 0;
BA_ "GenSigTimeoutTime_AGSM" SG_ 292 BPCM_HV_Capacity 0;
BA_ "GenSigTimeoutTime_SGW" SG_ 288 BPCM_HV_Power_MaxDischarge_MdTrm 0;
BA_ "GenSigTimeoutTime_PBWM" SG_ 288 BPCM_HV_Power_MaxDischarge_MdTrm 0;
BA_ "GenSigTimeoutTime_IDCM" SG_ 288 BPCM_HV_Power_MaxDischarge_MdTrm 0;
BA_ "GenSigTimeoutTime_ECM" SG_ 288 BPCM_HV_Power_MaxDischarge_MdTrm 0;
BA_ "GenSigTimeoutTime_DMPI" SG_ 288 BPCM_HV_Power_MaxDischarge_MdTrm 0;
BA_ "GenSigTimeoutTime_BPCM" SG_ 288 BPCM_HV_Power_MaxDischarge_MdTrm 0;
BA_ "GenSigTimeoutTime_AGSM" SG_ 288 BPCM_HV_Power_MaxDischarge_MdTrm 0;
BA_ "GenSigTimeoutTime_SGW" SG_ 288 BPCM_HV_Pwr_MaxDischrg_ShrTrm 0;
BA_ "GenSigTimeoutTime_PBWM" SG_ 288 BPCM_HV_Pwr_MaxDischrg_ShrTrm 0;
BA_ "GenSigTimeoutTime_IDCM" SG_ 288 BPCM_HV_Pwr_MaxDischrg_ShrTrm 0;
BA_ "GenSigTimeoutTime_ECM" SG_ 288 BPCM_HV_Pwr_MaxDischrg_ShrTrm 0;
BA_ "GenSigTimeoutTime_BPCM" SG_ 288 BPCM_HV_Pwr_MaxDischrg_ShrTrm 0;
BA_ "GenSigTimeoutTime_AGSM" SG_ 288 BPCM_HV_Pwr_MaxDischrg_ShrTrm 0;
BA_ "GenSigTimeoutTime_SGW" SG_ 288 BPCM_HV_PwrLmtInstChrg 0;
BA_ "GenSigTimeoutTime_PBWM" SG_ 288 BPCM_HV_PwrLmtInstChrg 0;
BA_ "GenSigTimeoutTime_IDCM" SG_ 288 BPCM_HV_PwrLmtInstChrg 0;
BA_ "GenSigTimeoutTime_ECM" SG_ 288 BPCM_HV_PwrLmtInstChrg 0;
BA_ "GenSigTimeoutTime_DMPI" SG_ 288 BPCM_HV_PwrLmtInstChrg 0;
BA_ "GenSigTimeoutTime_BPCM" SG_ 288 BPCM_HV_PwrLmtInstChrg 0;
BA_ "GenSigTimeoutTime_AGSM" SG_ 288 BPCM_HV_PwrLmtInstChrg 0;
BA_ "GenSigTimeoutTime_SGW" SG_ 288 BPCM_HV_PwrLmtInstDschg 0;
BA_ "GenSigTimeoutTime_PBWM" SG_ 288 BPCM_HV_PwrLmtInstDschg 0;
BA_ "GenSigTimeoutTime_IDCM" SG_ 288 BPCM_HV_PwrLmtInstDschg 0;
BA_ "GenSigTimeoutTime_ECM" SG_ 288 BPCM_HV_PwrLmtInstDschg 0;
BA_ "GenSigTimeoutTime_DMPI" SG_ 288 BPCM_HV_PwrLmtInstDschg 0;
BA_ "GenSigTimeoutTime_BPCM" SG_ 288 BPCM_HV_PwrLmtInstDschg 0;
BA_ "GenSigTimeoutTime_AGSM" SG_ 288 BPCM_HV_PwrLmtInstDschg 0;
BA_ "GenSigTimeoutTime_SGW" SG_ 288 BPCM_HV_Cell_MinDischrg_Imped 0;
BA_ "GenSigTimeoutTime_PBWM" SG_ 288 BPCM_HV_Cell_MinDischrg_Imped 0;
BA_ "GenSigTimeoutTime_IDCM" SG_ 288 BPCM_HV_Cell_MinDischrg_Imped 0;
BA_ "GenSigTimeoutTime_ECM" SG_ 288 BPCM_HV_Cell_MinDischrg_Imped 0;
BA_ "GenSigTimeoutTime_DMPI" SG_ 288 BPCM_HV_Cell_MinDischrg_Imped 0;
BA_ "GenSigTimeoutTime_BPCM" SG_ 288 BPCM_HV_Cell_MinDischrg_Imped 0;
BA_ "GenSigTimeoutTime_AGSM" SG_ 288 BPCM_HV_Cell_MinDischrg_Imped 0;
BA_ "GenSigTimeoutTime_SGW" SG_ 288 BPCM_HV_ChargingCurrentProfile 0;
BA_ "GenSigTimeoutTime_PBWM" SG_ 288 BPCM_HV_ChargingCurrentProfile 0;
BA_ "GenSigTimeoutTime_IDCM" SG_ 288 BPCM_HV_ChargingCurrentProfile 0;
BA_ "GenSigTimeoutTime_ECM" SG_ 288 BPCM_HV_ChargingCurrentProfile 0;
BA_ "GenSigTimeoutTime_DMPI" SG_ 288 BPCM_HV_ChargingCurrentProfile 0;
BA_ "GenSigTimeoutTime_BPCM" SG_ 288 BPCM_HV_ChargingCurrentProfile 0;
BA_ "GenSigTimeoutTime_AGSM" SG_ 288 BPCM_HV_ChargingCurrentProfile 0;
BA_ "GenSigTimeoutTime_SGW" SG_ 288 BPCM_HV_CrntLmtInstChrg 0;
BA_ "GenSigTimeoutTime_PBWM" SG_ 288 BPCM_HV_CrntLmtInstChrg 0;
BA_ "GenSigTimeoutTime_IDCM" SG_ 288 BPCM_HV_CrntLmtInstChrg 0;
BA_ "GenSigTimeoutTime_ECM" SG_ 288 BPCM_HV_CrntLmtInstChrg 0;
BA_ "GenSigTimeoutTime_DMPI" SG_ 288 BPCM_HV_CrntLmtInstChrg 0;
BA_ "GenSigTimeoutTime_BPCM" SG_ 288 BPCM_HV_CrntLmtInstChrg 0;
BA_ "GenSigTimeoutTime_AGSM" SG_ 288 BPCM_HV_CrntLmtInstChrg 0;
BA_ "GenSigTimeoutTime_SGW" SG_ 288 BPCM_HV_CrntLmtInstDschg 0;
BA_ "GenSigTimeoutTime_PBWM" SG_ 288 BPCM_HV_CrntLmtInstDschg 0;
BA_ "GenSigTimeoutTime_IDCM" SG_ 288 BPCM_HV_CrntLmtInstDschg 0;
BA_ "GenSigTimeoutTime_ECM" SG_ 288 BPCM_HV_CrntLmtInstDschg 0;
BA_ "GenSigTimeoutTime_DMPI" SG_ 288 BPCM_HV_CrntLmtInstDschg 0;
BA_ "GenSigTimeoutTime_BPCM" SG_ 288 BPCM_HV_CrntLmtInstDschg 0;
BA_ "GenSigTimeoutTime_AGSM" SG_ 288 BPCM_HV_CrntLmtInstDschg 0;
BA_ "GenSigTimeoutTime_SGW" SG_ 288 BPCM_HV_Power_MaxCharge_LgTrm 0;
BA_ "GenSigTimeoutTime_PBWM" SG_ 288 BPCM_HV_Power_MaxCharge_LgTrm 0;
BA_ "GenSigTimeoutTime_IDCM" SG_ 288 BPCM_HV_Power_MaxCharge_LgTrm 0;
BA_ "GenSigTimeoutTime_ECM" SG_ 288 BPCM_HV_Power_MaxCharge_LgTrm 0;
BA_ "GenSigTimeoutTime_DMPI" SG_ 288 BPCM_HV_Power_MaxCharge_LgTrm 0;
BA_ "GenSigTimeoutTime_BPCM" SG_ 288 BPCM_HV_Power_MaxCharge_LgTrm 0;
BA_ "GenSigTimeoutTime_AGSM" SG_ 288 BPCM_HV_Power_MaxCharge_LgTrm 0;
BA_ "GenSigTimeoutTime_SGW" SG_ 288 BPCM_HV_Power_MaxCharge_MdTrm 0;
BA_ "GenSigTimeoutTime_PBWM" SG_ 288 BPCM_HV_Power_MaxCharge_MdTrm 0;
BA_ "GenSigTimeoutTime_IDCM" SG_ 288 BPCM_HV_Power_MaxCharge_MdTrm 0;
BA_ "GenSigTimeoutTime_ECM" SG_ 288 BPCM_HV_Power_MaxCharge_MdTrm 0;
BA_ "GenSigTimeoutTime_DMPI" SG_ 288 BPCM_HV_Power_MaxCharge_MdTrm 0;
BA_ "GenSigTimeoutTime_BPCM" SG_ 288 BPCM_HV_Power_MaxCharge_MdTrm 0;
BA_ "GenSigTimeoutTime_AGSM" SG_ 288 BPCM_HV_Power_MaxCharge_MdTrm 0;
BA_ "GenSigTimeoutTime_SGW" SG_ 288 BPCM_HV_Power_MaxCharge_ShrTrm 0;
BA_ "GenSigTimeoutTime_PBWM" SG_ 288 BPCM_HV_Power_MaxCharge_ShrTrm 0;
BA_ "GenSigTimeoutTime_IDCM" SG_ 288 BPCM_HV_Power_MaxCharge_ShrTrm 0;
BA_ "GenSigTimeoutTime_ECM" SG_ 288 BPCM_HV_Power_MaxCharge_ShrTrm 0;
BA_ "GenSigTimeoutTime_DMPI" SG_ 288 BPCM_HV_Power_MaxCharge_ShrTrm 0;
BA_ "GenSigTimeoutTime_BPCM" SG_ 288 BPCM_HV_Power_MaxCharge_ShrTrm 0;
BA_ "GenSigTimeoutTime_AGSM" SG_ 288 BPCM_HV_Power_MaxCharge_ShrTrm 0;
BA_ "GenSigTimeoutTime_SGW" SG_ 288 BPCM_HV_Power_MaxDischarge_LgTrm 0;
BA_ "GenSigTimeoutTime_PBWM" SG_ 288 BPCM_HV_Power_MaxDischarge_LgTrm 0;
BA_ "GenSigTimeoutTime_IDCM" SG_ 288 BPCM_HV_Power_MaxDischarge_LgTrm 0;
BA_ "GenSigTimeoutTime_ECM" SG_ 288 BPCM_HV_Power_MaxDischarge_LgTrm 0;
BA_ "GenSigTimeoutTime_DMPI" SG_ 288 BPCM_HV_Power_MaxDischarge_LgTrm 0;
BA_ "GenSigTimeoutTime_BPCM" SG_ 288 BPCM_HV_Power_MaxDischarge_LgTrm 0;
BA_ "GenSigTimeoutTime_AGSM" SG_ 288 BPCM_HV_Power_MaxDischarge_LgTrm 0;
BA_ "GenSigTimeoutTime_SGW" SG_ 288 BPCM_CntctrsMidTrmOpeningWarn 0;
BA_ "GenSigTimeoutTime_PBWM" SG_ 288 BPCM_CntctrsMidTrmOpeningWarn 0;
BA_ "GenSigTimeoutTime_IDCM" SG_ 288 BPCM_CntctrsMidTrmOpeningWarn 0;
BA_ "GenSigTimeoutTime_ECM" SG_ 288 BPCM_CntctrsMidTrmOpeningWarn 0;
BA_ "GenSigTimeoutTime_DMPI" SG_ 288 BPCM_CntctrsMidTrmOpeningWarn 0;
BA_ "GenSigTimeoutTime_BPCM" SG_ 288 BPCM_CntctrsMidTrmOpeningWarn 0;
BA_ "GenSigTimeoutTime_AGSM" SG_ 288 BPCM_CntctrsMidTrmOpeningWarn 0;
BA_ "GenSigTimeoutTime_SGW" SG_ 288 BPCM_CntctrsShtTrmOpeningWarn 0;
BA_ "GenSigTimeoutTime_PBWM" SG_ 288 BPCM_CntctrsShtTrmOpeningWarn 0;
BA_ "GenSigTimeoutTime_ECM" SG_ 288 BPCM_CntctrsShtTrmOpeningWarn 0;
BA_ "GenSigTimeoutTime_BPCM" SG_ 288 BPCM_CntctrsShtTrmOpeningWarn 0;
BA_ "GenSigTimeoutTime_AGSM" SG_ 288 BPCM_CntctrsShtTrmOpeningWarn 0;
BA_ "GenSigTimeoutTime_SGW" SG_ 288 BPCM_HV_Cell_MaxDischrg_Imped 0;
BA_ "GenSigTimeoutTime_PBWM" SG_ 288 BPCM_HV_Cell_MaxDischrg_Imped 0;
BA_ "GenSigTimeoutTime_IDCM" SG_ 288 BPCM_HV_Cell_MaxDischrg_Imped 0;
BA_ "GenSigTimeoutTime_ECM" SG_ 288 BPCM_HV_Cell_MaxDischrg_Imped 0;
BA_ "GenSigTimeoutTime_DMPI" SG_ 288 BPCM_HV_Cell_MaxDischrg_Imped 0;
BA_ "GenSigTimeoutTime_BPCM" SG_ 288 BPCM_HV_Cell_MaxDischrg_Imped 0;
BA_ "GenSigTimeoutTime_AGSM" SG_ 288 BPCM_HV_Cell_MaxDischrg_Imped 0;
BA_ "GenSigTimeoutTime_AGSM" SG_ 292 BPCM_HV_Char_Main_Contac_Sts 0;
BA_ "GenSigTimeoutTime_SGW" SG_ 292 BPCM_HV_BalancingMode 0;
BA_ "GenSigTimeoutTime_PBWM" SG_ 292 BPCM_HV_BalancingMode 0;
BA_ "GenSigTimeoutTime_IDCM" SG_ 292 BPCM_HV_BalancingMode 0;
BA_ "GenSigTimeoutTime_ECM" SG_ 292 BPCM_HV_BalancingMode 0;
BA_ "GenSigTimeoutTime_DMPI" SG_ 292 BPCM_HV_BalancingMode 0;
BA_ "GenSigTimeoutTime_BPCM" SG_ 292 BPCM_HV_BalancingMode 0;
BA_ "GenSigTimeoutTime_AGSM" SG_ 292 BPCM_HV_BalancingMode 0;
BA_ "GenSigTimeoutTime_SGW" SG_ 292 BPCM_DC_CntctrsShtTrmOpeningWarn 0;
BA_ "GenSigTimeoutTime_PBWM" SG_ 292 BPCM_DC_CntctrsShtTrmOpeningWarn 0;
BA_ "GenSigTimeoutTime_IDCM" SG_ 292 BPCM_DC_CntctrsShtTrmOpeningWarn 0;
BA_ "GenSigTimeoutTime_ECM" SG_ 292 BPCM_DC_CntctrsShtTrmOpeningWarn 0;
BA_ "GenSigTimeoutTime_DMPI" SG_ 292 BPCM_DC_CntctrsShtTrmOpeningWarn 0;
BA_ "GenSigTimeoutTime_BPCM" SG_ 292 BPCM_DC_CntctrsShtTrmOpeningWarn 0;
BA_ "GenSigTimeoutTime_AGSM" SG_ 292 BPCM_DC_CntctrsShtTrmOpeningWarn 0;
BA_ "GenSigTimeoutTime_SGW" SG_ 292 BPCM_DC_CntctrsMidTrmOpeningWarn 0;
BA_ "GenSigTimeoutTime_PBWM" SG_ 292 BPCM_DC_CntctrsMidTrmOpeningWarn 0;
BA_ "GenSigTimeoutTime_IDCM" SG_ 292 BPCM_DC_CntctrsMidTrmOpeningWarn 0;
BA_ "GenSigTimeoutTime_ECM" SG_ 292 BPCM_DC_CntctrsMidTrmOpeningWarn 0;
BA_ "GenSigTimeoutTime_DMPI" SG_ 292 BPCM_DC_CntctrsMidTrmOpeningWarn 0;
BA_ "GenSigTimeoutTime_BPCM" SG_ 292 BPCM_DC_CntctrsMidTrmOpeningWarn 0;
BA_ "GenSigTimeoutTime_AGSM" SG_ 292 BPCM_DC_CntctrsMidTrmOpeningWarn 0;
BA_ "GenSigTimeoutTime_SGW" SG_ 292 BPCM_HV_Char_Bus_Sts 0;
BA_ "GenSigTimeoutTime_PBWM" SG_ 292 BPCM_HV_Char_Bus_Sts 0;
BA_ "GenSigTimeoutTime_IDCM" SG_ 292 BPCM_HV_Char_Bus_Sts 0;
BA_ "GenSigTimeoutTime_ECM" SG_ 292 BPCM_HV_Char_Bus_Sts 0;
BA_ "GenSigTimeoutTime_DMPI" SG_ 292 BPCM_HV_Char_Bus_Sts 0;
BA_ "GenSigTimeoutTime_BPCM" SG_ 292 BPCM_HV_Char_Bus_Sts 0;
BA_ "GenSigTimeoutTime_AGSM" SG_ 292 BPCM_HV_Char_Bus_Sts 0;
BA_ "GenSigTimeoutTime_SGW" SG_ 288 BPCM_HV_HVBatChargeStat 0;
BA_ "GenSigTimeoutTime_PBWM" SG_ 288 BPCM_HV_HVBatChargeStat 0;
BA_ "GenSigTimeoutTime_IDCM" SG_ 288 BPCM_HV_HVBatChargeStat 0;
BA_ "GenSigTimeoutTime_ECM" SG_ 288 BPCM_HV_HVBatChargeStat 0;
BA_ "GenSigTimeoutTime_DMPI" SG_ 288 BPCM_HV_HVBatChargeStat 0;
BA_ "GenSigTimeoutTime_BPCM" SG_ 288 BPCM_HV_HVBatChargeStat 0;
BA_ "GenSigTimeoutTime_AGSM" SG_ 288 BPCM_HV_HVBatChargeStat 0;
BA_ "GenSigTimeoutTime_SGW" SG_ 292 BPCM_HV_BatIntrlk_InternalStat 0;
BA_ "GenSigTimeoutTime_PBWM" SG_ 292 BPCM_HV_BatIntrlk_InternalStat 0;
BA_ "GenSigTimeoutTime_IDCM" SG_ 292 BPCM_HV_BatIntrlk_InternalStat 0;
BA_ "GenSigTimeoutTime_ECM" SG_ 292 BPCM_HV_BatIntrlk_InternalStat 0;
BA_ "GenSigTimeoutTime_DMPI" SG_ 292 BPCM_HV_BatIntrlk_InternalStat 0;
BA_ "GenSigTimeoutTime_BPCM" SG_ 292 BPCM_HV_BatIntrlk_InternalStat 0;
BA_ "GenSigTimeoutTime_AGSM" SG_ 292 BPCM_HV_BatIntrlk_InternalStat 0;
BA_ "GenSigTimeoutTime_SGW" SG_ 2564485698 N_PDU 0;
BA_ "GenSigTimeoutTime_PBWM" SG_ 2564485698 N_PDU 0;
BA_ "GenSigTimeoutTime_SGW" SG_ 2564486468 N_PDU 0;
BA_ "GenSigTimeoutTime_PBWM" SG_ 2564486468 N_PDU 0;
BA_ "GenSigTimeoutTime_IDCM" SG_ 2564486468 N_PDU 0;
BA_ "GenSigTimeoutTime_EVCU2" SG_ 2564486468 N_PDU 0;
BA_ "GenSigTimeoutTime_ECM" SG_ 2564486468 N_PDU 0;
BA_ "GenSigTimeoutTime_DMPI" SG_ 2564486468 N_PDU 0;
BA_ "GenSigTimeoutTime_BPCM" SG_ 2564486468 N_PDU 0;
BA_ "GenSigTimeoutTime_AGSM" SG_ 2564486468 N_PDU 0;
BA_ "GenSigTimeoutTime_SGW" SG_ 2564486420 N_PDU 0;
BA_ "GenSigTimeoutTime_PBWM" SG_ 2564486420 N_PDU 0;
BA_ "GenSigTimeoutTime_IDCM" SG_ 2564486420 N_PDU 0;
BA_ "GenSigTimeoutTime_EVCU2" SG_ 2564486420 N_PDU 0;
BA_ "GenSigTimeoutTime_ECM" SG_ 2564486420 N_PDU 0;
BA_ "GenSigTimeoutTime_DMPI" SG_ 2564486420 N_PDU 0;
BA_ "GenSigTimeoutTime_BPCM" SG_ 2564486420 N_PDU 0;
BA_ "GenSigTimeoutTime_AGSM" SG_ 2564486420 N_PDU 0;
BA_ "GenSigTimeoutTime_SGW" SG_ 2564486421 N_PDU 0;
BA_ "GenSigTimeoutTime_PBWM" SG_ 2564486421 N_PDU 0;
BA_ "GenSigTimeoutTime_IDCM" SG_ 2564486421 N_PDU 0;
BA_ "GenSigTimeoutTime_EVCU2" SG_ 2564486421 N_PDU 0;
BA_ "GenSigTimeoutTime_ECM" SG_ 2564486421 N_PDU 0;
BA_ "GenSigTimeoutTime_DMPI" SG_ 2564486421 N_PDU 0;
BA_ "GenSigTimeoutTime_BPCM" SG_ 2564486421 N_PDU 0;
BA_ "GenSigTimeoutTime_AGSM" SG_ 2564486421 N_PDU 0;
BA_ "GenSigTimeoutTime_SGW" SG_ 1063 CLrDiagInfo_MCPB 0;
BA_ "GenSigTimeoutTime_PBWM" SG_ 1063 CLrDiagInfo_MCPB 0;
BA_ "GenSigTimeoutTime_IDCM" SG_ 1063 CLrDiagInfo_MCPB 0;
BA_ "GenSigTimeoutTime_ECM" SG_ 1063 CLrDiagInfo_MCPB 0;
BA_ "GenSigTimeoutTime_DMPI" SG_ 1063 CLrDiagInfo_MCPB 0;
BA_ "GenSigTimeoutTime_BPCM" SG_ 1063 CLrDiagInfo_MCPB 0;
BA_ "GenSigTimeoutTime_AGSM" SG_ 1063 CLrDiagInfo_MCPB 0;
BA_ "GenSigTimeoutTime_SGW" SG_ 1063 MCPB_Inverter_Temp 0;
BA_ "GenSigTimeoutTime_PBWM" SG_ 1063 MCPB_Inverter_Temp 0;
BA_ "GenSigTimeoutTime_IDCM" SG_ 1063 MCPB_Inverter_Temp 0;
BA_ "GenSigTimeoutTime_ECM" SG_ 1063 MCPB_Inverter_Temp 0;
BA_ "GenSigTimeoutTime_DMPI" SG_ 1063 MCPB_Inverter_Temp 0;
BA_ "GenSigTimeoutTime_BPCM" SG_ 1063 MCPB_Inverter_Temp 0;
BA_ "GenSigTimeoutTime_AGSM" SG_ 1063 MCPB_Inverter_Temp 0;
BA_ "GenSigStartValue" SG_ 1063 MCPB_Inverter_Temp 40;
BA_ "GenSigTimeoutTime_SGW" SG_ 1063 MCPB_Rotor_Temperature 0;
BA_ "GenSigTimeoutTime_PBWM" SG_ 1063 MCPB_Rotor_Temperature 0;
BA_ "GenSigTimeoutTime_IDCM" SG_ 1063 MCPB_Rotor_Temperature 0;
BA_ "GenSigTimeoutTime_ECM" SG_ 1063 MCPB_Rotor_Temperature 0;
BA_ "GenSigTimeoutTime_DMPI" SG_ 1063 MCPB_Rotor_Temperature 0;
BA_ "GenSigTimeoutTime_BPCM" SG_ 1063 MCPB_Rotor_Temperature 0;
BA_ "GenSigTimeoutTime_AGSM" SG_ 1063 MCPB_Rotor_Temperature 0;
BA_ "GenSigStartValue" SG_ 1063 MCPB_Rotor_Temperature 255;
BA_ "GenSigTimeoutTime_PBWM" SG_ 1063 MCPB_Temp 0;
BA_ "GenSigTimeoutTime_IDCM" SG_ 1063 MCPB_Temp 0;
BA_ "GenSigTimeoutTime_ECM" SG_ 1063 MCPB_Temp 0;
BA_ "GenSigTimeoutTime_DMPI" SG_ 1063 MCPB_Temp 0;
BA_ "GenSigTimeoutTime_BPCM" SG_ 1063 MCPB_Temp 0;
BA_ "GenSigTimeoutTime_AGSM" SG_ 1063 MCPB_Temp 0;
BA_ "GenSigStartValue" SG_ 1063 MCPB_Temp 40;
BA_ "GenSigTimeoutTime_SGW" SG_ 1063 MCPB_ROL_Request 0;
BA_ "GenSigTimeoutTime_PBWM" SG_ 1063 MCPB_ROL_Request 0;
BA_ "GenSigTimeoutTime_IDCM" SG_ 1063 MCPB_ROL_Request 0;
BA_ "GenSigTimeoutTime_ECM" SG_ 1063 MCPB_ROL_Request 0;
BA_ "GenSigTimeoutTime_DMPI" SG_ 1063 MCPB_ROL_Request 0;
BA_ "GenSigTimeoutTime_BPCM" SG_ 1063 MCPB_ROL_Request 0;
BA_ "GenSigTimeoutTime_AGSM" SG_ 1063 MCPB_ROL_Request 0;
BA_ "GenSigTimeoutTime_BPCM" SG_ 1960 HVBatCellVoltage_Cell306 0;
BA_ "GenSigTimeoutTime_AGSM" SG_ 1960 HVBatCellVoltage_Cell306 0;
BA_ "GenSigTimeoutTime_PBWM" SG_ 1960 HVBatCellVoltage_Cell307 0;
BA_ "GenSigTimeoutTime_IDCM" SG_ 1960 HVBatCellVoltage_Cell307 0;
BA_ "GenSigTimeoutTime_EVCU2" SG_ 1960 HVBatCellVoltage_Cell307 0;
BA_ "GenSigTimeoutTime_ECM" SG_ 1960 HVBatCellVoltage_Cell307 0;
BA_ "GenSigTimeoutTime_DMPI" SG_ 1960 HVBatCellVoltage_Cell307 0;
BA_ "GenSigTimeoutTime_BPCM" SG_ 1960 HVBatCellVoltage_Cell307 0;
BA_ "GenSigTimeoutTime_AGSM" SG_ 1960 HVBatCellVoltage_Cell307 0;
BA_ "GenSigTimeoutTime_PBWM" SG_ 1960 HVBatCellVoltage_Cell308 0;
BA_ "GenSigTimeoutTime_IDCM" SG_ 1960 HVBatCellVoltage_Cell308 0;
BA_ "GenSigTimeoutTime_EVCU2" SG_ 1960 HVBatCellVoltage_Cell308 0;
BA_ "GenSigTimeoutTime_ECM" SG_ 1960 HVBatCellVoltage_Cell308 0;
BA_ "GenSigTimeoutTime_DMPI" SG_ 1960 HVBatCellVoltage_Cell308 0;
BA_ "GenSigTimeoutTime_BPCM" SG_ 1960 HVBatCellVoltage_Cell308 0;
BA_ "GenSigTimeoutTime_AGSM" SG_ 1960 HVBatCellVoltage_Cell308 0;
BA_ "GenSigTimeoutTime_PBWM" SG_ 1960 HVBatCellVoltage_Cell309 0;
BA_ "GenSigTimeoutTime_IDCM" SG_ 1960 HVBatCellVoltage_Cell309 0;
BA_ "GenSigTimeoutTime_EVCU2" SG_ 1960 HVBatCellVoltage_Cell309 0;
BA_ "GenSigTimeoutTime_ECM" SG_ 1960 HVBatCellVoltage_Cell309 0;
BA_ "GenSigTimeoutTime_DMPI" SG_ 1960 HVBatCellVoltage_Cell309 0;
BA_ "GenSigTimeoutTime_BPCM" SG_ 1960 HVBatCellVoltage_Cell309 0;
BA_ "GenSigTimeoutTime_AGSM" SG_ 1960 HVBatCellVoltage_Cell309 0;
BA_ "GenSigTimeoutTime_PBWM" SG_ 1960 HVBatCellVoltage_Cell310 0;
BA_ "GenSigTimeoutTime_IDCM" SG_ 1960 HVBatCellVoltage_Cell310 0;
BA_ "GenSigTimeoutTime_EVCU2" SG_ 1960 HVBatCellVoltage_Cell310 0;
BA_ "GenSigTimeoutTime_ECM" SG_ 1960 HVBatCellVoltage_Cell310 0;
BA_ "GenSigTimeoutTime_DMPI" SG_ 1960 HVBatCellVoltage_Cell310 0;
BA_ "GenSigTimeoutTime_BPCM" SG_ 1960 HVBatCellVoltage_Cell310 0;
BA_ "GenSigTimeoutTime_AGSM" SG_ 1960 HVBatCellVoltage_Cell310 0;
BA_ "GenSigTimeoutTime_PBWM" SG_ 1960 HVBatCellVoltage_Cell311 0;
BA_ "GenSigTimeoutTime_IDCM" SG_ 1960 HVBatCellVoltage_Cell311 0;
BA_ "GenSigTimeoutTime_EVCU2" SG_ 1960 HVBatCellVoltage_Cell311 0;
BA_ "GenSigTimeoutTime_ECM" SG_ 1960 HVBatCellVoltage_Cell311 0;
BA_ "GenSigTimeoutTime_DMPI" SG_ 1960 HVBatCellVoltage_Cell311 0;
BA_ "GenSigTimeoutTime_BPCM" SG_ 1960 HVBatCellVoltage_Cell311 0;
BA_ "GenSigTimeoutTime_AGSM" SG_ 1960 HVBatCellVoltage_Cell311 0;
BA_ "GenSigTimeoutTime_PBWM" SG_ 1960 HVBatCellVoltage_Cell312 0;
BA_ "GenSigTimeoutTime_IDCM" SG_ 1960 HVBatCellVoltage_Cell312 0;
BA_ "GenSigTimeoutTime_EVCU2" SG_ 1960 HVBatCellVoltage_Cell312 0;
BA_ "GenSigTimeoutTime_ECM" SG_ 1960 HVBatCellVoltage_Cell312 0;
BA_ "GenSigTimeoutTime_DMPI" SG_ 1960 HVBatCellVoltage_Cell312 0;
BA_ "GenSigTimeoutTime_BPCM" SG_ 1960 HVBatCellVoltage_Cell312 0;
BA_ "GenSigTimeoutTime_AGSM" SG_ 1960 HVBatCellVoltage_Cell312 0;
BA_ "GenSigTimeoutTime_PBWM" SG_ 1960 HVBatCellVoltage_Cell313 0;
BA_ "GenSigTimeoutTime_IDCM" SG_ 1960 HVBatCellVoltage_Cell313 0;
BA_ "GenSigTimeoutTime_EVCU2" SG_ 1960 HVBatCellVoltage_Cell313 0;
BA_ "GenSigTimeoutTime_ECM" SG_ 1960 HVBatCellVoltage_Cell313 0;
BA_ "GenSigTimeoutTime_DMPI" SG_ 1960 HVBatCellVoltage_Cell313 0;
BA_ "GenSigTimeoutTime_BPCM" SG_ 1960 HVBatCellVoltage_Cell313 0;
BA_ "GenSigTimeoutTime_AGSM" SG_ 1960 HVBatCellVoltage_Cell313 0;
BA_ "GenSigTimeoutTime_PBWM" SG_ 1960 HVBatCellVoltage_Cell314 0;
BA_ "GenSigTimeoutTime_IDCM" SG_ 1960 HVBatCellVoltage_Cell314 0;
BA_ "GenSigTimeoutTime_EVCU2" SG_ 1960 HVBatCellVoltage_Cell314 0;
BA_ "GenSigTimeoutTime_ECM" SG_ 1960 HVBatCellVoltage_Cell314 0;
BA_ "GenSigTimeoutTime_DMPI" SG_ 1960 HVBatCellVoltage_Cell314 0;
BA_ "GenSigTimeoutTime_BPCM" SG_ 1960 HVBatCellVoltage_Cell314 0;
BA_ "GenSigTimeoutTime_AGSM" SG_ 1960 HVBatCellVoltage_Cell314 0;
BA_ "GenSigTimeoutTime_PBWM" SG_ 1960 HVBatCellVoltage_Cell297 0;
BA_ "GenSigTimeoutTime_IDCM" SG_ 1960 HVBatCellVoltage_Cell297 0;
BA_ "GenSigTimeoutTime_EVCU2" SG_ 1960 HVBatCellVoltage_Cell297 0;
BA_ "GenSigTimeoutTime_ECM" SG_ 1960 HVBatCellVoltage_Cell297 0;
BA_ "GenSigTimeoutTime_DMPI" SG_ 1960 HVBatCellVoltage_Cell297 0;
BA_ "GenSigTimeoutTime_BPCM" SG_ 1960 HVBatCellVoltage_Cell297 0;
BA_ "GenSigTimeoutTime_AGSM" SG_ 1960 HVBatCellVoltage_Cell297 0;
BA_ "GenSigTimeoutTime_PBWM" SG_ 1960 HVBatCellVoltage_Cell298 0;
BA_ "GenSigTimeoutTime_IDCM" SG_ 1960 HVBatCellVoltage_Cell298 0;
BA_ "GenSigTimeoutTime_EVCU2" SG_ 1960 HVBatCellVoltage_Cell298 0;
BA_ "GenSigTimeoutTime_ECM" SG_ 1960 HVBatCellVoltage_Cell298 0;
BA_ "GenSigTimeoutTime_DMPI" SG_ 1960 HVBatCellVoltage_Cell298 0;
BA_ "GenSigTimeoutTime_BPCM" SG_ 1960 HVBatCellVoltage_Cell298 0;
BA_ "GenSigTimeoutTime_AGSM" SG_ 1960 HVBatCellVoltage_Cell298 0;
BA_ "GenSigTimeoutTime_SGW" SG_ 1031 InputCurrentAvailable 0;
BA_ "GenSigTimeoutTime_PBWM" SG_ 1031 InputCurrentAvailable 0;
BA_ "GenSigTimeoutTime_IDCM" SG_ 1031 InputCurrentAvailable 0;
BA_ "GenSigTimeoutTime_ECM" SG_ 1031 InputCurrentAvailable 0;
BA_ "GenSigTimeoutTime_DMPI" SG_ 1031 InputCurrentAvailable 0;
BA_ "GenSigTimeoutTime_BPCM" SG_ 1031 InputCurrentAvailable 0;
BA_ "GenSigTimeoutTime_AGSM" SG_ 1031 InputCurrentAvailable 0;
BA_ "GenSigTimeoutTime_PBWM" SG_ 1031 AC_Side_Curr3 0;
BA_ "GenSigTimeoutTime_IDCM" SG_ 1031 AC_Side_Curr3 0;
BA_ "GenSigTimeoutTime_ECM" SG_ 1031 AC_Side_Curr3 0;
BA_ "GenSigTimeoutTime_DMPI" SG_ 1031 AC_Side_Curr3 0;
BA_ "GenSigTimeoutTime_BPCM" SG_ 1031 AC_Side_Curr3 0;
BA_ "GenSigTimeoutTime_AGSM" SG_ 1031 AC_Side_Curr3 0;
BA_ "GenSigStartValue" SG_ 1031 AC_Side_Curr3 1000;
BA_ "GenSigTimeoutTime_DMPI" SG_ 1031 AC_Side_Volt1 0;
BA_ "GenSigTimeoutTime_BPCM" SG_ 1031 AC_Side_Volt1 0;
BA_ "GenSigTimeoutTime_AGSM" SG_ 1031 AC_Side_Volt1 0;
BA_ "GenSigTimeoutTime_PBWM" SG_ 1031 AC_Side_Volt1 0;
BA_ "GenSigTimeoutTime_IDCM" SG_ 1031 AC_Side_Volt1 0;
BA_ "GenSigTimeoutTime_ECM" SG_ 1031 AC_Side_Volt1 0;
BA_ "GenSigTimeoutTime_PBWM" SG_ 1031 AC_Side_Volt3 0;
BA_ "GenSigTimeoutTime_IDCM" SG_ 1031 AC_Side_Volt3 0;
BA_ "GenSigTimeoutTime_ECM" SG_ 1031 AC_Side_Volt3 0;
VAL_ 1031 InputCurrentAvailable 511 "SNA";
VAL_ 1031 AC_Side_Volt3 8191 "SNA";
VAL_ 1031 AC_Side_Volt2 8191 "SNA";
VAL_ 1031 AC_Side_Volt1 8191 "SNA";
VAL_ 1031 AC_Side_Curr3 2047 "SNA";
VAL_ 1031 AC_Side_Curr2 2047 "SNA";
VAL_ 1031 AC_Side_Curr1 2047 "SNA";
VAL_ 1031 ProximitySts 0 "PROX_LO" 1 "Prox_Out" 2 "Prox_In" 3 "Prox_Un" 4 "VOOR" 5 "PROX_HI";
VAL_ 1031 OBCM_SlacSts 0 "SLAC_NOT_PERFORMED" 1 "EVSE_FOUND" 2 "EVSE_NOT_FOUND" 3 "FAILURE";
VAL_ 1031 OBCM_SdpSts 0 "SPD_NOT_PERFORMED" 1 "CONN_ESTABLISHED" 2 "CONN_NOT_ESTABLISHED" 3 "FAILURE";
VAL_ 1031 OBCInterlockSts 0 "Not_Performed" 1 "OK" 2 "Fail" 3 "Invalid";
VAL_ 1031 OBC_DeratingReason 0 "No_Derating" 1 "High_Temp_Derating" 2 "Low_Temp_Derating" 3 "Input_Voltage_Limit" 4 "Input_Current_Limit" 5 "Output_Voltage_Limit" 6 "Output_Current_Limit" 7 "Internal_Fault_Derating" 8 "High_Charge_Inlet_Temperature";
VAL_ 1031 J1772_State 0 "STATE_A" 1 "STATE_B" 2 "STATE_C" 3 "STATE_D" 4 "STATE_E" 5 "STATE_F" 7 "SNA";
VAL_ 1031 J1772_S2_Sts 0 "Open" 1 "Closed";
VAL_ 1031 ControlPilotSts 0 "NO_EVSE" 1 "CP_DET" 2 "VOOR" 3 "EVSE_NO_AC" 4 "HW_FAULT" 5 "EVSE_FAULT";
VAL_ 1031 ChargeEnableSts 0 "NotCharging" 1 "Charging" 3 "SNA";
VAL_ 1031 ChargeCurrentAvailable 1023 "SNA";
VAL_ 1031 ChargeCurrent 1023 "SNA";
VAL_ 1031 BatterySideCurrent 2047 "SNA";
VAL_ 1031 AC_Present 0 "AC not detected" 1 "AC detected";
VAL_ 1063 MCPB_Temp 255 "SNA";
VAL_ 1063 MCPB_Rotor_Temperature 255 "SNA";
VAL_ 1063 MCPB_Inverter_Temp 255 "SNA";
VAL_ 1063 CLrDiagInfo_MCPB 0 "False" 1 "True";
VAL_ 1031 Supported_VerNumberMinor 0 "No_Version" 1 "Version_1" 2 "Version_2" 7 "SNA";
VAL_ 1031 Supported_VerNumberMajor 0 "No_Version" 1 "Version_1" 2 "Version_2" 7 "SNA";
VAL_ 1031 Supported_SchemaID 0 "No_Schema_ID" 1 "Schema_ID_1" 2 "Schema_ID_2" 3 "Schema_ID_3" 7 "SNA";
VAL_ 1031 Supported_ProtocolName 0 "No_Protocol" 1 "ISO_Gen2" 2 "ISO_Gen1" 3 "DIN" 7 "SNA";
VAL_ 1031 EVCC_FailureReason 0 "None" 1 "SLAC_Failed." 2 "SECCDiscoverProtocol_Failed" 3 "TransportLayer_Failed" 4 "SupportAppProtocol_Failed" 5 "SessionSetup_Failed" 6 "Session Discover_Failed" 7 "ReadContrCertChain_Failed" 8 "ServiceDetail_Failed" 9 "PaymentServiceSelection_Failed" 10 "ReadRootCerts_Failed" 11 "ReadProvCert_Failed" 12 "CertificateInstallation_Failed" 13 "CertificateUpdate_Failed" 14 "PaymentDetails_Failed" 15 "Authorization_Failed" 16 "ChargeParameterDiscovery_Failed" 17 "PowerDelivery_Failed" 18 "MeteringReceipt_Failed" 19 "ChargingStatus_Failed" 20 "CableCheck_Failed" 21 "Precharge_Failed" 22 "CurrentDemand_Failed" 23 "WeldingDetection_Failed." 24 "SessionStop_Failed." 25 "StopCommunicationSession_Failed." 26 "IPAddressWaitTime" 27 "Sequence Performancetime." 28 "CommunicationSetupTime" 29 "ReadyToChargeTime" 30 "AuthorizationOngoinTime" 31 "ChrgParaDiscoveryOngoingTime" 32 "CableCheckOngoingTime." 33 "PrechargeOngoingTime." 34 "Init_ContractSelectionFailed" 35 "SDP_NoSharedSecurityOption." 36 "SDP_InvalidEnergyTransferMode." 37 "SD_NoSharedPaymentOption" 38 "SD_NoContractAndNoCertSrvcAvail" 39 "SrvcDet_NoContr_InstallSrvcAvail" 40 "TLS_Failed" 41 "V2G_Cert_Invalid" 63 "SNA";
VAL_ 1031 BatterySideVoltage 16383 "SNA";
VAL_ 1031 AC_LnLow 0 "voltage_in_range" 1 "voltage_above_threshold";
VAL_ 1031 AC_LnHi 0 "voltage_in_range" 1 "voltage_above_threshold";
VAL_ 288 BPCM_HV_Power_MaxCharge_LgTrm 16383 "SNA";
VAL_ 288 BPCM_HV_CrntLmtInstDschg 32767 "SNA";
VAL_ 288 BPCM_HV_CrntLmtInstChrg 32767 "SNA";
VAL_ 288 BPCM_HV_ChargingCurrentProfile 32767 "SNA";
VAL_ 288 BPCM_HV_Cell_MinDischrg_Imped 8191 "SNA";
VAL_ 288 BPCM_HV_Cell_MaxDischrg_Imped 8191 "SNA";
VAL_ 288 BPCM_CntctrsShtTrmOpeningWarn 0 "FALSE" 1 "TRUE";
VAL_ 292 HVBatContactorWeldCheck 0 "Not_Complete" 1 "Complete";
VAL_ 292 HVBatReady 0 "False" 1 "True";
VAL_ 292 BPCM_DC_CntctrsMidTrmOpeningWarn 0 "False" 1 "True";
VAL_ 292 BPCM_DC_CntctrsShtTrmOpeningWarn 0 "False" 1 "True";
VAL_ 292 BPCM_ImpactHardwireV 0 "Fail_Not_Present" 1 "Fail_Present";
VAL_ 292 BPCM_ImpactHardwire 0 "Not_Actuate" 1 "Actuate";
VAL_ 292 BPCM_HV_Char_Main_Contac_Sts 0 "Open" 1 "Closed" 3 "Error_Stuck_Open" 4 "Error_Stuck_Closed" 7 "SNA";
VAL_ 292 BPCM_HV_Trac_Main_Contac_Sts 0 "Open" 1 "Closed" 3 "Error_Stuck_Open" 4 "Error_Stuck_Closed" 7 "SNA";
VAL_ 292 BPCM_HV_BalancingMode 0 "No_balancing" 1 "Balancing_in_progress" 2 "Balancing_complete" 3 "Balancing_Error";
VAL_ 292 BPCM_HV_ChargingBusVoltage 2047 "SNA";
VAL_ 292 BPCM_HV_TractionBusVoltage 2047 "SNA";
VAL_ 292 BPCM_Pwr_Limp_Home_On 0 "Disable" 1 "Enable";
VAL_ 292 BPCM_HV_Trac_Bus_Sts 0 "Open" 1 "Closed" 2 "Precharging" 3 "Precharging_Failed" 4 "Precharging_Inhibited" 7 "SNA";
VAL_ 292 BPCM_HV_Char_Bus_Sts 0 "Open" 1 "Closed" 2 "Precharging" 3 "Precharging_Failed" 4 "Precharging_Inhibited" 7 "SNA";
VAL_ 292 BPCM_HV_SOH_Low 127 "SNA";
VAL_ 292 BPCM_HV_SOH 127 "SNA";
VAL_ 485 BPCM_HV_NumCellMinTemp 511 "SNA";
VAL_ 485 BPCM_HV_NumCellMaxTemp 511 "SNA";
VAL_ 485 BPCM_HV_NumCellMinVolt 511 "SNA";
VAL_ 485 BPCM_HV_NumCellMaxVolt 511 "SNA";
VAL_ 485 BPCM_Min_Pk_Volt_Allowed 2047 "SNA";
VAL_ 485 BPCM_Max_Pk_Volt_Allowed 2047 "SNA";
VAL_ 288 BPCM_HV_HVBatChargeStat 0 "NOT_READY" 1 "READY" 2 "ERROR_DETECTED" 3 "COMPLETE" 7 "SNA";
VAL_ 292 BPCMInterlockSts 0 "Not_Performed" 1 "OK" 2 "Fail" 3 "Invalid" 4 "Service_Disconnect";
VAL_ 292 BPCM_HV_BatIntrlk_InternalStat 0 "Not_Performed" 1 "OK" 2 "Fail" 3 "Invalid";
VAL_ 485 BPCM_OCV_Min_Cell_Volt 8191 "SNA";
VAL_ 485 BPCM_OCV_Max_Cell_Volt 8191 "SNA";
VAL_ 485 BPCM_OCV_Avg_Cell_Volt 8191 "SNA";
VAL_ 485 BPCM_Min_Cell_Volt_Allowed 8191 "SNA";
VAL_ 485 BPCM_Max_Cell_Volt_Allowed 8191 "SNA";
VAL_ 485 BPCM_Cell_Volt_Min 8191 "SNA";
VAL_ 485 BPCM_Cell_Volt_Max 8191 "SNA";
VAL_ 485 BPCM_Cell_Volt_Avg 8191 "SNA";
VAL_ 292 BPCM_HV_Temperature_Min 2047 "SNA";
VAL_ 292 BPCM_HV_Temperature_Max 2047 "SNA";
VAL_ 292 BPCM_HV_Temperature_Avg 2047 "SNA";
VAL_ 292 BPCM_HV_SOC 1023 "SNA";
VAL_ 292 BPCM_HV_Outlet_Temp 2047 "SNA";
VAL_ 292 BPCM_HV_InternalVoltage 16383 "SNA";
VAL_ 292 BPCM_HV_Inlet_Temp 2047 "SNA";
VAL_ 292 BPCM_HV_Current 65535 "SNA";
VAL_ 292 BPCM_HV_Capacity 4095 "SNA";
VAL_ 292 BPCM_HV_Battery_GFD_Sts 0 "GFD_Not_Performed" 1 "GFD_OK" 2 "GFD_Fail" 3 "GFD_INVALID_meas_noise" 4 "Disabled";
VAL_ 288 BPCM_HV_PwrLmtInstDschg 16383 "SNA";
VAL_ 288 BPCM_HV_PwrLmtInstChrg 16383 "SNA";
VAL_ 288 BPCM_HV_Pwr_MaxDischrg_ShrTrm 16383 "SNA";
VAL_ 288 BPCM_HV_Power_MaxDischarge_MdTrm 16383 "SNA";
VAL_ 288 BPCM_HV_Power_MaxDischarge_LgTrm 16383 "SNA";
VAL_ 288 BPCM_HV_Power_MaxCharge_ShrTrm 16383 "SNA";
VAL_ 288 BPCM_HV_Power_MaxCharge_MdTrm 16383 "SNA";
VAL_ 288 BPCM_CntctrsMidTrmOpeningWarn 0 "FALSE" 1 "TRUE";
VAL_ 1965 HVBatCellVoltage_Cell232 8191 "SNA";
VAL_ 1965 HVBatCellVoltage_Cell231 8191 "SNA";
VAL_ 1965 HVBatCellVoltage_Cell230 8191 "SNA";
VAL_ 1965 HVBatCellVoltage_Cell229 8191 "SNA";
VAL_ 1965 HVBatCellVoltage_Cell228 8191 "SNA";
VAL_ 1965 HVBatCellVoltage_Cell227 8191 "SNA";
VAL_ 1965 HVBatCellVoltage_Cell226 8191 "SNA";
VAL_ 1965 HVBatCellVoltage_Cell225 8191 "SNA";
VAL_ 1965 HVBatCellVoltage_Cell224 8191 "SNA";
VAL_ 1965 HVBatCellVoltage_Cell223 8191 "SNA";
VAL_ 1965 HVBatCellVoltage_Cell222 8191 "SNA";
VAL_ 1965 HVBatCellVoltage_Cell221 8191 "SNA";
VAL_ 1965 HVBatCellVoltage_Cell220 8191 "SNA";
VAL_ 1965 HVBatCellVoltage_Cell219 8191 "SNA";
VAL_ 1965 HVBatCellVoltage_Cell218 8191 "SNA";
VAL_ 1965 HVBatCellVoltage_Cell217 8191 "SNA";
VAL_ 1963 HVBatCellVoltage_Cell400 8191 "SNA";
VAL_ 1963 HVBatCellVoltage_Cell399 8191 "SNA";
VAL_ 1963 HVBatCellVoltage_Cell398 8191 "SNA";
VAL_ 1963 HVBatCellVoltage_Cell397 8191 "SNA";
VAL_ 1963 HVBatCellVoltage_Cell396 8191 "SNA";
VAL_ 1963 HVBatCellVoltage_Cell395 8191 "SNA";
VAL_ 1963 HVBatCellVoltage_Cell394 8191 "SNA";
VAL_ 1963 HVBatCellVoltage_Cell393 8191 "SNA";
VAL_ 1962 HVBatCellVoltage_Cell392 8191 "SNA";
VAL_ 1962 HVBatCellVoltage_Cell391 8191 "SNA";
VAL_ 1962 HVBatCellVoltage_Cell390 8191 "SNA";
VAL_ 1962 HVBatCellVoltage_Cell389 8191 "SNA";
VAL_ 1962 HVBatCellVoltage_Cell388 8191 "SNA";
VAL_ 1962 HVBatCellVoltage_Cell387 8191 "SNA";
VAL_ 1962 HVBatCellVoltage_Cell386 8191 "SNA";
VAL_ 1962 HVBatCellVoltage_Cell385 8191 "SNA";
VAL_ 1962 HVBatCellVoltage_Cell384 8191 "SNA";
VAL_ 1962 HVBatCellVoltage_Cell383 8191 "SNA";
VAL_ 1962 HVBatCellVoltage_Cell382 8191 "SNA";
VAL_ 1962 HVBatCellVoltage_Cell381 8191 "SNA";
VAL_ 1962 HVBatCellVoltage_Cell380 8191 "SNA";
VAL_ 1962 HVBatCellVoltage_Cell379 8191 "SNA";
VAL_ 1962 HVBatCellVoltage_Cell378 8191 "SNA";
VAL_ 1962 HVBatCellVoltage_Cell377 8191 "SNA";
VAL_ 1962 HVBatCellVoltage_Cell376 8191 "SNA";
VAL_ 1962 HVBatCellVoltage_Cell375 8191 "SNA";
VAL_ 1962 HVBatCellVoltage_Cell374 8191 "SNA";
VAL_ 1962 HVBatCellVoltage_Cell373 8191 "SNA";
VAL_ 1962 HVBatCellVoltage_Cell372 8191 "SNA";
VAL_ 1962 HVBatCellVoltage_Cell371 8191 "SNA";
VAL_ 1962 HVBatCellVoltage_Cell370 8191 "SNA";
VAL_ 1962 HVBatCellVoltage_Cell369 8191 "SNA";
VAL_ 1962 HVBatCellVoltage_Cell368 8191 "SNA";
VAL_ 1962 HVBatCellVoltage_Cell367 8191 "SNA";
VAL_ 1962 HVBatCellVoltage_Cell366 8191 "SNA";
VAL_ 1962 HVBatCellVoltage_Cell365 8191 "SNA";
VAL_ 1962 HVBatCellVoltage_Cell364 8191 "SNA";
VAL_ 1962 HVBatCellVoltage_Cell363 8191 "SNA";
VAL_ 1962 HVBatCellVoltage_Cell362 8191 "SNA";
VAL_ 1962 HVBatCellVoltage_Cell361 8191 "SNA";
VAL_ 1961 HVBatCellVoltage_Cell360 8191 "SNA";
VAL_ 1961 HVBatCellVoltage_Cell359 8191 "SNA";
VAL_ 1961 HVBatCellVoltage_Cell358 8191 "SNA";
VAL_ 1961 HVBatCellVoltage_Cell357 8191 "SNA";
VAL_ 1961 HVBatCellVoltage_Cell356 8191 "SNA";
VAL_ 1961 HVBatCellVoltage_Cell355 8191 "SNA";
VAL_ 1961 HVBatCellVoltage_Cell354 8191 "SNA";
VAL_ 1961 HVBatCellVoltage_Cell353 8191 "SNA";
VAL_ 1961 HVBatCellVoltage_Cell352 8191 "SNA";
VAL_ 1961 HVBatCellVoltage_Cell351 8191 "SNA";
VAL_ 1961 HVBatCellVoltage_Cell350 8191 "SNA";
VAL_ 1961 HVBatCellVoltage_Cell349 8191 "SNA";
VAL_ 1961 HVBatCellVoltage_Cell348 8191 "SNA";
VAL_ 1961 HVBatCellVoltage_Cell347 8191 "SNA";
VAL_ 1961 HVBatCellVoltage_Cell346 8191 "SNA";
VAL_ 1961 HVBatCellVoltage_Cell345 8191 "SNA";
VAL_ 1961 HVBatCellVoltage_Cell344 8191 "SNA";
VAL_ 1961 HVBatCellVoltage_Cell343 8191 "SNA";
VAL_ 1961 HVBatCellVoltage_Cell342 8191 "SNA";
VAL_ 1961 HVBatCellVoltage_Cell341 8191 "SNA";
VAL_ 1961 HVBatCellVoltage_Cell340 8191 "SNA";
VAL_ 1961 HVBatCellVoltage_Cell339 8191 "SNA";
VAL_ 1961 HVBatCellVoltage_Cell338 8191 "SNA";
VAL_ 1961 HVBatCellVoltage_Cell337 8191 "SNA";
VAL_ 1961 HVBatCellVoltage_Cell336 8191 "SNA";
VAL_ 1961 HVBatCellVoltage_Cell335 8191 "SNA";
VAL_ 1961 HVBatCellVoltage_Cell334 8191 "SNA";
VAL_ 1961 HVBatCellVoltage_Cell333 8191 "SNA";
VAL_ 1961 HVBatCellVoltage_Cell332 8191 "SNA";
VAL_ 1961 HVBatCellVoltage_Cell331 8191 "SNA";
VAL_ 1961 HVBatCellVoltage_Cell330 8191 "SNA";
VAL_ 1961 HVBatCellVoltage_Cell329 8191 "SNA";
VAL_ 1960 HVBatCellVoltage_Cell328 8191 "SNA";
VAL_ 1960 HVBatCellVoltage_Cell327 8191 "SNA";
VAL_ 1960 HVBatCellVoltage_Cell326 8191 "SNA";
VAL_ 1960 HVBatCellVoltage_Cell325 8191 "SNA";
VAL_ 1960 HVBatCellVoltage_Cell324 8191 "SNA";
VAL_ 1960 HVBatCellVoltage_Cell323 8191 "SNA";
VAL_ 1960 HVBatCellVoltage_Cell322 8191 "SNA";
VAL_ 1960 HVBatCellVoltage_Cell321 8191 "SNA";
VAL_ 1960 HVBatCellVoltage_Cell320 8191 "SNA";
VAL_ 1960 HVBatCellVoltage_Cell319 8191 "SNA";
VAL_ 1960 HVBatCellVoltage_Cell318 8191 "SNA";
VAL_ 1960 HVBatCellVoltage_Cell317 8191 "SNA";
VAL_ 1960 HVBatCellVoltage_Cell316 8191 "SNA";
VAL_ 1960 HVBatCellVoltage_Cell315 8191 "SNA";
VAL_ 1960 HVBatCellVoltage_Cell314 8191 "SNA";
VAL_ 1960 HVBatCellVoltage_Cell313 8191 "SNA";
VAL_ 1960 HVBatCellVoltage_Cell312 8191 "SNA";
VAL_ 1960 HVBatCellVoltage_Cell311 8191 "SNA";
VAL_ 1960 HVBatCellVoltage_Cell310 8191 "SNA";
VAL_ 1960 HVBatCellVoltage_Cell309 8191 "SNA";
VAL_ 1960 HVBatCellVoltage_Cell308 8191 "SNA";
VAL_ 1960 HVBatCellVoltage_Cell307 8191 "SNA";
VAL_ 1960 HVBatCellVoltage_Cell306 8191 "SNA";
VAL_ 1960 HVBatCellVoltage_Cell305 8191 "SNA";
VAL_ 1960 HVBatCellVoltage_Cell304 8191 "SNA";
VAL_ 1960 HVBatCellVoltage_Cell303 8191 "SNA";
VAL_ 1960 HVBatCellVoltage_Cell302 8191 "SNA";
VAL_ 1960 HVBatCellVoltage_Cell301 8191 "SNA";
VAL_ 1960 HVBatCellVoltage_Cell300 8191 "SNA";
VAL_ 1960 HVBatCellVoltage_Cell299 8191 "SNA";
VAL_ 1960 HVBatCellVoltage_Cell298 8191 "SNA";
VAL_ 1960 HVBatCellVoltage_Cell297 8191 "SNA";
VAL_ 292 BPCM_Wakeup_Request 0 "No_Event" 1 "Wakeup_Event";
VAL_ 292 BPCM_HV_ThermalRunaway 0 "Default" 1 "No_Thermal_Runaway" 2 "Thermal_Runaway_Detected" 3 "SNA";
VAL_ 1031 Plug_And_Charge_Contract_Sts 0 "No_Contract" 1 "Transfer_In_Progress" 2 "Contract_Load_Failed" 3 "Contract_Success";
VAL_ 1031 RCD 0 "No_Error" 1 "Error";
VAL_ 1031 EVSENominalVoltage 1023 "SNA";
VAL_ 1031 EVSEMaxCurrent 511 "SNA";
VAL_ 1063 MCPB_ROL_STATUS 0 "Not_Learned" 1 "Standby" 2 "Exe" 3 "FBend" 4 "End" 5 "OFF";
VAL_ 292 BPCM_MILRequest 0 "False" 1 "True";
VAL_ 292 HVBP_Busbar_Temp 255 "SNA";
VAL_ 292 HVBP_BDU_Busbar_Temp 255 "SNA";
VAL_ 292 BPCM_HV_DCFC_Isolation_Sts 0 "Not_Performed" 1 "No_Failure" 3 "Failure" 4 "Error" 7 "SNA";
VAL_ 1063 MCPB_ROL_Request 0 "No_Request" 1 "ROL_Request";
VAL_ 292 BPCM_HV_Trac_PreCha_Contac_Sts 0 "Not_Performed" 1 "No_Failure" 3 "Failure" 4 "Error" 7 "SNA";
SIG_GROUP_ 1031 HV_CHARGER1_Pkt 1 : InputCurrentAvailable AC_Side_Volt3 AC_Side_Volt2 AC_Side_Volt1 AC_Side_Curr3 AC_Side_Curr2 AC_Side_Curr1 ProximitySts OBCM_SlacSts OBCM_SdpSts OBCInterlockSts OBC_DeratingReason J1772_State J1772_S2_Sts InputVoltage_isAC InputVoltage_is60Hz HV_Overvoltage HV_Overcurrent ControlPilotSts ChargeEnableSts ChargeCurrentAvailable ChargeCurrent BatterySideCurrent AC_Present AC_HighLoadWarning Supported_VerNumberMinor Supported_VerNumberMajor Supported_SchemaID Supported_ProtocolName MessageCounter_HV_CHARGER1 EVCC_FailureReason CRC_HV_CHARGER1 BatterySideVoltage AC_LnLow AC_LnHi Plug_And_Charge_Contract_Sts RCD EVSENominalVoltage EVSEMaxCurrent;
SIG_GROUP_ 1063 MCPB_DATA2_Pkt 1 : MCPB_Temp MCPB_Rotor_Temperature MCPB_Inverter_Temp CLrDiagInfo_MCPB MessageCounter_MCPB_DATA2 MCPB_ROL_STATUS MAC_MCPB_DATA2 CRC_MCPB_DATA2 Cntr_MCPB_DATA2 MCPB_ROL_Request;
SIG_GROUP_ 292 BATTERY_HV_STATUS1_Pkt 1 : MessageCounter_BATT_HV_STATUS1 CRC_BATT_HV_STATUS1 HVBatContactorWeldCheck HVBatReady BPCM_DC_CntctrsMidTrmOpeningWarn BPCM_DC_CntctrsShtTrmOpeningWarn BPCM_ImpactHardwireV BPCM_ImpactHardwire BPCM_HV_Char_Main_Contac_Sts BPCM_HV_Trac_Main_Contac_Sts BPCM_HV_BalancingMode BPCM_HV_ChargingBusVoltage BPCM_HV_TractionBusVoltage BPCM_Pwr_Limp_Home_On BPCM_HV_Trac_Bus_Sts BPCM_HV_Char_Bus_Sts BPCM_HV_SOH_Low BPCM_HV_SOH HVBatContactorOpenTime HVBatLastSlept BPCMInterlockSts BPCM_HV_BatIntrlk_InternalStat BPCM_HV_Temperature_Min BPCM_HV_Temperature_Max BPCM_HV_Temperature_Avg BPCM_HV_SOC BPCM_HV_Outlet_Temp BPCM_HV_InternalVoltage BPCM_HV_Inlet_Temp BPCM_HV_Current BPCM_HV_Capacity BPCM_HV_Battery_GFD_Sts BPCM_Wakeup_Request BPCM_HV_ThermalRunaway BPCM_MILRequest HVBP_Busbar_Temp HVBP_BDU_Busbar_Temp BPCM_HV_DCFC_Isolation_Sts BPCM_HV_Trac_PreCha_Contac_Sts;
SIG_GROUP_ 485 BATTERY_HV_VLIMITS_Pkt 1 : MessageCounter_BATT_HV_VLIMITS CRC_BATT_HV_VLIMITS BPCM_HV_NumCellMinTemp BPCM_HV_NumCellMaxTemp BPCM_HV_NumCellMinVolt BPCM_HV_NumCellMaxVolt BPCM_Min_Pk_Volt_Allowed BPCM_Max_Pk_Volt_Allowed BPCM_OCV_Min_Cell_Volt BPCM_OCV_Max_Cell_Volt BPCM_OCV_Avg_Cell_Volt BPCM_Min_Cell_Volt_Allowed BPCM_Max_Cell_Volt_Allowed BPCM_HV_Insulation_Resistance BPCM_Cell_Volt_Min BPCM_Cell_Volt_Max BPCM_Cell_Volt_Avg;
SIG_GROUP_ 288 BATTERY_HV_POWERLIMITS_Pkt 1 : BPCM_HV_HVBatChargeStat BPCM_HV_PwrLmtInstDschg BPCM_HV_PwrLmtInstChrg BPCM_HV_Pwr_MaxDischrg_ShrTrm BPCM_HV_Power_MaxDischarge_MdTrm BPCM_HV_Power_MaxDischarge_LgTrm BPCM_HV_Power_MaxCharge_ShrTrm BPCM_HV_Power_MaxCharge_MdTrm BPCM_HV_Power_MaxCharge_LgTrm BPCM_HV_CrntLmtInstDschg BPCM_HV_CrntLmtInstChrg BPCM_HV_ChargingCurrentProfile BPCM_HV_Cell_MinDischrg_Imped BPCM_HV_Cell_MaxDischrg_Imped BPCM_CntctrsShtTrmOpeningWarn BPCM_CntctrsMidTrmOpeningWarn MessageCounter_BATT_HV_POWERLIMS CRC_BATT_HV_POWERLIMS;

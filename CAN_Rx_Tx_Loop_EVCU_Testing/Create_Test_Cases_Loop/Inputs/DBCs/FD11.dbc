VERSION ""

NS_ :

BS_:

BU_: SGW PBWM IDCM EVCU2 ECM DMPI BPCM AGSM

BO_ 502 VDCM_OBCM: 48 EVCU2
 SG_ VDCM_OBCDischCurrentLim : 265|14@0+ (0.1,-815) [-815|823.3] "A"  IDCM
 SG_ VDCM_BattBulkSOC : 283|10@0+ (0.1,0) [0|100] "%"  IDCM
 SG_ HVCMS_ServiceScope : 87|16@0+ (1,0) [0|65534] "" IDCM
 SG_ HVCMS_ReadyToChargeState : 271|1@0+ (1,0) [0|1] "" IDCM
 SG_ HVCMS_Protocol_Entry3 : 39|16@0+ (1,0) [0|65534] "" IDCM
 SG_ HVCMS_Protocol_Entry2 : 23|16@0+ (1,0) [0|65534] "" IDCM
 SG_ HVCMS_Protocol_Entry1 : 7|16@0+ (1,0) [0|65534] "" IDCM
 SG_ HVCMS_EVTargetVoltage : 247|14@0+ (0.1,0) [0|1638.2] "V"  IDCM
 SG_ HVCMS_EVTargetCurrent : 249|10@0+ (1,-500) [-500|522] "" IDCM
 SG_ HVCMS_EVRESSConditioning : 171|1@0+ (1,0) [0|1] "" IDCM
 SG_ HVCMS_EVRESS_SOC : 159|12@0+ (0.02442,0) [0|99.97548] "%"  IDCM
 SG_ HVCMS_EVReady : 170|1@0+ (1,0) [0|1] "" IDCM
 SG_ HVCMS_EVMax_V_Limit : 215|14@0+ (0.1,0) [0|1638.2] "V"  IDCM
 SG_ HVCMS_EVMax_P_Limit : 191|24@0+ (0.1,0) [0|1677721.4] "W"  IDCM
 SG_ HVCMS_EVMax_I_Limit : 169|10@0+ (1,-500) [-500|522] "A"  IDCM
 SG_ HVCMS_EVEnergyCapacity : 217|17@0+ (1,0) [0|131070] "Wh"  IDCM
 SG_ HVCMS_ChargingComplete : 269|1@0+ (1,0) [0|1] "" IDCM
 SG_ HVCMS_BulkChargingComplete : 270|1@0+ (1,0) [0|1] "" IDCM
 SG_ VDCM_TypeCNegotiationSts : 378|3@0+ (1,0) [0|7] "" IDCM
 SG_ VDCM_GenChallenge : 362|16@0+ (1,0) [0|65535] "" IDCM
 SG_ VDCM_ContractAuthenticationID : 346|16@0+ (1,0) [0|65535] "" IDCM
 SG_ HVCMS_EVEnergyRequest : 331|17@0+ (1,0) [0|131071] "Wh"  IDCM
 SG_ OBCM_OutVoltageSyncTgt : 289|10@0+ (1,0) [0|1022] "V"  IDCM
 SG_ HVCMS_ServiceCategory : 103|4@0+ (1,0) [0|15] "" IDCM
 SG_ HVCMS_SelectedServiceId : 135|16@0+ (1,0) [0|65535] "" IDCM
 SG_ HVCMS_SelectedPaymentOptn : 119|2@0+ (1,0) [0|3] "" IDCM
 SG_ HVCMS_SelectedEnergyTransferType : 151|4@0+ (1,0) [0|15] "" IDCM
 SG_ HVCMS_RemaningTimeToFullSOC : 71|16@0+ (1,0) [0|65535] "sec"  IDCM
 SG_ HVCMS_RemaningTimeToBulkSOC : 55|16@0+ (1,0) [0|65534] "" IDCM
 SG_ HVCMS_EVErrorCode : 163|4@0+ (1,0) [0|15] "" IDCM

BO_ 498 OBCM_VDCM: 48 IDCM
 SG_ HVCMS_EVSEPresentVoltage : 250|14@0+ (0.1,0) [0|1638.3] "V"  EVCU2
 SG_ HVCMS_EVSEPeakCurrentRipple : 199|10@0+ (1,-500) [-500|523] "A"  EVCU2
 SG_ HVCMS_EVSEMinCurrentLimit : 157|10@0+ (1,-500) [-500|523] "A"  EVCU2
 SG_ HVCMS_EVSEMaxPowerLimit : 205|24@0+ (0.1,0) [0|1677721.5] "W"  EVCU2
 SG_ HVCMS_EVSEMaxCurrentLimit : 151|10@0+ (1,-500) [-500|523] "A"  EVCU2
 SG_ HVCMS_EVSECurrRegulationTol : 244|10@0+ (1,-500) [-500|523] "A"  EVCU2
 SG_ HVCMS_EnergyToBeDelivered : 229|17@0+ (1,0) [0|131071] "Wh"  EVCU2
 SG_ EVSE_IsolationSts : 143|3@0+ (1,0) [0|7] "" EVCU2
 SG_ EVSE_Accepted_Protocol : 39|16@0+ (1,0) [0|65535] "" EVCU2
 SG_ DC_TimeOut : 139|1@0+ (1,0) [0|1] "" EVCU2
 SG_ DC_Isolation_Disable_Cmd : 140|1@0+ (1,0) [0|1] "" EVCU2
 SG_ OBCM_PLCTypeSts : 337|3@0+ (1,0) [0|6] "" EVCU2
 SG_ HVCMS_EVSEVoltageLimitAchieved : 286|2@0+ (1,0) [0|3] "" EVCU2
 SG_ HVCMS_EVSEPowerLimitAchieved : 272|2@0+ (1,0) [0|3] "" EVCU2
 SG_ HVCMS_EVSEMinimumVoltageLimit : 300|16@0+ (0.1,0) [0|6553.4] "V"  EVCU2
 SG_ HVCMS_EVSEMaximumVoltageLimit : 284|16@0+ (0.1,0) [0|6553.4] "V"  EVCU2
 SG_ HVCMS_EVSECurrentLimitAchieved : 274|2@0+ (1,0) [0|3] "" EVCU2
 SG_ HVCMS_EVSEPresentCurrent : 350|16@0+ (0.02,0) [0|1310.7] "A"  EVCU2
 SG_ EVSE_OfferedEnergyTransferType : 103|4@0+ (1,0) [0|15] "" EVCU2
 SG_ HVCMS_TxMessageStat : 7|5@0+ (1,0) [0|31] "" EVCU2
 SG_ HVCMS_ResponseCode : 23|5@0+ (1,0) [0|31] "" EVCU2
 SG_ HVCMS_EVSEProcessing : 119|1@0+ (1,0) [0|1] "" EVCU2
 SG_ EVSE_FreeService : 71|1@0+ (1,0) [0|1] "" EVCU2
 SG_ TxMessageResponse : 70|5@0+ (1,0) [0|31] "" EVCU2
 SG_ HVCMS_EVSEStatusCode : 135|4@0+ (1,0) [0|15] "" EVCU2
 SG_ EVSE_ServiceId : 55|16@0+ (1,0) [0|65535] "" EVCU2
 SG_ EVSE_OfferedService : 138|3@0+ (1,0) [0|7] "" EVCU2
 SG_ EVSE_OfferedPaymentOptn : 87|2@0+ (1,0) [0|3] "" EVCU2
 SG_ MC_OBCM_VDCM : 371|4@0+ (1,0) [0|15] "" EVCU2
 SG_ EVSE_Supported_ISO1 : 64|1@0+ (1,0) [0|1] "" EVCU2
 SG_ EVSE_Supported_DIN : 65|1@0+ (1,0) [0|1] "-"  EVCU2
 SG_ CRC_OBCM_VDCM : 383|8@0+ (1,0) [0|255] "" EVCU2
 SG_ EVSE_Service2_Certificate : 16|1@0+ (1,0) [0|1] "-"  EVCU2
 SG_ EVSE_OfferedPaymentEIM : 18|1@0+ (1,0) [0|1] "-"  EVCU2
 SG_ EVSE_OfferedPaymentContract : 17|1@0+ (1,0) [0|1] "-"  EVCU2
 SG_ EVSE_Notification : 2|2@0+ (1,0) [0|3] "" EVCU2
 SG_ ReceiptRequired : 0|1@0+ (1,0) [0|1] "-"  EVCU2

BO_ 244 BATTERY_HV: 64 BPCM
 SG_ BMS_HV_InternalVoltage : 278|13@0+ (0.1,90.9) [90.9|910] "V"  SGW
 SG_ BMS_HV_Current : 213|15@0+ (0.1,-1638.4) [-1638.4|1638.2] "A"  SGW
 SG_ BMS_HV_Battery_GFD_Sts : 251|3@0+ (1,0) [0|7] "" SGW
 SG_ BMS_HV_Temperature_Min : 157|11@0+ (0.1,-40) [-40|164.7] "°C"  SGW
 SG_ BMS_HV_Temperature_Max : 136|11@0+ (0.1,-40) [-40|164.7] "°C"  SGW
 SG_ ImpactHardwireV : 500|1@0+ (1,0) [0|1] "" EVCU2
 SG_ ImpactHardwire : 501|1@0+ (1,0) [0|1] "" EVCU2
 SG_ MC_BHV1 : 499|4@0+ (1,0) [0|15] "" EVCU2
 SG_ CRC_BHV1 : 511|8@0+ (1,0) [0|255] "" EVCU2

BO_ 500 BATT_PACK_DEV: 32 BPCM
 SG_ BMS_HV_NumCellMinTemp : 174|9@0+ (1,0) [0|510] "" SGW
 SG_ BMS_HV_NumCellMaxVolt : 53|8@0+ (1,0) [0|255] "" SGW
 SG_ BMS_HV_NumCellMaxTemp : 167|9@0+ (1,0) [0|510] "" SGW
 SG_ BMS_Cell_Volt_Min : 93|13@0+ (0.001,0) [0|8.19] "V"  SGW
 SG_ BMS_Cell_Volt_Max : 75|13@0+ (0.001,0) [0|8.19] "V"  SGW

BO_ 250 APM_VDCM: 32 DMPI
 SG_ APM_Water_Temp : 95|8@0+ (1,-40) [-40|214] "°C"  EVCU2
 SG_ APM_RecoveryAction : 101|8@0+ (1,0) [0|255] "" EVCU2
 SG_ APM_PSFB_Temp2 : 75|12@0+ (0.1,-40) [-40|369.4] "°C"  EVCU2
 SG_ APM_PSFB_Temp1 : 71|12@0+ (0.1,-40) [-40|369.4] "°C"  EVCU2
 SG_ APM_LV_V_Fbk : 47|12@0+ (0.009143,0) [0|37.431442] "V"  EVCU2
 SG_ APM_LV_I_Fbk : 23|12@0+ (0.076917,0) [0|314.898198] "A"  EVCU2
 SG_ APM_HV_V_Fbk : 51|12@0+ (0.445636,0) [0|1824.433784] "V"  EVCU2
 SG_ APM_HV_I_Fbk : 27|12@0+ (0.002718,0) [0|11.127492] "A"  EVCU2
 SG_ APM_Buck_Temp : 3|12@0+ (0.1,-40) [-40|369.4] "°C"  EVCU2
 SG_ APM_UtilPctOfDCDC : 154|7@0+ (1,0) [0|127] "%"  EVCU2
 SG_ APM_TempColdPlate : 146|8@0+ (1,-40) [-40|215] "degC"  EVCU2
 SG_ APM_PowerLimitMode : 112|1@0+ (1,0) [0|1] "" EVCU2
 SG_ APM_OutputPower : 179|10@0+ (3,0) [0|3069] "W"  EVCU2
 SG_ APM_InputPower : 173|10@0+ (3,0) [0|3069] "W"  EVCU2
 SG_ APM_IdcHvSetPFdbk : 140|10@0+ (0.2,-100) [-100|104.6] "Amp"  EVCU2
 SG_ APM_HvVsetPFdbk : 185|9@0+ (1,0) [0|511] "V"  EVCU2
 SG_ APM_HvOverVStatus : 114|1@0+ (1,0) [0|1] "" EVCU2
 SG_ APM_FailureType : 103|2@0+ (1,0) [0|3] "" EVCU2
 SG_ APM_FailureReason : 122|6@0+ (1,0) [0|63] "" EVCU2
 SG_ APM_EstPwrLoss : 132|8@0+ (2,0) [0|510] "W"  EVCU2
 SG_ APM_DeratingReason : 127|5@0+ (1,0) [0|31] "" EVCU2
 SG_ APM_DeratingModeStatus : 109|3@0+ (1,0) [0|7] "" EVCU2
 SG_ APM_CurrentLimitMode : 113|1@0+ (1,0) [0|1] "" EVCU2
 SG_ APM_CtrlSts_Fbk : 7|4@0+ (1,0) [0|15] "" EVCU2
 SG_ MessageCounter_APM_VDCM : 243|4@0+ (1,0) [0|15] "-"  EVCU2
 SG_ CRC_APM_VDCM : 255|8@0+ (1,0) [0|255] "-"  EVCU2
 SG_ APM_DeratingPower : 163|6@0+ (50,0) [0|3100] "W"  EVCU2

BO_ 546 VDCM_OBCM2: 64 EVCU2
 SG_ VDCM_MaxChrgTime_sec : 47|8@0+ (10,0) [0|2550] "sec"  IDCM
 SG_ VDCM_MaxChrgTime_min : 39|8@0+ (1,0) [0|255] "min"  IDCM
 SG_ VDCM_EV_Batt_Max_T_Limit : 23|8@0+ (1,0) [0|255] "°C"  IDCM
 SG_ VDCM_EstChrgTime_min : 31|8@0+ (1,0) [0|255] "min"  IDCM
 SG_ VDCM_ChrgMode_Req : 15|8@0+ (1,0) [0|255] "" IDCM
 SG_ VDCM_ChrgCurrDeviationErr : 48|1@0+ (1,0) [0|1] "" IDCM
 SG_ VDCM_ChrgCompleteReason : 63|3@0+ (1,0) [0|7] "" IDCM
 SG_ VDCM_BattUnderVolt : 51|1@0+ (1,0) [0|1] "" IDCM
 SG_ VDCM_BattOverVolt : 52|1@0+ (1,0) [0|1] "" IDCM
 SG_ VDCM_BattFullSOC_prc : 7|8@0+ (1,0) [0|255] "%"  IDCM
 SG_ CPIM_Over_Temperature : 54|1@0+ (1,0) [0|1] "" IDCM
 SG_ CPIM_Error : 55|1@0+ (1,0) [0|1] "" IDCM
 SG_ WeldCheck_Complete : 258|1@0+ (1,0) [0|1] "" IDCM
 SG_ VDCM_SOCIsOOR : 273|2@0+ (1,0) [0|3] "" IDCM
 SG_ VDCM_ChargeCurrIsOOR : 287|2@0+ (1,0) [0|3] "" IDCM
 SG_ VDCM_CellVoltIsOOR : 275|2@0+ (1,0) [0|3] "" IDCM
 SG_ VDCM_BattTempIsOOR : 285|2@0+ (1,0) [0|3] "" IDCM
 SG_ ReadyToChargeState : 259|1@0+ (1,0) [0|1] "" IDCM
 SG_ HCP_SessionStopCmd : 260|1@0+ (1,0) [0|1] "" IDCM
 SG_ HCP_DC_Retry : 249|5@0+ (1,0) [0|31] "" IDCM
 SG_ DCChrg_BatSideCurrent_VDCM : 237|10@0+ (1,-50) [-50|973] "A"  IDCM
 SG_ BMS_Max_Pk_Volt_Allowed_VDCM : 196|10@0+ (1,0) [0|1022] "V"  IDCM
 SG_ BMS_Max_Cell_Volt_Allowed_Vldty : 98|1@0+ (1,0) [0|1] "" IDCM
 SG_ BMS_Max_Cell_Volt_Allowed_VDCM : 95|13@0+ (0.001,0) [0|8.19] "V"  IDCM
 SG_ BMS_HV_Trac_PreCha_Contac_Sts_V : 176|3@0+ (1,0) [0|7] "" IDCM,BPCM
 SG_ BMS_HV_Trac_Main_Contac_Sts_VDCM : 189|3@0+ (1,0) [0|7] "" IDCM,BPCM
 SG_ BMS_HV_Temperature_Min_VDCM : 118|11@0+ (0.1,-40) [-40|164.6] "°C"  IDCM
 SG_ BMS_HV_Temperature_Max_VDCM : 97|11@0+ (0.1,-40) [-40|164.6] "°C"  IDCM
 SG_ BMS_HV_SOC_AccuracySts_VDCM : 161|2@0+ (1,0) [0|2] "-"  IDCM
 SG_ BMS_HV_NumCellMinTemp_VDCM : 123|9@0+ (1,0) [0|510] "" IDCM
 SG_ BMS_HV_NumCellMaxVolt_VDCM : 130|8@0+ (1,0) [0|255] "" IDCM
 SG_ BMS_HV_NumCellMaxTemp_VDCM : 172|9@0+ (1,0) [0|510] "" IDCM
 SG_ BMS_HV_Low_Temp_Thrsh_VDCM : 159|11@0+ (0.1,-40) [-40|164.7] "°C"  IDCM
 SG_ BMS_HV_InternalVoltage_VDCM : 213|13@0+ (0.1,90.9) [90.9|910] "V"  IDCM,BPCM
 SG_ BMS_HV_High_Temp_Thrsh_VDCM : 138|11@0+ (0.1,-40) [-40|164.7] "°C"  IDCM
 SG_ BMS_HV_Common_Contactor_Sts_VDCM : 164|3@0+ (1,0) [0|6] "" IDCM,BPCM
 SG_ BMS_HV_Battery_GFD_Sts_VDCM : 179|3@0+ (1,0) [0|7] "" IDCM,BPCM
 SG_ BMS_HV_BatIntrlk_InternalStat_V : 175|3@0+ (1,0) [0|7] "" IDCM,BPCM
 SG_ BMS_HV_AC_Char_Main_Contac_Sts_ : 200|3@0+ (1,0) [0|7] "" IDCM,BPCM
 SG_ BMS_Cell_Volt_Min_Vldty_VDCM : 80|1@0+ (1,0) [0|1] "" IDCM
 SG_ BMS_Cell_Volt_Min_VDCM : 77|13@0+ (0.001,0) [0|8.19] "V"  IDCM
 SG_ BMS_Cell_Volt_Max_Vldty_VDCM : 78|1@0+ (1,0) [0|1] "" IDCM
 SG_ BMS_Cell_Volt_Max_VDCM : 59|13@0+ (0.001,0) [0|8.19] "V"  IDCM
 SG_ AC_Chrg_Branch_Voltage_VDCM : 243|10@0+ (1,0) [0|1023] "V"  IDCM
 SG_ BMS_HV_Char_PreCha_Contac_Sts_V : 199|3@0+ (1,0) [0|7] "" IDCM,BPCM
 SG_ BMS_HV_Char_Main_Contac_Sts_VDCM : 186|3@0+ (1,0) [0|7] "" IDCM,BPCM
 SG_ BMS_HV_TractionBusVoltage_VDCM : 311|10@0+ (1,0) [0|1023] "V"  IDCM,BPCM
 SG_ BMS_HV_Trac_Bus_Sts_VDCM : 283|3@0+ (1,0) [0|7] "" IDCM,BPCM
 SG_ BMS_HV_ChargingBusVoltage_VDCM : 289|10@0+ (1,0) [0|1023] "V"  IDCM,BPCM
 SG_ BMS_HV_Char_Bus_Sts_VDCM : 280|3@0+ (1,0) [0|7] "" IDCM,BPCM
 SG_ BMS_HV_BatState_VDCM : 293|4@0+ (1,0) [0|15] "" IDCM,BPCM
 SG_ BMS_HV_BatActualPower_VDCM : 317|15@0+ (0.1,-1638.3) [-1638.3|1638.4] "kW"  IDCM,BPCM
 SG_ VDCM_ChargingPermitting : 53|1@0+ (1,0) [0|1] "" IDCM
 SG_ GBT_Target_Voltage_Reached : 334|2@0+ (1,0) [0|3] "" IDCM
 SG_ GBT_Target_Cell_Voltage_Reached : 332|2@0+ (1,0) [0|3] "" IDCM
 SG_ GBT_Ready_to_Charge : 60|1@0+ (1,0) [0|1] "" IDCM
 SG_ GBT_Desired_SOC_Reached : 50|2@0+ (1,0) [0|3] "" IDCM
 SG_ GBT_Charger_Active_Interruption : 330|2@0+ (1,0) [0|3] "" IDCM
 SG_ MessageCounter_VO2 : 435|4@0+ (1,0) [0|15] "" IDCM,BPCM
 SG_ CRC_VO2 : 447|8@0+ (1,0) [0|255] "" IDCM,BPCM
 SG_ SelectedSecurityProtocol : 328|1@0+ (1,0) [0|1] "-"  IDCM
 SG_ SelectedAppProtocol : 343|2@0+ (1,0) [0|3] "-"  IDCM

BO_ 496 PARK_DATA: 24 PBWM
 SG_ MessageCounter_PARK_DATA : 115|4@0+ (1,0) [0|15] "" EVCU2
 SG_ CRC_PARK_DATA : 127|8@0+ (1,0) [0|255] "" EVCU2
 SG_ PlockFailSts : 4|3@0+ (1,0) [0|6] "" EVCU2
 SG_ Plock_PosSensor : 1|3@0+ (1,0) [0|6] "" EVCU2
 SG_ Plock_MotorPosSts : 29|3@0+ (1,0) [0|6] "" EVCU2
 SG_ Plock_fdbk_sts : 7|3@0+ (1,0) [0|7] "" EVCU2

BO_ 544 OBCM_VDCM2: 64 IDCM
 SG_ Plug_Locked_by_EVSE : 52|2@0+ (1,0) [0|2] "" EVCU2
 SG_ HVCMS_EVSEID : 7|32@0+ (1,0) [0|4294967294] "" EVCU2
 SG_ ExtChargerSts : 42|2@0+ (1,0) [0|2] "" EVCU2
 SG_ EVSE_Error : 54|2@0+ (1,0) [0|2] "" EVCU2
 SG_ EVSE_ChrgStopControl : 40|2@0+ (1,0) [0|2] "" EVCU2
 SG_ Charger_WeldingDetectAvail : 44|2@0+ (1,0) [0|2] "" EVCU2
 SG_ Charger_StndbyReqReason : 47|3@0+ (1,0) [0|6] "" EVCU2
 SG_ Charger_StndbyReq : 33|2@0+ (1,0) [0|2] "" EVCU2
 SG_ Charger_FaultStates : 37|4@0+ (1,0) [0|14] "" EVCU2
 SG_ CC2VoltDetError : 39|2@0+ (1,0) [0|2] "" EVCU2
 SG_ OBCM_CSSts : 152|2@0+ (1,0) [0|3] "" EVCU2
 SG_ OBCM_CP3Sts : 158|3@0+ (1,0) [0|7] "" EVCU2
 SG_ OBCM_CP2Sts : 145|3@0+ (1,0) [0|7] "" EVCU2
 SG_ OBCM_CCSts : 155|3@0+ (1,0) [0|7] "" EVCU2
 SG_ OBCM_APAMSts : 147|2@0+ (1,0) [0|3] "" EVCU2
 SG_ TCP_Communication_Terminated : 162|1@0+ (1,0) [0|1] "" EVCU2
 SG_ OBCM_CP1Sts : 166|3@0+ (1,0) [0|7] "" EVCU2
 SG_ TxGBTMessageResponse : 61|5@0+ (1,0) [0|31] "" EVCU2
 SG_ TxGBTMessageRequest : 50|5@0+ (1,0) [0|31] "" EVCU2
 SG_ OBCM_Timeout : 56|1@0+ (1,0) [0|1] "" EVCU2
 SG_ EVCC_FailureSts : 163|1@0+ (1,0) [0|1] "" EVCU2
 SG_ CC2_VoltageValue : 71|8@0+ (0.1,0) [0|25.5] "V"  EVCU2
 SG_ GBT_EVSE_Charge_Permitting : 79|1@0+ (1,0) [0|1] "" EVCU2
 SG_ MessageCounter_OV2 : 435|4@0+ (1,0) [0|15] "" EVCU2
 SG_ CRC_OV2 : 447|8@0+ (1,0) [0|255] "" EVCU2
 SG_ EVSE_NotificationMaxDelay : 87|18@0+ (1,0) [0|262143] "s"  EVCU2
 SG_ CdM_ExtFun_Reset_Max_Time : 77|1@0+ (1,0) [0|1] "" EVCU2
 SG_ CdM_ExtFun_Relia_Design : 150|1@0+ (1,0) [0|1] "" EVCU2
 SG_ CdM_ExtFun_Over_Temp_Trotec_Conn : 149|1@0+ (1,0) [0|1] "" EVCU2
 SG_ CdM_ExtFun_Oper_Cond : 148|1@0+ (1,0) [0|1] "" EVCU2
 SG_ CdM_ExtFun_Cur_Lim_Conn : 72|1@0+ (1,0) [0|1] "" EVCU2
 SG_ CdM_ExtFun_Cur_Lim_Cable : 73|1@0+ (1,0) [0|1] "" EVCU2
 SG_ CdM_ExtFun_Cool_Func_Conn : 74|1@0+ (1,0) [0|1] "" EVCU2
 SG_ CdM_ExtFun_Cool_Func_Cable : 75|1@0+ (1,0) [0|1] "" EVCU2
 SG_ CdM_ExtFun_Chr_Dyn_Control_Comp : 78|1@0+ (1,0) [0|1] "" EVCU2
 SG_ CdM_ExtFun_Char_HC_Control_Comp : 76|1@0+ (1,0) [0|1] "" EVCU2

BO_ 1454 MCPB_DATA: 16 DMPI
 SG_ MCPB_Service_Lamp_Request : 22|1@0+ (1,0) [0|1] "" EVCU2
 SG_ MC_MCPB_DATA : 51|4@0+ (1,0) [0|15] "" EVCU2
 SG_ CRC_MCPB_DATA : 63|8@0+ (1,0) [0|255] "" EVCU2

BO_ 1444 MCPA_DATA: 16 DMPI
 SG_ MCPA_Service_Lamp_Request : 22|1@0+ (1,0) [0|1] "" EVCU2
 SG_ MC_MCPA_DATA : 51|4@0+ (1,0) [0|15] "" EVCU2
 SG_ CRC_MCPA_DATA : 63|8@0+ (1,0) [0|255] "" EVCU2

BO_ 1790 BATTERY_HV2: 32 BPCM
 SG_ BMS_HV_SOC_AccuracySts : 17|2@0+ (1,0) [0|2] "-"  EVCU2
 SG_ BMS_HV_Low_Temp_Thrsh : 12|11@0+ (0.1,-40) [-40|164.7] "°C"  EVCU2
 SG_ BMS_HV_High_Temp_Thrsh : 7|11@0+ (0.1,-40) [-40|164.7] "°C"  EVCU2
 SG_ HVBatCell_Voltage_Low_Thrsh : 49|13@0+ (0.001,0) [0|8.191] "" EVCU2
 SG_ HVBatCell_Voltage_High_Thrsh : 46|13@0+ (0.001,0) [0|8.191] "" EVCU2
 SG_ HEV_OnRq_BPCM : 31|1@0+ (1,0) [0|1] "" EVCU2
 SG_ BMS_HV_SOC_Min : 30|8@0+ (0.391257,0) [0|100] "%"  EVCU2
 SG_ BMS_HV_SOC_Max : 38|8@0+ (0.392157,0) [0|100] "%"  EVCU2
 SG_ MC_BATHV2 : 179|4@0+ (1,0) [0|15] "-"  EVCU2
 SG_ CRC_BATHV2 : 191|8@0+ (1,0) [0|255] "-"  EVCU2

BO_ 834 GLIWA_T1_TX: 8 EVCU2
 SG_ N_PDU : 7|64@0+ (1,0) [0|0] "" SGW

BO_ 835 GLIWA_T1_RX: 8 SGW
 SG_ N_PDU : 7|64@0+ (1,0) [0|0] "" EVCU2

BO_ 105 VDCM_PWT3: 64 EVCU2
 SG_ T7_Sensor_Temp : 330|11@0+ (0.1,-40) [-40|164.7] "°C"  DMPI
 SG_ T4_Sensor_Temp : 378|11@0+ (0.1,-40) [-40|164.7] "°C"  DMPI
 SG_ PIMF_CoolantFlowVldty : 327|1@0+ (1,0) [0|1] "" DMPI
 SG_ ClrLgsDiagInfo : 431|1@0+ (1,0) [0|1] "" IDCM
 SG_ PIMF_CoolantFlow : 326|7@0+ (0.5,0) [0|63.5] "Lpm"  DMPI

BO_ 1062 MCPA_DATA2: 64 DMPI
 SG_ MCPA_Temp : 7|8@0+ (1,-40) [-40|215] "°C"  EVCU2,SGW
 SG_ MCPA_Rotor_Temperature : 31|8@0+ (1,-40) [-40|215] "°C"  EVCU2
 SG_ MCPA_Inverter_Temp : 15|8@0+ (1,-40) [-40|215] "°C"  EVCU2
 SG_ CLrDiagInfo_MCPA : 248|1@0+ (1,0) [0|1] "" EVCU2
 SG_ MessageCounter_MCPA_DATA2 : 435|4@0+ (1,0) [0|15] "" EVCU2
 SG_ MCPA_ROL_STATUS : 38|3@0+ (1,0) [0|7] "" EVCU2
 SG_ MAC_MCPA_DATA2 : 471|48@0+ (1,0) [0|0] "" EVCU2
 SG_ CRC_MCPA_DATA2 : 447|8@0+ (1,0) [0|255] "" EVCU2
 SG_ Cntr_MCPA_DATA2 : 455|16@0+ (1,0) [0|65535] "" EVCU2
 SG_ MCPA_ROL_Request : 39|1@0+ (1,0) [0|1] "" EVCU2

BO_ 1893 HVBATTERY_RM_MODS2: 48 BPCM
 SG_ HVBatModuleTemp_66 : 199|8@0+ (1,-40) [-40|215] "°C"  SGW
 SG_ HVBatModuleTemp_65 : 191|8@0+ (1,-40) [-40|215] "°C"  SGW
 SG_ HVBatModuleTemp_64 : 183|8@0+ (1,-40) [-40|215] "°C"  SGW
 SG_ HVBatModuleTemp_63 : 175|8@0+ (1,-40) [-40|215] "°C"  SGW
 SG_ HVBatModuleTemp_62 : 167|8@0+ (1,-40) [-40|215] "°C"  SGW
 SG_ HVBatModuleTemp_61 : 159|8@0+ (1,-40) [-40|215] "°C"  SGW
 SG_ HVBatModuleTemp_60 : 151|8@0+ (1,-40) [-40|215] "°C"  SGW
 SG_ HVBatModuleTemp_59 : 143|8@0+ (1,-40) [-40|215] "°C"  SGW
 SG_ HVBatModuleTemp_58 : 135|8@0+ (1,-40) [-40|215] "°C"  SGW
 SG_ HVBatModuleTemp_57 : 127|8@0+ (1,-40) [-40|215] "°C"  SGW
 SG_ HVBatModuleTemp_56 : 119|8@0+ (1,-40) [-40|215] "°C"  SGW
 SG_ HVBatModuleTemp_55 : 111|8@0+ (1,-40) [-40|215] "°C"  SGW
 SG_ HVBatModuleTemp_54 : 103|8@0+ (1,-40) [-40|215] "°C"  SGW
 SG_ HVBatModuleTemp_41 : 223|8@0+ (1,-40) [-40|215] "°C"  SGW
 SG_ HVBatModuleTemp_40 : 215|8@0+ (1,-40) [-40|215] "°C"  SGW
 SG_ HVBatModuleTemp_39 : 207|8@0+ (1,-40) [-40|215] "°C"  SGW
 SG_ HVBatModuleVoltage_NumMin : 225|6@0+ (1,0) [0|63] "" Vector__XXX
 SG_ HVBatModuleVoltage_NumMax : 231|6@0+ (1,0) [0|63] "" Vector__XXX
 SG_ HVBatModuleTemp_53 : 95|8@0+ (1,-40) [-40|215] "°C"  SGW
 SG_ HVBatModuleTemp_52 : 87|8@0+ (1,-40) [-40|215] "°C"  SGW
 SG_ HVBatModuleTemp_51 : 79|8@0+ (1,-40) [-40|215] "°C"  SGW
 SG_ HVBatModuleTemp_50 : 71|8@0+ (1,-40) [-40|215] "°C"  SGW
 SG_ HVBatModuleTemp_49 : 63|8@0+ (1,-40) [-40|215] "°C"  SGW
 SG_ HVBatModuleTemp_48 : 55|8@0+ (1,-40) [-40|215] "°C"  SGW
 SG_ HVBatModuleTemp_47 : 47|8@0+ (1,-40) [-40|215] "°C"  SGW
 SG_ HVBatModuleTemp_46 : 39|8@0+ (1,-40) [-40|215] "°C"  SGW
 SG_ HVBatModuleTemp_45 : 31|8@0+ (1,-40) [-40|215] "°C"  SGW
 SG_ HVBatModuleTemp_44 : 23|8@0+ (1,-40) [-40|215] "°C"  SGW
 SG_ HVBatModuleTemp_43 : 15|8@0+ (1,-40) [-40|215] "°C"  SGW
 SG_ HVBatModuleTemp_42 : 7|8@0+ (1,-40) [-40|215] "°C"  SGW

BO_TX_BU_ 250 : DMPI,IDCM;
CM_ SG_ 502 VDCM_TypeCNegotiationSts "This signal indicates the Status of Negotiation in case of Type C EVSE";
CM_ SG_ 502 VDCM_OBCDischCurrentLim "This signal indicates the Limit of discharge current.";
CM_ SG_ 502 VDCM_GenChallenge "This signal indicates the Contract Authentication request gen challenge.";
CM_ SG_ 502 VDCM_ContractAuthenticationID "This signal indicates the Contract Authentication ID.";
CM_ SG_ 502 VDCM_BattBulkSOC "This signal indicates the SOC at which the battery is considered as full.";
CM_ SG_ 502 OBCM_OutVoltageSyncTgt "This signal indicates the OBCM Precharge Voltage Level";
CM_ SG_ 502 HVCMS_ServiceScope "This signal indicates the HVCMS Service Scope.";
CM_ SG_ 502 HVCMS_ServiceCategory "This signal indicates the HVCMS Service Category.";
CM_ SG_ 502 HVCMS_SelectedServiceId "This signal indicates the HVCMS Selected Service Identifier.";
CM_ SG_ 502 HVCMS_SelectedPaymentOptn "This signal indicates the HVCMS Selected Payment Option.";
CM_ SG_ 502 HVCMS_SelectedEnergyTransferType "This signal indicates the HVCMS Selected Energy Transfer Type.";
CM_ SG_ 502 HVCMS_RemaningTimeToFullSOC "This signal indicates the HVCM Remaning Time To Full SOC.";
CM_ SG_ 502 HVCMS_RemaningTimeToBulkSOC "This signal indicates the HVCM Remaning Time To Bulk SOC.";
CM_ SG_ 502 HVCMS_ReadyToChargeState "This signal indicates the HVCMS_ReadyToChargeState.";
CM_ SG_ 502 HVCMS_Protocol_Entry3 "HVCMS Protocol";
CM_ SG_ 502 HVCMS_Protocol_Entry2 "HVCMS Protocol";
CM_ SG_ 502 HVCMS_Protocol_Entry1 "HVCMS Protocol";
CM_ SG_ 502 HVCMS_EVTargetVoltage "This signal indicates the HVCMS EV Target Voltage.";
CM_ SG_ 502 HVCMS_EVTargetCurrent "This signal indicates the HVCMS_EVTargetCurrent.";
CM_ SG_ 502 HVCMS_EVRESSConditioning "This signal indicates the HVCMS EV RESS Conditioning.";
CM_ SG_ 502 HVCMS_EVRESS_SOC "This signal indicates the HVCMS EV RESS State Of Charge.";
CM_ SG_ 502 HVCMS_EVReady "This signal indicates the HVCMS EV Ready.";
CM_ SG_ 502 HVCMS_EVMax_V_Limit "This signal indicates the HVCMS EV Max Voltage Limit.";
CM_ SG_ 502 HVCMS_EVMax_P_Limit "This signal indicates the HVCMS EV Max Power Limit.";
CM_ SG_ 502 HVCMS_EVMax_I_Limit "This signal indicates the HVCMS EV Max Current Limit.";
CM_ SG_ 502 HVCMS_EVErrorCode "This signal indicates the HVCMS EV Error Code.";
CM_ SG_ 502 HVCMS_EVEnergyRequest "This signal indicates the HVCMS EV Energy Request.";
CM_ SG_ 502 HVCMS_EVEnergyCapacity "This signal indicates the HVCMS EV Energy Capacity.";
CM_ SG_ 502 HVCMS_ChargingComplete "This signal indicates the HVCMS Charging Complete.";
CM_ SG_ 502 HVCMS_BulkChargingComplete "This signal indicates the HVCMS Bulk Charging Complete.";
CM_ SG_ 498 TxMessageResponse "This signal indicates the HVCMS Service Category.";
CM_ SG_ 498 ReceiptRequired "Signal Used by SECC in order to request a MeteringReceiptReq message to the OBCM.";
CM_ SG_ 498 OBCM_PLCTypeSts "Power Line communication";
CM_ SG_ 498 HVCMS_TxMessageStat "Response code from the Charging Station";
CM_ SG_ 498 HVCMS_ResponseCode "Response code from the Charging Station";
CM_ SG_ 498 HVCMS_EVSEPeakCurrentRipple "Peak-to-peak magnitude of the current ripple of the EVSE.";
CM_ SG_ 498 HVCMS_EVSEMinimumVoltageLimit "For communication with charging station type A,B,C";
CM_ SG_ 498 HVCMS_EVSEMaxPowerLimit "Maximum power the EVSE can deliver.";
CM_ SG_ 498 HVCMS_EVSEMaximumVoltageLimit "For communication with charging station type A,B,C";
CM_ SG_ 498 HVCMS_EVSECurrRegulationTol "Absolute magnitude of the regulation tolerance of the EVSE.";
CM_ SG_ 498 HVCMS_EnergyToBeDelivered "Amount of energy to be delivered by the EVSE.";
CM_ SG_ 498 EVSE_Supported_ISO1 "Used to report if ISO15118_2 protocol is offered or not.";
CM_ SG_ 498 EVSE_Supported_DIN "Used to report if DIN protocol is offered or not.";
CM_ SG_ 498 EVSE_ServiceId "EVSE Service ID";
CM_ SG_ 498 EVSE_Service2_Certificate "Used to report the availability of Contract Certificate services.";
CM_ SG_ 498 EVSE_OfferedPaymentOptn "List of payment options offered.";
CM_ SG_ 498 EVSE_OfferedPaymentEIM "Used to report if EIM is offered as a method of paymet by EVSE.";
CM_ SG_ 498 EVSE_OfferedPaymentContract "Used to report if Contract is offered as a method of paymet by EVSE.";
CM_ SG_ 498 EVSE_Notification "This signal contains an action that the SECC wants the EVCC to perform.";
CM_ SG_ 498 DC_TimeOut "DC Charging session time out";
CM_ SG_ 498 DC_Isolation_Disable_Cmd "Isolation Disabling command for DC charging";
CM_ SG_ 244 CRC_BHV1 "CRC according to SAE J1850 standard at each frame transmission.";
CM_ SG_ 244 MC_BHV1 "This signal is a counter used for safety checks strategies. This counter is incremented of 1 (one) unit at each frame transmission.";
CM_ SG_ 244 ImpactHardwireV "This signal is used to indicate a Valid serial line comunication";
CM_ SG_ 244 ImpactHardwire "This signal is used to indicate that a crash happened";
CM_ SG_ 244 BMS_HV_Temperature_Min "Battery Minimum Temperature";
CM_ SG_ 244 BMS_HV_Temperature_Max "Battery Maximum Temperature";
CM_ SG_ 244 BMS_HV_InternalVoltage "Battery internal voltage";
CM_ SG_ 244 BMS_HV_Current "Battery Current";
CM_ SG_ 244 BMS_HV_Battery_GFD_Sts "HV Battery ground fault detection(Isolation)";
CM_ SG_ 500 BMS_HV_NumCellMinTemp "This signal indicates the Numner of the battery cell with the lowest temperature.";
CM_ SG_ 500 BMS_HV_NumCellMaxVolt "This signal indicates the ID No. of cell with max. voltage";
CM_ SG_ 500 BMS_HV_NumCellMaxTemp "This signal indicates the Number of the battery cell with the highest temperature.";
CM_ SG_ 500 BMS_Cell_Volt_Min "This signal indicates the Min cell voltage.";
CM_ SG_ 500 BMS_Cell_Volt_Max "This signal indicates the Max cell voltage.";
CM_ SG_ 250 MessageCounter_APM_VDCM "This signal is a counter used for safety checks strategies. This counter is incremented of 1 (one) unit at each frame transmission.";
CM_ SG_ 250 CRC_APM_VDCM "CRC according to SAE J1850 standard at each frame transmission.";
CM_ SG_ 250 APM_Water_Temp "This signal indicates the Estimated water temperature  into the cooling channel.";
CM_ SG_ 250 APM_UtilPctOfDCDC "Utilization of DCDC output power capability";
CM_ SG_ 250 APM_TempColdPlate "Cold Plate Temperature";
CM_ SG_ 250 APM_RecoveryAction "This signal indicates the APM recovery action according to fault error";
CM_ SG_ 250 APM_PSFB_Temp2 "This signal indicates the Measured temperature on the phase shift full bridge converter hot spot 2";
CM_ SG_ 250 APM_PSFB_Temp1 "This signal indicates the Measured temperature on the phase shift full bridge converter hot spot 1";
CM_ SG_ 250 APM_PowerLimitMode "Low voltage at HV side";
CM_ SG_ 250 APM_OutputPower "APM Output Power";
CM_ SG_ 250 APM_LV_V_Fbk "This signal indicates the LV voltage feedback.";
CM_ SG_ 250 APM_LV_I_Fbk "This signal indicates the LV bus current feedback.";
CM_ SG_ 250 APM_InputPower "APM Input Power";
CM_ SG_ 250 APM_IdcHvSetPFdbk "Feedback of set point high voltage current";
CM_ SG_ 250 APM_HvVsetPFdbk "APM HV  Voltage set point feedback";
CM_ SG_ 250 APM_HvOverVStatus "over voltage at HV";
CM_ SG_ 250 APM_HV_V_Fbk "This signal indicates the HV voltage feedback.";
CM_ SG_ 250 APM_HV_I_Fbk "This signal indicates the HV bus current feedback.";
CM_ SG_ 250 APM_FailureType "APM Failure type";
CM_ SG_ 250 APM_FailureReason "FailureReason";
CM_ SG_ 250 APM_EstPwrLoss "Estimated Power Loss";
CM_ SG_ 250 APM_DeratingReason "APM Derating";
CM_ SG_ 250 APM_DeratingModeStatus "APM Derating status during operation";
CM_ SG_ 250 APM_CurrentLimitMode "Derating becasuse of too high current at HV";
CM_ SG_ 250 APM_CtrlSts_Fbk "This signal indicates the DC-DC feedback mode.";
CM_ SG_ 250 APM_Buck_Temp "This signal indicates the Buck stage hot spot temperature.";
CM_ SG_ 546 BMS_HV_Common_Contactor_Sts_VDCM "HV Bus common contactor status";
CM_ SG_ 546 BMS_HV_ChargingBusVoltage_VDCM "Battery link charging bus voltage";
CM_ SG_ 546 BMS_HV_Char_PreCha_Contac_Sts_V "Charging pre-charge contactor physical relay status";
CM_ SG_ 546 BMS_HV_Char_Main_Contac_Sts_VDCM "Charging main contactor physical relay status";
CM_ SG_ 546 BMS_HV_Char_Bus_Sts_VDCM "HV Traction Bus Status";
CM_ SG_ 546 BMS_HV_Battery_GFD_Sts_VDCM "HV Battery ground fault detection(Isolation)";
CM_ SG_ 546 BMS_HV_BatState_VDCM "Battery state";
CM_ SG_ 546 BMS_HV_BatIntrlk_InternalStat_V "HVIL Status internal";
CM_ SG_ 546 BMS_HV_BatActualPower_VDCM "Battery Pack actual power";
CM_ SG_ 546 BMS_HV_AC_Char_Main_Contac_Sts_ "AC Charging main contactor physical relay status from VDCM";
CM_ SG_ 546 BMS_Cell_Volt_Min_Vldty_VDCM "This signal indicates the Min cell voltage validity.";
CM_ SG_ 546 BMS_Cell_Volt_Min_VDCM "This signal indicates the Min cell voltage.";
CM_ SG_ 546 BMS_Cell_Volt_Max_Vldty_VDCM "This signal indicates the Max cell voltage validity.";
CM_ SG_ 546 BMS_Cell_Volt_Max_VDCM "This signal indicates the Max cell voltage.";
CM_ SG_ 546 AC_Chrg_Branch_Voltage_VDCM "Voltage measured after AC charge switch interpreted by VDCM";
CM_ SG_ 546 HCP_SessionStopCmd "Session stop command to stop charging";
CM_ SG_ 546 GBT_Target_Voltage_Reached "BMS end of charge for Targer Voltage Reached for GBT Applications.";
CM_ SG_ 546 HCP_DC_Retry "Retry command";
CM_ SG_ 546 MessageCounter_VO2 "This signal is a counter used for safety checks strategies. This counter is incremented of 1 (one) unit at each frame transmission.";
CM_ SG_ 546 ReadyToChargeState "Bit to indicate if EV is ready to charge or not";
CM_ SG_ 546 SelectedAppProtocol "Signal Used by VDCM to select one of various standard needed for HLC communication.";
CM_ SG_ 546 SelectedSecurityProtocol "Signal Used by VDCM to select or not TLS communication between EV and SECC.";
CM_ SG_ 546 GBT_Target_Cell_Voltage_Reached "BMS end of charge for Targer Cell Voltage Reached for GBT Applications.";
CM_ SG_ 546 GBT_Ready_to_Charge "VDCM boolean value for starting charging phase and Ending Charge for GBT applications";
CM_ SG_ 546 GBT_Desired_SOC_Reached "BMS end of charge for Targer SOC Reached for GBT Applications.";
CM_ SG_ 546 GBT_Charger_Active_Interruption "BMS end of charge for Active Interruption for GBT applications";
CM_ SG_ 546 DCChrg_BatSideCurrent_VDCM "DC Charging Current, measured in boost, read from EVSE in bypass";
CM_ SG_ 546 CRC_VO2 "CRC according to SAE J1850 standard at each frame transmission.";
CM_ SG_ 546 BMS_Max_Pk_Volt_Allowed_VDCM "This signal indicates the Maximum battery pack voltage allowed.";
CM_ SG_ 546 BMS_Max_Cell_Volt_Allowed_Vldty "This signal indicates the Max cell voltage allowed valid.";
CM_ SG_ 546 BMS_Max_Cell_Volt_Allowed_VDCM "This signal indicates the Max cell voltage allowed.";
CM_ SG_ 546 BMS_HV_TractionBusVoltage_VDCM "Battery link traction bus voltage";
CM_ SG_ 546 BMS_HV_Trac_PreCha_Contac_Sts_V "Traction pre-charge contactor Physical relay status";
CM_ SG_ 546 BMS_HV_Trac_Main_Contac_Sts_VDCM "Traction main contactor physical relay status";
CM_ SG_ 546 BMS_HV_Trac_Bus_Sts_VDCM "HV Traction Bus Status";
CM_ SG_ 546 BMS_HV_Temperature_Min_VDCM "Battery Minimum Temperature";
CM_ SG_ 546 BMS_HV_Temperature_Max_VDCM "Battery Average Temperature";
CM_ SG_ 546 BMS_HV_SOC_AccuracySts_VDCM "This signal indicates the Validity of the SOC value read";
CM_ SG_ 546 BMS_HV_NumCellMinTemp_VDCM "This signal indicates the Numner of the battery cell with the lowest temperature.";
CM_ SG_ 546 BMS_HV_NumCellMaxVolt_VDCM "This signal indicates the ID No. of cell with max. voltage";
CM_ SG_ 546 BMS_HV_NumCellMaxTemp_VDCM "This signal indicates the Number of the battery cell with the highest temperature.";
CM_ SG_ 546 BMS_HV_Low_Temp_Thrsh_VDCM "This signal indicates the lowest battery pack temperature allowed.";
CM_ SG_ 546 BMS_HV_InternalVoltage_VDCM "This signal indicates the Battery internal voltage as interpreted from VDCM.";
CM_ SG_ 546 BMS_HV_High_Temp_Thrsh_VDCM "This signal indicates the highest battery pack temperature allowed.";
CM_ SG_ 546 VDCM_BattFullSOC_prc "For comm with charging station type B";
CM_ SG_ 546 VDCM_ChargingPermitting "VDCM boolean value that allows the charge process for GBT applications";
CM_ SG_ 546 VDCM_ChrgMode_Req "For comm with charging station type B";
CM_ SG_ 546 VDCM_EstChrgTime_min "For comm with charging station type A";
CM_ SG_ 546 VDCM_EV_Batt_Max_T_Limit "For comm with charging station type B";
CM_ SG_ 546 VDCM_MaxChrgTime_min "For comm with charging station type A";
CM_ SG_ 546 VDCM_MaxChrgTime_sec "For comm with charging station type A";
CM_ SG_ 546 WeldCheck_Complete "Weld check complete";
CM_ SG_ 496 PlockFailSts "Park Lock Fail Sts";
CM_ SG_ 496 Plock_PosSensor "Par lock physical position sensor feedback";
CM_ SG_ 496 Plock_MotorPosSts "Park lock motor position status";
CM_ SG_ 496 Plock_fdbk_sts "Park lock status";
CM_ SG_ 496 MessageCounter_PARK_DATA "This signal is a counter used for safety checks strategies. This counter is incremented of 1 (one) unit at each frame transmission.";
CM_ SG_ 496 CRC_PARK_DATA "CRC according to SAE J1850 standard at each frame transmission.";
CM_ SG_ 544 TxGBTMessageResponse "Last message communicated from SECC to EVCC for type B.";
CM_ SG_ 544 TxGBTMessageRequest "Last message communicated from EVCC to SECC for type B.";
CM_ SG_ 544 TCP_Communication_Terminated "TCP communication terminated";
CM_ SG_ 544 OBCM_Timeout "This signal indicates a timeout from the OBCM side.";
CM_ SG_ 544 OBCM_CSSts "Proximity signal of CHAdeMO charging Plug";
CM_ SG_ 544 OBCM_CP3Sts "CP3 line status for CHAdeMO";
CM_ SG_ 544 OBCM_CP2Sts "CP2 line status for CHAdeMO";
CM_ SG_ 544 OBCM_CP1Sts "CP1 line status for CHAdeMO";
CM_ SG_ 544 OBCM_CCSts "Proximity signal of GBT charging contact";
CM_ SG_ 544 OBCM_APAMSts "Status of charging station LV supply on terminals A plus and A minus for GB/T charging";
CM_ SG_ 544 MessageCounter_OV2 "This signal is a counter used for safety checks strategies. This counter is incremented of 1 (one) unit at each frame transmission.";
CM_ SG_ 544 GBT_EVSE_Charge_Permitting "EVSE boolean value that allows to charge for GBT applications.";
CM_ SG_ 544 EVSE_NotificationMaxDelay "This signal is used to indicate the time until SECC expects the EVCC to react on the action request.";
CM_ SG_ 544 EVCC_FailureSts "EVCC failure status";
CM_ SG_ 544 CRC_OV2 "CRC according to SAE J1850 standard at each frame transmission.";
CM_ SG_ 544 Charger_StndbyReq "For communication with charging station type B";
CM_ SG_ 544 CdM_ExtFun_Reset_Max_Time "Flag which indicate to reset timing of maximum charging time.(0: enable 1: disable)";
CM_ SG_ 544 CdM_ExtFun_Relia_Design "A flag indicating the charging current shall be decreased less than or equal to the continuous rated current 1 or the charger shall shift to error stop in case a malfunction of the charging cable and the charging connector is detected";
CM_ SG_ 544 CdM_ExtFun_Over_Temp_Trotec_Conn "A flag indicating the charging connector is compatible with the function of overtemperature protection of the charging connector";
CM_ SG_ 544 CdM_ExtFun_Oper_Cond "A flag indicating operating condition of a charger.";
CM_ SG_ 544 CdM_ExtFun_Cur_Lim_Conn "A flag indicating the charging connector is compatible with the function which retains charging current based on measured result of terminal temperature of the charging connector";
CM_ SG_ 544 CdM_ExtFun_Cur_Lim_Cable "A flag indicating the charging cable is compatible with a function which retains the charging current based on measured result of surface temperature of the charging cable";
CM_ SG_ 544 CdM_ExtFun_Cool_Func_Conn "A flag indicating the charging connector is compatible with the function which retains temperature rise of the charging connector";
CM_ SG_ 544 CdM_ExtFun_Cool_Func_Cable "A flag indicating the charging cable is compatible with a function that retains the temperature rise of the charging cable";
CM_ SG_ 544 CdM_ExtFun_Chr_Dyn_Control_Comp "Flag indicating charger that is compatible with dynamic control.";
CM_ SG_ 544 CdM_ExtFun_Char_HC_Control_Comp "A flag indicating a charger is compatible with high current control";
CM_ SG_ 544 CC2VoltDetError "For communication with charging station type B";
CM_ SG_ 544 CC2_VoltageValue "This signal indicates the voltage value measured on the CC2 pin.";
CM_ SG_ 1454 MCPB_Service_Lamp_Request "The Service Lamp Request from the MCPB";
CM_ SG_ 1454 CRC_MCPB_DATA  "CRC according to SAE J1850 standard at each frame transmission.";
CM_ SG_ 1454 MC_MCPB_DATA  "This signal is a counter used for safety checks strategies. This counter is incremented of 1 (one) unit at each frame transmission.";
CM_ SG_ 1444 MCPA_Service_Lamp_Request "The Service Light Request from the MCPA";
CM_ SG_ 1444 CRC_MCPA_DATA  "CRC according to SAE J1850 standard at each frame transmission.";
CM_ SG_ 1444 MC_MCPA_DATA  "This signal is a counter used for safety checks strategies. This counter is incremented of 1 (one) unit at each frame transmission.";
CM_ SG_ 1790 HVBatCell_Voltage_Low_Thrsh "HV Battery Cell Voltage Low Thrsh";
CM_ SG_ 1790 HVBatCell_Voltage_High_Thrsh "HV Battery Cell Voltage High Thrsh";
CM_ SG_ 1790 BMS_HV_SOC_Min "Minimum HV battery cell state of charge";
CM_ SG_ 1790 BMS_HV_SOC_Max "Maximum HV battery cell state of charge";
CM_ SG_ 1790 BMS_HV_SOC_AccuracySts "This signal indicates the Validity of the SOC value read";
CM_ SG_ 1790 BMS_HV_Low_Temp_Thrsh "This signal indicates the lowest battery pack temperature allowed.";
CM_ SG_ 1790 BMS_HV_High_Temp_Thrsh "This signal indicates the highest battery pack temperature allowed.";
CM_ SG_ 1790 CRC_BATHV2 "CRC according to SAE J1850 standard at each frame transmission.";
CM_ SG_ 1790 MC_BATHV2 "This signal is a counter used for safety checks strategies. This counter is incremented of 1 (one) unit at each frame transmission.";
CM_ SG_ 834 N_PDU "This signal is used for diagnostic purposes";
CM_ SG_ 835 N_PDU "This signal is used for diagnostic purposes";
CM_ SG_ 105 ClrLgsDiagInfo "Clear Legislated Diagnostic Information";
CM_ SG_ 105 PIMF_CoolantFlow "Front PIM flow rate";
CM_ SG_ 105 PIMF_CoolantFlowVldty "PIM flow rate validity";
CM_ SG_ 105 T4_Sensor_Temp "T4 Temperature sensor";
CM_ SG_ 105 T7_Sensor_Temp "T7 Temperature sensor";
CM_ SG_ 1062 MessageCounter_MCPA_DATA2 "This signal is a counter used for safety checks strategies. This counter is incremented of 1 (one) unit at each frame transmission.";
CM_ SG_ 1062 MCPA_Temp "Motor A temperature";
CM_ SG_ 1062 MCPA_Rotor_Temperature "Rotor Temperature from Motor";
CM_ SG_ 1062 MCPA_ROL_STATUS "MCPA Resolver Offset Learn Status";
CM_ SG_ 1062 MCPA_ROL_Request "MCPA Resolver Offset Learn Request";
CM_ SG_ 1062 MCPA_Inverter_Temp "Inverter B Temperature";
CM_ SG_ 1062 MAC_MCPA_DATA2 "MAC";
CM_ SG_ 1062 CRC_MCPA_DATA2 "CRC according to SAE J1850 standard at each frame transmission.";
CM_ SG_ 1062 Cntr_MCPA_DATA2 "Cntr";
CM_ SG_ 1062 CLrDiagInfo_MCPA "Legislative Diagnostic Clear information for MCPA";
CM_ SG_ 1893 HVBatModuleVoltage_NumMin "Module number - Minimum voltage; Enumeration 0 = Module 1, ...31 = Module 32.MASAH ONLY: Module number - Minimum voltage; Enumeration 1 = Module 1 ...32 = Module 32.";
CM_ SG_ 1893 HVBatModuleVoltage_NumMax "Module number - maximum voltage; Enumeration 0 = Module 1 ...31 = Module 32.MASAH ONLY: Module number - maximum voltage; Enumeration 1 = Module 1 ...32 = Module 32.";
CM_ SG_ 1893 HVBatModuleTemp_66 "High voltage battery module temperature";
CM_ SG_ 1893 HVBatModuleTemp_65 "High voltage battery module temperature";
CM_ SG_ 1893 HVBatModuleTemp_64 "High voltage battery module temperature";
CM_ SG_ 1893 HVBatModuleTemp_63 "High voltage battery module temperature";
CM_ SG_ 1893 HVBatModuleTemp_62 "High voltage battery module temperature";
CM_ SG_ 1893 HVBatModuleTemp_61 "High voltage battery module temperature";
CM_ SG_ 1893 HVBatModuleTemp_60 "High voltage battery module temperature";
CM_ SG_ 1893 HVBatModuleTemp_59 "High voltage battery module temperature";
CM_ SG_ 1893 HVBatModuleTemp_58 "High voltage battery module temperature";
CM_ SG_ 1893 HVBatModuleTemp_57 "High voltage battery module temperature";
CM_ SG_ 1893 HVBatModuleTemp_56 "High voltage battery module temperature";
CM_ SG_ 1893 HVBatModuleTemp_55 "High voltage battery module temperature";
CM_ SG_ 1893 HVBatModuleTemp_54 "High voltage battery module temperature";
CM_ SG_ 1893 HVBatModuleTemp_53 "High voltage battery module temperature";
CM_ SG_ 1893 HVBatModuleTemp_52 "High voltage battery module temperature";
CM_ SG_ 1893 HVBatModuleTemp_51 "High voltage battery module temperature";
CM_ SG_ 1893 HVBatModuleTemp_50 "High voltage battery module temperature";
CM_ SG_ 1893 HVBatModuleTemp_49 "High voltage battery module temperature";
CM_ SG_ 1893 HVBatModuleTemp_48 "High voltage battery module temperature";
CM_ SG_ 1893 HVBatModuleTemp_47 "High voltage battery module temperature";
CM_ SG_ 1893 HVBatModuleTemp_46 "High voltage battery module temperature";
CM_ SG_ 1893 HVBatModuleTemp_45 "High voltage battery module temperature";
CM_ SG_ 1893 HVBatModuleTemp_44 "High voltage battery module temperature";
CM_ SG_ 1893 HVBatModuleTemp_43 "High voltage battery module temperature";
CM_ SG_ 1893 HVBatModuleTemp_42 "High voltage battery module temperature";
CM_ SG_ 1893 HVBatModuleTemp_41 "High voltage battery module temperature";
CM_ SG_ 1893 HVBatModuleTemp_40 "High voltage battery module temperature";
CM_ SG_ 1893 HVBatModuleTemp_39 "High voltage battery module temperature";
BA_DEF_ BO_ "CANFD_BRS" ENUM "0","1";
BA_DEF_ BO_ "VFrameFormat" ENUM "StandardCAN","ExtendedCAN","reserved","reserved","reserved","reserved","reserved","reserved","reserved","reserved","reserved","reserved","reserved","reserved","StandardCAN_FD","ExtendedCAN_FD";
BA_DEF_ BO_ "CanTpFcFrameId" HEX 0 2147483647;
BA_DEF_ BO_ "DiagConnection" HEX 0 65535;
BA_DEF_ BO_ "DiagState" ENUM "No","Yes";
BA_DEF_ BO_ "NmAsrMessage" ENUM "No","Yes";
BA_DEF_ BO_ "GenMsgDelayTime" INT 0 65535;
BA_DEF_ BO_ "GenMsgCycleTime" INT 0 65535;
BA_DEF_ BO_ "GenMsgCycleTimeFast" INT 0 65535;
BA_DEF_ BO_ "GenMsgStartDelayTime" INT 0 65535;
BA_DEF_ BO_ "GenMsgILSupport" ENUM "No","Yes";
BA_DEF_ BO_ "GenMsgNrOfRepetition" INT 0 255;
BA_DEF_ BO_ "GenMsgSendType" ENUM "Cyclic","NotUsed","NotUsed","NotUsed","NotUsed","NotUsed","NotUsed","NotUsed","NoMsgSendType";
BA_DEF_ BO_ "NmMessage" ENUM "No","Yes";
BA_DEF_ BO_ "DiagResponse" ENUM "No","Yes";
BA_DEF_ BO_ "Type" ENUM "P","C","PE","COC","PE_Cntrl","E","E_Cntrl","OC","S","BAF","DC","EM","MM","ISO-TP","-";
BA_DEF_ BO_ "DiagRequest" ENUM "No","Yes";
BA_DEF_ SG_ "GenSigTimeoutTime_SGW" INT 0 65535;
BA_DEF_ SG_ "GenSigTimeoutTime_PBWM" INT 0 65535;
BA_DEF_ SG_ "GenSigTimeoutTime_IDCM" INT 0 65535;
BA_DEF_ SG_ "GenSigTimeoutTime_EVCU2" INT 0 65535;
BA_DEF_ SG_ "GenSigTimeoutTime_ECM" INT 0 65535;
BA_DEF_ SG_ "GenSigTimeoutTime_DMPI" INT 0 65535;
BA_DEF_ SG_ "GenSigTimeoutTime_BPCM" INT 0 65535;
BA_DEF_ SG_ "GenSigTimeoutTime_AGSM" INT 0 65535;
BA_DEF_ SG_ "SystemSignalLongSymbol" STRING ;
BA_DEF_ SG_ "GenSigSendType" ENUM "NotUsed","OnWrite","OnWriteWithRepetition","OnChange","OnChangeWithRepetition","IfActive","IfActiveWithRepetition","NoSigSendType";
BA_DEF_ SG_ "GenSigInactiveValue" INT 0 2147483647;
BA_DEF_ SG_ "GenSigStartValue" INT 0 2147483647;
BA_DEF_DEF_ "CANFD_BRS" "0";
BA_DEF_DEF_ "VFrameFormat" "StandardCAN_FD";
BA_DEF_DEF_ "CanTpFcFrameId" 2147483647;
BA_DEF_DEF_ "DiagConnection" 0;
BA_DEF_DEF_ "DiagState" "No";
BA_DEF_DEF_ "NmAsrMessage" "No";
BA_DEF_DEF_ "GenMsgDelayTime" 0;
BA_DEF_DEF_ "GenMsgCycleTime" 0;
BA_DEF_DEF_ "GenMsgCycleTimeFast" 0;
BA_DEF_DEF_ "GenMsgStartDelayTime" 0;
BA_DEF_DEF_ "GenMsgILSupport" "No";
BA_DEF_DEF_ "GenMsgNrOfRepetition" 0;
BA_DEF_DEF_ "GenMsgSendType" "NoMsgSendType";
BA_DEF_DEF_ "NmMessage" "No";
BA_DEF_DEF_ "DiagResponse" "No";
BA_DEF_DEF_ "Type" "-";
BA_DEF_DEF_ "DiagRequest" "No";
BA_DEF_DEF_ "GenSigTimeoutTime_SGW" 2500;
BA_DEF_DEF_ "GenSigTimeoutTime_PBWM" 2500;
BA_DEF_DEF_ "GenSigTimeoutTime_IDCM" 2500;
BA_DEF_DEF_ "GenSigTimeoutTime_EVCU2" 2500;
BA_DEF_DEF_ "GenSigTimeoutTime_ECM" 2500;
BA_DEF_DEF_ "GenSigTimeoutTime_DMPI" 2500;
BA_DEF_DEF_ "GenSigTimeoutTime_BPCM" 2500;
BA_DEF_DEF_ "GenSigTimeoutTime_AGSM" 2500;
BA_DEF_DEF_ "SystemSignalLongSymbol" "";
BA_DEF_DEF_ "GenSigSendType" "NoSigSendType";
BA_DEF_DEF_ "GenSigInactiveValue" 0;
BA_DEF_DEF_ "GenSigStartValue" 0;
BA_ "CANFD_BRS" BO_ 502 1;
BA_ "GenMsgCycleTime" BO_ 502 20;
BA_ "GenMsgILSupport" BO_ 502 1;
BA_ "GenMsgSendType" BO_ 502 0;
BA_ "Type" BO_ 502 1;
BA_ "CANFD_BRS" BO_ 498 1;
BA_ "GenMsgCycleTime" BO_ 498 20;
BA_ "GenMsgILSupport" BO_ 498 1;
BA_ "GenMsgSendType" BO_ 498 0;
BA_ "Type" BO_ 498 1;
BA_ "CANFD_BRS" BO_ 244 1;
BA_ "GenMsgCycleTime" BO_ 244 10;
BA_ "GenMsgILSupport" BO_ 244 1;
BA_ "GenMsgSendType" BO_ 244 0;
BA_ "Type" BO_ 244 1;
BA_ "CANFD_BRS" BO_ 500 1;
BA_ "GenMsgCycleTime" BO_ 500 20;
BA_ "GenMsgILSupport" BO_ 500 1;
BA_ "GenMsgSendType" BO_ 500 0;
BA_ "Type" BO_ 500 1;
BA_ "CANFD_BRS" BO_ 250 1;
BA_ "GenMsgCycleTime" BO_ 250 20;
BA_ "GenMsgILSupport" BO_ 250 1;
BA_ "GenMsgSendType" BO_ 250 0;
BA_ "Type" BO_ 250 1;
BA_ "CANFD_BRS" BO_ 546 1;
BA_ "GenMsgCycleTime" BO_ 546 20;
BA_ "GenMsgILSupport" BO_ 546 1;
BA_ "GenMsgSendType" BO_ 546 0;
BA_ "Type" BO_ 546 1;
BA_ "CANFD_BRS" BO_ 496 1;
BA_ "GenMsgCycleTime" BO_ 496 10;
BA_ "GenMsgILSupport" BO_ 496 1;
BA_ "GenMsgSendType" BO_ 496 0;
BA_ "Type" BO_ 496 1;
BA_ "CANFD_BRS" BO_ 544 1;
BA_ "GenMsgCycleTime" BO_ 544 20;
BA_ "GenMsgILSupport" BO_ 544 1;
BA_ "GenMsgSendType" BO_ 544 0;
BA_ "Type" BO_ 544 1;
BA_ "CANFD_BRS" BO_ 1454 1;
BA_ "GenMsgDelayTime" BO_ 1454 20;
BA_ "GenMsgCycleTime" BO_ 1454 1000;
BA_ "GenMsgCycleTimeFast" BO_ 1454 20;
BA_ "GenMsgILSupport" BO_ 1454 1;
BA_ "GenMsgNrOfRepetition" BO_ 1454 3;
BA_ "GenMsgSendType" BO_ 1454 0;
BA_ "Type" BO_ 1454 3;
BA_ "CANFD_BRS" BO_ 1444 1;
BA_ "GenMsgDelayTime" BO_ 1444 20;
BA_ "GenMsgCycleTime" BO_ 1444 1000;
BA_ "GenMsgCycleTimeFast" BO_ 1444 20;
BA_ "GenMsgILSupport" BO_ 1444 1;
BA_ "GenMsgNrOfRepetition" BO_ 1444 3;
BA_ "GenMsgSendType" BO_ 1444 0;
BA_ "Type" BO_ 1444 3;
BA_ "CANFD_BRS" BO_ 1790 1;
BA_ "GenMsgDelayTime" BO_ 1790 20;
BA_ "GenMsgCycleTime" BO_ 1790 500;
BA_ "GenMsgILSupport" BO_ 1790 1;
BA_ "GenMsgSendType" BO_ 1790 0;
BA_ "Type" BO_ 1790 3;
BA_ "CANFD_BRS" BO_ 834 1;
BA_ "GenMsgILSupport" BO_ 834 1;
BA_ "Type" BO_ 834 8;
BA_ "CANFD_BRS" BO_ 835 1;
BA_ "GenMsgILSupport" BO_ 835 1;
BA_ "Type" BO_ 835 8;
BA_ "CANFD_BRS" BO_ 105 1;
BA_ "GenMsgDelayTime" BO_ 105 100;
BA_ "GenMsgCycleTime" BO_ 105 1000;
BA_ "GenMsgILSupport" BO_ 105 1;
BA_ "GenMsgSendType" BO_ 105 0;
BA_ "Type" BO_ 105 3;
BA_ "CANFD_BRS" BO_ 1062 1;
BA_ "GenMsgCycleTime" BO_ 1062 100;
BA_ "GenMsgILSupport" BO_ 1062 1;
BA_ "GenMsgSendType" BO_ 1062 0;
BA_ "Type" BO_ 1062 1;
BA_ "CANFD_BRS" BO_ 1893 1;
BA_ "GenMsgCycleTime" BO_ 1893 1000;
BA_ "GenMsgILSupport" BO_ 1893 1;
BA_ "GenMsgSendType" BO_ 1893 0;
BA_ "Type" BO_ 1893 1;
BA_ "GenSigTimeoutTime_SGW" SG_ 546 VDCM_MaxChrgTime_sec 0;
BA_ "GenSigTimeoutTime_PBWM" SG_ 546 VDCM_MaxChrgTime_sec 0;
BA_ "GenSigTimeoutTime_EVCU2" SG_ 546 VDCM_MaxChrgTime_sec 0;
BA_ "GenSigTimeoutTime_ECM" SG_ 546 VDCM_MaxChrgTime_sec 0;
BA_ "GenSigTimeoutTime_DMPI" SG_ 546 VDCM_MaxChrgTime_sec 0;
BA_ "GenSigTimeoutTime_BPCM" SG_ 546 VDCM_MaxChrgTime_sec 0;
BA_ "GenSigTimeoutTime_AGSM" SG_ 546 VDCM_MaxChrgTime_sec 0;
BA_ "GenSigStartValue" SG_ 546 VDCM_MaxChrgTime_sec 255;
BA_ "GenSigTimeoutTime_SGW" SG_ 546 VDCM_MaxChrgTime_min 0;
BA_ "GenSigTimeoutTime_PBWM" SG_ 546 VDCM_MaxChrgTime_min 0;
BA_ "GenSigTimeoutTime_EVCU2" SG_ 546 VDCM_MaxChrgTime_min 0;
BA_ "GenSigTimeoutTime_ECM" SG_ 546 VDCM_MaxChrgTime_min 0;
BA_ "GenSigTimeoutTime_DMPI" SG_ 546 VDCM_MaxChrgTime_min 0;
BA_ "GenSigTimeoutTime_BPCM" SG_ 546 VDCM_MaxChrgTime_min 0;
BA_ "GenSigTimeoutTime_AGSM" SG_ 546 VDCM_MaxChrgTime_min 0;
BA_ "GenSigStartValue" SG_ 546 VDCM_MaxChrgTime_min 255;
BA_ "GenSigTimeoutTime_SGW" SG_ 546 VDCM_EV_Batt_Max_T_Limit 0;
BA_ "GenSigTimeoutTime_PBWM" SG_ 546 VDCM_EV_Batt_Max_T_Limit 0;
BA_ "GenSigTimeoutTime_EVCU2" SG_ 546 VDCM_EV_Batt_Max_T_Limit 0;
BA_ "GenSigTimeoutTime_ECM" SG_ 546 VDCM_EV_Batt_Max_T_Limit 0;
BA_ "GenSigTimeoutTime_DMPI" SG_ 546 VDCM_EV_Batt_Max_T_Limit 0;
BA_ "GenSigTimeoutTime_BPCM" SG_ 546 VDCM_EV_Batt_Max_T_Limit 0;
BA_ "GenSigTimeoutTime_AGSM" SG_ 546 VDCM_EV_Batt_Max_T_Limit 0;
BA_ "GenSigStartValue" SG_ 546 VDCM_EV_Batt_Max_T_Limit 60;
BA_ "GenSigTimeoutTime_SGW" SG_ 546 VDCM_EstChrgTime_min 0;
BA_ "GenSigTimeoutTime_PBWM" SG_ 546 VDCM_EstChrgTime_min 0;
BA_ "GenSigTimeoutTime_EVCU2" SG_ 546 VDCM_EstChrgTime_min 0;
BA_ "GenSigTimeoutTime_ECM" SG_ 546 VDCM_EstChrgTime_min 0;
BA_ "GenSigTimeoutTime_DMPI" SG_ 546 VDCM_EstChrgTime_min 0;
BA_ "GenSigTimeoutTime_BPCM" SG_ 546 VDCM_EstChrgTime_min 0;
BA_ "GenSigTimeoutTime_AGSM" SG_ 546 VDCM_EstChrgTime_min 0;
BA_ "GenSigStartValue" SG_ 546 VDCM_EstChrgTime_min 255;
BA_ "GenSigTimeoutTime_SGW" SG_ 546 VDCM_ChrgMode_Req 0;
BA_ "GenSigTimeoutTime_PBWM" SG_ 546 VDCM_ChrgMode_Req 0;
BA_ "GenSigTimeoutTime_EVCU2" SG_ 546 VDCM_ChrgMode_Req 0;
BA_ "GenSigTimeoutTime_ECM" SG_ 546 VDCM_ChrgMode_Req 0;
BA_ "GenSigTimeoutTime_DMPI" SG_ 546 VDCM_ChrgMode_Req 0;
BA_ "GenSigTimeoutTime_BPCM" SG_ 546 VDCM_ChrgMode_Req 0;
BA_ "GenSigTimeoutTime_AGSM" SG_ 546 VDCM_ChrgMode_Req 0;
BA_ "GenSigTimeoutTime_SGW" SG_ 546 VDCM_ChrgCurrDeviationErr 0;
BA_ "GenSigTimeoutTime_PBWM" SG_ 546 VDCM_ChrgCurrDeviationErr 0;
BA_ "GenSigTimeoutTime_EVCU2" SG_ 546 VDCM_ChrgCurrDeviationErr 0;
BA_ "GenSigTimeoutTime_ECM" SG_ 546 VDCM_ChrgCurrDeviationErr 0;
BA_ "GenSigTimeoutTime_DMPI" SG_ 546 VDCM_ChrgCurrDeviationErr 0;
BA_ "GenSigTimeoutTime_BPCM" SG_ 546 VDCM_ChrgCurrDeviationErr 0;
BA_ "GenSigTimeoutTime_AGSM" SG_ 546 VDCM_ChrgCurrDeviationErr 0;
BA_ "GenSigTimeoutTime_SGW" SG_ 546 VDCM_ChrgCompleteReason 0;
BA_ "GenSigTimeoutTime_PBWM" SG_ 546 VDCM_ChrgCompleteReason 0;
BA_ "GenSigTimeoutTime_EVCU2" SG_ 546 VDCM_ChrgCompleteReason 0;
BA_ "GenSigTimeoutTime_ECM" SG_ 546 VDCM_ChrgCompleteReason 0;
BA_ "GenSigTimeoutTime_DMPI" SG_ 546 VDCM_ChrgCompleteReason 0;
BA_ "GenSigTimeoutTime_BPCM" SG_ 546 VDCM_ChrgCompleteReason 0;
BA_ "GenSigTimeoutTime_AGSM" SG_ 546 VDCM_ChrgCompleteReason 0;
BA_ "GenSigTimeoutTime_SGW" SG_ 546 VDCM_BattUnderVolt 0;
BA_ "GenSigTimeoutTime_PBWM" SG_ 546 VDCM_BattUnderVolt 0;
BA_ "GenSigTimeoutTime_EVCU2" SG_ 546 VDCM_BattUnderVolt 0;
BA_ "GenSigTimeoutTime_ECM" SG_ 546 VDCM_BattUnderVolt 0;
BA_ "GenSigTimeoutTime_DMPI" SG_ 546 VDCM_BattUnderVolt 0;
BA_ "GenSigTimeoutTime_BPCM" SG_ 546 VDCM_BattUnderVolt 0;
BA_ "GenSigTimeoutTime_AGSM" SG_ 546 VDCM_BattUnderVolt 0;
BA_ "GenSigTimeoutTime_SGW" SG_ 546 VDCM_BattOverVolt 0;
BA_ "GenSigTimeoutTime_PBWM" SG_ 546 VDCM_BattOverVolt 0;
BA_ "GenSigTimeoutTime_EVCU2" SG_ 546 VDCM_BattOverVolt 0;
BA_ "GenSigTimeoutTime_ECM" SG_ 546 VDCM_BattOverVolt 0;
BA_ "GenSigTimeoutTime_DMPI" SG_ 546 VDCM_BattOverVolt 0;
BA_ "GenSigTimeoutTime_BPCM" SG_ 546 VDCM_BattOverVolt 0;
BA_ "GenSigTimeoutTime_AGSM" SG_ 546 VDCM_BattOverVolt 0;
BA_ "GenSigTimeoutTime_SGW" SG_ 546 VDCM_BattFullSOC_prc 0;
BA_ "GenSigTimeoutTime_PBWM" SG_ 546 VDCM_BattFullSOC_prc 0;
BA_ "GenSigTimeoutTime_EVCU2" SG_ 546 VDCM_BattFullSOC_prc 0;
BA_ "GenSigTimeoutTime_ECM" SG_ 546 VDCM_BattFullSOC_prc 0;
BA_ "GenSigTimeoutTime_DMPI" SG_ 546 VDCM_BattFullSOC_prc 0;
BA_ "GenSigTimeoutTime_BPCM" SG_ 546 VDCM_BattFullSOC_prc 0;
BA_ "GenSigTimeoutTime_AGSM" SG_ 546 VDCM_BattFullSOC_prc 0;
BA_ "GenSigStartValue" SG_ 546 VDCM_BattFullSOC_prc 100;
BA_ "GenSigTimeoutTime_SGW" SG_ 105 T7_Sensor_Temp 0;
BA_ "GenSigTimeoutTime_PBWM" SG_ 105 T7_Sensor_Temp 0;
BA_ "GenSigTimeoutTime_IDCM" SG_ 105 T7_Sensor_Temp 0;
BA_ "GenSigTimeoutTime_EVCU2" SG_ 105 T7_Sensor_Temp 0;
BA_ "GenSigTimeoutTime_ECM" SG_ 105 T7_Sensor_Temp 0;
BA_ "GenSigTimeoutTime_BPCM" SG_ 105 T7_Sensor_Temp 0;
BA_ "GenSigTimeoutTime_AGSM" SG_ 105 T7_Sensor_Temp 0;
BA_ "GenSigSendType" SG_ 105 T7_Sensor_Temp 3;
BA_ "GenSigTimeoutTime_SGW" SG_ 105 T4_Sensor_Temp 0;
BA_ "GenSigTimeoutTime_PBWM" SG_ 105 T4_Sensor_Temp 0;
BA_ "GenSigTimeoutTime_IDCM" SG_ 105 T4_Sensor_Temp 0;
BA_ "GenSigTimeoutTime_EVCU2" SG_ 105 T4_Sensor_Temp 0;
BA_ "GenSigTimeoutTime_ECM" SG_ 105 T4_Sensor_Temp 0;
BA_ "GenSigTimeoutTime_BPCM" SG_ 105 T4_Sensor_Temp 0;
BA_ "GenSigTimeoutTime_AGSM" SG_ 105 T4_Sensor_Temp 0;
BA_ "GenSigSendType" SG_ 105 T4_Sensor_Temp 3;
BA_ "GenSigTimeoutTime_SGW" SG_ 105 PIMF_CoolantFlowVldty 0;
BA_ "GenSigTimeoutTime_PBWM" SG_ 105 PIMF_CoolantFlowVldty 0;
BA_ "GenSigTimeoutTime_IDCM" SG_ 105 PIMF_CoolantFlowVldty 0;
BA_ "GenSigTimeoutTime_EVCU2" SG_ 105 PIMF_CoolantFlowVldty 0;
BA_ "GenSigTimeoutTime_ECM" SG_ 105 PIMF_CoolantFlowVldty 0;
BA_ "GenSigTimeoutTime_BPCM" SG_ 105 PIMF_CoolantFlowVldty 0;
BA_ "GenSigTimeoutTime_AGSM" SG_ 105 PIMF_CoolantFlowVldty 0;
BA_ "GenSigSendType" SG_ 105 PIMF_CoolantFlowVldty 3;
BA_ "GenSigTimeoutTime_SGW" SG_ 105 ClrLgsDiagInfo 0;
BA_ "GenSigTimeoutTime_PBWM" SG_ 105 ClrLgsDiagInfo 0;
BA_ "GenSigTimeoutTime_EVCU2" SG_ 105 ClrLgsDiagInfo 0;
BA_ "GenSigTimeoutTime_ECM" SG_ 105 ClrLgsDiagInfo 0;
BA_ "GenSigTimeoutTime_DMPI" SG_ 105 ClrLgsDiagInfo 0;
BA_ "GenSigTimeoutTime_BPCM" SG_ 105 ClrLgsDiagInfo 0;
BA_ "GenSigTimeoutTime_AGSM" SG_ 105 ClrLgsDiagInfo 0;
BA_ "GenSigTimeoutTime_SGW" SG_ 546 WeldCheck_Complete 0;
BA_ "GenSigTimeoutTime_PBWM" SG_ 546 WeldCheck_Complete 0;
BA_ "GenSigTimeoutTime_EVCU2" SG_ 546 WeldCheck_Complete 0;
BA_ "GenSigTimeoutTime_ECM" SG_ 546 WeldCheck_Complete 0;
BA_ "GenSigTimeoutTime_DMPI" SG_ 546 WeldCheck_Complete 0;
BA_ "GenSigTimeoutTime_BPCM" SG_ 546 WeldCheck_Complete 0;
BA_ "GenSigTimeoutTime_AGSM" SG_ 546 WeldCheck_Complete 0;
BA_ "GenSigTimeoutTime_SGW" SG_ 546 VDCM_SOCIsOOR 0;
BA_ "GenSigTimeoutTime_PBWM" SG_ 546 VDCM_SOCIsOOR 0;
BA_ "GenSigTimeoutTime_EVCU2" SG_ 546 VDCM_SOCIsOOR 0;
BA_ "GenSigTimeoutTime_ECM" SG_ 546 VDCM_SOCIsOOR 0;
BA_ "GenSigTimeoutTime_DMPI" SG_ 546 VDCM_SOCIsOOR 0;
BA_ "GenSigTimeoutTime_BPCM" SG_ 546 VDCM_SOCIsOOR 0;
BA_ "GenSigTimeoutTime_AGSM" SG_ 546 VDCM_SOCIsOOR 0;
BA_ "GenSigTimeoutTime_SGW" SG_ 546 VDCM_ChargeCurrIsOOR 0;
BA_ "GenSigTimeoutTime_PBWM" SG_ 546 VDCM_ChargeCurrIsOOR 0;
BA_ "GenSigTimeoutTime_EVCU2" SG_ 546 VDCM_ChargeCurrIsOOR 0;
BA_ "GenSigTimeoutTime_ECM" SG_ 546 VDCM_ChargeCurrIsOOR 0;
BA_ "GenSigTimeoutTime_DMPI" SG_ 546 VDCM_ChargeCurrIsOOR 0;
BA_ "GenSigTimeoutTime_BPCM" SG_ 546 VDCM_ChargeCurrIsOOR 0;
BA_ "GenSigTimeoutTime_AGSM" SG_ 546 VDCM_ChargeCurrIsOOR 0;
BA_ "GenSigTimeoutTime_SGW" SG_ 546 VDCM_CellVoltIsOOR 0;
BA_ "GenSigTimeoutTime_PBWM" SG_ 546 VDCM_CellVoltIsOOR 0;
BA_ "GenSigTimeoutTime_EVCU2" SG_ 546 VDCM_CellVoltIsOOR 0;
BA_ "GenSigTimeoutTime_ECM" SG_ 546 VDCM_CellVoltIsOOR 0;
BA_ "GenSigTimeoutTime_DMPI" SG_ 546 VDCM_CellVoltIsOOR 0;
BA_ "GenSigTimeoutTime_BPCM" SG_ 546 VDCM_CellVoltIsOOR 0;
BA_ "GenSigTimeoutTime_AGSM" SG_ 546 VDCM_CellVoltIsOOR 0;
BA_ "GenSigTimeoutTime_SGW" SG_ 546 VDCM_BattTempIsOOR 0;
BA_ "GenSigTimeoutTime_PBWM" SG_ 546 VDCM_BattTempIsOOR 0;
BA_ "GenSigTimeoutTime_EVCU2" SG_ 546 VDCM_BattTempIsOOR 0;
BA_ "GenSigTimeoutTime_ECM" SG_ 546 VDCM_BattTempIsOOR 0;
BA_ "GenSigTimeoutTime_DMPI" SG_ 546 VDCM_BattTempIsOOR 0;
BA_ "GenSigTimeoutTime_BPCM" SG_ 546 VDCM_BattTempIsOOR 0;
BA_ "GenSigTimeoutTime_AGSM" SG_ 546 VDCM_BattTempIsOOR 0;
BA_ "GenSigTimeoutTime_ECM" SG_ 546 ReadyToChargeState 0;
BA_ "GenSigTimeoutTime_DMPI" SG_ 546 ReadyToChargeState 0;
BA_ "GenSigTimeoutTime_BPCM" SG_ 546 ReadyToChargeState 0;
BA_ "GenSigTimeoutTime_AGSM" SG_ 546 ReadyToChargeState 0;
BA_ "GenSigTimeoutTime_SGW" SG_ 546 ReadyToChargeState 0;
BA_ "GenSigTimeoutTime_PBWM" SG_ 546 ReadyToChargeState 0;
BA_ "GenSigTimeoutTime_EVCU2" SG_ 546 ReadyToChargeState 0;
BA_ "GenSigTimeoutTime_SGW" SG_ 546 HCP_SessionStopCmd 0;
BA_ "GenSigTimeoutTime_PBWM" SG_ 546 HCP_SessionStopCmd 0;
BA_ "GenSigTimeoutTime_EVCU2" SG_ 546 HCP_SessionStopCmd 0;
BA_ "GenSigTimeoutTime_ECM" SG_ 546 HCP_SessionStopCmd 0;
BA_ "GenSigTimeoutTime_DMPI" SG_ 546 HCP_SessionStopCmd 0;
BA_ "GenSigTimeoutTime_BPCM" SG_ 546 HCP_SessionStopCmd 0;
BA_ "GenSigTimeoutTime_AGSM" SG_ 546 HCP_SessionStopCmd 0;
BA_ "GenSigTimeoutTime_SGW" SG_ 546 HCP_DC_Retry 0;
BA_ "GenSigTimeoutTime_PBWM" SG_ 546 HCP_DC_Retry 0;
BA_ "GenSigTimeoutTime_EVCU2" SG_ 546 HCP_DC_Retry 0;
BA_ "GenSigTimeoutTime_ECM" SG_ 546 HCP_DC_Retry 0;
BA_ "GenSigTimeoutTime_DMPI" SG_ 546 HCP_DC_Retry 0;
BA_ "GenSigTimeoutTime_BPCM" SG_ 546 HCP_DC_Retry 0;
BA_ "GenSigTimeoutTime_SGW" SG_ 546 VDCM_ChargingPermitting 0;
BA_ "GenSigTimeoutTime_PBWM" SG_ 546 VDCM_ChargingPermitting 0;
BA_ "GenSigTimeoutTime_EVCU2" SG_ 546 VDCM_ChargingPermitting 0;
BA_ "GenSigTimeoutTime_ECM" SG_ 546 VDCM_ChargingPermitting 0;
BA_ "GenSigTimeoutTime_DMPI" SG_ 546 VDCM_ChargingPermitting 0;
BA_ "GenSigTimeoutTime_BPCM" SG_ 546 VDCM_ChargingPermitting 0;
BA_ "GenSigTimeoutTime_AGSM" SG_ 546 VDCM_ChargingPermitting 0;
BA_ "GenSigTimeoutTime_SGW" SG_ 105 PIMF_CoolantFlow 0;
BA_ "GenSigTimeoutTime_PBWM" SG_ 105 PIMF_CoolantFlow 0;
BA_ "GenSigTimeoutTime_IDCM" SG_ 105 PIMF_CoolantFlow 0;
BA_ "GenSigTimeoutTime_EVCU2" SG_ 105 PIMF_CoolantFlow 0;
BA_ "GenSigTimeoutTime_ECM" SG_ 105 PIMF_CoolantFlow 0;
BA_ "GenSigTimeoutTime_BPCM" SG_ 105 PIMF_CoolantFlow 0;
BA_ "GenSigTimeoutTime_AGSM" SG_ 105 PIMF_CoolantFlow 0;
BA_ "GenSigSendType" SG_ 105 PIMF_CoolantFlow 3;
BA_ "GenSigTimeoutTime_SGW" SG_ 546 MessageCounter_VO2 0;
BA_ "GenSigTimeoutTime_PBWM" SG_ 546 MessageCounter_VO2 0;
BA_ "GenSigTimeoutTime_EVCU2" SG_ 546 MessageCounter_VO2 0;
BA_ "GenSigTimeoutTime_ECM" SG_ 546 MessageCounter_VO2 0;
BA_ "GenSigTimeoutTime_DMPI" SG_ 546 MessageCounter_VO2 0;
BA_ "GenSigTimeoutTime_AGSM" SG_ 546 MessageCounter_VO2 0;
BA_ "GenSigTimeoutTime_SGW" SG_ 546 SelectedAppProtocol 0;
BA_ "GenSigTimeoutTime_PBWM" SG_ 546 SelectedAppProtocol 0;
BA_ "GenSigTimeoutTime_EVCU2" SG_ 546 SelectedAppProtocol 0;
BA_ "GenSigTimeoutTime_ECM" SG_ 546 SelectedAppProtocol 0;
BA_ "GenSigTimeoutTime_DMPI" SG_ 546 SelectedAppProtocol 0;
BA_ "GenSigTimeoutTime_BPCM" SG_ 546 SelectedAppProtocol 0;
BA_ "GenSigTimeoutTime_AGSM" SG_ 546 SelectedAppProtocol 0;
BA_ "GenSigTimeoutTime_SGW" SG_ 546 SelectedSecurityProtocol 0;
BA_ "GenSigTimeoutTime_PBWM" SG_ 546 SelectedSecurityProtocol 0;
BA_ "GenSigTimeoutTime_EVCU2" SG_ 546 SelectedSecurityProtocol 0;
BA_ "GenSigTimeoutTime_ECM" SG_ 546 SelectedSecurityProtocol 0;
BA_ "GenSigTimeoutTime_DMPI" SG_ 546 SelectedSecurityProtocol 0;
BA_ "GenSigTimeoutTime_BPCM" SG_ 546 SelectedSecurityProtocol 0;
BA_ "GenSigTimeoutTime_AGSM" SG_ 546 SelectedSecurityProtocol 0;
BA_ "GenSigTimeoutTime_SGW" SG_ 546 BMS_HV_Char_PreCha_Contac_Sts_V 0;
BA_ "GenSigTimeoutTime_PBWM" SG_ 546 BMS_HV_Char_PreCha_Contac_Sts_V 0;
BA_ "GenSigTimeoutTime_EVCU2" SG_ 546 BMS_HV_Char_PreCha_Contac_Sts_V 0;
BA_ "GenSigTimeoutTime_ECM" SG_ 546 BMS_HV_Char_PreCha_Contac_Sts_V 0;
BA_ "GenSigTimeoutTime_DMPI" SG_ 546 BMS_HV_Char_PreCha_Contac_Sts_V 0;
BA_ "GenSigTimeoutTime_AGSM" SG_ 546 BMS_HV_Char_PreCha_Contac_Sts_V 0;
BA_ "SystemSignalLongSymbol" SG_ 546 BMS_HV_Char_PreCha_Contac_Sts_V "BMS_HV_Char_PreCha_Contac_Sts_VDCM";
BA_ "GenSigTimeoutTime_SGW" SG_ 546 BMS_HV_Trac_Bus_Sts_VDCM 0;
BA_ "GenSigTimeoutTime_PBWM" SG_ 546 BMS_HV_Trac_Bus_Sts_VDCM 0;
BA_ "GenSigTimeoutTime_EVCU2" SG_ 546 BMS_HV_Trac_Bus_Sts_VDCM 0;
BA_ "GenSigTimeoutTime_ECM" SG_ 546 BMS_HV_Trac_Bus_Sts_VDCM 0;
BA_ "GenSigTimeoutTime_DMPI" SG_ 546 BMS_HV_Trac_Bus_Sts_VDCM 0;
BA_ "GenSigTimeoutTime_AGSM" SG_ 546 BMS_HV_Trac_Bus_Sts_VDCM 0;
BA_ "GenSigTimeoutTime_SGW" SG_ 546 BMS_HV_TractionBusVoltage_VDCM 0;
BA_ "GenSigTimeoutTime_PBWM" SG_ 546 BMS_HV_TractionBusVoltage_VDCM 0;
BA_ "GenSigTimeoutTime_EVCU2" SG_ 546 BMS_HV_TractionBusVoltage_VDCM 0;
BA_ "GenSigTimeoutTime_ECM" SG_ 546 BMS_HV_TractionBusVoltage_VDCM 0;
BA_ "GenSigTimeoutTime_DMPI" SG_ 546 BMS_HV_TractionBusVoltage_VDCM 0;
BA_ "GenSigTimeoutTime_AGSM" SG_ 546 BMS_HV_TractionBusVoltage_VDCM 0;
BA_ "GenSigTimeoutTime_SGW" SG_ 546 BMS_HV_Char_Main_Contac_Sts_VDCM 0;
BA_ "GenSigTimeoutTime_PBWM" SG_ 546 BMS_HV_Char_Main_Contac_Sts_VDCM 0;
BA_ "GenSigTimeoutTime_EVCU2" SG_ 546 BMS_HV_Char_Main_Contac_Sts_VDCM 0;
BA_ "GenSigTimeoutTime_ECM" SG_ 546 BMS_HV_Char_Main_Contac_Sts_VDCM 0;
BA_ "GenSigTimeoutTime_DMPI" SG_ 546 BMS_HV_Char_Main_Contac_Sts_VDCM 0;
BA_ "GenSigTimeoutTime_AGSM" SG_ 546 BMS_HV_Char_Main_Contac_Sts_VDCM 0;
BA_ "GenSigTimeoutTime_SGW" SG_ 546 BMS_HV_Common_Contactor_Sts_VDCM 0;
BA_ "GenSigTimeoutTime_PBWM" SG_ 546 BMS_HV_Common_Contactor_Sts_VDCM 0;
BA_ "GenSigTimeoutTime_EVCU2" SG_ 546 BMS_HV_Common_Contactor_Sts_VDCM 0;
BA_ "GenSigTimeoutTime_ECM" SG_ 546 BMS_HV_Common_Contactor_Sts_VDCM 0;
BA_ "GenSigTimeoutTime_DMPI" SG_ 546 BMS_HV_Common_Contactor_Sts_VDCM 0;
BA_ "GenSigTimeoutTime_AGSM" SG_ 546 BMS_HV_Common_Contactor_Sts_VDCM 0;
BA_ "GenSigTimeoutTime_SGW" SG_ 546 BMS_HV_High_Temp_Thrsh_VDCM 0;
BA_ "GenSigTimeoutTime_PBWM" SG_ 546 BMS_HV_High_Temp_Thrsh_VDCM 0;
BA_ "GenSigTimeoutTime_EVCU2" SG_ 546 BMS_HV_High_Temp_Thrsh_VDCM 0;
BA_ "GenSigTimeoutTime_ECM" SG_ 546 BMS_HV_High_Temp_Thrsh_VDCM 0;
BA_ "GenSigTimeoutTime_DMPI" SG_ 546 BMS_HV_High_Temp_Thrsh_VDCM 0;
BA_ "GenSigTimeoutTime_BPCM" SG_ 546 BMS_HV_High_Temp_Thrsh_VDCM 0;
BA_ "GenSigTimeoutTime_AGSM" SG_ 546 BMS_HV_High_Temp_Thrsh_VDCM 0;
BA_ "GenSigTimeoutTime_SGW" SG_ 546 BMS_HV_InternalVoltage_VDCM 0;
BA_ "GenSigTimeoutTime_PBWM" SG_ 546 BMS_HV_InternalVoltage_VDCM 0;
BA_ "GenSigTimeoutTime_EVCU2" SG_ 546 BMS_HV_InternalVoltage_VDCM 0;
BA_ "GenSigTimeoutTime_ECM" SG_ 546 BMS_HV_InternalVoltage_VDCM 0;
BA_ "GenSigTimeoutTime_DMPI" SG_ 546 BMS_HV_InternalVoltage_VDCM 0;
BA_ "GenSigTimeoutTime_AGSM" SG_ 546 BMS_HV_InternalVoltage_VDCM 0;
BA_ "GenSigTimeoutTime_SGW" SG_ 546 BMS_HV_Low_Temp_Thrsh_VDCM 0;
BA_ "GenSigTimeoutTime_PBWM" SG_ 546 BMS_HV_Low_Temp_Thrsh_VDCM 0;
BA_ "GenSigTimeoutTime_EVCU2" SG_ 546 BMS_HV_Low_Temp_Thrsh_VDCM 0;
BA_ "GenSigTimeoutTime_ECM" SG_ 546 BMS_HV_Low_Temp_Thrsh_VDCM 0;
BA_ "GenSigTimeoutTime_DMPI" SG_ 546 BMS_HV_Low_Temp_Thrsh_VDCM 0;
BA_ "GenSigTimeoutTime_BPCM" SG_ 546 BMS_HV_Low_Temp_Thrsh_VDCM 0;
BA_ "GenSigTimeoutTime_AGSM" SG_ 546 BMS_HV_Low_Temp_Thrsh_VDCM 0;
BA_ "GenSigTimeoutTime_SGW" SG_ 546 BMS_HV_NumCellMaxTemp_VDCM 0;
BA_ "GenSigTimeoutTime_PBWM" SG_ 546 BMS_HV_NumCellMaxTemp_VDCM 0;
BA_ "GenSigTimeoutTime_EVCU2" SG_ 546 BMS_HV_NumCellMaxTemp_VDCM 0;
BA_ "GenSigTimeoutTime_ECM" SG_ 546 BMS_HV_NumCellMaxTemp_VDCM 0;
BA_ "GenSigTimeoutTime_DMPI" SG_ 546 BMS_HV_NumCellMaxTemp_VDCM 0;
BA_ "GenSigTimeoutTime_BPCM" SG_ 546 BMS_HV_NumCellMaxTemp_VDCM 0;
BA_ "GenSigTimeoutTime_AGSM" SG_ 546 BMS_HV_NumCellMaxTemp_VDCM 0;
BA_ "GenSigTimeoutTime_SGW" SG_ 546 BMS_HV_NumCellMaxVolt_VDCM 0;
BA_ "GenSigTimeoutTime_PBWM" SG_ 546 BMS_HV_NumCellMaxVolt_VDCM 0;
BA_ "GenSigTimeoutTime_EVCU2" SG_ 546 BMS_HV_NumCellMaxVolt_VDCM 0;
BA_ "GenSigTimeoutTime_ECM" SG_ 546 BMS_HV_NumCellMaxVolt_VDCM 0;
BA_ "GenSigTimeoutTime_DMPI" SG_ 546 BMS_HV_NumCellMaxVolt_VDCM 0;
BA_ "GenSigTimeoutTime_BPCM" SG_ 546 BMS_HV_NumCellMaxVolt_VDCM 0;
BA_ "GenSigTimeoutTime_AGSM" SG_ 546 BMS_HV_NumCellMaxVolt_VDCM 0;
BA_ "GenSigTimeoutTime_SGW" SG_ 546 BMS_HV_NumCellMinTemp_VDCM 0;
BA_ "GenSigTimeoutTime_PBWM" SG_ 546 BMS_HV_NumCellMinTemp_VDCM 0;
BA_ "GenSigTimeoutTime_EVCU2" SG_ 546 BMS_HV_NumCellMinTemp_VDCM 0;
BA_ "GenSigTimeoutTime_ECM" SG_ 546 BMS_HV_NumCellMinTemp_VDCM 0;
BA_ "GenSigTimeoutTime_DMPI" SG_ 546 BMS_HV_NumCellMinTemp_VDCM 0;
BA_ "GenSigTimeoutTime_BPCM" SG_ 546 BMS_HV_NumCellMinTemp_VDCM 0;
BA_ "GenSigTimeoutTime_AGSM" SG_ 546 BMS_HV_NumCellMinTemp_VDCM 0;
BA_ "GenSigTimeoutTime_SGW" SG_ 546 BMS_HV_SOC_AccuracySts_VDCM 0;
BA_ "GenSigTimeoutTime_PBWM" SG_ 546 BMS_HV_SOC_AccuracySts_VDCM 0;
BA_ "GenSigTimeoutTime_EVCU2" SG_ 546 BMS_HV_SOC_AccuracySts_VDCM 0;
BA_ "GenSigTimeoutTime_ECM" SG_ 546 BMS_HV_SOC_AccuracySts_VDCM 0;
BA_ "GenSigTimeoutTime_DMPI" SG_ 546 BMS_HV_SOC_AccuracySts_VDCM 0;
BA_ "GenSigTimeoutTime_BPCM" SG_ 546 BMS_HV_SOC_AccuracySts_VDCM 0;
BA_ "GenSigTimeoutTime_AGSM" SG_ 546 BMS_HV_SOC_AccuracySts_VDCM 0;
BA_ "GenSigSendType" SG_ 546 BMS_HV_SOC_AccuracySts_VDCM 3;
BA_ "GenSigTimeoutTime_SGW" SG_ 546 BMS_HV_Temperature_Max_VDCM 0;
BA_ "GenSigTimeoutTime_PBWM" SG_ 546 BMS_HV_Temperature_Max_VDCM 0;
BA_ "GenSigTimeoutTime_EVCU2" SG_ 546 BMS_HV_Temperature_Max_VDCM 0;
BA_ "GenSigTimeoutTime_ECM" SG_ 546 BMS_HV_Temperature_Max_VDCM 0;
BA_ "GenSigTimeoutTime_DMPI" SG_ 546 BMS_HV_Temperature_Max_VDCM 0;
BA_ "GenSigTimeoutTime_BPCM" SG_ 546 BMS_HV_Temperature_Max_VDCM 0;
BA_ "GenSigTimeoutTime_AGSM" SG_ 546 BMS_HV_Temperature_Max_VDCM 0;
BA_ "GenSigTimeoutTime_AGSM" SG_ 546 HCP_DC_Retry 0;
BA_ "GenSigTimeoutTime_SGW" SG_ 546 BMS_HV_Temperature_Min_VDCM 0;
BA_ "GenSigTimeoutTime_PBWM" SG_ 546 BMS_HV_Temperature_Min_VDCM 0;
BA_ "GenSigTimeoutTime_EVCU2" SG_ 546 BMS_HV_Temperature_Min_VDCM 0;
BA_ "GenSigTimeoutTime_ECM" SG_ 546 BMS_HV_Temperature_Min_VDCM 0;
BA_ "GenSigTimeoutTime_DMPI" SG_ 546 BMS_HV_Temperature_Min_VDCM 0;
BA_ "GenSigTimeoutTime_BPCM" SG_ 546 BMS_HV_Temperature_Min_VDCM 0;
BA_ "GenSigTimeoutTime_AGSM" SG_ 546 BMS_HV_Temperature_Min_VDCM 0;
BA_ "GenSigTimeoutTime_SGW" SG_ 546 BMS_HV_Trac_Main_Contac_Sts_VDCM 0;
BA_ "GenSigTimeoutTime_PBWM" SG_ 546 BMS_HV_Trac_Main_Contac_Sts_VDCM 0;
BA_ "GenSigTimeoutTime_EVCU2" SG_ 546 BMS_HV_Trac_Main_Contac_Sts_VDCM 0;
BA_ "GenSigTimeoutTime_ECM" SG_ 546 BMS_HV_Trac_Main_Contac_Sts_VDCM 0;
BA_ "GenSigTimeoutTime_DMPI" SG_ 546 BMS_HV_Trac_Main_Contac_Sts_VDCM 0;
BA_ "GenSigTimeoutTime_AGSM" SG_ 546 BMS_HV_Trac_Main_Contac_Sts_VDCM 0;
BA_ "GenSigTimeoutTime_SGW" SG_ 546 BMS_HV_Trac_PreCha_Contac_Sts_V 0;
BA_ "GenSigTimeoutTime_PBWM" SG_ 546 BMS_HV_Trac_PreCha_Contac_Sts_V 0;
BA_ "GenSigTimeoutTime_EVCU2" SG_ 546 BMS_HV_Trac_PreCha_Contac_Sts_V 0;
BA_ "GenSigTimeoutTime_ECM" SG_ 546 BMS_HV_Trac_PreCha_Contac_Sts_V 0;
BA_ "GenSigTimeoutTime_DMPI" SG_ 546 BMS_HV_Trac_PreCha_Contac_Sts_V 0;
BA_ "GenSigTimeoutTime_AGSM" SG_ 546 BMS_HV_Trac_PreCha_Contac_Sts_V 0;
BA_ "SystemSignalLongSymbol" SG_ 546 BMS_HV_Trac_PreCha_Contac_Sts_V "BMS_HV_Trac_PreCha_Contac_Sts_VDCM";
BA_ "GenSigTimeoutTime_SGW" SG_ 546 BMS_Max_Cell_Volt_Allowed_VDCM 0;
BA_ "GenSigTimeoutTime_PBWM" SG_ 546 BMS_Max_Cell_Volt_Allowed_VDCM 0;
BA_ "GenSigTimeoutTime_EVCU2" SG_ 546 BMS_Max_Cell_Volt_Allowed_VDCM 0;
BA_ "GenSigTimeoutTime_ECM" SG_ 546 BMS_Max_Cell_Volt_Allowed_VDCM 0;
BA_ "GenSigTimeoutTime_DMPI" SG_ 546 BMS_Max_Cell_Volt_Allowed_VDCM 0;
BA_ "GenSigTimeoutTime_BPCM" SG_ 546 BMS_Max_Cell_Volt_Allowed_VDCM 0;
BA_ "GenSigTimeoutTime_AGSM" SG_ 546 BMS_Max_Cell_Volt_Allowed_VDCM 0;
BA_ "GenSigTimeoutTime_SGW" SG_ 546 BMS_Max_Cell_Volt_Allowed_Vldty 0;
BA_ "GenSigTimeoutTime_PBWM" SG_ 546 BMS_Max_Cell_Volt_Allowed_Vldty 0;
BA_ "GenSigTimeoutTime_EVCU2" SG_ 546 BMS_Max_Cell_Volt_Allowed_Vldty 0;
BA_ "GenSigTimeoutTime_ECM" SG_ 546 BMS_Max_Cell_Volt_Allowed_Vldty 0;
BA_ "GenSigTimeoutTime_DMPI" SG_ 546 BMS_Max_Cell_Volt_Allowed_Vldty 0;
BA_ "GenSigTimeoutTime_BPCM" SG_ 546 BMS_Max_Cell_Volt_Allowed_Vldty 0;
BA_ "GenSigTimeoutTime_AGSM" SG_ 546 BMS_Max_Cell_Volt_Allowed_Vldty 0;
BA_ "SystemSignalLongSymbol" SG_ 546 BMS_Max_Cell_Volt_Allowed_Vldty "BMS_Max_Cell_Volt_Allowed_Vldty_VDCM";
BA_ "GenSigTimeoutTime_SGW" SG_ 546 BMS_Max_Pk_Volt_Allowed_VDCM 0;
BA_ "GenSigTimeoutTime_PBWM" SG_ 546 BMS_Max_Pk_Volt_Allowed_VDCM 0;
BA_ "GenSigTimeoutTime_EVCU2" SG_ 546 BMS_Max_Pk_Volt_Allowed_VDCM 0;
BA_ "GenSigTimeoutTime_ECM" SG_ 546 BMS_Max_Pk_Volt_Allowed_VDCM 0;
BA_ "GenSigTimeoutTime_DMPI" SG_ 546 BMS_Max_Pk_Volt_Allowed_VDCM 0;
BA_ "GenSigTimeoutTime_BPCM" SG_ 546 BMS_Max_Pk_Volt_Allowed_VDCM 0;
BA_ "GenSigTimeoutTime_AGSM" SG_ 546 BMS_Max_Pk_Volt_Allowed_VDCM 0;
BA_ "GenSigTimeoutTime_SGW" SG_ 546 DCChrg_BatSideCurrent_VDCM 0;
BA_ "GenSigTimeoutTime_PBWM" SG_ 546 DCChrg_BatSideCurrent_VDCM 0;
BA_ "GenSigTimeoutTime_EVCU2" SG_ 546 DCChrg_BatSideCurrent_VDCM 0;
BA_ "GenSigTimeoutTime_ECM" SG_ 546 DCChrg_BatSideCurrent_VDCM 0;
BA_ "GenSigTimeoutTime_DMPI" SG_ 546 DCChrg_BatSideCurrent_VDCM 0;
BA_ "GenSigTimeoutTime_BPCM" SG_ 546 DCChrg_BatSideCurrent_VDCM 0;
BA_ "GenSigTimeoutTime_AGSM" SG_ 546 DCChrg_BatSideCurrent_VDCM 0;
BA_ "GenSigStartValue" SG_ 546 DCChrg_BatSideCurrent_VDCM 50;
BA_ "GenSigTimeoutTime_SGW" SG_ 546 CPIM_Error 0;
BA_ "GenSigTimeoutTime_PBWM" SG_ 546 CPIM_Error 0;
BA_ "GenSigTimeoutTime_EVCU2" SG_ 546 CPIM_Error 0;
BA_ "GenSigTimeoutTime_ECM" SG_ 546 CPIM_Error 0;
BA_ "GenSigTimeoutTime_DMPI" SG_ 546 CPIM_Error 0;
BA_ "GenSigTimeoutTime_BPCM" SG_ 546 CPIM_Error 0;
BA_ "GenSigTimeoutTime_AGSM" SG_ 546 CPIM_Error 0;
BA_ "GenSigTimeoutTime_SGW" SG_ 546 CPIM_Over_Temperature 0;
BA_ "GenSigTimeoutTime_PBWM" SG_ 546 CPIM_Over_Temperature 0;
BA_ "GenSigTimeoutTime_EVCU2" SG_ 546 CPIM_Over_Temperature 0;
BA_ "GenSigTimeoutTime_ECM" SG_ 546 CPIM_Over_Temperature 0;
BA_ "GenSigTimeoutTime_DMPI" SG_ 546 CPIM_Over_Temperature 0;
BA_ "GenSigTimeoutTime_BPCM" SG_ 546 CPIM_Over_Temperature 0;
BA_ "GenSigTimeoutTime_AGSM" SG_ 546 CPIM_Over_Temperature 0;
BA_ "GenSigTimeoutTime_SGW" SG_ 546 GBT_Target_Cell_Voltage_Reached 0;
BA_ "GenSigTimeoutTime_PBWM" SG_ 546 GBT_Target_Cell_Voltage_Reached 0;
BA_ "GenSigTimeoutTime_EVCU2" SG_ 546 GBT_Target_Cell_Voltage_Reached 0;
BA_ "GenSigTimeoutTime_ECM" SG_ 546 GBT_Target_Cell_Voltage_Reached 0;
BA_ "GenSigTimeoutTime_DMPI" SG_ 546 GBT_Target_Cell_Voltage_Reached 0;
BA_ "GenSigTimeoutTime_BPCM" SG_ 546 GBT_Target_Cell_Voltage_Reached 0;
BA_ "GenSigTimeoutTime_AGSM" SG_ 546 GBT_Target_Cell_Voltage_Reached 0;
BA_ "GenSigTimeoutTime_SGW" SG_ 546 GBT_Desired_SOC_Reached 0;
BA_ "GenSigTimeoutTime_PBWM" SG_ 546 GBT_Desired_SOC_Reached 0;
BA_ "GenSigTimeoutTime_EVCU2" SG_ 546 GBT_Desired_SOC_Reached 0;
BA_ "GenSigTimeoutTime_ECM" SG_ 546 GBT_Desired_SOC_Reached 0;
BA_ "GenSigTimeoutTime_DMPI" SG_ 546 GBT_Desired_SOC_Reached 0;
BA_ "GenSigTimeoutTime_BPCM" SG_ 546 GBT_Desired_SOC_Reached 0;
BA_ "GenSigTimeoutTime_AGSM" SG_ 546 GBT_Desired_SOC_Reached 0;
BA_ "GenSigTimeoutTime_SGW" SG_ 546 GBT_Ready_to_Charge 0;
BA_ "GenSigTimeoutTime_PBWM" SG_ 546 GBT_Ready_to_Charge 0;
BA_ "GenSigTimeoutTime_EVCU2" SG_ 546 GBT_Ready_to_Charge 0;
BA_ "GenSigTimeoutTime_ECM" SG_ 546 GBT_Ready_to_Charge 0;
BA_ "GenSigTimeoutTime_DMPI" SG_ 546 GBT_Ready_to_Charge 0;
BA_ "GenSigTimeoutTime_BPCM" SG_ 546 GBT_Ready_to_Charge 0;
BA_ "GenSigTimeoutTime_AGSM" SG_ 546 GBT_Ready_to_Charge 0;
BA_ "GenSigTimeoutTime_SGW" SG_ 546 GBT_Charger_Active_Interruption 0;
BA_ "GenSigTimeoutTime_PBWM" SG_ 546 GBT_Charger_Active_Interruption 0;
BA_ "GenSigTimeoutTime_EVCU2" SG_ 546 GBT_Charger_Active_Interruption 0;
BA_ "GenSigTimeoutTime_ECM" SG_ 546 GBT_Charger_Active_Interruption 0;
BA_ "GenSigTimeoutTime_DMPI" SG_ 546 GBT_Charger_Active_Interruption 0;
BA_ "GenSigTimeoutTime_BPCM" SG_ 546 GBT_Charger_Active_Interruption 0;
BA_ "GenSigTimeoutTime_AGSM" SG_ 546 GBT_Charger_Active_Interruption 0;
BA_ "GenSigTimeoutTime_SGW" SG_ 546 GBT_Target_Voltage_Reached 0;
BA_ "GenSigTimeoutTime_PBWM" SG_ 546 GBT_Target_Voltage_Reached 0;
BA_ "GenSigTimeoutTime_EVCU2" SG_ 546 GBT_Target_Voltage_Reached 0;
BA_ "GenSigTimeoutTime_ECM" SG_ 546 GBT_Target_Voltage_Reached 0;
BA_ "GenSigTimeoutTime_DMPI" SG_ 546 GBT_Target_Voltage_Reached 0;
BA_ "GenSigTimeoutTime_BPCM" SG_ 546 GBT_Target_Voltage_Reached 0;
BA_ "GenSigTimeoutTime_AGSM" SG_ 546 GBT_Target_Voltage_Reached 0;
BA_ "GenSigTimeoutTime_SGW" SG_ 546 BMS_HV_Char_Bus_Sts_VDCM 0;
BA_ "GenSigTimeoutTime_PBWM" SG_ 546 BMS_HV_Char_Bus_Sts_VDCM 0;
BA_ "GenSigTimeoutTime_EVCU2" SG_ 546 BMS_HV_Char_Bus_Sts_VDCM 0;
BA_ "GenSigTimeoutTime_ECM" SG_ 546 BMS_HV_Char_Bus_Sts_VDCM 0;
BA_ "GenSigTimeoutTime_DMPI" SG_ 546 BMS_HV_Char_Bus_Sts_VDCM 0;
BA_ "GenSigTimeoutTime_SGW" SG_ 546 BMS_HV_ChargingBusVoltage_VDCM 0;
BA_ "GenSigTimeoutTime_PBWM" SG_ 546 BMS_HV_ChargingBusVoltage_VDCM 0;
BA_ "GenSigTimeoutTime_EVCU2" SG_ 546 BMS_HV_ChargingBusVoltage_VDCM 0;
BA_ "GenSigTimeoutTime_ECM" SG_ 546 BMS_HV_ChargingBusVoltage_VDCM 0;
BA_ "GenSigTimeoutTime_DMPI" SG_ 546 BMS_HV_ChargingBusVoltage_VDCM 0;
BA_ "GenSigTimeoutTime_AGSM" SG_ 546 BMS_HV_ChargingBusVoltage_VDCM 0;
BA_ "GenSigTimeoutTime_SGW" SG_ 546 CRC_VO2 0;
BA_ "GenSigTimeoutTime_PBWM" SG_ 546 CRC_VO2 0;
BA_ "GenSigTimeoutTime_EVCU2" SG_ 546 CRC_VO2 0;
BA_ "GenSigTimeoutTime_ECM" SG_ 546 CRC_VO2 0;
BA_ "GenSigTimeoutTime_DMPI" SG_ 546 CRC_VO2 0;
BA_ "GenSigTimeoutTime_AGSM" SG_ 546 CRC_VO2 0;
BA_ "GenSigTimeoutTime_AGSM" SG_ 546 BMS_HV_Char_Bus_Sts_VDCM 0;
BA_ "GenSigTimeoutTime_SGW" SG_ 546 BMS_HV_BatActualPower_VDCM 0;
BA_ "GenSigTimeoutTime_PBWM" SG_ 546 BMS_HV_BatActualPower_VDCM 0;
BA_ "GenSigTimeoutTime_EVCU2" SG_ 546 BMS_HV_BatActualPower_VDCM 0;
BA_ "GenSigTimeoutTime_ECM" SG_ 546 BMS_HV_BatActualPower_VDCM 0;
BA_ "GenSigTimeoutTime_DMPI" SG_ 546 BMS_HV_BatActualPower_VDCM 0;
BA_ "GenSigTimeoutTime_AGSM" SG_ 546 BMS_HV_BatActualPower_VDCM 0;
BA_ "GenSigTimeoutTime_SGW" SG_ 546 BMS_HV_BatState_VDCM 0;
BA_ "GenSigTimeoutTime_PBWM" SG_ 546 BMS_HV_BatState_VDCM 0;
BA_ "GenSigTimeoutTime_EVCU2" SG_ 546 BMS_HV_BatState_VDCM 0;
BA_ "GenSigTimeoutTime_ECM" SG_ 546 BMS_HV_BatState_VDCM 0;
BA_ "GenSigTimeoutTime_DMPI" SG_ 546 BMS_HV_BatState_VDCM 0;
BA_ "GenSigTimeoutTime_AGSM" SG_ 546 BMS_HV_BatState_VDCM 0;
BA_ "GenSigTimeoutTime_SGW" SG_ 502 HVCMS_ServiceCategory 0;
BA_ "GenSigTimeoutTime_PBWM" SG_ 502 HVCMS_ServiceCategory 0;
BA_ "GenSigTimeoutTime_EVCU2" SG_ 502 HVCMS_ServiceCategory 0;
BA_ "GenSigTimeoutTime_ECM" SG_ 502 HVCMS_ServiceCategory 0;
BA_ "GenSigTimeoutTime_DMPI" SG_ 502 HVCMS_ServiceCategory 0;
BA_ "GenSigTimeoutTime_BPCM" SG_ 502 HVCMS_ServiceCategory 0;
BA_ "GenSigTimeoutTime_AGSM" SG_ 502 HVCMS_ServiceCategory 0;
BA_ "GenSigTimeoutTime_SGW" SG_ 502 HVCMS_SelectedPaymentOptn 0;
BA_ "GenSigTimeoutTime_PBWM" SG_ 502 HVCMS_SelectedPaymentOptn 0;
BA_ "GenSigTimeoutTime_EVCU2" SG_ 502 HVCMS_SelectedPaymentOptn 0;
BA_ "GenSigTimeoutTime_ECM" SG_ 502 HVCMS_SelectedPaymentOptn 0;
BA_ "GenSigTimeoutTime_DMPI" SG_ 502 HVCMS_SelectedPaymentOptn 0;
BA_ "GenSigTimeoutTime_BPCM" SG_ 502 HVCMS_SelectedPaymentOptn 0;
BA_ "GenSigTimeoutTime_AGSM" SG_ 502 HVCMS_SelectedPaymentOptn 0;
BA_ "GenSigTimeoutTime_SGW" SG_ 502 HVCMS_SelectedServiceId 0;
BA_ "GenSigTimeoutTime_PBWM" SG_ 502 HVCMS_SelectedServiceId 0;
BA_ "GenSigTimeoutTime_EVCU2" SG_ 502 HVCMS_SelectedServiceId 0;
BA_ "GenSigTimeoutTime_ECM" SG_ 502 HVCMS_SelectedServiceId 0;
BA_ "GenSigTimeoutTime_DMPI" SG_ 502 HVCMS_SelectedServiceId 0;
BA_ "GenSigTimeoutTime_BPCM" SG_ 502 HVCMS_SelectedServiceId 0;
BA_ "GenSigTimeoutTime_AGSM" SG_ 502 HVCMS_SelectedServiceId 0;
BA_ "GenSigTimeoutTime_SGW" SG_ 502 HVCMS_RemaningTimeToBulkSOC 0;
BA_ "GenSigTimeoutTime_PBWM" SG_ 502 HVCMS_RemaningTimeToBulkSOC 0;
BA_ "GenSigTimeoutTime_EVCU2" SG_ 502 HVCMS_RemaningTimeToBulkSOC 0;
BA_ "GenSigTimeoutTime_ECM" SG_ 502 HVCMS_RemaningTimeToBulkSOC 0;
BA_ "GenSigTimeoutTime_DMPI" SG_ 502 HVCMS_RemaningTimeToBulkSOC 0;
BA_ "GenSigTimeoutTime_BPCM" SG_ 502 HVCMS_RemaningTimeToBulkSOC 0;
BA_ "GenSigTimeoutTime_AGSM" SG_ 502 HVCMS_RemaningTimeToBulkSOC 0;
BA_ "GenSigTimeoutTime_SGW" SG_ 502 HVCMS_RemaningTimeToFullSOC 0;
BA_ "GenSigTimeoutTime_PBWM" SG_ 502 HVCMS_RemaningTimeToFullSOC 0;
BA_ "GenSigTimeoutTime_EVCU2" SG_ 502 HVCMS_RemaningTimeToFullSOC 0;
BA_ "GenSigTimeoutTime_ECM" SG_ 502 HVCMS_RemaningTimeToFullSOC 0;
BA_ "GenSigTimeoutTime_DMPI" SG_ 502 HVCMS_RemaningTimeToFullSOC 0;
BA_ "GenSigTimeoutTime_BPCM" SG_ 502 HVCMS_RemaningTimeToFullSOC 0;
BA_ "GenSigTimeoutTime_AGSM" SG_ 502 HVCMS_RemaningTimeToFullSOC 0;
BA_ "GenSigTimeoutTime_SGW" SG_ 502 HVCMS_SelectedEnergyTransferType 0;
BA_ "GenSigTimeoutTime_PBWM" SG_ 502 HVCMS_SelectedEnergyTransferType 0;
BA_ "GenSigTimeoutTime_EVCU2" SG_ 502 HVCMS_SelectedEnergyTransferType 0;
BA_ "GenSigTimeoutTime_ECM" SG_ 502 HVCMS_SelectedEnergyTransferType 0;
BA_ "GenSigTimeoutTime_DMPI" SG_ 502 HVCMS_SelectedEnergyTransferType 0;
BA_ "GenSigTimeoutTime_BPCM" SG_ 502 HVCMS_SelectedEnergyTransferType 0;
BA_ "GenSigTimeoutTime_AGSM" SG_ 502 HVCMS_SelectedEnergyTransferType 0;
BA_ "GenSigTimeoutTime_SGW" SG_ 502 VDCM_TypeCNegotiationSts 0;
BA_ "GenSigTimeoutTime_PBWM" SG_ 502 VDCM_TypeCNegotiationSts 0;
BA_ "GenSigTimeoutTime_EVCU2" SG_ 502 VDCM_TypeCNegotiationSts 0;
BA_ "GenSigTimeoutTime_ECM" SG_ 502 VDCM_TypeCNegotiationSts 0;
BA_ "GenSigTimeoutTime_DMPI" SG_ 502 VDCM_TypeCNegotiationSts 0;
BA_ "GenSigTimeoutTime_BPCM" SG_ 502 VDCM_TypeCNegotiationSts 0;
BA_ "GenSigTimeoutTime_AGSM" SG_ 502 VDCM_TypeCNegotiationSts 0;
BA_ "GenSigTimeoutTime_SGW" SG_ 502 VDCM_ContractAuthenticationID 0;
BA_ "GenSigTimeoutTime_PBWM" SG_ 502 VDCM_ContractAuthenticationID 0;
BA_ "GenSigTimeoutTime_EVCU2" SG_ 502 VDCM_ContractAuthenticationID 0;
BA_ "GenSigTimeoutTime_ECM" SG_ 502 VDCM_ContractAuthenticationID 0;
BA_ "GenSigTimeoutTime_DMPI" SG_ 502 VDCM_ContractAuthenticationID 0;
BA_ "GenSigTimeoutTime_BPCM" SG_ 502 VDCM_ContractAuthenticationID 0;
BA_ "GenSigTimeoutTime_AGSM" SG_ 502 VDCM_ContractAuthenticationID 0;
BA_ "GenSigTimeoutTime_SGW" SG_ 502 VDCM_GenChallenge 0;
BA_ "GenSigTimeoutTime_PBWM" SG_ 502 VDCM_GenChallenge 0;
BA_ "GenSigTimeoutTime_EVCU2" SG_ 502 VDCM_GenChallenge 0;
BA_ "GenSigTimeoutTime_ECM" SG_ 502 VDCM_GenChallenge 0;
BA_ "GenSigTimeoutTime_DMPI" SG_ 502 VDCM_GenChallenge 0;
BA_ "GenSigTimeoutTime_BPCM" SG_ 502 VDCM_GenChallenge 0;
BA_ "GenSigTimeoutTime_AGSM" SG_ 502 VDCM_GenChallenge 0;
BA_ "GenSigTimeoutTime_SGW" SG_ 546 BMS_HV_Battery_GFD_Sts_VDCM 0;
BA_ "GenSigTimeoutTime_PBWM" SG_ 546 BMS_HV_Battery_GFD_Sts_VDCM 0;
BA_ "GenSigTimeoutTime_EVCU2" SG_ 546 BMS_HV_Battery_GFD_Sts_VDCM 0;
BA_ "GenSigTimeoutTime_ECM" SG_ 546 BMS_HV_Battery_GFD_Sts_VDCM 0;
BA_ "GenSigTimeoutTime_DMPI" SG_ 546 BMS_HV_Battery_GFD_Sts_VDCM 0;
BA_ "GenSigTimeoutTime_AGSM" SG_ 546 BMS_HV_Battery_GFD_Sts_VDCM 0;
BA_ "GenSigTimeoutTime_SGW" SG_ 546 BMS_HV_AC_Char_Main_Contac_Sts_ 0;
BA_ "GenSigTimeoutTime_PBWM" SG_ 546 BMS_HV_AC_Char_Main_Contac_Sts_ 0;
BA_ "GenSigTimeoutTime_EVCU2" SG_ 546 BMS_HV_AC_Char_Main_Contac_Sts_ 0;
BA_ "GenSigTimeoutTime_ECM" SG_ 546 BMS_HV_AC_Char_Main_Contac_Sts_ 0;
BA_ "GenSigTimeoutTime_DMPI" SG_ 546 BMS_HV_AC_Char_Main_Contac_Sts_ 0;
BA_ "GenSigTimeoutTime_AGSM" SG_ 546 BMS_HV_AC_Char_Main_Contac_Sts_ 0;
BA_ "SystemSignalLongSymbol" SG_ 546 BMS_HV_AC_Char_Main_Contac_Sts_ "BMS_HV_AC_Char_Main_Contac_Sts_VDCM";
BA_ "GenSigTimeoutTime_SGW" SG_ 546 BMS_HV_BatIntrlk_InternalStat_V 0;
BA_ "GenSigTimeoutTime_PBWM" SG_ 546 BMS_HV_BatIntrlk_InternalStat_V 0;
BA_ "GenSigTimeoutTime_EVCU2" SG_ 546 BMS_HV_BatIntrlk_InternalStat_V 0;
BA_ "GenSigTimeoutTime_ECM" SG_ 546 BMS_HV_BatIntrlk_InternalStat_V 0;
BA_ "GenSigTimeoutTime_DMPI" SG_ 546 BMS_HV_BatIntrlk_InternalStat_V 0;
BA_ "GenSigTimeoutTime_AGSM" SG_ 546 BMS_HV_BatIntrlk_InternalStat_V 0;
BA_ "SystemSignalLongSymbol" SG_ 546 BMS_HV_BatIntrlk_InternalStat_V "BMS_HV_BatIntrlk_InternalStat_VDCM";
BA_ "GenSigTimeoutTime_SGW" SG_ 546 BMS_Cell_Volt_Max_VDCM 0;
BA_ "GenSigTimeoutTime_PBWM" SG_ 546 BMS_Cell_Volt_Max_VDCM 0;
BA_ "GenSigTimeoutTime_EVCU2" SG_ 546 BMS_Cell_Volt_Max_VDCM 0;
BA_ "GenSigTimeoutTime_ECM" SG_ 546 BMS_Cell_Volt_Max_VDCM 0;
BA_ "GenSigTimeoutTime_DMPI" SG_ 546 BMS_Cell_Volt_Max_VDCM 0;
BA_ "GenSigTimeoutTime_BPCM" SG_ 546 BMS_Cell_Volt_Max_VDCM 0;
BA_ "GenSigTimeoutTime_AGSM" SG_ 546 BMS_Cell_Volt_Max_VDCM 0;
BA_ "GenSigTimeoutTime_SGW" SG_ 546 BMS_Cell_Volt_Max_Vldty_VDCM 0;
BA_ "GenSigTimeoutTime_PBWM" SG_ 546 BMS_Cell_Volt_Max_Vldty_VDCM 0;
BA_ "GenSigTimeoutTime_EVCU2" SG_ 546 BMS_Cell_Volt_Max_Vldty_VDCM 0;
BA_ "GenSigTimeoutTime_ECM" SG_ 546 BMS_Cell_Volt_Max_Vldty_VDCM 0;
BA_ "GenSigTimeoutTime_DMPI" SG_ 546 BMS_Cell_Volt_Max_Vldty_VDCM 0;
BA_ "GenSigTimeoutTime_BPCM" SG_ 546 BMS_Cell_Volt_Max_Vldty_VDCM 0;
BA_ "GenSigTimeoutTime_AGSM" SG_ 546 BMS_Cell_Volt_Max_Vldty_VDCM 0;
BA_ "GenSigTimeoutTime_SGW" SG_ 546 BMS_Cell_Volt_Min_VDCM 0;
BA_ "GenSigTimeoutTime_PBWM" SG_ 546 BMS_Cell_Volt_Min_VDCM 0;
BA_ "GenSigTimeoutTime_EVCU2" SG_ 546 BMS_Cell_Volt_Min_VDCM 0;
BA_ "GenSigTimeoutTime_ECM" SG_ 546 BMS_Cell_Volt_Min_VDCM 0;
BA_ "GenSigTimeoutTime_DMPI" SG_ 546 BMS_Cell_Volt_Min_VDCM 0;
BA_ "GenSigTimeoutTime_BPCM" SG_ 546 BMS_Cell_Volt_Min_VDCM 0;
BA_ "GenSigTimeoutTime_AGSM" SG_ 546 BMS_Cell_Volt_Min_VDCM 0;
BA_ "GenSigTimeoutTime_SGW" SG_ 546 BMS_Cell_Volt_Min_Vldty_VDCM 0;
BA_ "GenSigTimeoutTime_PBWM" SG_ 546 BMS_Cell_Volt_Min_Vldty_VDCM 0;
BA_ "GenSigTimeoutTime_EVCU2" SG_ 546 BMS_Cell_Volt_Min_Vldty_VDCM 0;
BA_ "GenSigTimeoutTime_ECM" SG_ 546 BMS_Cell_Volt_Min_Vldty_VDCM 0;
BA_ "GenSigTimeoutTime_DMPI" SG_ 546 BMS_Cell_Volt_Min_Vldty_VDCM 0;
BA_ "GenSigTimeoutTime_BPCM" SG_ 546 BMS_Cell_Volt_Min_Vldty_VDCM 0;
BA_ "GenSigTimeoutTime_AGSM" SG_ 546 BMS_Cell_Volt_Min_Vldty_VDCM 0;
BA_ "GenSigTimeoutTime_SGW" SG_ 502 OBCM_OutVoltageSyncTgt 0;
BA_ "GenSigTimeoutTime_PBWM" SG_ 502 OBCM_OutVoltageSyncTgt 0;
BA_ "GenSigTimeoutTime_EVCU2" SG_ 502 OBCM_OutVoltageSyncTgt 0;
BA_ "GenSigTimeoutTime_ECM" SG_ 502 OBCM_OutVoltageSyncTgt 0;
BA_ "GenSigTimeoutTime_DMPI" SG_ 502 OBCM_OutVoltageSyncTgt 0;
BA_ "GenSigTimeoutTime_BPCM" SG_ 502 OBCM_OutVoltageSyncTgt 0;
BA_ "GenSigTimeoutTime_AGSM" SG_ 502 OBCM_OutVoltageSyncTgt 0;
BA_ "GenSigTimeoutTime_SGW" SG_ 546 AC_Chrg_Branch_Voltage_VDCM 0;
BA_ "GenSigTimeoutTime_PBWM" SG_ 546 AC_Chrg_Branch_Voltage_VDCM 0;
BA_ "GenSigTimeoutTime_EVCU2" SG_ 546 AC_Chrg_Branch_Voltage_VDCM 0;
BA_ "GenSigTimeoutTime_ECM" SG_ 546 AC_Chrg_Branch_Voltage_VDCM 0;
BA_ "GenSigTimeoutTime_DMPI" SG_ 546 AC_Chrg_Branch_Voltage_VDCM 0;
BA_ "GenSigTimeoutTime_BPCM" SG_ 546 AC_Chrg_Branch_Voltage_VDCM 0;
BA_ "GenSigTimeoutTime_AGSM" SG_ 546 AC_Chrg_Branch_Voltage_VDCM 0;
BA_ "GenSigTimeoutTime_SGW" SG_ 502 VDCM_BattBulkSOC 0;
BA_ "GenSigTimeoutTime_PBWM" SG_ 502 VDCM_BattBulkSOC 0;
BA_ "GenSigTimeoutTime_EVCU2" SG_ 502 VDCM_BattBulkSOC 0;
BA_ "GenSigTimeoutTime_ECM" SG_ 502 VDCM_BattBulkSOC 0;
BA_ "GenSigTimeoutTime_DMPI" SG_ 502 VDCM_BattBulkSOC 0;
BA_ "GenSigTimeoutTime_BPCM" SG_ 502 VDCM_BattBulkSOC 0;
BA_ "GenSigTimeoutTime_AGSM" SG_ 502 VDCM_BattBulkSOC 0;
BA_ "GenSigTimeoutTime_SGW" SG_ 502 VDCM_OBCDischCurrentLim 0;
BA_ "GenSigTimeoutTime_PBWM" SG_ 502 VDCM_OBCDischCurrentLim 0;
BA_ "GenSigTimeoutTime_EVCU2" SG_ 502 VDCM_OBCDischCurrentLim 0;
BA_ "GenSigTimeoutTime_ECM" SG_ 502 VDCM_OBCDischCurrentLim 0;
BA_ "GenSigTimeoutTime_DMPI" SG_ 502 VDCM_OBCDischCurrentLim 0;
BA_ "GenSigTimeoutTime_BPCM" SG_ 502 VDCM_OBCDischCurrentLim 0;
BA_ "GenSigTimeoutTime_AGSM" SG_ 502 VDCM_OBCDischCurrentLim 0;
BA_ "GenSigStartValue" SG_ 502 VDCM_OBCDischCurrentLim 815;
BA_ "GenSigTimeoutTime_SGW" SG_ 502 HVCMS_EVRESSConditioning 0;
BA_ "GenSigTimeoutTime_PBWM" SG_ 502 HVCMS_EVRESSConditioning 0;
BA_ "GenSigTimeoutTime_EVCU2" SG_ 502 HVCMS_EVRESSConditioning 0;
BA_ "GenSigTimeoutTime_SGW" SG_ 502 HVCMS_EVTargetCurrent 0;
BA_ "GenSigTimeoutTime_PBWM" SG_ 502 HVCMS_EVTargetCurrent 0;
BA_ "GenSigTimeoutTime_EVCU2" SG_ 502 HVCMS_EVTargetCurrent 0;
BA_ "GenSigTimeoutTime_ECM" SG_ 502 HVCMS_EVTargetCurrent 0;
BA_ "GenSigTimeoutTime_DMPI" SG_ 502 HVCMS_EVTargetCurrent 0;
BA_ "GenSigTimeoutTime_BPCM" SG_ 502 HVCMS_EVTargetCurrent 0;
BA_ "GenSigTimeoutTime_AGSM" SG_ 502 HVCMS_EVTargetCurrent 0;
BA_ "GenSigTimeoutTime_SGW" SG_ 502 HVCMS_EVTargetVoltage 0;
BA_ "GenSigTimeoutTime_PBWM" SG_ 502 HVCMS_EVTargetVoltage 0;
BA_ "GenSigTimeoutTime_EVCU2" SG_ 502 HVCMS_EVTargetVoltage 0;
BA_ "GenSigTimeoutTime_ECM" SG_ 502 HVCMS_EVTargetVoltage 0;
BA_ "GenSigTimeoutTime_DMPI" SG_ 502 HVCMS_EVTargetVoltage 0;
BA_ "GenSigTimeoutTime_BPCM" SG_ 502 HVCMS_EVTargetVoltage 0;
BA_ "GenSigTimeoutTime_AGSM" SG_ 502 HVCMS_EVTargetVoltage 0;
BA_ "GenSigTimeoutTime_SGW" SG_ 502 HVCMS_Protocol_Entry1 0;
BA_ "GenSigTimeoutTime_PBWM" SG_ 502 HVCMS_Protocol_Entry1 0;
BA_ "GenSigTimeoutTime_EVCU2" SG_ 502 HVCMS_Protocol_Entry1 0;
BA_ "GenSigTimeoutTime_ECM" SG_ 502 HVCMS_Protocol_Entry1 0;
BA_ "GenSigTimeoutTime_DMPI" SG_ 502 HVCMS_Protocol_Entry1 0;
BA_ "GenSigTimeoutTime_BPCM" SG_ 502 HVCMS_Protocol_Entry1 0;
BA_ "GenSigTimeoutTime_AGSM" SG_ 502 HVCMS_Protocol_Entry1 0;
BA_ "GenSigTimeoutTime_BPCM" SG_ 502 HVCMS_Protocol_Entry2 0;
BA_ "GenSigTimeoutTime_AGSM" SG_ 502 HVCMS_Protocol_Entry2 0;
BA_ "GenSigTimeoutTime_SGW" SG_ 502 HVCMS_Protocol_Entry2 0;
BA_ "GenSigTimeoutTime_PBWM" SG_ 502 HVCMS_Protocol_Entry2 0;
BA_ "GenSigTimeoutTime_EVCU2" SG_ 502 HVCMS_Protocol_Entry2 0;
BA_ "GenSigTimeoutTime_ECM" SG_ 502 HVCMS_Protocol_Entry2 0;
BA_ "GenSigTimeoutTime_DMPI" SG_ 502 HVCMS_Protocol_Entry2 0;
BA_ "GenSigTimeoutTime_SGW" SG_ 502 HVCMS_Protocol_Entry3 0;
BA_ "GenSigTimeoutTime_PBWM" SG_ 502 HVCMS_Protocol_Entry3 0;
BA_ "GenSigTimeoutTime_EVCU2" SG_ 502 HVCMS_Protocol_Entry3 0;
BA_ "GenSigTimeoutTime_ECM" SG_ 502 HVCMS_Protocol_Entry3 0;
BA_ "GenSigTimeoutTime_DMPI" SG_ 502 HVCMS_Protocol_Entry3 0;
BA_ "GenSigTimeoutTime_BPCM" SG_ 502 HVCMS_Protocol_Entry3 0;
BA_ "GenSigTimeoutTime_AGSM" SG_ 502 HVCMS_Protocol_Entry3 0;
BA_ "GenSigTimeoutTime_SGW" SG_ 502 HVCMS_ReadyToChargeState 0;
BA_ "GenSigTimeoutTime_PBWM" SG_ 502 HVCMS_ReadyToChargeState 0;
BA_ "GenSigTimeoutTime_EVCU2" SG_ 502 HVCMS_ReadyToChargeState 0;
BA_ "GenSigTimeoutTime_ECM" SG_ 502 HVCMS_ReadyToChargeState 0;
BA_ "GenSigTimeoutTime_DMPI" SG_ 502 HVCMS_ReadyToChargeState 0;
BA_ "GenSigTimeoutTime_BPCM" SG_ 502 HVCMS_ReadyToChargeState 0;
BA_ "GenSigTimeoutTime_AGSM" SG_ 502 HVCMS_ReadyToChargeState 0;
BA_ "GenSigTimeoutTime_SGW" SG_ 502 HVCMS_ServiceScope 0;
BA_ "GenSigTimeoutTime_PBWM" SG_ 502 HVCMS_ServiceScope 0;
BA_ "GenSigTimeoutTime_EVCU2" SG_ 502 HVCMS_ServiceScope 0;
BA_ "GenSigTimeoutTime_ECM" SG_ 502 HVCMS_ServiceScope 0;
BA_ "GenSigTimeoutTime_DMPI" SG_ 502 HVCMS_ServiceScope 0;
BA_ "GenSigTimeoutTime_BPCM" SG_ 502 HVCMS_ServiceScope 0;
BA_ "GenSigTimeoutTime_AGSM" SG_ 502 HVCMS_ServiceScope 0;
BA_ "GenSigTimeoutTime_ECM" SG_ 502 HVCMS_EVRESSConditioning 0;
BA_ "GenSigTimeoutTime_DMPI" SG_ 502 HVCMS_EVRESSConditioning 0;
BA_ "GenSigTimeoutTime_BPCM" SG_ 502 HVCMS_EVRESSConditioning 0;
BA_ "GenSigTimeoutTime_AGSM" SG_ 502 HVCMS_EVRESSConditioning 0;
BA_ "GenSigTimeoutTime_SGW" SG_ 502 HVCMS_BulkChargingComplete 0;
BA_ "GenSigTimeoutTime_PBWM" SG_ 502 HVCMS_BulkChargingComplete 0;
BA_ "GenSigTimeoutTime_EVCU2" SG_ 502 HVCMS_BulkChargingComplete 0;
BA_ "GenSigTimeoutTime_ECM" SG_ 502 HVCMS_BulkChargingComplete 0;
BA_ "GenSigTimeoutTime_DMPI" SG_ 502 HVCMS_BulkChargingComplete 0;
BA_ "GenSigTimeoutTime_BPCM" SG_ 502 HVCMS_BulkChargingComplete 0;
BA_ "GenSigTimeoutTime_AGSM" SG_ 502 HVCMS_BulkChargingComplete 0;
BA_ "GenSigTimeoutTime_SGW" SG_ 502 HVCMS_ChargingComplete 0;
BA_ "GenSigTimeoutTime_PBWM" SG_ 502 HVCMS_ChargingComplete 0;
BA_ "GenSigTimeoutTime_EVCU2" SG_ 502 HVCMS_ChargingComplete 0;
BA_ "GenSigTimeoutTime_ECM" SG_ 502 HVCMS_ChargingComplete 0;
BA_ "GenSigTimeoutTime_DMPI" SG_ 502 HVCMS_ChargingComplete 0;
BA_ "GenSigTimeoutTime_BPCM" SG_ 502 HVCMS_ChargingComplete 0;
BA_ "GenSigTimeoutTime_AGSM" SG_ 502 HVCMS_ChargingComplete 0;
BA_ "GenSigTimeoutTime_SGW" SG_ 502 HVCMS_EVEnergyCapacity 0;
BA_ "GenSigTimeoutTime_PBWM" SG_ 502 HVCMS_EVEnergyCapacity 0;
BA_ "GenSigTimeoutTime_EVCU2" SG_ 502 HVCMS_EVEnergyCapacity 0;
BA_ "GenSigTimeoutTime_ECM" SG_ 502 HVCMS_EVEnergyCapacity 0;
BA_ "GenSigTimeoutTime_DMPI" SG_ 502 HVCMS_EVEnergyCapacity 0;
BA_ "GenSigTimeoutTime_BPCM" SG_ 502 HVCMS_EVEnergyCapacity 0;
BA_ "GenSigTimeoutTime_AGSM" SG_ 502 HVCMS_EVEnergyCapacity 0;
BA_ "GenSigTimeoutTime_SGW" SG_ 502 HVCMS_EVMax_I_Limit 0;
BA_ "GenSigTimeoutTime_PBWM" SG_ 502 HVCMS_EVMax_I_Limit 0;
BA_ "GenSigTimeoutTime_EVCU2" SG_ 502 HVCMS_EVMax_I_Limit 0;
BA_ "GenSigTimeoutTime_ECM" SG_ 502 HVCMS_EVMax_I_Limit 0;
BA_ "GenSigTimeoutTime_DMPI" SG_ 502 HVCMS_EVMax_I_Limit 0;
BA_ "GenSigTimeoutTime_BPCM" SG_ 502 HVCMS_EVMax_I_Limit 0;
BA_ "GenSigTimeoutTime_AGSM" SG_ 502 HVCMS_EVMax_I_Limit 0;
BA_ "GenSigTimeoutTime_SGW" SG_ 502 HVCMS_EVMax_P_Limit 0;
BA_ "GenSigTimeoutTime_PBWM" SG_ 502 HVCMS_EVMax_P_Limit 0;
BA_ "GenSigTimeoutTime_EVCU2" SG_ 502 HVCMS_EVMax_P_Limit 0;
BA_ "GenSigTimeoutTime_ECM" SG_ 502 HVCMS_EVMax_P_Limit 0;
BA_ "GenSigTimeoutTime_DMPI" SG_ 502 HVCMS_EVMax_P_Limit 0;
BA_ "GenSigTimeoutTime_BPCM" SG_ 502 HVCMS_EVMax_P_Limit 0;
BA_ "GenSigTimeoutTime_AGSM" SG_ 502 HVCMS_EVMax_P_Limit 0;
BA_ "GenSigTimeoutTime_SGW" SG_ 502 HVCMS_EVMax_V_Limit 0;
BA_ "GenSigTimeoutTime_PBWM" SG_ 502 HVCMS_EVMax_V_Limit 0;
BA_ "GenSigTimeoutTime_EVCU2" SG_ 502 HVCMS_EVMax_V_Limit 0;
BA_ "GenSigTimeoutTime_ECM" SG_ 502 HVCMS_EVMax_V_Limit 0;
BA_ "GenSigTimeoutTime_DMPI" SG_ 502 HVCMS_EVMax_V_Limit 0;
BA_ "GenSigTimeoutTime_BPCM" SG_ 502 HVCMS_EVMax_V_Limit 0;
BA_ "GenSigTimeoutTime_AGSM" SG_ 502 HVCMS_EVMax_V_Limit 0;
BA_ "GenSigTimeoutTime_SGW" SG_ 502 HVCMS_EVReady 0;
BA_ "GenSigTimeoutTime_PBWM" SG_ 502 HVCMS_EVReady 0;
BA_ "GenSigTimeoutTime_EVCU2" SG_ 502 HVCMS_EVReady 0;
BA_ "GenSigTimeoutTime_ECM" SG_ 502 HVCMS_EVReady 0;
BA_ "GenSigTimeoutTime_DMPI" SG_ 502 HVCMS_EVReady 0;
BA_ "GenSigTimeoutTime_BPCM" SG_ 502 HVCMS_EVReady 0;
BA_ "GenSigTimeoutTime_AGSM" SG_ 502 HVCMS_EVReady 0;
BA_ "GenSigTimeoutTime_SGW" SG_ 502 HVCMS_EVRESS_SOC 0;
BA_ "GenSigTimeoutTime_PBWM" SG_ 502 HVCMS_EVRESS_SOC 0;
BA_ "GenSigTimeoutTime_EVCU2" SG_ 502 HVCMS_EVRESS_SOC 0;
BA_ "GenSigTimeoutTime_ECM" SG_ 502 HVCMS_EVRESS_SOC 0;
BA_ "GenSigTimeoutTime_DMPI" SG_ 502 HVCMS_EVRESS_SOC 0;
BA_ "GenSigTimeoutTime_BPCM" SG_ 502 HVCMS_EVRESS_SOC 0;
BA_ "GenSigTimeoutTime_AGSM" SG_ 502 HVCMS_EVRESS_SOC 0;
BA_ "GenSigTimeoutTime_SGW" SG_ 502 HVCMS_EVEnergyRequest 0;
BA_ "GenSigTimeoutTime_PBWM" SG_ 502 HVCMS_EVEnergyRequest 0;
BA_ "GenSigTimeoutTime_EVCU2" SG_ 502 HVCMS_EVEnergyRequest 0;
BA_ "GenSigTimeoutTime_ECM" SG_ 502 HVCMS_EVEnergyRequest 0;
BA_ "GenSigTimeoutTime_DMPI" SG_ 502 HVCMS_EVEnergyRequest 0;
BA_ "GenSigTimeoutTime_BPCM" SG_ 502 HVCMS_EVEnergyRequest 0;
BA_ "GenSigTimeoutTime_AGSM" SG_ 502 HVCMS_EVEnergyRequest 0;
BA_ "GenSigStartValue" SG_ 502 HVCMS_EVEnergyRequest 131071;
BA_ "GenSigTimeoutTime_SGW" SG_ 502 HVCMS_EVErrorCode 0;
BA_ "GenSigTimeoutTime_PBWM" SG_ 502 HVCMS_EVErrorCode 0;
BA_ "GenSigTimeoutTime_EVCU2" SG_ 502 HVCMS_EVErrorCode 0;
BA_ "GenSigTimeoutTime_ECM" SG_ 502 HVCMS_EVErrorCode 0;
BA_ "GenSigTimeoutTime_DMPI" SG_ 502 HVCMS_EVErrorCode 0;
BA_ "GenSigTimeoutTime_BPCM" SG_ 502 HVCMS_EVErrorCode 0;
BA_ "GenSigTimeoutTime_AGSM" SG_ 502 HVCMS_EVErrorCode 0;
BA_ "GenSigTimeoutTime_SGW" SG_ 1062 MessageCounter_MCPA_DATA2 0;
BA_ "GenSigTimeoutTime_PBWM" SG_ 1062 MessageCounter_MCPA_DATA2 0;
BA_ "GenSigTimeoutTime_IDCM" SG_ 1062 MessageCounter_MCPA_DATA2 0;
BA_ "GenSigTimeoutTime_ECM" SG_ 1062 MessageCounter_MCPA_DATA2 0;
BA_ "GenSigTimeoutTime_DMPI" SG_ 1062 MessageCounter_MCPA_DATA2 0;
BA_ "GenSigTimeoutTime_BPCM" SG_ 1062 MessageCounter_MCPA_DATA2 0;
BA_ "GenSigTimeoutTime_AGSM" SG_ 1062 MessageCounter_MCPA_DATA2 0;
BA_ "GenSigTimeoutTime_SGW" SG_ 1062 MAC_MCPA_DATA2 0;
BA_ "GenSigTimeoutTime_PBWM" SG_ 1062 MAC_MCPA_DATA2 0;
BA_ "GenSigTimeoutTime_IDCM" SG_ 1062 MAC_MCPA_DATA2 0;
BA_ "GenSigTimeoutTime_ECM" SG_ 1062 MAC_MCPA_DATA2 0;
BA_ "GenSigTimeoutTime_DMPI" SG_ 1062 MAC_MCPA_DATA2 0;
BA_ "GenSigTimeoutTime_BPCM" SG_ 1062 MAC_MCPA_DATA2 0;
BA_ "GenSigTimeoutTime_AGSM" SG_ 1062 MAC_MCPA_DATA2 0;
BA_ "GenSigTimeoutTime_SGW" SG_ 1062 MCPA_ROL_STATUS 0;
BA_ "GenSigTimeoutTime_PBWM" SG_ 1062 MCPA_ROL_STATUS 0;
BA_ "GenSigTimeoutTime_IDCM" SG_ 1062 MCPA_ROL_STATUS 0;
BA_ "GenSigTimeoutTime_ECM" SG_ 1062 MCPA_ROL_STATUS 0;
BA_ "GenSigTimeoutTime_DMPI" SG_ 1062 MCPA_ROL_STATUS 0;
BA_ "GenSigTimeoutTime_BPCM" SG_ 1062 MCPA_ROL_STATUS 0;
BA_ "GenSigTimeoutTime_AGSM" SG_ 1062 MCPA_ROL_STATUS 0;
BA_ "GenSigTimeoutTime_SGW" SG_ 1062 Cntr_MCPA_DATA2 0;
BA_ "GenSigTimeoutTime_PBWM" SG_ 1062 Cntr_MCPA_DATA2 0;
BA_ "GenSigTimeoutTime_IDCM" SG_ 1062 Cntr_MCPA_DATA2 0;
BA_ "GenSigTimeoutTime_ECM" SG_ 1062 Cntr_MCPA_DATA2 0;
BA_ "GenSigTimeoutTime_DMPI" SG_ 1062 Cntr_MCPA_DATA2 0;
BA_ "GenSigTimeoutTime_BPCM" SG_ 1062 Cntr_MCPA_DATA2 0;
BA_ "GenSigTimeoutTime_AGSM" SG_ 1062 Cntr_MCPA_DATA2 0;
BA_ "GenSigTimeoutTime_SGW" SG_ 1062 CRC_MCPA_DATA2 0;
BA_ "GenSigTimeoutTime_PBWM" SG_ 1062 CRC_MCPA_DATA2 0;
BA_ "GenSigTimeoutTime_IDCM" SG_ 1062 CRC_MCPA_DATA2 0;
BA_ "GenSigTimeoutTime_ECM" SG_ 1062 CRC_MCPA_DATA2 0;
BA_ "GenSigTimeoutTime_DMPI" SG_ 1062 CRC_MCPA_DATA2 0;
BA_ "GenSigTimeoutTime_BPCM" SG_ 1062 CRC_MCPA_DATA2 0;
BA_ "GenSigTimeoutTime_AGSM" SG_ 1062 CRC_MCPA_DATA2 0;
BA_ "GenSigTimeoutTime_SGW" SG_ 1062 MCPA_ROL_Request 0;
BA_ "GenSigTimeoutTime_PBWM" SG_ 1062 MCPA_ROL_Request 0;
BA_ "GenSigTimeoutTime_IDCM" SG_ 1062 MCPA_ROL_Request 0;
BA_ "GenSigTimeoutTime_ECM" SG_ 1062 MCPA_ROL_Request 0;
BA_ "GenSigTimeoutTime_DMPI" SG_ 1062 MCPA_ROL_Request 0;
BA_ "GenSigTimeoutTime_BPCM" SG_ 1062 MCPA_ROL_Request 0;
BA_ "GenSigTimeoutTime_AGSM" SG_ 1062 MCPA_ROL_Request 0;
BA_ "GenSigTimeoutTime_PBWM" SG_ 1062 MCPA_Rotor_Temperature 0;
BA_ "GenSigTimeoutTime_IDCM" SG_ 1062 MCPA_Rotor_Temperature 0;
BA_ "GenSigTimeoutTime_ECM" SG_ 1062 MCPA_Rotor_Temperature 0;
BA_ "GenSigTimeoutTime_DMPI" SG_ 1062 MCPA_Rotor_Temperature 0;
BA_ "GenSigTimeoutTime_BPCM" SG_ 1062 MCPA_Rotor_Temperature 0;
BA_ "GenSigTimeoutTime_AGSM" SG_ 1062 MCPA_Rotor_Temperature 0;
BA_ "GenSigStartValue" SG_ 1062 MCPA_Rotor_Temperature 255;
BA_ "GenSigTimeoutTime_SGW" SG_ 1062 MCPA_Inverter_Temp 0;
BA_ "GenSigTimeoutTime_PBWM" SG_ 1062 MCPA_Inverter_Temp 0;
BA_ "GenSigTimeoutTime_IDCM" SG_ 1062 MCPA_Inverter_Temp 0;
BA_ "GenSigTimeoutTime_ECM" SG_ 1062 MCPA_Inverter_Temp 0;
BA_ "GenSigTimeoutTime_DMPI" SG_ 1062 MCPA_Inverter_Temp 0;
BA_ "GenSigTimeoutTime_BPCM" SG_ 1062 MCPA_Inverter_Temp 0;
BA_ "GenSigTimeoutTime_AGSM" SG_ 1062 MCPA_Inverter_Temp 0;
BA_ "GenSigStartValue" SG_ 1062 MCPA_Inverter_Temp 40;
BA_ "GenSigTimeoutTime_SGW" SG_ 1444 MCPA_Service_Lamp_Request 0;
BA_ "GenSigTimeoutTime_PBWM" SG_ 1444 MCPA_Service_Lamp_Request 0;
BA_ "GenSigTimeoutTime_IDCM" SG_ 1444 MCPA_Service_Lamp_Request 0;
BA_ "GenSigTimeoutTime_ECM" SG_ 1444 MCPA_Service_Lamp_Request 0;
BA_ "GenSigTimeoutTime_DMPI" SG_ 1444 MCPA_Service_Lamp_Request 0;
BA_ "GenSigTimeoutTime_BPCM" SG_ 1444 MCPA_Service_Lamp_Request 0;
BA_ "GenSigTimeoutTime_AGSM" SG_ 1444 MCPA_Service_Lamp_Request 0;
BA_ "GenSigTimeoutTime_SGW" SG_ 1062 CLrDiagInfo_MCPA 0;
BA_ "GenSigTimeoutTime_PBWM" SG_ 1062 CLrDiagInfo_MCPA 0;
BA_ "GenSigTimeoutTime_IDCM" SG_ 1062 CLrDiagInfo_MCPA 0;
BA_ "GenSigTimeoutTime_ECM" SG_ 1062 CLrDiagInfo_MCPA 0;
BA_ "GenSigTimeoutTime_DMPI" SG_ 1062 CLrDiagInfo_MCPA 0;
BA_ "GenSigTimeoutTime_BPCM" SG_ 1062 CLrDiagInfo_MCPA 0;
BA_ "GenSigTimeoutTime_AGSM" SG_ 1062 CLrDiagInfo_MCPA 0;
BA_ "GenSigTimeoutTime_AGSM" SG_ 1893 HVBatModuleTemp_59 0;
BA_ "GenSigTimeoutTime_PBWM" SG_ 1893 HVBatModuleTemp_59 0;
BA_ "GenSigTimeoutTime_IDCM" SG_ 1893 HVBatModuleTemp_59 0;
BA_ "GenSigTimeoutTime_EVCU2" SG_ 1893 HVBatModuleTemp_59 0;
BA_ "GenSigTimeoutTime_ECM" SG_ 1893 HVBatModuleTemp_59 0;
BA_ "GenSigTimeoutTime_DMPI" SG_ 1893 HVBatModuleTemp_59 0;
BA_ "GenSigTimeoutTime_BPCM" SG_ 1893 HVBatModuleTemp_59 0;
BA_ "GenSigTimeoutTime_PBWM" SG_ 1893 HVBatModuleTemp_60 0;
BA_ "GenSigTimeoutTime_IDCM" SG_ 1893 HVBatModuleTemp_60 0;
BA_ "GenSigTimeoutTime_EVCU2" SG_ 1893 HVBatModuleTemp_60 0;
BA_ "GenSigTimeoutTime_ECM" SG_ 1893 HVBatModuleTemp_60 0;
BA_ "GenSigTimeoutTime_DMPI" SG_ 1893 HVBatModuleTemp_60 0;
BA_ "GenSigTimeoutTime_BPCM" SG_ 1893 HVBatModuleTemp_60 0;
BA_ "GenSigTimeoutTime_AGSM" SG_ 1893 HVBatModuleTemp_60 0;
BA_ "GenSigTimeoutTime_PBWM" SG_ 1893 HVBatModuleTemp_61 0;
BA_ "GenSigTimeoutTime_IDCM" SG_ 1893 HVBatModuleTemp_61 0;
BA_ "GenSigTimeoutTime_EVCU2" SG_ 1893 HVBatModuleTemp_61 0;
BA_ "GenSigTimeoutTime_ECM" SG_ 1893 HVBatModuleTemp_61 0;
BA_ "GenSigTimeoutTime_DMPI" SG_ 1893 HVBatModuleTemp_61 0;
BA_ "GenSigTimeoutTime_BPCM" SG_ 1893 HVBatModuleTemp_61 0;
BA_ "GenSigTimeoutTime_AGSM" SG_ 1893 HVBatModuleTemp_61 0;
BA_ "GenSigTimeoutTime_PBWM" SG_ 1893 HVBatModuleTemp_62 0;
BA_ "GenSigTimeoutTime_IDCM" SG_ 1893 HVBatModuleTemp_62 0;
BA_ "GenSigTimeoutTime_EVCU2" SG_ 1893 HVBatModuleTemp_62 0;
BA_ "GenSigTimeoutTime_ECM" SG_ 1893 HVBatModuleTemp_62 0;
BA_ "GenSigTimeoutTime_DMPI" SG_ 1893 HVBatModuleTemp_62 0;
BA_ "GenSigTimeoutTime_BPCM" SG_ 1893 HVBatModuleTemp_62 0;
BA_ "GenSigTimeoutTime_AGSM" SG_ 1893 HVBatModuleTemp_62 0;
BA_ "GenSigTimeoutTime_PBWM" SG_ 1893 HVBatModuleTemp_63 0;
BA_ "GenSigTimeoutTime_IDCM" SG_ 1893 HVBatModuleTemp_63 0;
BA_ "GenSigTimeoutTime_EVCU2" SG_ 1893 HVBatModuleTemp_63 0;
BA_ "GenSigTimeoutTime_ECM" SG_ 1893 HVBatModuleTemp_63 0;
BA_ "GenSigTimeoutTime_DMPI" SG_ 1893 HVBatModuleTemp_63 0;
BA_ "GenSigTimeoutTime_BPCM" SG_ 1893 HVBatModuleTemp_63 0;
BA_ "GenSigTimeoutTime_AGSM" SG_ 1893 HVBatModuleTemp_63 0;
BA_ "GenSigTimeoutTime_PBWM" SG_ 1893 HVBatModuleTemp_64 0;
BA_ "GenSigTimeoutTime_IDCM" SG_ 1893 HVBatModuleTemp_64 0;
BA_ "GenSigTimeoutTime_EVCU2" SG_ 1893 HVBatModuleTemp_64 0;
BA_ "GenSigTimeoutTime_ECM" SG_ 1893 HVBatModuleTemp_64 0;
BA_ "GenSigTimeoutTime_DMPI" SG_ 1893 HVBatModuleTemp_64 0;
BA_ "GenSigTimeoutTime_BPCM" SG_ 1893 HVBatModuleTemp_64 0;
BA_ "GenSigTimeoutTime_AGSM" SG_ 1893 HVBatModuleTemp_64 0;
BA_ "GenSigTimeoutTime_PBWM" SG_ 1893 HVBatModuleTemp_65 0;
BA_ "GenSigTimeoutTime_IDCM" SG_ 1893 HVBatModuleTemp_65 0;
BA_ "GenSigTimeoutTime_EVCU2" SG_ 1893 HVBatModuleTemp_65 0;
BA_ "GenSigTimeoutTime_ECM" SG_ 1893 HVBatModuleTemp_65 0;
BA_ "GenSigTimeoutTime_DMPI" SG_ 1893 HVBatModuleTemp_65 0;
BA_ "GenSigTimeoutTime_BPCM" SG_ 1893 HVBatModuleTemp_65 0;
BA_ "GenSigTimeoutTime_AGSM" SG_ 1893 HVBatModuleTemp_65 0;
BA_ "GenSigTimeoutTime_PBWM" SG_ 1893 HVBatModuleTemp_66 0;
BA_ "GenSigTimeoutTime_IDCM" SG_ 1893 HVBatModuleTemp_66 0;
BA_ "GenSigTimeoutTime_EVCU2" SG_ 1893 HVBatModuleTemp_66 0;
BA_ "GenSigTimeoutTime_ECM" SG_ 1893 HVBatModuleTemp_66 0;
BA_ "GenSigTimeoutTime_DMPI" SG_ 1893 HVBatModuleTemp_66 0;
BA_ "GenSigTimeoutTime_BPCM" SG_ 1893 HVBatModuleTemp_66 0;
BA_ "GenSigTimeoutTime_AGSM" SG_ 1893 HVBatModuleTemp_66 0;
BA_ "GenSigTimeoutTime_PBWM" SG_ 1893 HVBatModuleTemp_55 0;
BA_ "GenSigTimeoutTime_IDCM" SG_ 1893 HVBatModuleTemp_55 0;
BA_ "GenSigTimeoutTime_EVCU2" SG_ 1893 HVBatModuleTemp_55 0;
BA_ "GenSigTimeoutTime_ECM" SG_ 1893 HVBatModuleTemp_55 0;
BA_ "GenSigTimeoutTime_DMPI" SG_ 1893 HVBatModuleTemp_55 0;
BA_ "GenSigTimeoutTime_PBWM" SG_ 1893 HVBatModuleTemp_56 0;
BA_ "GenSigTimeoutTime_IDCM" SG_ 1893 HVBatModuleTemp_56 0;
BA_ "GenSigTimeoutTime_EVCU2" SG_ 1893 HVBatModuleTemp_56 0;
BA_ "GenSigTimeoutTime_ECM" SG_ 1893 HVBatModuleTemp_56 0;
BA_ "GenSigTimeoutTime_DMPI" SG_ 1893 HVBatModuleTemp_56 0;
BA_ "GenSigTimeoutTime_BPCM" SG_ 1893 HVBatModuleTemp_56 0;
BA_ "GenSigTimeoutTime_AGSM" SG_ 1893 HVBatModuleTemp_56 0;
BA_ "GenSigTimeoutTime_PBWM" SG_ 1893 HVBatModuleTemp_57 0;
BA_ "GenSigTimeoutTime_IDCM" SG_ 1893 HVBatModuleTemp_57 0;
BA_ "GenSigTimeoutTime_EVCU2" SG_ 1893 HVBatModuleTemp_57 0;
BA_ "GenSigTimeoutTime_ECM" SG_ 1893 HVBatModuleTemp_57 0;
BA_ "GenSigTimeoutTime_DMPI" SG_ 1893 HVBatModuleTemp_57 0;
BA_ "GenSigTimeoutTime_BPCM" SG_ 1893 HVBatModuleTemp_57 0;
BA_ "GenSigTimeoutTime_AGSM" SG_ 1893 HVBatModuleTemp_57 0;
BA_ "GenSigTimeoutTime_PBWM" SG_ 1893 HVBatModuleTemp_58 0;
BA_ "GenSigTimeoutTime_IDCM" SG_ 1893 HVBatModuleTemp_58 0;
BA_ "GenSigTimeoutTime_EVCU2" SG_ 1893 HVBatModuleTemp_58 0;
BA_ "GenSigTimeoutTime_ECM" SG_ 1893 HVBatModuleTemp_58 0;
BA_ "GenSigTimeoutTime_DMPI" SG_ 1893 HVBatModuleTemp_58 0;
BA_ "GenSigTimeoutTime_BPCM" SG_ 1893 HVBatModuleTemp_58 0;
BA_ "GenSigTimeoutTime_AGSM" SG_ 1893 HVBatModuleTemp_58 0;
BA_ "GenSigTimeoutTime_SGW" SG_ 1893 HVBatModuleVoltage_NumMax 0;
BA_ "GenSigTimeoutTime_PBWM" SG_ 1893 HVBatModuleVoltage_NumMax 0;
BA_ "GenSigTimeoutTime_IDCM" SG_ 1893 HVBatModuleVoltage_NumMax 0;
BA_ "GenSigTimeoutTime_EVCU2" SG_ 1893 HVBatModuleVoltage_NumMax 0;
BA_ "GenSigTimeoutTime_ECM" SG_ 1893 HVBatModuleVoltage_NumMax 0;
BA_ "GenSigTimeoutTime_DMPI" SG_ 1893 HVBatModuleVoltage_NumMax 0;
BA_ "GenSigTimeoutTime_BPCM" SG_ 1893 HVBatModuleVoltage_NumMax 0;
BA_ "GenSigTimeoutTime_AGSM" SG_ 1893 HVBatModuleVoltage_NumMax 0;
BA_ "GenSigTimeoutTime_SGW" SG_ 1893 HVBatModuleVoltage_NumMin 0;
BA_ "GenSigTimeoutTime_PBWM" SG_ 1893 HVBatModuleVoltage_NumMin 0;
BA_ "GenSigTimeoutTime_IDCM" SG_ 1893 HVBatModuleVoltage_NumMin 0;
BA_ "GenSigTimeoutTime_EVCU2" SG_ 1893 HVBatModuleVoltage_NumMin 0;
BA_ "GenSigTimeoutTime_ECM" SG_ 1893 HVBatModuleVoltage_NumMin 0;
BA_ "GenSigTimeoutTime_DMPI" SG_ 1893 HVBatModuleVoltage_NumMin 0;
BA_ "GenSigTimeoutTime_BPCM" SG_ 1893 HVBatModuleVoltage_NumMin 0;
BA_ "GenSigTimeoutTime_AGSM" SG_ 1893 HVBatModuleVoltage_NumMin 0;
BA_ "GenSigTimeoutTime_PBWM" SG_ 1893 HVBatModuleTemp_52 0;
BA_ "GenSigTimeoutTime_IDCM" SG_ 1893 HVBatModuleTemp_52 0;
BA_ "GenSigTimeoutTime_EVCU2" SG_ 1893 HVBatModuleTemp_52 0;
BA_ "GenSigTimeoutTime_ECM" SG_ 1893 HVBatModuleTemp_52 0;
BA_ "GenSigTimeoutTime_DMPI" SG_ 1893 HVBatModuleTemp_52 0;
BA_ "GenSigTimeoutTime_BPCM" SG_ 1893 HVBatModuleTemp_52 0;
BA_ "GenSigTimeoutTime_AGSM" SG_ 1893 HVBatModuleTemp_52 0;
BA_ "GenSigTimeoutTime_PBWM" SG_ 1893 HVBatModuleTemp_53 0;
BA_ "GenSigTimeoutTime_IDCM" SG_ 1893 HVBatModuleTemp_53 0;
BA_ "GenSigTimeoutTime_EVCU2" SG_ 1893 HVBatModuleTemp_53 0;
BA_ "GenSigTimeoutTime_ECM" SG_ 1893 HVBatModuleTemp_53 0;
BA_ "GenSigTimeoutTime_DMPI" SG_ 1893 HVBatModuleTemp_53 0;
BA_ "GenSigTimeoutTime_BPCM" SG_ 1893 HVBatModuleTemp_53 0;
BA_ "GenSigTimeoutTime_AGSM" SG_ 1893 HVBatModuleTemp_53 0;
BA_ "GenSigTimeoutTime_PBWM" SG_ 1893 HVBatModuleTemp_42 0;
BA_ "GenSigTimeoutTime_IDCM" SG_ 1893 HVBatModuleTemp_42 0;
BA_ "GenSigTimeoutTime_EVCU2" SG_ 1893 HVBatModuleTemp_42 0;
BA_ "GenSigTimeoutTime_ECM" SG_ 1893 HVBatModuleTemp_42 0;
BA_ "GenSigTimeoutTime_DMPI" SG_ 1893 HVBatModuleTemp_42 0;
BA_ "GenSigTimeoutTime_BPCM" SG_ 1893 HVBatModuleTemp_42 0;
BA_ "GenSigTimeoutTime_AGSM" SG_ 1893 HVBatModuleTemp_42 0;
BA_ "GenSigTimeoutTime_PBWM" SG_ 1893 HVBatModuleTemp_43 0;
BA_ "GenSigTimeoutTime_IDCM" SG_ 1893 HVBatModuleTemp_43 0;
BA_ "GenSigTimeoutTime_EVCU2" SG_ 1893 HVBatModuleTemp_43 0;
BA_ "GenSigTimeoutTime_ECM" SG_ 1893 HVBatModuleTemp_43 0;
BA_ "GenSigTimeoutTime_DMPI" SG_ 1893 HVBatModuleTemp_43 0;
BA_ "GenSigTimeoutTime_BPCM" SG_ 1893 HVBatModuleTemp_43 0;
BA_ "GenSigTimeoutTime_AGSM" SG_ 1893 HVBatModuleTemp_43 0;
BA_ "GenSigTimeoutTime_PBWM" SG_ 1893 HVBatModuleTemp_44 0;
BA_ "GenSigTimeoutTime_IDCM" SG_ 1893 HVBatModuleTemp_44 0;
BA_ "GenSigTimeoutTime_EVCU2" SG_ 1893 HVBatModuleTemp_44 0;
BA_ "GenSigTimeoutTime_ECM" SG_ 1893 HVBatModuleTemp_44 0;
BA_ "GenSigTimeoutTime_DMPI" SG_ 1893 HVBatModuleTemp_44 0;
BA_ "GenSigTimeoutTime_BPCM" SG_ 1893 HVBatModuleTemp_44 0;
BA_ "GenSigTimeoutTime_AGSM" SG_ 1893 HVBatModuleTemp_44 0;
BA_ "GenSigTimeoutTime_PBWM" SG_ 1893 HVBatModuleTemp_45 0;
BA_ "GenSigTimeoutTime_IDCM" SG_ 1893 HVBatModuleTemp_45 0;
BA_ "GenSigTimeoutTime_EVCU2" SG_ 1893 HVBatModuleTemp_45 0;
BA_ "GenSigTimeoutTime_ECM" SG_ 1893 HVBatModuleTemp_45 0;
BA_ "GenSigTimeoutTime_DMPI" SG_ 1893 HVBatModuleTemp_45 0;
BA_ "GenSigTimeoutTime_BPCM" SG_ 1893 HVBatModuleTemp_45 0;
BA_ "GenSigTimeoutTime_AGSM" SG_ 1893 HVBatModuleTemp_45 0;
BA_ "GenSigTimeoutTime_PBWM" SG_ 1893 HVBatModuleTemp_46 0;
BA_ "GenSigTimeoutTime_IDCM" SG_ 1893 HVBatModuleTemp_46 0;
BA_ "GenSigTimeoutTime_EVCU2" SG_ 1893 HVBatModuleTemp_46 0;
BA_ "GenSigTimeoutTime_ECM" SG_ 1893 HVBatModuleTemp_46 0;
BA_ "GenSigTimeoutTime_DMPI" SG_ 1893 HVBatModuleTemp_46 0;
BA_ "GenSigTimeoutTime_BPCM" SG_ 1893 HVBatModuleTemp_46 0;
BA_ "GenSigTimeoutTime_AGSM" SG_ 1893 HVBatModuleTemp_46 0;
BA_ "GenSigTimeoutTime_PBWM" SG_ 1893 HVBatModuleTemp_47 0;
BA_ "GenSigTimeoutTime_IDCM" SG_ 1893 HVBatModuleTemp_47 0;
BA_ "GenSigTimeoutTime_EVCU2" SG_ 1893 HVBatModuleTemp_47 0;
BA_ "GenSigTimeoutTime_ECM" SG_ 1893 HVBatModuleTemp_47 0;
BA_ "GenSigTimeoutTime_DMPI" SG_ 1893 HVBatModuleTemp_47 0;
BA_ "GenSigTimeoutTime_BPCM" SG_ 1893 HVBatModuleTemp_47 0;
BA_ "GenSigTimeoutTime_AGSM" SG_ 1893 HVBatModuleTemp_47 0;
BA_ "GenSigTimeoutTime_PBWM" SG_ 1893 HVBatModuleTemp_48 0;
BA_ "GenSigTimeoutTime_IDCM" SG_ 1893 HVBatModuleTemp_48 0;
BA_ "GenSigTimeoutTime_EVCU2" SG_ 1893 HVBatModuleTemp_48 0;
BA_ "GenSigTimeoutTime_ECM" SG_ 1893 HVBatModuleTemp_48 0;
BA_ "GenSigTimeoutTime_DMPI" SG_ 1893 HVBatModuleTemp_48 0;
BA_ "GenSigTimeoutTime_BPCM" SG_ 1893 HVBatModuleTemp_48 0;
BA_ "GenSigTimeoutTime_AGSM" SG_ 1893 HVBatModuleTemp_48 0;
BA_ "GenSigTimeoutTime_PBWM" SG_ 1893 HVBatModuleTemp_49 0;
BA_ "GenSigTimeoutTime_IDCM" SG_ 1893 HVBatModuleTemp_49 0;
BA_ "GenSigTimeoutTime_EVCU2" SG_ 1893 HVBatModuleTemp_49 0;
BA_ "GenSigTimeoutTime_ECM" SG_ 1893 HVBatModuleTemp_49 0;
BA_ "GenSigTimeoutTime_DMPI" SG_ 1893 HVBatModuleTemp_49 0;
BA_ "GenSigTimeoutTime_BPCM" SG_ 1893 HVBatModuleTemp_49 0;
BA_ "GenSigTimeoutTime_AGSM" SG_ 1893 HVBatModuleTemp_49 0;
BA_ "GenSigTimeoutTime_PBWM" SG_ 1893 HVBatModuleTemp_50 0;
BA_ "GenSigTimeoutTime_IDCM" SG_ 1893 HVBatModuleTemp_50 0;
BA_ "GenSigTimeoutTime_EVCU2" SG_ 1893 HVBatModuleTemp_50 0;
BA_ "GenSigTimeoutTime_ECM" SG_ 1893 HVBatModuleTemp_50 0;
BA_ "GenSigTimeoutTime_DMPI" SG_ 1893 HVBatModuleTemp_50 0;
BA_ "GenSigTimeoutTime_BPCM" SG_ 1893 HVBatModuleTemp_50 0;
BA_ "GenSigTimeoutTime_AGSM" SG_ 1893 HVBatModuleTemp_50 0;
BA_ "GenSigTimeoutTime_PBWM" SG_ 1893 HVBatModuleTemp_51 0;
BA_ "GenSigTimeoutTime_IDCM" SG_ 1893 HVBatModuleTemp_51 0;
BA_ "GenSigTimeoutTime_EVCU2" SG_ 1893 HVBatModuleTemp_51 0;
BA_ "GenSigTimeoutTime_ECM" SG_ 1893 HVBatModuleTemp_51 0;
BA_ "GenSigTimeoutTime_DMPI" SG_ 1893 HVBatModuleTemp_51 0;
BA_ "GenSigTimeoutTime_BPCM" SG_ 1893 HVBatModuleTemp_51 0;
BA_ "GenSigTimeoutTime_AGSM" SG_ 1893 HVBatModuleTemp_51 0;
BA_ "GenSigTimeoutTime_BPCM" SG_ 1893 HVBatModuleTemp_55 0;
BA_ "GenSigTimeoutTime_AGSM" SG_ 1893 HVBatModuleTemp_55 0;
BA_ "GenSigTimeoutTime_PBWM" SG_ 1893 HVBatModuleTemp_39 0;
BA_ "GenSigTimeoutTime_IDCM" SG_ 1893 HVBatModuleTemp_39 0;
BA_ "GenSigTimeoutTime_EVCU2" SG_ 1893 HVBatModuleTemp_39 0;
BA_ "GenSigTimeoutTime_ECM" SG_ 1893 HVBatModuleTemp_39 0;
BA_ "GenSigTimeoutTime_DMPI" SG_ 1893 HVBatModuleTemp_39 0;
BA_ "GenSigTimeoutTime_BPCM" SG_ 1893 HVBatModuleTemp_39 0;
BA_ "GenSigTimeoutTime_AGSM" SG_ 1893 HVBatModuleTemp_39 0;
BA_ "GenSigTimeoutTime_PBWM" SG_ 1893 HVBatModuleTemp_40 0;
BA_ "GenSigTimeoutTime_IDCM" SG_ 1893 HVBatModuleTemp_40 0;
BA_ "GenSigTimeoutTime_EVCU2" SG_ 1893 HVBatModuleTemp_40 0;
BA_ "GenSigTimeoutTime_ECM" SG_ 1893 HVBatModuleTemp_40 0;
BA_ "GenSigTimeoutTime_DMPI" SG_ 1893 HVBatModuleTemp_40 0;
BA_ "GenSigTimeoutTime_BPCM" SG_ 1893 HVBatModuleTemp_40 0;
BA_ "GenSigTimeoutTime_AGSM" SG_ 1893 HVBatModuleTemp_40 0;
BA_ "GenSigTimeoutTime_PBWM" SG_ 1893 HVBatModuleTemp_41 0;
BA_ "GenSigTimeoutTime_IDCM" SG_ 1893 HVBatModuleTemp_41 0;
BA_ "GenSigTimeoutTime_EVCU2" SG_ 1893 HVBatModuleTemp_41 0;
BA_ "GenSigTimeoutTime_ECM" SG_ 1893 HVBatModuleTemp_41 0;
BA_ "GenSigTimeoutTime_DMPI" SG_ 1893 HVBatModuleTemp_41 0;
BA_ "GenSigTimeoutTime_BPCM" SG_ 1893 HVBatModuleTemp_41 0;
BA_ "GenSigTimeoutTime_AGSM" SG_ 1893 HVBatModuleTemp_41 0;
BA_ "GenSigTimeoutTime_PBWM" SG_ 1893 HVBatModuleTemp_54 0;
BA_ "GenSigTimeoutTime_IDCM" SG_ 1893 HVBatModuleTemp_54 0;
BA_ "GenSigTimeoutTime_EVCU2" SG_ 1893 HVBatModuleTemp_54 0;
BA_ "GenSigTimeoutTime_ECM" SG_ 1893 HVBatModuleTemp_54 0;
BA_ "GenSigTimeoutTime_DMPI" SG_ 1893 HVBatModuleTemp_54 0;
BA_ "GenSigTimeoutTime_BPCM" SG_ 1893 HVBatModuleTemp_54 0;
BA_ "GenSigTimeoutTime_AGSM" SG_ 1893 HVBatModuleTemp_54 0;
BA_ "GenSigTimeoutTime_SGW" SG_ 835 N_PDU 0;
BA_ "GenSigTimeoutTime_PBWM" SG_ 835 N_PDU 0;
BA_ "GenSigTimeoutTime_IDCM" SG_ 835 N_PDU 0;
BA_ "GenSigTimeoutTime_ECM" SG_ 835 N_PDU 0;
BA_ "GenSigTimeoutTime_DMPI" SG_ 835 N_PDU 0;
BA_ "GenSigTimeoutTime_BPCM" SG_ 835 N_PDU 0;
BA_ "GenSigTimeoutTime_AGSM" SG_ 835 N_PDU 0;
BA_ "GenSigTimeoutTime_PBWM" SG_ 834 N_PDU 0;
BA_ "GenSigTimeoutTime_IDCM" SG_ 834 N_PDU 0;
BA_ "GenSigTimeoutTime_EVCU2" SG_ 834 N_PDU 0;
BA_ "GenSigTimeoutTime_ECM" SG_ 834 N_PDU 0;
BA_ "GenSigTimeoutTime_DMPI" SG_ 834 N_PDU 0;
BA_ "GenSigTimeoutTime_BPCM" SG_ 834 N_PDU 0;
BA_ "GenSigTimeoutTime_AGSM" SG_ 834 N_PDU 0;
BA_ "GenSigTimeoutTime_SGW" SG_ 1790 HVBatCell_Voltage_Low_Thrsh 0;
BA_ "GenSigTimeoutTime_PBWM" SG_ 1790 HVBatCell_Voltage_Low_Thrsh 0;
BA_ "GenSigTimeoutTime_IDCM" SG_ 1790 HVBatCell_Voltage_Low_Thrsh 0;
BA_ "GenSigTimeoutTime_ECM" SG_ 1790 HVBatCell_Voltage_Low_Thrsh 0;
BA_ "GenSigTimeoutTime_DMPI" SG_ 1790 HVBatCell_Voltage_Low_Thrsh 0;
BA_ "GenSigTimeoutTime_BPCM" SG_ 1790 HVBatCell_Voltage_Low_Thrsh 0;
BA_ "GenSigTimeoutTime_AGSM" SG_ 1790 HVBatCell_Voltage_Low_Thrsh 0;
BA_ "GenSigTimeoutTime_SGW" SG_ 1790 HVBatCell_Voltage_High_Thrsh 0;
BA_ "GenSigTimeoutTime_PBWM" SG_ 1790 HVBatCell_Voltage_High_Thrsh 0;
BA_ "GenSigTimeoutTime_IDCM" SG_ 1790 HVBatCell_Voltage_High_Thrsh 0;
BA_ "GenSigTimeoutTime_ECM" SG_ 1790 HVBatCell_Voltage_High_Thrsh 0;
BA_ "GenSigTimeoutTime_DMPI" SG_ 1790 HVBatCell_Voltage_High_Thrsh 0;
BA_ "GenSigTimeoutTime_BPCM" SG_ 1790 HVBatCell_Voltage_High_Thrsh 0;
BA_ "GenSigTimeoutTime_AGSM" SG_ 1790 HVBatCell_Voltage_High_Thrsh 0;
BA_ "GenSigTimeoutTime_SGW" SG_ 1790 BMS_HV_SOC_Min 0;
BA_ "GenSigTimeoutTime_PBWM" SG_ 1790 BMS_HV_SOC_Min 0;
BA_ "GenSigTimeoutTime_IDCM" SG_ 1790 BMS_HV_SOC_Min 0;
BA_ "GenSigTimeoutTime_ECM" SG_ 1790 BMS_HV_SOC_Min 0;
BA_ "GenSigTimeoutTime_DMPI" SG_ 1790 BMS_HV_SOC_Min 0;
BA_ "GenSigTimeoutTime_BPCM" SG_ 1790 BMS_HV_SOC_Min 0;
BA_ "GenSigTimeoutTime_AGSM" SG_ 1790 BMS_HV_SOC_Min 0;
BA_ "GenSigSendType" SG_ 1790 BMS_HV_SOC_Min 3;
BA_ "GenSigStartValue" SG_ 1790 BMS_HV_SOC_Min 50;
BA_ "GenSigTimeoutTime_SGW" SG_ 1790 HEV_OnRq_BPCM 0;
BA_ "GenSigTimeoutTime_PBWM" SG_ 1790 HEV_OnRq_BPCM 0;
BA_ "GenSigTimeoutTime_IDCM" SG_ 1790 HEV_OnRq_BPCM 0;
BA_ "GenSigTimeoutTime_ECM" SG_ 1790 HEV_OnRq_BPCM 0;
BA_ "GenSigTimeoutTime_DMPI" SG_ 1790 HEV_OnRq_BPCM 0;
BA_ "GenSigTimeoutTime_BPCM" SG_ 1790 HEV_OnRq_BPCM 0;
BA_ "GenSigTimeoutTime_AGSM" SG_ 1790 HEV_OnRq_BPCM 0;
BA_ "GenSigSendType" SG_ 1790 HEV_OnRq_BPCM 3;
BA_ "GenSigTimeoutTime_SGW" SG_ 1790 BMS_HV_SOC_Max 0;
BA_ "GenSigTimeoutTime_PBWM" SG_ 1790 BMS_HV_SOC_Max 0;
BA_ "GenSigTimeoutTime_IDCM" SG_ 1790 BMS_HV_SOC_Max 0;
BA_ "GenSigTimeoutTime_ECM" SG_ 1790 BMS_HV_SOC_Max 0;
BA_ "GenSigTimeoutTime_DMPI" SG_ 1790 BMS_HV_SOC_Max 0;
BA_ "GenSigTimeoutTime_BPCM" SG_ 1790 BMS_HV_SOC_Max 0;
BA_ "GenSigTimeoutTime_AGSM" SG_ 1790 BMS_HV_SOC_Max 0;
BA_ "GenSigSendType" SG_ 1790 BMS_HV_SOC_Max 3;
BA_ "GenSigStartValue" SG_ 1790 BMS_HV_SOC_Max 50;
BA_ "GenSigTimeoutTime_SGW" SG_ 1790 BMS_HV_High_Temp_Thrsh 0;
BA_ "GenSigTimeoutTime_PBWM" SG_ 1790 BMS_HV_High_Temp_Thrsh 0;
BA_ "GenSigTimeoutTime_IDCM" SG_ 1790 BMS_HV_High_Temp_Thrsh 0;
BA_ "GenSigTimeoutTime_ECM" SG_ 1790 BMS_HV_High_Temp_Thrsh 0;
BA_ "GenSigTimeoutTime_DMPI" SG_ 1790 BMS_HV_High_Temp_Thrsh 0;
BA_ "GenSigTimeoutTime_BPCM" SG_ 1790 BMS_HV_High_Temp_Thrsh 0;
BA_ "GenSigTimeoutTime_AGSM" SG_ 1790 BMS_HV_High_Temp_Thrsh 0;
BA_ "GenSigTimeoutTime_SGW" SG_ 1790 BMS_HV_Low_Temp_Thrsh 0;
BA_ "GenSigTimeoutTime_PBWM" SG_ 1790 BMS_HV_Low_Temp_Thrsh 0;
BA_ "GenSigTimeoutTime_IDCM" SG_ 1790 BMS_HV_Low_Temp_Thrsh 0;
BA_ "GenSigTimeoutTime_ECM" SG_ 1790 BMS_HV_Low_Temp_Thrsh 0;
BA_ "GenSigTimeoutTime_DMPI" SG_ 1790 BMS_HV_Low_Temp_Thrsh 0;
BA_ "GenSigTimeoutTime_BPCM" SG_ 1790 BMS_HV_Low_Temp_Thrsh 0;
BA_ "GenSigTimeoutTime_AGSM" SG_ 1790 BMS_HV_Low_Temp_Thrsh 0;
BA_ "GenSigTimeoutTime_SGW" SG_ 1790 BMS_HV_SOC_AccuracySts 0;
BA_ "GenSigTimeoutTime_PBWM" SG_ 1790 BMS_HV_SOC_AccuracySts 0;
BA_ "GenSigTimeoutTime_IDCM" SG_ 1790 BMS_HV_SOC_AccuracySts 0;
BA_ "GenSigTimeoutTime_ECM" SG_ 1790 BMS_HV_SOC_AccuracySts 0;
BA_ "GenSigTimeoutTime_DMPI" SG_ 1790 BMS_HV_SOC_AccuracySts 0;
BA_ "GenSigTimeoutTime_BPCM" SG_ 1790 BMS_HV_SOC_AccuracySts 0;
BA_ "GenSigTimeoutTime_AGSM" SG_ 1790 BMS_HV_SOC_AccuracySts 0;
BA_ "GenSigSendType" SG_ 1790 BMS_HV_SOC_AccuracySts 3;
BA_ "GenSigTimeoutTime_BPCM" SG_ 244 ImpactHardwireV 0;
BA_ "GenSigTimeoutTime_AGSM" SG_ 244 ImpactHardwireV 0;
BA_ "GenSigTimeoutTime_SGW" SG_ 244 ImpactHardwireV 0;
BA_ "GenSigTimeoutTime_PBWM" SG_ 244 ImpactHardwireV 0;
BA_ "GenSigTimeoutTime_IDCM" SG_ 244 ImpactHardwireV 0;
BA_ "GenSigTimeoutTime_ECM" SG_ 244 ImpactHardwireV 0;
BA_ "GenSigTimeoutTime_DMPI" SG_ 244 ImpactHardwireV 0;
BA_ "GenSigTimeoutTime_SGW" SG_ 244 ImpactHardwire 0;
BA_ "GenSigTimeoutTime_PBWM" SG_ 244 ImpactHardwire 0;
BA_ "GenSigTimeoutTime_IDCM" SG_ 244 ImpactHardwire 0;
BA_ "GenSigTimeoutTime_ECM" SG_ 244 ImpactHardwire 0;
BA_ "GenSigTimeoutTime_DMPI" SG_ 244 ImpactHardwire 0;
BA_ "GenSigTimeoutTime_BPCM" SG_ 244 ImpactHardwire 0;
BA_ "GenSigTimeoutTime_AGSM" SG_ 244 ImpactHardwire 0;
BA_ "GenSigTimeoutTime_PBWM" SG_ 244 BMS_HV_InternalVoltage 0;
BA_ "GenSigTimeoutTime_IDCM" SG_ 244 BMS_HV_InternalVoltage 0;
BA_ "GenSigTimeoutTime_EVCU2" SG_ 244 BMS_HV_InternalVoltage 0;
BA_ "GenSigTimeoutTime_ECM" SG_ 244 BMS_HV_InternalVoltage 0;
BA_ "GenSigTimeoutTime_DMPI" SG_ 244 BMS_HV_InternalVoltage 0;
BA_ "GenSigTimeoutTime_PBWM" SG_ 244 BMS_HV_Temperature_Min 0;
BA_ "GenSigTimeoutTime_IDCM" SG_ 244 BMS_HV_Temperature_Min 0;
BA_ "GenSigTimeoutTime_EVCU2" SG_ 244 BMS_HV_Temperature_Min 0;
BA_ "GenSigTimeoutTime_ECM" SG_ 244 BMS_HV_Temperature_Min 0;
BA_ "GenSigTimeoutTime_DMPI" SG_ 244 BMS_HV_Temperature_Min 0;
BA_ "GenSigTimeoutTime_BPCM" SG_ 244 BMS_HV_Temperature_Min 0;
BA_ "GenSigTimeoutTime_AGSM" SG_ 244 BMS_HV_Temperature_Min 0;
BA_ "GenSigTimeoutTime_PBWM" SG_ 244 BMS_HV_Temperature_Max 0;
BA_ "GenSigTimeoutTime_IDCM" SG_ 244 BMS_HV_Temperature_Max 0;
BA_ "GenSigTimeoutTime_EVCU2" SG_ 244 BMS_HV_Temperature_Max 0;
BA_ "GenSigTimeoutTime_ECM" SG_ 244 BMS_HV_Temperature_Max 0;
BA_ "GenSigTimeoutTime_DMPI" SG_ 244 BMS_HV_Temperature_Max 0;
BA_ "GenSigTimeoutTime_BPCM" SG_ 244 BMS_HV_Temperature_Max 0;
BA_ "GenSigTimeoutTime_AGSM" SG_ 244 BMS_HV_Temperature_Max 0;
BA_ "GenSigTimeoutTime_SGW" SG_ 250 APM_UtilPctOfDCDC 0;
BA_ "GenSigTimeoutTime_PBWM" SG_ 250 APM_UtilPctOfDCDC 0;
BA_ "GenSigTimeoutTime_IDCM" SG_ 250 APM_UtilPctOfDCDC 0;
BA_ "GenSigTimeoutTime_ECM" SG_ 250 APM_UtilPctOfDCDC 0;
BA_ "GenSigTimeoutTime_DMPI" SG_ 250 APM_UtilPctOfDCDC 0;
BA_ "GenSigTimeoutTime_BPCM" SG_ 250 APM_UtilPctOfDCDC 0;
BA_ "GenSigTimeoutTime_AGSM" SG_ 250 APM_UtilPctOfDCDC 0;
BA_ "GenSigTimeoutTime_SGW" SG_ 250 APM_InputPower 0;
BA_ "GenSigTimeoutTime_PBWM" SG_ 250 APM_InputPower 0;
BA_ "GenSigTimeoutTime_IDCM" SG_ 250 APM_InputPower 0;
BA_ "GenSigTimeoutTime_ECM" SG_ 250 APM_InputPower 0;
BA_ "GenSigTimeoutTime_DMPI" SG_ 250 APM_InputPower 0;
BA_ "GenSigTimeoutTime_BPCM" SG_ 250 APM_InputPower 0;
BA_ "GenSigTimeoutTime_AGSM" SG_ 250 APM_InputPower 0;
BA_ "GenSigTimeoutTime_SGW" SG_ 250 APM_OutputPower 0;
BA_ "GenSigTimeoutTime_PBWM" SG_ 250 APM_OutputPower 0;
BA_ "GenSigTimeoutTime_IDCM" SG_ 250 APM_OutputPower 0;
BA_ "GenSigTimeoutTime_ECM" SG_ 250 APM_OutputPower 0;
BA_ "GenSigTimeoutTime_DMPI" SG_ 250 APM_OutputPower 0;
BA_ "GenSigTimeoutTime_BPCM" SG_ 250 APM_OutputPower 0;
BA_ "GenSigTimeoutTime_AGSM" SG_ 250 APM_OutputPower 0;
BA_ "GenSigTimeoutTime_SGW" SG_ 250 APM_PowerLimitMode 0;
BA_ "GenSigTimeoutTime_PBWM" SG_ 250 APM_PowerLimitMode 0;
BA_ "GenSigTimeoutTime_IDCM" SG_ 250 APM_PowerLimitMode 0;
BA_ "GenSigTimeoutTime_ECM" SG_ 250 APM_PowerLimitMode 0;
BA_ "GenSigTimeoutTime_DMPI" SG_ 250 APM_PowerLimitMode 0;
BA_ "GenSigTimeoutTime_BPCM" SG_ 250 APM_PowerLimitMode 0;
BA_ "GenSigTimeoutTime_AGSM" SG_ 250 APM_PowerLimitMode 0;
BA_ "GenSigTimeoutTime_SGW" SG_ 250 APM_TempColdPlate 0;
BA_ "GenSigTimeoutTime_PBWM" SG_ 250 APM_TempColdPlate 0;
BA_ "GenSigTimeoutTime_IDCM" SG_ 250 APM_TempColdPlate 0;
BA_ "GenSigTimeoutTime_ECM" SG_ 250 APM_TempColdPlate 0;
BA_ "GenSigTimeoutTime_DMPI" SG_ 250 APM_TempColdPlate 0;
BA_ "GenSigTimeoutTime_BPCM" SG_ 250 APM_TempColdPlate 0;
BA_ "GenSigTimeoutTime_AGSM" SG_ 250 APM_TempColdPlate 0;
BA_ "GenSigStartValue" SG_ 250 APM_TempColdPlate 25;
BA_ "GenSigTimeoutTime_SGW" SG_ 250 APM_DeratingReason 0;
BA_ "GenSigTimeoutTime_PBWM" SG_ 250 APM_DeratingReason 0;
BA_ "GenSigTimeoutTime_IDCM" SG_ 250 APM_DeratingReason 0;
BA_ "GenSigTimeoutTime_ECM" SG_ 250 APM_DeratingReason 0;
BA_ "GenSigTimeoutTime_DMPI" SG_ 250 APM_DeratingReason 0;
BA_ "GenSigTimeoutTime_BPCM" SG_ 250 APM_DeratingReason 0;
BA_ "GenSigTimeoutTime_AGSM" SG_ 250 APM_DeratingReason 0;
BA_ "GenSigTimeoutTime_SGW" SG_ 250 APM_EstPwrLoss 0;
BA_ "GenSigTimeoutTime_PBWM" SG_ 250 APM_EstPwrLoss 0;
BA_ "GenSigTimeoutTime_IDCM" SG_ 250 APM_EstPwrLoss 0;
BA_ "GenSigTimeoutTime_ECM" SG_ 250 APM_EstPwrLoss 0;
BA_ "GenSigTimeoutTime_DMPI" SG_ 250 APM_EstPwrLoss 0;
BA_ "GenSigTimeoutTime_BPCM" SG_ 250 APM_EstPwrLoss 0;
BA_ "GenSigTimeoutTime_AGSM" SG_ 250 APM_EstPwrLoss 0;
BA_ "GenSigTimeoutTime_SGW" SG_ 250 APM_FailureReason 0;
BA_ "GenSigTimeoutTime_PBWM" SG_ 250 APM_FailureReason 0;
BA_ "GenSigTimeoutTime_IDCM" SG_ 250 APM_FailureReason 0;
BA_ "GenSigTimeoutTime_ECM" SG_ 250 APM_FailureReason 0;
BA_ "GenSigTimeoutTime_DMPI" SG_ 250 APM_FailureReason 0;
BA_ "GenSigTimeoutTime_BPCM" SG_ 250 APM_FailureReason 0;
BA_ "GenSigTimeoutTime_AGSM" SG_ 250 APM_FailureReason 0;
BA_ "GenSigTimeoutTime_DMPI" SG_ 250 APM_FailureType 0;
BA_ "GenSigTimeoutTime_BPCM" SG_ 250 APM_FailureType 0;
BA_ "GenSigTimeoutTime_AGSM" SG_ 250 APM_FailureType 0;
BA_ "GenSigTimeoutTime_SGW" SG_ 250 APM_FailureType 0;
BA_ "GenSigTimeoutTime_PBWM" SG_ 250 APM_FailureType 0;
BA_ "GenSigTimeoutTime_IDCM" SG_ 250 APM_FailureType 0;
BA_ "GenSigTimeoutTime_ECM" SG_ 250 APM_FailureType 0;
BA_ "GenSigTimeoutTime_SGW" SG_ 250 APM_HvOverVStatus 0;
BA_ "GenSigTimeoutTime_PBWM" SG_ 250 APM_HvOverVStatus 0;
BA_ "GenSigTimeoutTime_IDCM" SG_ 250 APM_HvOverVStatus 0;
BA_ "GenSigTimeoutTime_ECM" SG_ 250 APM_HvOverVStatus 0;
BA_ "GenSigTimeoutTime_DMPI" SG_ 250 APM_HvOverVStatus 0;
BA_ "GenSigTimeoutTime_BPCM" SG_ 250 APM_HvOverVStatus 0;
BA_ "GenSigTimeoutTime_AGSM" SG_ 250 APM_HvOverVStatus 0;
BA_ "GenSigTimeoutTime_SGW" SG_ 250 APM_HvVsetPFdbk 0;
BA_ "GenSigTimeoutTime_PBWM" SG_ 250 APM_HvVsetPFdbk 0;
BA_ "GenSigTimeoutTime_IDCM" SG_ 250 APM_HvVsetPFdbk 0;
BA_ "GenSigTimeoutTime_ECM" SG_ 250 APM_HvVsetPFdbk 0;
BA_ "GenSigTimeoutTime_DMPI" SG_ 250 APM_HvVsetPFdbk 0;
BA_ "GenSigTimeoutTime_BPCM" SG_ 250 APM_HvVsetPFdbk 0;
BA_ "GenSigTimeoutTime_AGSM" SG_ 250 APM_HvVsetPFdbk 0;
BA_ "GenSigTimeoutTime_SGW" SG_ 250 APM_IdcHvSetPFdbk 0;
BA_ "GenSigTimeoutTime_PBWM" SG_ 250 APM_IdcHvSetPFdbk 0;
BA_ "GenSigTimeoutTime_IDCM" SG_ 250 APM_IdcHvSetPFdbk 0;
BA_ "GenSigTimeoutTime_ECM" SG_ 250 APM_IdcHvSetPFdbk 0;
BA_ "GenSigTimeoutTime_DMPI" SG_ 250 APM_IdcHvSetPFdbk 0;
BA_ "GenSigTimeoutTime_BPCM" SG_ 250 APM_IdcHvSetPFdbk 0;
BA_ "GenSigTimeoutTime_AGSM" SG_ 250 APM_IdcHvSetPFdbk 0;
BA_ "GenSigStartValue" SG_ 250 APM_IdcHvSetPFdbk 1021;
BA_ "GenSigTimeoutTime_BPCM" SG_ 244 BMS_HV_InternalVoltage 0;
BA_ "GenSigTimeoutTime_AGSM" SG_ 244 BMS_HV_InternalVoltage 0;
BA_ "GenSigTimeoutTime_PBWM" SG_ 244 BMS_HV_Battery_GFD_Sts 0;
BA_ "GenSigTimeoutTime_IDCM" SG_ 244 BMS_HV_Battery_GFD_Sts 0;
BA_ "GenSigTimeoutTime_EVCU2" SG_ 244 BMS_HV_Battery_GFD_Sts 0;
BA_ "GenSigTimeoutTime_ECM" SG_ 244 BMS_HV_Battery_GFD_Sts 0;
BA_ "GenSigTimeoutTime_DMPI" SG_ 244 BMS_HV_Battery_GFD_Sts 0;
BA_ "GenSigTimeoutTime_BPCM" SG_ 244 BMS_HV_Battery_GFD_Sts 0;
BA_ "GenSigTimeoutTime_AGSM" SG_ 244 BMS_HV_Battery_GFD_Sts 0;
BA_ "GenSigTimeoutTime_PBWM" SG_ 244 BMS_HV_Current 0;
BA_ "GenSigTimeoutTime_IDCM" SG_ 244 BMS_HV_Current 0;
BA_ "GenSigTimeoutTime_EVCU2" SG_ 244 BMS_HV_Current 0;
BA_ "GenSigTimeoutTime_ECM" SG_ 244 BMS_HV_Current 0;
BA_ "GenSigTimeoutTime_DMPI" SG_ 244 BMS_HV_Current 0;
BA_ "GenSigTimeoutTime_BPCM" SG_ 244 BMS_HV_Current 0;
BA_ "GenSigTimeoutTime_AGSM" SG_ 244 BMS_HV_Current 0;
BA_ "GenSigTimeoutTime_PBWM" SG_ 500 BMS_Cell_Volt_Min 0;
BA_ "GenSigTimeoutTime_IDCM" SG_ 500 BMS_Cell_Volt_Min 0;
BA_ "GenSigTimeoutTime_EVCU2" SG_ 500 BMS_Cell_Volt_Min 0;
BA_ "GenSigTimeoutTime_ECM" SG_ 500 BMS_Cell_Volt_Min 0;
BA_ "GenSigTimeoutTime_DMPI" SG_ 500 BMS_Cell_Volt_Min 0;
BA_ "GenSigTimeoutTime_BPCM" SG_ 500 BMS_Cell_Volt_Min 0;
BA_ "GenSigTimeoutTime_AGSM" SG_ 500 BMS_Cell_Volt_Min 0;
BA_ "GenSigTimeoutTime_PBWM" SG_ 500 BMS_HV_NumCellMaxTemp 0;
BA_ "GenSigTimeoutTime_IDCM" SG_ 500 BMS_HV_NumCellMaxTemp 0;
BA_ "GenSigTimeoutTime_EVCU2" SG_ 500 BMS_HV_NumCellMaxTemp 0;
BA_ "GenSigTimeoutTime_ECM" SG_ 500 BMS_HV_NumCellMaxTemp 0;
BA_ "GenSigTimeoutTime_DMPI" SG_ 500 BMS_HV_NumCellMaxTemp 0;
BA_ "GenSigTimeoutTime_BPCM" SG_ 500 BMS_HV_NumCellMaxTemp 0;
BA_ "GenSigTimeoutTime_AGSM" SG_ 500 BMS_HV_NumCellMaxTemp 0;
BA_ "GenSigTimeoutTime_PBWM" SG_ 500 BMS_HV_NumCellMaxVolt 0;
BA_ "GenSigTimeoutTime_IDCM" SG_ 500 BMS_HV_NumCellMaxVolt 0;
BA_ "GenSigTimeoutTime_EVCU2" SG_ 500 BMS_HV_NumCellMaxVolt 0;
BA_ "GenSigTimeoutTime_ECM" SG_ 500 BMS_HV_NumCellMaxVolt 0;
BA_ "GenSigTimeoutTime_DMPI" SG_ 500 BMS_HV_NumCellMaxVolt 0;
BA_ "GenSigTimeoutTime_BPCM" SG_ 500 BMS_HV_NumCellMaxVolt 0;
BA_ "GenSigTimeoutTime_AGSM" SG_ 500 BMS_HV_NumCellMaxVolt 0;
BA_ "GenSigTimeoutTime_PBWM" SG_ 500 BMS_HV_NumCellMinTemp 0;
BA_ "GenSigTimeoutTime_IDCM" SG_ 500 BMS_HV_NumCellMinTemp 0;
BA_ "GenSigTimeoutTime_EVCU2" SG_ 500 BMS_HV_NumCellMinTemp 0;
BA_ "GenSigTimeoutTime_ECM" SG_ 500 BMS_HV_NumCellMinTemp 0;
BA_ "GenSigTimeoutTime_DMPI" SG_ 500 BMS_HV_NumCellMinTemp 0;
BA_ "GenSigTimeoutTime_BPCM" SG_ 500 BMS_HV_NumCellMinTemp 0;
BA_ "GenSigTimeoutTime_AGSM" SG_ 500 BMS_HV_NumCellMinTemp 0;
BA_ "GenSigTimeoutTime_SGW" SG_ 250 APM_HV_V_Fbk 0;
BA_ "GenSigTimeoutTime_PBWM" SG_ 250 APM_HV_V_Fbk 0;
BA_ "GenSigTimeoutTime_IDCM" SG_ 250 APM_HV_V_Fbk 0;
BA_ "GenSigTimeoutTime_ECM" SG_ 250 APM_HV_V_Fbk 0;
BA_ "GenSigTimeoutTime_DMPI" SG_ 250 APM_HV_V_Fbk 0;
BA_ "GenSigTimeoutTime_BPCM" SG_ 250 APM_HV_V_Fbk 0;
BA_ "GenSigTimeoutTime_AGSM" SG_ 250 APM_HV_V_Fbk 0;
BA_ "GenSigTimeoutTime_SGW" SG_ 250 APM_LV_I_Fbk 0;
BA_ "GenSigTimeoutTime_PBWM" SG_ 250 APM_LV_I_Fbk 0;
BA_ "GenSigTimeoutTime_IDCM" SG_ 250 APM_LV_I_Fbk 0;
BA_ "GenSigTimeoutTime_ECM" SG_ 250 APM_LV_I_Fbk 0;
BA_ "GenSigTimeoutTime_DMPI" SG_ 250 APM_LV_I_Fbk 0;
BA_ "GenSigTimeoutTime_BPCM" SG_ 250 APM_LV_I_Fbk 0;
BA_ "GenSigTimeoutTime_AGSM" SG_ 250 APM_LV_I_Fbk 0;
BA_ "GenSigTimeoutTime_SGW" SG_ 250 APM_LV_V_Fbk 0;
BA_ "GenSigTimeoutTime_PBWM" SG_ 250 APM_LV_V_Fbk 0;
BA_ "GenSigTimeoutTime_IDCM" SG_ 250 APM_LV_V_Fbk 0;
BA_ "GenSigTimeoutTime_ECM" SG_ 250 APM_LV_V_Fbk 0;
BA_ "GenSigTimeoutTime_DMPI" SG_ 250 APM_LV_V_Fbk 0;
BA_ "GenSigTimeoutTime_BPCM" SG_ 250 APM_LV_V_Fbk 0;
BA_ "GenSigTimeoutTime_AGSM" SG_ 250 APM_LV_V_Fbk 0;
BA_ "GenSigTimeoutTime_SGW" SG_ 250 APM_PSFB_Temp1 0;
BA_ "GenSigTimeoutTime_PBWM" SG_ 250 APM_PSFB_Temp1 0;
BA_ "GenSigTimeoutTime_IDCM" SG_ 250 APM_PSFB_Temp1 0;
BA_ "GenSigTimeoutTime_ECM" SG_ 250 APM_PSFB_Temp1 0;
BA_ "GenSigTimeoutTime_DMPI" SG_ 250 APM_PSFB_Temp1 0;
BA_ "GenSigTimeoutTime_BPCM" SG_ 250 APM_PSFB_Temp1 0;
BA_ "GenSigTimeoutTime_AGSM" SG_ 250 APM_PSFB_Temp1 0;
BA_ "GenSigTimeoutTime_SGW" SG_ 250 APM_PSFB_Temp2 0;
BA_ "GenSigTimeoutTime_PBWM" SG_ 250 APM_PSFB_Temp2 0;
BA_ "GenSigTimeoutTime_IDCM" SG_ 250 APM_PSFB_Temp2 0;
BA_ "GenSigTimeoutTime_ECM" SG_ 250 APM_PSFB_Temp2 0;
BA_ "GenSigTimeoutTime_DMPI" SG_ 250 APM_PSFB_Temp2 0;
BA_ "GenSigTimeoutTime_BPCM" SG_ 250 APM_PSFB_Temp2 0;
BA_ "GenSigTimeoutTime_AGSM" SG_ 250 APM_PSFB_Temp2 0;
BA_ "GenSigTimeoutTime_SGW" SG_ 250 APM_RecoveryAction 0;
BA_ "GenSigTimeoutTime_PBWM" SG_ 250 APM_RecoveryAction 0;
BA_ "GenSigTimeoutTime_IDCM" SG_ 250 APM_RecoveryAction 0;
BA_ "GenSigTimeoutTime_ECM" SG_ 250 APM_RecoveryAction 0;
BA_ "GenSigTimeoutTime_DMPI" SG_ 250 APM_RecoveryAction 0;
BA_ "GenSigTimeoutTime_BPCM" SG_ 250 APM_RecoveryAction 0;
BA_ "GenSigTimeoutTime_AGSM" SG_ 250 APM_RecoveryAction 0;
BA_ "GenSigTimeoutTime_SGW" SG_ 250 APM_Water_Temp 0;
BA_ "GenSigTimeoutTime_PBWM" SG_ 250 APM_Water_Temp 0;
BA_ "GenSigTimeoutTime_IDCM" SG_ 250 APM_Water_Temp 0;
BA_ "GenSigTimeoutTime_ECM" SG_ 250 APM_Water_Temp 0;
BA_ "GenSigTimeoutTime_DMPI" SG_ 250 APM_Water_Temp 0;
BA_ "GenSigTimeoutTime_BPCM" SG_ 250 APM_Water_Temp 0;
BA_ "GenSigTimeoutTime_AGSM" SG_ 250 APM_Water_Temp 0;
BA_ "GenSigTimeoutTime_PBWM" SG_ 500 BMS_Cell_Volt_Max 0;
BA_ "GenSigTimeoutTime_IDCM" SG_ 500 BMS_Cell_Volt_Max 0;
BA_ "GenSigTimeoutTime_EVCU2" SG_ 500 BMS_Cell_Volt_Max 0;
BA_ "GenSigTimeoutTime_ECM" SG_ 500 BMS_Cell_Volt_Max 0;
BA_ "GenSigTimeoutTime_DMPI" SG_ 500 BMS_Cell_Volt_Max 0;
BA_ "GenSigTimeoutTime_BPCM" SG_ 500 BMS_Cell_Volt_Max 0;
BA_ "GenSigTimeoutTime_AGSM" SG_ 500 BMS_Cell_Volt_Max 0;
BA_ "GenSigTimeoutTime_SGW" SG_ 250 APM_HV_I_Fbk 0;
BA_ "GenSigTimeoutTime_PBWM" SG_ 250 APM_HV_I_Fbk 0;
BA_ "GenSigTimeoutTime_IDCM" SG_ 250 APM_HV_I_Fbk 0;
BA_ "GenSigTimeoutTime_ECM" SG_ 250 APM_HV_I_Fbk 0;
BA_ "GenSigTimeoutTime_DMPI" SG_ 250 APM_HV_I_Fbk 0;
BA_ "GenSigTimeoutTime_BPCM" SG_ 250 APM_HV_I_Fbk 0;
BA_ "GenSigTimeoutTime_AGSM" SG_ 250 APM_HV_I_Fbk 0;
BA_ "GenSigTimeoutTime_SGW" SG_ 250 MessageCounter_APM_VDCM 0;
BA_ "GenSigTimeoutTime_PBWM" SG_ 250 MessageCounter_APM_VDCM 0;
BA_ "GenSigTimeoutTime_IDCM" SG_ 250 MessageCounter_APM_VDCM 0;
BA_ "GenSigTimeoutTime_ECM" SG_ 250 MessageCounter_APM_VDCM 0;
BA_ "GenSigTimeoutTime_DMPI" SG_ 250 MessageCounter_APM_VDCM 0;
BA_ "GenSigTimeoutTime_BPCM" SG_ 250 MessageCounter_APM_VDCM 0;
BA_ "GenSigTimeoutTime_AGSM" SG_ 250 MessageCounter_APM_VDCM 0;
BA_ "GenSigTimeoutTime_SGW" SG_ 250 CRC_APM_VDCM 0;
BA_ "GenSigTimeoutTime_PBWM" SG_ 250 CRC_APM_VDCM 0;
BA_ "GenSigTimeoutTime_IDCM" SG_ 250 CRC_APM_VDCM 0;
BA_ "GenSigTimeoutTime_ECM" SG_ 250 CRC_APM_VDCM 0;
BA_ "GenSigTimeoutTime_DMPI" SG_ 250 CRC_APM_VDCM 0;
BA_ "GenSigTimeoutTime_BPCM" SG_ 250 CRC_APM_VDCM 0;
BA_ "GenSigTimeoutTime_AGSM" SG_ 250 CRC_APM_VDCM 0;
BA_ "GenSigTimeoutTime_SGW" SG_ 250 APM_DeratingPower 0;
BA_ "GenSigTimeoutTime_PBWM" SG_ 250 APM_DeratingPower 0;
BA_ "GenSigTimeoutTime_IDCM" SG_ 250 APM_DeratingPower 0;
BA_ "GenSigTimeoutTime_ECM" SG_ 250 APM_DeratingPower 0;
BA_ "GenSigTimeoutTime_DMPI" SG_ 250 APM_DeratingPower 0;
BA_ "GenSigTimeoutTime_BPCM" SG_ 250 APM_DeratingPower 0;
BA_ "GenSigTimeoutTime_AGSM" SG_ 250 APM_DeratingPower 0;
BA_ "GenSigTimeoutTime_SGW" SG_ 250 APM_Buck_Temp 0;
BA_ "GenSigTimeoutTime_PBWM" SG_ 250 APM_Buck_Temp 0;
BA_ "GenSigTimeoutTime_IDCM" SG_ 250 APM_Buck_Temp 0;
BA_ "GenSigTimeoutTime_ECM" SG_ 250 APM_Buck_Temp 0;
BA_ "GenSigTimeoutTime_DMPI" SG_ 250 APM_Buck_Temp 0;
BA_ "GenSigTimeoutTime_BPCM" SG_ 250 APM_Buck_Temp 0;
BA_ "GenSigTimeoutTime_AGSM" SG_ 250 APM_Buck_Temp 0;
BA_ "GenSigTimeoutTime_SGW" SG_ 250 APM_DeratingModeStatus 0;
BA_ "GenSigTimeoutTime_PBWM" SG_ 250 APM_DeratingModeStatus 0;
BA_ "GenSigTimeoutTime_IDCM" SG_ 250 APM_DeratingModeStatus 0;
BA_ "GenSigTimeoutTime_ECM" SG_ 250 APM_DeratingModeStatus 0;
BA_ "GenSigTimeoutTime_DMPI" SG_ 250 APM_DeratingModeStatus 0;
BA_ "GenSigTimeoutTime_BPCM" SG_ 250 APM_DeratingModeStatus 0;
BA_ "GenSigTimeoutTime_AGSM" SG_ 250 APM_DeratingModeStatus 0;
BA_ "GenSigTimeoutTime_SGW" SG_ 250 APM_CtrlSts_Fbk 0;
BA_ "GenSigTimeoutTime_PBWM" SG_ 250 APM_CtrlSts_Fbk 0;
BA_ "GenSigTimeoutTime_IDCM" SG_ 250 APM_CtrlSts_Fbk 0;
BA_ "GenSigTimeoutTime_ECM" SG_ 250 APM_CtrlSts_Fbk 0;
BA_ "GenSigTimeoutTime_DMPI" SG_ 250 APM_CtrlSts_Fbk 0;
BA_ "GenSigTimeoutTime_BPCM" SG_ 250 APM_CtrlSts_Fbk 0;
BA_ "GenSigTimeoutTime_AGSM" SG_ 250 APM_CtrlSts_Fbk 0;
BA_ "GenSigTimeoutTime_SGW" SG_ 250 APM_CurrentLimitMode 0;
BA_ "GenSigTimeoutTime_PBWM" SG_ 250 APM_CurrentLimitMode 0;
BA_ "GenSigTimeoutTime_IDCM" SG_ 250 APM_CurrentLimitMode 0;
BA_ "GenSigTimeoutTime_ECM" SG_ 250 APM_CurrentLimitMode 0;
BA_ "GenSigTimeoutTime_DMPI" SG_ 250 APM_CurrentLimitMode 0;
BA_ "GenSigTimeoutTime_BPCM" SG_ 250 APM_CurrentLimitMode 0;
BA_ "GenSigTimeoutTime_AGSM" SG_ 250 APM_CurrentLimitMode 0;
BA_ "GenSigTimeoutTime_SGW" SG_ 544 GBT_EVSE_Charge_Permitting 0;
BA_ "GenSigTimeoutTime_PBWM" SG_ 544 GBT_EVSE_Charge_Permitting 0;
BA_ "GenSigTimeoutTime_SGW" SG_ 544 OBCM_Timeout 0;
BA_ "GenSigTimeoutTime_PBWM" SG_ 544 OBCM_Timeout 0;
BA_ "GenSigTimeoutTime_IDCM" SG_ 544 OBCM_Timeout 0;
BA_ "GenSigTimeoutTime_ECM" SG_ 544 OBCM_Timeout 0;
BA_ "GenSigTimeoutTime_DMPI" SG_ 544 OBCM_Timeout 0;
BA_ "GenSigTimeoutTime_BPCM" SG_ 544 OBCM_Timeout 0;
BA_ "GenSigTimeoutTime_AGSM" SG_ 544 OBCM_Timeout 0;
BA_ "GenSigTimeoutTime_SGW" SG_ 544 TxGBTMessageRequest 0;
BA_ "GenSigTimeoutTime_PBWM" SG_ 544 TxGBTMessageRequest 0;
BA_ "GenSigTimeoutTime_IDCM" SG_ 544 TxGBTMessageRequest 0;
BA_ "GenSigTimeoutTime_ECM" SG_ 544 TxGBTMessageRequest 0;
BA_ "GenSigTimeoutTime_DMPI" SG_ 544 TxGBTMessageRequest 0;
BA_ "GenSigTimeoutTime_BPCM" SG_ 544 TxGBTMessageRequest 0;
BA_ "GenSigTimeoutTime_AGSM" SG_ 544 TxGBTMessageRequest 0;
BA_ "GenSigTimeoutTime_SGW" SG_ 544 TxGBTMessageResponse 0;
BA_ "GenSigTimeoutTime_PBWM" SG_ 544 TxGBTMessageResponse 0;
BA_ "GenSigTimeoutTime_IDCM" SG_ 544 TxGBTMessageResponse 0;
BA_ "GenSigTimeoutTime_ECM" SG_ 544 TxGBTMessageResponse 0;
BA_ "GenSigTimeoutTime_DMPI" SG_ 544 TxGBTMessageResponse 0;
BA_ "GenSigTimeoutTime_BPCM" SG_ 544 TxGBTMessageResponse 0;
BA_ "GenSigTimeoutTime_AGSM" SG_ 544 TxGBTMessageResponse 0;
BA_ "GenSigTimeoutTime_SGW" SG_ 544 OBCM_CP1Sts 0;
BA_ "GenSigTimeoutTime_PBWM" SG_ 544 OBCM_CP1Sts 0;
BA_ "GenSigTimeoutTime_IDCM" SG_ 544 OBCM_CP1Sts 0;
BA_ "GenSigTimeoutTime_ECM" SG_ 544 OBCM_CP1Sts 0;
BA_ "GenSigTimeoutTime_DMPI" SG_ 544 OBCM_CP1Sts 0;
BA_ "GenSigTimeoutTime_BPCM" SG_ 544 OBCM_CP1Sts 0;
BA_ "GenSigTimeoutTime_AGSM" SG_ 544 OBCM_CP1Sts 0;
BA_ "GenSigTimeoutTime_SGW" SG_ 544 TCP_Communication_Terminated 0;
BA_ "GenSigTimeoutTime_PBWM" SG_ 544 TCP_Communication_Terminated 0;
BA_ "GenSigTimeoutTime_IDCM" SG_ 544 TCP_Communication_Terminated 0;
BA_ "GenSigTimeoutTime_ECM" SG_ 544 TCP_Communication_Terminated 0;
BA_ "GenSigTimeoutTime_DMPI" SG_ 544 TCP_Communication_Terminated 0;
BA_ "GenSigTimeoutTime_BPCM" SG_ 544 TCP_Communication_Terminated 0;
BA_ "GenSigTimeoutTime_AGSM" SG_ 544 TCP_Communication_Terminated 0;
BA_ "GenSigTimeoutTime_SGW" SG_ 496 Plock_PosSensor 0;
BA_ "GenSigTimeoutTime_PBWM" SG_ 496 Plock_PosSensor 0;
BA_ "GenSigTimeoutTime_IDCM" SG_ 496 Plock_PosSensor 0;
BA_ "GenSigTimeoutTime_ECM" SG_ 496 Plock_PosSensor 0;
BA_ "GenSigTimeoutTime_DMPI" SG_ 496 Plock_PosSensor 0;
BA_ "GenSigTimeoutTime_BPCM" SG_ 496 Plock_PosSensor 0;
BA_ "GenSigTimeoutTime_AGSM" SG_ 496 Plock_PosSensor 0;
BA_ "GenSigTimeoutTime_SGW" SG_ 496 PlockFailSts 0;
BA_ "GenSigTimeoutTime_PBWM" SG_ 496 PlockFailSts 0;
BA_ "GenSigTimeoutTime_IDCM" SG_ 496 PlockFailSts 0;
BA_ "GenSigTimeoutTime_ECM" SG_ 496 PlockFailSts 0;
BA_ "GenSigTimeoutTime_DMPI" SG_ 496 PlockFailSts 0;
BA_ "GenSigTimeoutTime_BPCM" SG_ 496 PlockFailSts 0;
BA_ "GenSigTimeoutTime_AGSM" SG_ 496 PlockFailSts 0;
BA_ "GenSigTimeoutTime_SGW" SG_ 544 OBCM_CP2Sts 0;
BA_ "GenSigTimeoutTime_PBWM" SG_ 544 OBCM_CP2Sts 0;
BA_ "GenSigTimeoutTime_IDCM" SG_ 544 OBCM_CP2Sts 0;
BA_ "GenSigTimeoutTime_ECM" SG_ 544 OBCM_CP2Sts 0;
BA_ "GenSigTimeoutTime_DMPI" SG_ 544 OBCM_CP2Sts 0;
BA_ "GenSigTimeoutTime_BPCM" SG_ 544 OBCM_CP2Sts 0;
BA_ "GenSigTimeoutTime_AGSM" SG_ 544 OBCM_CP2Sts 0;
BA_ "GenSigTimeoutTime_SGW" SG_ 544 OBCM_CP3Sts 0;
BA_ "GenSigTimeoutTime_PBWM" SG_ 544 OBCM_CP3Sts 0;
BA_ "GenSigTimeoutTime_IDCM" SG_ 544 OBCM_CP3Sts 0;
BA_ "GenSigTimeoutTime_ECM" SG_ 544 OBCM_CP3Sts 0;
BA_ "GenSigTimeoutTime_DMPI" SG_ 544 OBCM_CP3Sts 0;
BA_ "GenSigTimeoutTime_BPCM" SG_ 544 OBCM_CP3Sts 0;
BA_ "GenSigTimeoutTime_AGSM" SG_ 544 OBCM_CP3Sts 0;
BA_ "GenSigTimeoutTime_SGW" SG_ 544 OBCM_CSSts 0;
BA_ "GenSigTimeoutTime_PBWM" SG_ 544 OBCM_CSSts 0;
BA_ "GenSigTimeoutTime_IDCM" SG_ 544 OBCM_CSSts 0;
BA_ "GenSigTimeoutTime_ECM" SG_ 544 OBCM_CSSts 0;
BA_ "GenSigTimeoutTime_DMPI" SG_ 544 OBCM_CSSts 0;
BA_ "GenSigTimeoutTime_BPCM" SG_ 544 OBCM_CSSts 0;
BA_ "GenSigTimeoutTime_AGSM" SG_ 544 OBCM_CSSts 0;
BA_ "GenSigTimeoutTime_SGW" SG_ 496 Plock_MotorPosSts 0;
BA_ "GenSigTimeoutTime_PBWM" SG_ 496 Plock_MotorPosSts 0;
BA_ "GenSigTimeoutTime_IDCM" SG_ 496 Plock_MotorPosSts 0;
BA_ "GenSigTimeoutTime_ECM" SG_ 496 Plock_MotorPosSts 0;
BA_ "GenSigTimeoutTime_DMPI" SG_ 496 Plock_MotorPosSts 0;
BA_ "GenSigTimeoutTime_BPCM" SG_ 496 Plock_MotorPosSts 0;
BA_ "GenSigTimeoutTime_AGSM" SG_ 496 Plock_MotorPosSts 0;
BA_ "GenSigTimeoutTime_SGW" SG_ 544 OBCM_APAMSts 0;
BA_ "GenSigTimeoutTime_PBWM" SG_ 544 OBCM_APAMSts 0;
BA_ "GenSigTimeoutTime_IDCM" SG_ 544 OBCM_APAMSts 0;
BA_ "GenSigTimeoutTime_ECM" SG_ 544 OBCM_APAMSts 0;
BA_ "GenSigTimeoutTime_DMPI" SG_ 544 OBCM_APAMSts 0;
BA_ "GenSigTimeoutTime_BPCM" SG_ 544 OBCM_APAMSts 0;
BA_ "GenSigTimeoutTime_AGSM" SG_ 544 OBCM_APAMSts 0;
BA_ "GenSigTimeoutTime_IDCM" SG_ 544 OBCM_CCSts 0;
BA_ "GenSigTimeoutTime_ECM" SG_ 544 OBCM_CCSts 0;
BA_ "GenSigTimeoutTime_DMPI" SG_ 544 OBCM_CCSts 0;
BA_ "GenSigTimeoutTime_BPCM" SG_ 544 OBCM_CCSts 0;
BA_ "GenSigTimeoutTime_AGSM" SG_ 544 OBCM_CCSts 0;
BA_ "GenSigTimeoutTime_SGW" SG_ 544 OBCM_CCSts 0;
BA_ "GenSigTimeoutTime_PBWM" SG_ 544 OBCM_CCSts 0;
BA_ "GenSigTimeoutTime_SGW" SG_ 496 MessageCounter_PARK_DATA 0;
BA_ "GenSigTimeoutTime_PBWM" SG_ 496 MessageCounter_PARK_DATA 0;
BA_ "GenSigTimeoutTime_IDCM" SG_ 496 MessageCounter_PARK_DATA 0;
BA_ "GenSigTimeoutTime_ECM" SG_ 496 MessageCounter_PARK_DATA 0;
BA_ "GenSigTimeoutTime_DMPI" SG_ 496 MessageCounter_PARK_DATA 0;
BA_ "GenSigTimeoutTime_BPCM" SG_ 496 MessageCounter_PARK_DATA 0;
BA_ "GenSigTimeoutTime_AGSM" SG_ 496 MessageCounter_PARK_DATA 0;
BA_ "GenSigTimeoutTime_SGW" SG_ 544 HVCMS_EVSEID 0;
BA_ "GenSigTimeoutTime_PBWM" SG_ 544 HVCMS_EVSEID 0;
BA_ "GenSigTimeoutTime_IDCM" SG_ 544 HVCMS_EVSEID 0;
BA_ "GenSigTimeoutTime_ECM" SG_ 544 HVCMS_EVSEID 0;
BA_ "GenSigTimeoutTime_DMPI" SG_ 544 HVCMS_EVSEID 0;
BA_ "GenSigTimeoutTime_BPCM" SG_ 544 HVCMS_EVSEID 0;
BA_ "GenSigTimeoutTime_AGSM" SG_ 544 HVCMS_EVSEID 0;
BA_ "GenSigTimeoutTime_SGW" SG_ 544 Plug_Locked_by_EVSE 0;
BA_ "GenSigTimeoutTime_PBWM" SG_ 544 Plug_Locked_by_EVSE 0;
BA_ "GenSigTimeoutTime_IDCM" SG_ 544 Plug_Locked_by_EVSE 0;
BA_ "GenSigTimeoutTime_ECM" SG_ 544 Plug_Locked_by_EVSE 0;
BA_ "GenSigTimeoutTime_DMPI" SG_ 544 Plug_Locked_by_EVSE 0;
BA_ "GenSigTimeoutTime_BPCM" SG_ 544 Plug_Locked_by_EVSE 0;
BA_ "GenSigTimeoutTime_AGSM" SG_ 544 Plug_Locked_by_EVSE 0;
BA_ "GenSigStartValue" SG_ 544 Plug_Locked_by_EVSE 2;
BA_ "GenSigTimeoutTime_SGW" SG_ 496 CRC_PARK_DATA 0;
BA_ "GenSigTimeoutTime_PBWM" SG_ 496 CRC_PARK_DATA 0;
BA_ "GenSigTimeoutTime_IDCM" SG_ 496 CRC_PARK_DATA 0;
BA_ "GenSigTimeoutTime_ECM" SG_ 496 CRC_PARK_DATA 0;
BA_ "GenSigTimeoutTime_DMPI" SG_ 496 CRC_PARK_DATA 0;
BA_ "GenSigTimeoutTime_BPCM" SG_ 496 CRC_PARK_DATA 0;
BA_ "GenSigTimeoutTime_AGSM" SG_ 496 CRC_PARK_DATA 0;
BA_ "GenSigTimeoutTime_SGW" SG_ 544 MessageCounter_OV2 0;
BA_ "GenSigTimeoutTime_PBWM" SG_ 544 MessageCounter_OV2 0;
BA_ "GenSigTimeoutTime_IDCM" SG_ 544 MessageCounter_OV2 0;
BA_ "GenSigTimeoutTime_ECM" SG_ 544 MessageCounter_OV2 0;
BA_ "GenSigTimeoutTime_DMPI" SG_ 544 MessageCounter_OV2 0;
BA_ "GenSigTimeoutTime_BPCM" SG_ 544 MessageCounter_OV2 0;
BA_ "GenSigTimeoutTime_AGSM" SG_ 544 MessageCounter_OV2 0;
BA_ "GenSigTimeoutTime_SGW" SG_ 496 Plock_fdbk_sts 0;
BA_ "GenSigTimeoutTime_PBWM" SG_ 496 Plock_fdbk_sts 0;
BA_ "GenSigTimeoutTime_IDCM" SG_ 496 Plock_fdbk_sts 0;
BA_ "GenSigTimeoutTime_ECM" SG_ 496 Plock_fdbk_sts 0;
BA_ "GenSigTimeoutTime_DMPI" SG_ 496 Plock_fdbk_sts 0;
BA_ "GenSigTimeoutTime_BPCM" SG_ 496 Plock_fdbk_sts 0;
BA_ "GenSigTimeoutTime_AGSM" SG_ 496 Plock_fdbk_sts 0;
BA_ "GenSigTimeoutTime_SGW" SG_ 544 CRC_OV2 0;
BA_ "GenSigTimeoutTime_PBWM" SG_ 544 CRC_OV2 0;
BA_ "GenSigTimeoutTime_IDCM" SG_ 544 CRC_OV2 0;
BA_ "GenSigTimeoutTime_ECM" SG_ 544 CRC_OV2 0;
BA_ "GenSigTimeoutTime_DMPI" SG_ 544 CRC_OV2 0;
BA_ "GenSigTimeoutTime_BPCM" SG_ 544 CRC_OV2 0;
BA_ "GenSigTimeoutTime_AGSM" SG_ 544 CRC_OV2 0;
BA_ "GenSigTimeoutTime_SGW" SG_ 498 MC_OBCM_VDCM 0;
BA_ "GenSigTimeoutTime_PBWM" SG_ 498 MC_OBCM_VDCM 0;
BA_ "GenSigTimeoutTime_IDCM" SG_ 498 MC_OBCM_VDCM 0;
BA_ "GenSigTimeoutTime_ECM" SG_ 498 MC_OBCM_VDCM 0;
BA_ "GenSigTimeoutTime_DMPI" SG_ 498 MC_OBCM_VDCM 0;
BA_ "GenSigTimeoutTime_BPCM" SG_ 498 MC_OBCM_VDCM 0;
BA_ "GenSigTimeoutTime_AGSM" SG_ 498 MC_OBCM_VDCM 0;
BA_ "GenSigTimeoutTime_SGW" SG_ 544 CdM_ExtFun_Reset_Max_Time 0;
BA_ "GenSigTimeoutTime_PBWM" SG_ 544 CdM_ExtFun_Reset_Max_Time 0;
BA_ "GenSigTimeoutTime_IDCM" SG_ 544 CdM_ExtFun_Reset_Max_Time 0;
BA_ "GenSigTimeoutTime_ECM" SG_ 544 CdM_ExtFun_Reset_Max_Time 0;
BA_ "GenSigTimeoutTime_DMPI" SG_ 544 CdM_ExtFun_Reset_Max_Time 0;
BA_ "GenSigTimeoutTime_BPCM" SG_ 544 CdM_ExtFun_Reset_Max_Time 0;
BA_ "GenSigTimeoutTime_AGSM" SG_ 544 CdM_ExtFun_Reset_Max_Time 0;
BA_ "GenSigTimeoutTime_SGW" SG_ 544 CdM_ExtFun_Over_Temp_Trotec_Conn 0;
BA_ "GenSigTimeoutTime_PBWM" SG_ 544 CdM_ExtFun_Over_Temp_Trotec_Conn 0;
BA_ "GenSigTimeoutTime_IDCM" SG_ 544 CdM_ExtFun_Over_Temp_Trotec_Conn 0;
BA_ "GenSigTimeoutTime_ECM" SG_ 544 CdM_ExtFun_Over_Temp_Trotec_Conn 0;
BA_ "GenSigTimeoutTime_DMPI" SG_ 544 CdM_ExtFun_Over_Temp_Trotec_Conn 0;
BA_ "GenSigTimeoutTime_BPCM" SG_ 544 CdM_ExtFun_Over_Temp_Trotec_Conn 0;
BA_ "GenSigTimeoutTime_AGSM" SG_ 544 CdM_ExtFun_Over_Temp_Trotec_Conn 0;
BA_ "GenSigTimeoutTime_SGW" SG_ 544 CdM_ExtFun_Relia_Design 0;
BA_ "GenSigTimeoutTime_PBWM" SG_ 544 CdM_ExtFun_Relia_Design 0;
BA_ "GenSigTimeoutTime_IDCM" SG_ 544 CdM_ExtFun_Relia_Design 0;
BA_ "GenSigTimeoutTime_ECM" SG_ 544 CdM_ExtFun_Relia_Design 0;
BA_ "GenSigTimeoutTime_DMPI" SG_ 544 CdM_ExtFun_Relia_Design 0;
BA_ "GenSigTimeoutTime_BPCM" SG_ 544 CdM_ExtFun_Relia_Design 0;
BA_ "GenSigTimeoutTime_AGSM" SG_ 544 CdM_ExtFun_Relia_Design 0;
BA_ "GenSigTimeoutTime_SGW" SG_ 544 CdM_ExtFun_Char_HC_Control_Comp 0;
BA_ "GenSigTimeoutTime_PBWM" SG_ 544 CdM_ExtFun_Char_HC_Control_Comp 0;
BA_ "GenSigTimeoutTime_IDCM" SG_ 544 CdM_ExtFun_Char_HC_Control_Comp 0;
BA_ "GenSigTimeoutTime_ECM" SG_ 544 CdM_ExtFun_Char_HC_Control_Comp 0;
BA_ "GenSigTimeoutTime_DMPI" SG_ 544 CdM_ExtFun_Char_HC_Control_Comp 0;
BA_ "GenSigTimeoutTime_BPCM" SG_ 544 CdM_ExtFun_Char_HC_Control_Comp 0;
BA_ "GenSigTimeoutTime_AGSM" SG_ 544 CdM_ExtFun_Char_HC_Control_Comp 0;
BA_ "GenSigTimeoutTime_SGW" SG_ 544 CdM_ExtFun_Chr_Dyn_Control_Comp 0;
BA_ "GenSigTimeoutTime_PBWM" SG_ 544 CdM_ExtFun_Chr_Dyn_Control_Comp 0;
BA_ "GenSigTimeoutTime_IDCM" SG_ 544 CdM_ExtFun_Chr_Dyn_Control_Comp 0;
BA_ "GenSigTimeoutTime_ECM" SG_ 544 CdM_ExtFun_Chr_Dyn_Control_Comp 0;
BA_ "GenSigTimeoutTime_DMPI" SG_ 544 CdM_ExtFun_Chr_Dyn_Control_Comp 0;
BA_ "GenSigTimeoutTime_BPCM" SG_ 544 CdM_ExtFun_Chr_Dyn_Control_Comp 0;
BA_ "GenSigTimeoutTime_AGSM" SG_ 544 CdM_ExtFun_Chr_Dyn_Control_Comp 0;
BA_ "GenSigTimeoutTime_SGW" SG_ 544 CdM_ExtFun_Cool_Func_Cable 0;
BA_ "GenSigTimeoutTime_PBWM" SG_ 544 CdM_ExtFun_Cool_Func_Cable 0;
BA_ "GenSigTimeoutTime_IDCM" SG_ 544 CdM_ExtFun_Cool_Func_Cable 0;
BA_ "GenSigTimeoutTime_ECM" SG_ 544 CdM_ExtFun_Cool_Func_Cable 0;
BA_ "GenSigTimeoutTime_DMPI" SG_ 544 CdM_ExtFun_Cool_Func_Cable 0;
BA_ "GenSigTimeoutTime_BPCM" SG_ 544 CdM_ExtFun_Cool_Func_Cable 0;
BA_ "GenSigTimeoutTime_AGSM" SG_ 544 CdM_ExtFun_Cool_Func_Cable 0;
BA_ "GenSigTimeoutTime_SGW" SG_ 544 CdM_ExtFun_Cool_Func_Conn 0;
BA_ "GenSigTimeoutTime_PBWM" SG_ 544 CdM_ExtFun_Cool_Func_Conn 0;
BA_ "GenSigTimeoutTime_IDCM" SG_ 544 CdM_ExtFun_Cool_Func_Conn 0;
BA_ "GenSigTimeoutTime_ECM" SG_ 544 CdM_ExtFun_Cool_Func_Conn 0;
BA_ "GenSigTimeoutTime_DMPI" SG_ 544 CdM_ExtFun_Cool_Func_Conn 0;
BA_ "GenSigTimeoutTime_BPCM" SG_ 544 CdM_ExtFun_Cool_Func_Conn 0;
BA_ "GenSigTimeoutTime_AGSM" SG_ 544 CdM_ExtFun_Cool_Func_Conn 0;
BA_ "GenSigTimeoutTime_SGW" SG_ 544 CdM_ExtFun_Cur_Lim_Cable 0;
BA_ "GenSigTimeoutTime_PBWM" SG_ 544 CdM_ExtFun_Cur_Lim_Cable 0;
BA_ "GenSigTimeoutTime_IDCM" SG_ 544 CdM_ExtFun_Cur_Lim_Cable 0;
BA_ "GenSigTimeoutTime_ECM" SG_ 544 CdM_ExtFun_Cur_Lim_Cable 0;
BA_ "GenSigTimeoutTime_DMPI" SG_ 544 CdM_ExtFun_Cur_Lim_Cable 0;
BA_ "GenSigTimeoutTime_BPCM" SG_ 544 CdM_ExtFun_Cur_Lim_Cable 0;
BA_ "GenSigTimeoutTime_AGSM" SG_ 544 CdM_ExtFun_Cur_Lim_Cable 0;
BA_ "GenSigTimeoutTime_SGW" SG_ 544 CdM_ExtFun_Cur_Lim_Conn 0;
BA_ "GenSigTimeoutTime_PBWM" SG_ 544 CdM_ExtFun_Cur_Lim_Conn 0;
BA_ "GenSigTimeoutTime_IDCM" SG_ 544 CdM_ExtFun_Cur_Lim_Conn 0;
BA_ "GenSigTimeoutTime_ECM" SG_ 544 CdM_ExtFun_Cur_Lim_Conn 0;
BA_ "GenSigTimeoutTime_DMPI" SG_ 544 CdM_ExtFun_Cur_Lim_Conn 0;
BA_ "GenSigTimeoutTime_BPCM" SG_ 544 CdM_ExtFun_Cur_Lim_Conn 0;
BA_ "GenSigTimeoutTime_AGSM" SG_ 544 CdM_ExtFun_Cur_Lim_Conn 0;
BA_ "GenSigTimeoutTime_SGW" SG_ 544 CdM_ExtFun_Oper_Cond 0;
BA_ "GenSigTimeoutTime_PBWM" SG_ 544 CdM_ExtFun_Oper_Cond 0;
BA_ "GenSigTimeoutTime_IDCM" SG_ 544 CdM_ExtFun_Oper_Cond 0;
BA_ "GenSigTimeoutTime_ECM" SG_ 544 CdM_ExtFun_Oper_Cond 0;
BA_ "GenSigTimeoutTime_DMPI" SG_ 544 CdM_ExtFun_Oper_Cond 0;
BA_ "GenSigTimeoutTime_BPCM" SG_ 544 CdM_ExtFun_Oper_Cond 0;
BA_ "GenSigTimeoutTime_AGSM" SG_ 544 CdM_ExtFun_Oper_Cond 0;
BA_ "GenSigTimeoutTime_SGW" SG_ 498 ReceiptRequired 0;
BA_ "GenSigTimeoutTime_PBWM" SG_ 498 ReceiptRequired 0;
BA_ "GenSigTimeoutTime_IDCM" SG_ 498 ReceiptRequired 0;
BA_ "GenSigTimeoutTime_ECM" SG_ 498 ReceiptRequired 0;
BA_ "GenSigTimeoutTime_DMPI" SG_ 498 ReceiptRequired 0;
BA_ "GenSigTimeoutTime_BPCM" SG_ 498 ReceiptRequired 0;
BA_ "GenSigTimeoutTime_AGSM" SG_ 498 ReceiptRequired 0;
BA_ "GenSigTimeoutTime_SGW" SG_ 544 EVSE_NotificationMaxDelay 0;
BA_ "GenSigTimeoutTime_PBWM" SG_ 544 EVSE_NotificationMaxDelay 0;
BA_ "GenSigTimeoutTime_IDCM" SG_ 544 EVSE_NotificationMaxDelay 0;
BA_ "GenSigTimeoutTime_ECM" SG_ 544 EVSE_NotificationMaxDelay 0;
BA_ "GenSigTimeoutTime_DMPI" SG_ 544 EVSE_NotificationMaxDelay 0;
BA_ "GenSigTimeoutTime_BPCM" SG_ 544 EVSE_NotificationMaxDelay 0;
BA_ "GenSigTimeoutTime_AGSM" SG_ 544 EVSE_NotificationMaxDelay 0;
BA_ "GenSigStartValue" SG_ 544 EVSE_NotificationMaxDelay 1;
BA_ "GenSigTimeoutTime_SGW" SG_ 544 ExtChargerSts 0;
BA_ "GenSigTimeoutTime_PBWM" SG_ 544 ExtChargerSts 0;
BA_ "GenSigTimeoutTime_IDCM" SG_ 544 ExtChargerSts 0;
BA_ "GenSigTimeoutTime_ECM" SG_ 544 ExtChargerSts 0;
BA_ "GenSigTimeoutTime_DMPI" SG_ 544 ExtChargerSts 0;
BA_ "GenSigTimeoutTime_BPCM" SG_ 544 ExtChargerSts 0;
BA_ "GenSigTimeoutTime_AGSM" SG_ 544 ExtChargerSts 0;
BA_ "GenSigStartValue" SG_ 544 ExtChargerSts 2;
BA_ "GenSigTimeoutTime_SGW" SG_ 498 OBCM_PLCTypeSts 0;
BA_ "GenSigTimeoutTime_PBWM" SG_ 498 OBCM_PLCTypeSts 0;
BA_ "GenSigTimeoutTime_IDCM" SG_ 498 OBCM_PLCTypeSts 0;
BA_ "GenSigTimeoutTime_ECM" SG_ 498 OBCM_PLCTypeSts 0;
BA_ "GenSigTimeoutTime_DMPI" SG_ 498 OBCM_PLCTypeSts 0;
BA_ "GenSigTimeoutTime_BPCM" SG_ 498 OBCM_PLCTypeSts 0;
BA_ "GenSigTimeoutTime_AGSM" SG_ 498 OBCM_PLCTypeSts 0;
BA_ "GenSigTimeoutTime_SGW" SG_ 544 CC2VoltDetError 0;
BA_ "GenSigTimeoutTime_PBWM" SG_ 544 CC2VoltDetError 0;
BA_ "GenSigTimeoutTime_IDCM" SG_ 544 CC2VoltDetError 0;
BA_ "GenSigTimeoutTime_ECM" SG_ 544 CC2VoltDetError 0;
BA_ "GenSigTimeoutTime_DMPI" SG_ 544 CC2VoltDetError 0;
BA_ "GenSigTimeoutTime_BPCM" SG_ 544 CC2VoltDetError 0;
BA_ "GenSigTimeoutTime_AGSM" SG_ 544 CC2VoltDetError 0;
BA_ "GenSigStartValue" SG_ 544 CC2VoltDetError 2;
BA_ "GenSigTimeoutTime_SGW" SG_ 544 Charger_FaultStates 0;
BA_ "GenSigTimeoutTime_PBWM" SG_ 544 Charger_FaultStates 0;
BA_ "GenSigTimeoutTime_IDCM" SG_ 544 Charger_FaultStates 0;
BA_ "GenSigTimeoutTime_ECM" SG_ 544 Charger_FaultStates 0;
BA_ "GenSigTimeoutTime_DMPI" SG_ 544 Charger_FaultStates 0;
BA_ "GenSigTimeoutTime_BPCM" SG_ 544 Charger_FaultStates 0;
BA_ "GenSigTimeoutTime_AGSM" SG_ 544 Charger_FaultStates 0;
BA_ "GenSigStartValue" SG_ 544 Charger_FaultStates 14;
BA_ "GenSigTimeoutTime_SGW" SG_ 544 Charger_StndbyReq 0;
BA_ "GenSigTimeoutTime_PBWM" SG_ 544 Charger_StndbyReq 0;
BA_ "GenSigTimeoutTime_IDCM" SG_ 544 Charger_StndbyReq 0;
BA_ "GenSigTimeoutTime_ECM" SG_ 544 Charger_StndbyReq 0;
BA_ "GenSigTimeoutTime_DMPI" SG_ 544 Charger_StndbyReq 0;
BA_ "GenSigTimeoutTime_BPCM" SG_ 544 Charger_StndbyReq 0;
BA_ "GenSigTimeoutTime_AGSM" SG_ 544 Charger_StndbyReq 0;
BA_ "GenSigStartValue" SG_ 544 Charger_StndbyReq 2;
BA_ "GenSigTimeoutTime_SGW" SG_ 544 Charger_StndbyReqReason 0;
BA_ "GenSigTimeoutTime_PBWM" SG_ 544 Charger_StndbyReqReason 0;
BA_ "GenSigTimeoutTime_IDCM" SG_ 544 Charger_StndbyReqReason 0;
BA_ "GenSigTimeoutTime_ECM" SG_ 544 Charger_StndbyReqReason 0;
BA_ "GenSigTimeoutTime_DMPI" SG_ 544 Charger_StndbyReqReason 0;
BA_ "GenSigTimeoutTime_BPCM" SG_ 544 Charger_StndbyReqReason 0;
BA_ "GenSigTimeoutTime_AGSM" SG_ 544 Charger_StndbyReqReason 0;
BA_ "GenSigStartValue" SG_ 544 Charger_StndbyReqReason 6;
BA_ "GenSigTimeoutTime_SGW" SG_ 544 Charger_WeldingDetectAvail 0;
BA_ "GenSigTimeoutTime_PBWM" SG_ 544 Charger_WeldingDetectAvail 0;
BA_ "GenSigTimeoutTime_IDCM" SG_ 544 Charger_WeldingDetectAvail 0;
BA_ "GenSigTimeoutTime_ECM" SG_ 544 Charger_WeldingDetectAvail 0;
BA_ "GenSigTimeoutTime_DMPI" SG_ 544 Charger_WeldingDetectAvail 0;
BA_ "GenSigTimeoutTime_BPCM" SG_ 544 Charger_WeldingDetectAvail 0;
BA_ "GenSigTimeoutTime_AGSM" SG_ 544 Charger_WeldingDetectAvail 0;
BA_ "GenSigStartValue" SG_ 544 Charger_WeldingDetectAvail 2;
BA_ "GenSigTimeoutTime_SGW" SG_ 544 EVSE_ChrgStopControl 0;
BA_ "GenSigTimeoutTime_PBWM" SG_ 544 EVSE_ChrgStopControl 0;
BA_ "GenSigTimeoutTime_IDCM" SG_ 544 EVSE_ChrgStopControl 0;
BA_ "GenSigTimeoutTime_ECM" SG_ 544 EVSE_ChrgStopControl 0;
BA_ "GenSigTimeoutTime_DMPI" SG_ 544 EVSE_ChrgStopControl 0;
BA_ "GenSigTimeoutTime_BPCM" SG_ 544 EVSE_ChrgStopControl 0;
BA_ "GenSigTimeoutTime_AGSM" SG_ 544 EVSE_ChrgStopControl 0;
BA_ "GenSigStartValue" SG_ 544 EVSE_ChrgStopControl 2;
BA_ "GenSigTimeoutTime_SGW" SG_ 544 EVSE_Error 0;
BA_ "GenSigTimeoutTime_PBWM" SG_ 544 EVSE_Error 0;
BA_ "GenSigTimeoutTime_IDCM" SG_ 544 EVSE_Error 0;
BA_ "GenSigTimeoutTime_ECM" SG_ 544 EVSE_Error 0;
BA_ "GenSigTimeoutTime_DMPI" SG_ 544 EVSE_Error 0;
BA_ "GenSigTimeoutTime_BPCM" SG_ 544 EVSE_Error 0;
BA_ "GenSigTimeoutTime_AGSM" SG_ 544 EVSE_Error 0;
BA_ "GenSigStartValue" SG_ 544 EVSE_Error 2;
BA_ "GenSigTimeoutTime_SGW" SG_ 498 HVCMS_EVSEVoltageLimitAchieved 0;
BA_ "GenSigTimeoutTime_PBWM" SG_ 498 HVCMS_EVSEVoltageLimitAchieved 0;
BA_ "GenSigTimeoutTime_IDCM" SG_ 498 HVCMS_EVSEVoltageLimitAchieved 0;
BA_ "GenSigTimeoutTime_ECM" SG_ 498 HVCMS_EVSEVoltageLimitAchieved 0;
BA_ "GenSigTimeoutTime_DMPI" SG_ 498 HVCMS_EVSEVoltageLimitAchieved 0;
BA_ "GenSigTimeoutTime_BPCM" SG_ 498 HVCMS_EVSEVoltageLimitAchieved 0;
BA_ "GenSigTimeoutTime_AGSM" SG_ 498 HVCMS_EVSEVoltageLimitAchieved 0;
BA_ "GenSigTimeoutTime_SGW" SG_ 498 HVCMS_ResponseCode 0;
BA_ "GenSigTimeoutTime_PBWM" SG_ 498 HVCMS_ResponseCode 0;
BA_ "GenSigTimeoutTime_IDCM" SG_ 498 HVCMS_ResponseCode 0;
BA_ "GenSigTimeoutTime_ECM" SG_ 498 HVCMS_ResponseCode 0;
BA_ "GenSigTimeoutTime_DMPI" SG_ 498 HVCMS_ResponseCode 0;
BA_ "GenSigTimeoutTime_BPCM" SG_ 498 HVCMS_ResponseCode 0;
BA_ "GenSigTimeoutTime_AGSM" SG_ 498 HVCMS_ResponseCode 0;
BA_ "GenSigTimeoutTime_SGW" SG_ 498 HVCMS_TxMessageStat 0;
BA_ "GenSigTimeoutTime_PBWM" SG_ 498 HVCMS_TxMessageStat 0;
BA_ "GenSigTimeoutTime_IDCM" SG_ 498 HVCMS_TxMessageStat 0;
BA_ "GenSigTimeoutTime_ECM" SG_ 498 HVCMS_TxMessageStat 0;
BA_ "GenSigTimeoutTime_DMPI" SG_ 498 HVCMS_TxMessageStat 0;
BA_ "GenSigTimeoutTime_BPCM" SG_ 498 HVCMS_TxMessageStat 0;
BA_ "GenSigTimeoutTime_AGSM" SG_ 498 HVCMS_TxMessageStat 0;
BA_ "GenSigTimeoutTime_SGW" SG_ 544 EVCC_FailureSts 0;
BA_ "GenSigTimeoutTime_PBWM" SG_ 544 EVCC_FailureSts 0;
BA_ "GenSigTimeoutTime_IDCM" SG_ 544 EVCC_FailureSts 0;
BA_ "GenSigTimeoutTime_ECM" SG_ 544 EVCC_FailureSts 0;
BA_ "GenSigTimeoutTime_DMPI" SG_ 544 EVCC_FailureSts 0;
BA_ "GenSigTimeoutTime_BPCM" SG_ 544 EVCC_FailureSts 0;
BA_ "GenSigTimeoutTime_AGSM" SG_ 544 EVCC_FailureSts 0;
BA_ "GenSigTimeoutTime_IDCM" SG_ 544 GBT_EVSE_Charge_Permitting 0;
BA_ "GenSigTimeoutTime_ECM" SG_ 544 GBT_EVSE_Charge_Permitting 0;
BA_ "GenSigTimeoutTime_DMPI" SG_ 544 GBT_EVSE_Charge_Permitting 0;
BA_ "GenSigTimeoutTime_BPCM" SG_ 544 GBT_EVSE_Charge_Permitting 0;
BA_ "GenSigTimeoutTime_AGSM" SG_ 544 GBT_EVSE_Charge_Permitting 0;
BA_ "GenSigTimeoutTime_SGW" SG_ 498 TxMessageResponse 0;
BA_ "GenSigTimeoutTime_PBWM" SG_ 498 TxMessageResponse 0;
BA_ "GenSigTimeoutTime_IDCM" SG_ 498 TxMessageResponse 0;
BA_ "GenSigTimeoutTime_ECM" SG_ 498 TxMessageResponse 0;
BA_ "GenSigTimeoutTime_DMPI" SG_ 498 TxMessageResponse 0;
BA_ "GenSigTimeoutTime_BPCM" SG_ 498 TxMessageResponse 0;
BA_ "GenSigTimeoutTime_AGSM" SG_ 498 TxMessageResponse 0;
BA_ "GenSigTimeoutTime_SGW" SG_ 544 CC2_VoltageValue 0;
BA_ "GenSigTimeoutTime_PBWM" SG_ 544 CC2_VoltageValue 0;
BA_ "GenSigTimeoutTime_IDCM" SG_ 544 CC2_VoltageValue 0;
BA_ "GenSigTimeoutTime_ECM" SG_ 544 CC2_VoltageValue 0;
BA_ "GenSigTimeoutTime_DMPI" SG_ 544 CC2_VoltageValue 0;
BA_ "GenSigTimeoutTime_BPCM" SG_ 544 CC2_VoltageValue 0;
BA_ "GenSigTimeoutTime_AGSM" SG_ 544 CC2_VoltageValue 0;
BA_ "GenSigTimeoutTime_SGW" SG_ 498 EVSE_ServiceId 0;
BA_ "GenSigTimeoutTime_PBWM" SG_ 498 EVSE_ServiceId 0;
BA_ "GenSigTimeoutTime_IDCM" SG_ 498 EVSE_ServiceId 0;
BA_ "GenSigTimeoutTime_ECM" SG_ 498 EVSE_ServiceId 0;
BA_ "GenSigTimeoutTime_DMPI" SG_ 498 EVSE_ServiceId 0;
BA_ "GenSigTimeoutTime_BPCM" SG_ 498 EVSE_ServiceId 0;
BA_ "GenSigTimeoutTime_AGSM" SG_ 498 EVSE_ServiceId 0;
BA_ "GenSigTimeoutTime_SGW" SG_ 498 HVCMS_EVSEStatusCode 0;
BA_ "GenSigTimeoutTime_PBWM" SG_ 498 HVCMS_EVSEStatusCode 0;
BA_ "GenSigTimeoutTime_IDCM" SG_ 498 HVCMS_EVSEStatusCode 0;
BA_ "GenSigTimeoutTime_ECM" SG_ 498 HVCMS_EVSEStatusCode 0;
BA_ "GenSigTimeoutTime_DMPI" SG_ 498 HVCMS_EVSEStatusCode 0;
BA_ "GenSigTimeoutTime_BPCM" SG_ 498 HVCMS_EVSEStatusCode 0;
BA_ "GenSigTimeoutTime_AGSM" SG_ 498 HVCMS_EVSEStatusCode 0;
BA_ "GenSigStartValue" SG_ 498 HVCMS_EVSEStatusCode 15;
BA_ "GenSigTimeoutTime_SGW" SG_ 498 EVSE_OfferedPaymentOptn 0;
BA_ "GenSigTimeoutTime_PBWM" SG_ 498 EVSE_OfferedPaymentOptn 0;
BA_ "GenSigTimeoutTime_IDCM" SG_ 498 EVSE_OfferedPaymentOptn 0;
BA_ "GenSigTimeoutTime_ECM" SG_ 498 EVSE_OfferedPaymentOptn 0;
BA_ "GenSigTimeoutTime_DMPI" SG_ 498 EVSE_OfferedPaymentOptn 0;
BA_ "GenSigTimeoutTime_BPCM" SG_ 498 EVSE_OfferedPaymentOptn 0;
BA_ "GenSigTimeoutTime_AGSM" SG_ 498 EVSE_OfferedPaymentOptn 0;
BA_ "GenSigTimeoutTime_SGW" SG_ 498 EVSE_OfferedService 0;
BA_ "GenSigTimeoutTime_PBWM" SG_ 498 EVSE_OfferedService 0;
BA_ "GenSigTimeoutTime_IDCM" SG_ 498 EVSE_OfferedService 0;
BA_ "GenSigTimeoutTime_ECM" SG_ 498 EVSE_OfferedService 0;
BA_ "GenSigTimeoutTime_DMPI" SG_ 498 EVSE_OfferedService 0;
BA_ "GenSigTimeoutTime_BPCM" SG_ 498 EVSE_OfferedService 0;
BA_ "GenSigTimeoutTime_AGSM" SG_ 498 EVSE_OfferedService 0;
BA_ "GenSigTimeoutTime_DMPI" SG_ 498 EVSE_FreeService 0;
BA_ "GenSigTimeoutTime_BPCM" SG_ 498 EVSE_FreeService 0;
BA_ "GenSigTimeoutTime_AGSM" SG_ 498 EVSE_FreeService 0;
BA_ "GenSigTimeoutTime_SGW" SG_ 498 EVSE_FreeService 0;
BA_ "GenSigTimeoutTime_PBWM" SG_ 498 EVSE_FreeService 0;
BA_ "GenSigTimeoutTime_IDCM" SG_ 498 EVSE_FreeService 0;
BA_ "GenSigTimeoutTime_ECM" SG_ 498 EVSE_FreeService 0;
BA_ "GenSigTimeoutTime_SGW" SG_ 498 HVCMS_EVSEProcessing 0;
BA_ "GenSigTimeoutTime_PBWM" SG_ 498 HVCMS_EVSEProcessing 0;
BA_ "GenSigTimeoutTime_IDCM" SG_ 498 HVCMS_EVSEProcessing 0;
BA_ "GenSigTimeoutTime_ECM" SG_ 498 HVCMS_EVSEProcessing 0;
BA_ "GenSigTimeoutTime_DMPI" SG_ 498 HVCMS_EVSEProcessing 0;
BA_ "GenSigTimeoutTime_BPCM" SG_ 498 HVCMS_EVSEProcessing 0;
BA_ "GenSigTimeoutTime_AGSM" SG_ 498 HVCMS_EVSEProcessing 0;
BA_ "GenSigStartValue" SG_ 498 HVCMS_EVSEVoltageLimitAchieved 2;
BA_ "GenSigTimeoutTime_SGW" SG_ 498 HVCMS_EVSEPowerLimitAchieved 0;
BA_ "GenSigTimeoutTime_PBWM" SG_ 498 HVCMS_EVSEPowerLimitAchieved 0;
BA_ "GenSigTimeoutTime_IDCM" SG_ 498 HVCMS_EVSEPowerLimitAchieved 0;
BA_ "GenSigTimeoutTime_ECM" SG_ 498 HVCMS_EVSEPowerLimitAchieved 0;
BA_ "GenSigTimeoutTime_DMPI" SG_ 498 HVCMS_EVSEPowerLimitAchieved 0;
BA_ "GenSigTimeoutTime_BPCM" SG_ 498 HVCMS_EVSEPowerLimitAchieved 0;
BA_ "GenSigTimeoutTime_AGSM" SG_ 498 HVCMS_EVSEPowerLimitAchieved 0;
BA_ "GenSigStartValue" SG_ 498 HVCMS_EVSEPowerLimitAchieved 2;
BA_ "GenSigTimeoutTime_SGW" SG_ 498 HVCMS_EVSEMaximumVoltageLimit 0;
BA_ "GenSigTimeoutTime_PBWM" SG_ 498 HVCMS_EVSEMaximumVoltageLimit 0;
BA_ "GenSigTimeoutTime_IDCM" SG_ 498 HVCMS_EVSEMaximumVoltageLimit 0;
BA_ "GenSigTimeoutTime_ECM" SG_ 498 HVCMS_EVSEMaximumVoltageLimit 0;
BA_ "GenSigTimeoutTime_DMPI" SG_ 498 HVCMS_EVSEMaximumVoltageLimit 0;
BA_ "GenSigTimeoutTime_BPCM" SG_ 498 HVCMS_EVSEMaximumVoltageLimit 0;
BA_ "GenSigTimeoutTime_AGSM" SG_ 498 HVCMS_EVSEMaximumVoltageLimit 0;
BA_ "GenSigTimeoutTime_SGW" SG_ 498 HVCMS_EVSEMinimumVoltageLimit 0;
BA_ "GenSigTimeoutTime_PBWM" SG_ 498 HVCMS_EVSEMinimumVoltageLimit 0;
BA_ "GenSigTimeoutTime_IDCM" SG_ 498 HVCMS_EVSEMinimumVoltageLimit 0;
BA_ "GenSigTimeoutTime_ECM" SG_ 498 HVCMS_EVSEMinimumVoltageLimit 0;
BA_ "GenSigTimeoutTime_DMPI" SG_ 498 HVCMS_EVSEMinimumVoltageLimit 0;
BA_ "GenSigTimeoutTime_BPCM" SG_ 498 HVCMS_EVSEMinimumVoltageLimit 0;
BA_ "GenSigTimeoutTime_AGSM" SG_ 498 HVCMS_EVSEMinimumVoltageLimit 0;
BA_ "GenSigTimeoutTime_SGW" SG_ 498 HVCMS_EVSECurrentLimitAchieved 0;
BA_ "GenSigTimeoutTime_PBWM" SG_ 498 HVCMS_EVSECurrentLimitAchieved 0;
BA_ "GenSigTimeoutTime_IDCM" SG_ 498 HVCMS_EVSECurrentLimitAchieved 0;
BA_ "GenSigTimeoutTime_ECM" SG_ 498 HVCMS_EVSECurrentLimitAchieved 0;
BA_ "GenSigTimeoutTime_DMPI" SG_ 498 HVCMS_EVSECurrentLimitAchieved 0;
BA_ "GenSigTimeoutTime_BPCM" SG_ 498 HVCMS_EVSECurrentLimitAchieved 0;
BA_ "GenSigTimeoutTime_AGSM" SG_ 498 HVCMS_EVSECurrentLimitAchieved 0;
BA_ "GenSigStartValue" SG_ 498 HVCMS_EVSECurrentLimitAchieved 2;
BA_ "GenSigTimeoutTime_SGW" SG_ 498 DC_Isolation_Disable_Cmd 0;
BA_ "GenSigTimeoutTime_PBWM" SG_ 498 DC_Isolation_Disable_Cmd 0;
BA_ "GenSigTimeoutTime_IDCM" SG_ 498 DC_Isolation_Disable_Cmd 0;
BA_ "GenSigTimeoutTime_ECM" SG_ 498 DC_Isolation_Disable_Cmd 0;
BA_ "GenSigTimeoutTime_DMPI" SG_ 498 DC_Isolation_Disable_Cmd 0;
BA_ "GenSigTimeoutTime_BPCM" SG_ 498 DC_Isolation_Disable_Cmd 0;
BA_ "GenSigTimeoutTime_AGSM" SG_ 498 DC_Isolation_Disable_Cmd 0;
BA_ "GenSigTimeoutTime_SGW" SG_ 498 DC_TimeOut 0;
BA_ "GenSigTimeoutTime_PBWM" SG_ 498 DC_TimeOut 0;
BA_ "GenSigTimeoutTime_IDCM" SG_ 498 DC_TimeOut 0;
BA_ "GenSigTimeoutTime_ECM" SG_ 498 DC_TimeOut 0;
BA_ "GenSigTimeoutTime_DMPI" SG_ 498 DC_TimeOut 0;
BA_ "GenSigTimeoutTime_BPCM" SG_ 498 DC_TimeOut 0;
BA_ "GenSigTimeoutTime_AGSM" SG_ 498 DC_TimeOut 0;
BA_ "GenSigTimeoutTime_SGW" SG_ 498 EVSE_Accepted_Protocol 0;
BA_ "GenSigTimeoutTime_PBWM" SG_ 498 EVSE_Accepted_Protocol 0;
BA_ "GenSigTimeoutTime_IDCM" SG_ 498 EVSE_Accepted_Protocol 0;
BA_ "GenSigTimeoutTime_ECM" SG_ 498 EVSE_Accepted_Protocol 0;
BA_ "GenSigTimeoutTime_DMPI" SG_ 498 EVSE_Accepted_Protocol 0;
BA_ "GenSigTimeoutTime_BPCM" SG_ 498 EVSE_Accepted_Protocol 0;
BA_ "GenSigTimeoutTime_AGSM" SG_ 498 EVSE_Accepted_Protocol 0;
BA_ "GenSigTimeoutTime_SGW" SG_ 498 EVSE_IsolationSts 0;
BA_ "GenSigTimeoutTime_PBWM" SG_ 498 EVSE_IsolationSts 0;
BA_ "GenSigTimeoutTime_IDCM" SG_ 498 EVSE_IsolationSts 0;
BA_ "GenSigTimeoutTime_ECM" SG_ 498 EVSE_IsolationSts 0;
BA_ "GenSigTimeoutTime_DMPI" SG_ 498 EVSE_IsolationSts 0;
BA_ "GenSigTimeoutTime_BPCM" SG_ 498 EVSE_IsolationSts 0;
BA_ "GenSigTimeoutTime_AGSM" SG_ 498 EVSE_IsolationSts 0;
BA_ "GenSigTimeoutTime_SGW" SG_ 498 HVCMS_EnergyToBeDelivered 0;
BA_ "GenSigTimeoutTime_PBWM" SG_ 498 HVCMS_EnergyToBeDelivered 0;
BA_ "GenSigTimeoutTime_IDCM" SG_ 498 HVCMS_EnergyToBeDelivered 0;
BA_ "GenSigTimeoutTime_ECM" SG_ 498 HVCMS_EnergyToBeDelivered 0;
BA_ "GenSigTimeoutTime_DMPI" SG_ 498 HVCMS_EnergyToBeDelivered 0;
BA_ "GenSigTimeoutTime_BPCM" SG_ 498 HVCMS_EnergyToBeDelivered 0;
BA_ "GenSigTimeoutTime_AGSM" SG_ 498 HVCMS_EnergyToBeDelivered 0;
BA_ "GenSigTimeoutTime_SGW" SG_ 498 HVCMS_EVSECurrRegulationTol 0;
BA_ "GenSigTimeoutTime_PBWM" SG_ 498 HVCMS_EVSECurrRegulationTol 0;
BA_ "GenSigTimeoutTime_IDCM" SG_ 498 HVCMS_EVSECurrRegulationTol 0;
BA_ "GenSigTimeoutTime_ECM" SG_ 498 HVCMS_EVSECurrRegulationTol 0;
BA_ "GenSigTimeoutTime_DMPI" SG_ 498 HVCMS_EVSECurrRegulationTol 0;
BA_ "GenSigTimeoutTime_BPCM" SG_ 498 HVCMS_EVSECurrRegulationTol 0;
BA_ "GenSigTimeoutTime_AGSM" SG_ 498 HVCMS_EVSECurrRegulationTol 0;
BA_ "GenSigStartValue" SG_ 498 HVCMS_EVSECurrRegulationTol 500;
BA_ "GenSigTimeoutTime_SGW" SG_ 498 HVCMS_EVSEMaxCurrentLimit 0;
BA_ "GenSigTimeoutTime_PBWM" SG_ 498 HVCMS_EVSEMaxCurrentLimit 0;
BA_ "GenSigTimeoutTime_IDCM" SG_ 498 HVCMS_EVSEMaxCurrentLimit 0;
BA_ "GenSigTimeoutTime_ECM" SG_ 498 HVCMS_EVSEMaxCurrentLimit 0;
BA_ "GenSigTimeoutTime_DMPI" SG_ 498 HVCMS_EVSEMaxCurrentLimit 0;
BA_ "GenSigTimeoutTime_BPCM" SG_ 498 HVCMS_EVSEMaxCurrentLimit 0;
BA_ "GenSigTimeoutTime_AGSM" SG_ 498 HVCMS_EVSEMaxCurrentLimit 0;
BA_ "GenSigTimeoutTime_SGW" SG_ 498 HVCMS_EVSEMaxPowerLimit 0;
BA_ "GenSigTimeoutTime_PBWM" SG_ 498 HVCMS_EVSEMaxPowerLimit 0;
BA_ "GenSigTimeoutTime_IDCM" SG_ 498 HVCMS_EVSEMaxPowerLimit 0;
BA_ "GenSigTimeoutTime_ECM" SG_ 498 HVCMS_EVSEMaxPowerLimit 0;
BA_ "GenSigTimeoutTime_DMPI" SG_ 498 HVCMS_EVSEMaxPowerLimit 0;
BA_ "GenSigTimeoutTime_BPCM" SG_ 498 HVCMS_EVSEMaxPowerLimit 0;
BA_ "GenSigTimeoutTime_AGSM" SG_ 498 HVCMS_EVSEMaxPowerLimit 0;
BA_ "GenSigTimeoutTime_SGW" SG_ 498 HVCMS_EVSEMinCurrentLimit 0;
BA_ "GenSigTimeoutTime_PBWM" SG_ 498 HVCMS_EVSEMinCurrentLimit 0;
BA_ "GenSigTimeoutTime_IDCM" SG_ 498 HVCMS_EVSEMinCurrentLimit 0;
BA_ "GenSigTimeoutTime_ECM" SG_ 498 HVCMS_EVSEMinCurrentLimit 0;
BA_ "GenSigTimeoutTime_DMPI" SG_ 498 HVCMS_EVSEMinCurrentLimit 0;
BA_ "GenSigTimeoutTime_BPCM" SG_ 498 HVCMS_EVSEMinCurrentLimit 0;
BA_ "GenSigTimeoutTime_AGSM" SG_ 498 HVCMS_EVSEMinCurrentLimit 0;
BA_ "GenSigTimeoutTime_SGW" SG_ 498 HVCMS_EVSEPeakCurrentRipple 0;
BA_ "GenSigTimeoutTime_PBWM" SG_ 498 HVCMS_EVSEPeakCurrentRipple 0;
BA_ "GenSigTimeoutTime_IDCM" SG_ 498 HVCMS_EVSEPeakCurrentRipple 0;
BA_ "GenSigTimeoutTime_ECM" SG_ 498 HVCMS_EVSEPeakCurrentRipple 0;
BA_ "GenSigTimeoutTime_DMPI" SG_ 498 HVCMS_EVSEPeakCurrentRipple 0;
BA_ "GenSigTimeoutTime_BPCM" SG_ 498 HVCMS_EVSEPeakCurrentRipple 0;
BA_ "GenSigTimeoutTime_AGSM" SG_ 498 HVCMS_EVSEPeakCurrentRipple 0;
BA_ "GenSigStartValue" SG_ 498 HVCMS_EVSEPeakCurrentRipple 500;
BA_ "GenSigTimeoutTime_SGW" SG_ 498 HVCMS_EVSEPresentVoltage 0;
BA_ "GenSigTimeoutTime_PBWM" SG_ 498 HVCMS_EVSEPresentVoltage 0;
BA_ "GenSigTimeoutTime_IDCM" SG_ 498 HVCMS_EVSEPresentVoltage 0;
BA_ "GenSigTimeoutTime_ECM" SG_ 498 HVCMS_EVSEPresentVoltage 0;
BA_ "GenSigTimeoutTime_DMPI" SG_ 498 HVCMS_EVSEPresentVoltage 0;
BA_ "GenSigTimeoutTime_BPCM" SG_ 498 HVCMS_EVSEPresentVoltage 0;
BA_ "GenSigTimeoutTime_AGSM" SG_ 498 HVCMS_EVSEPresentVoltage 0;
BA_ "GenSigTimeoutTime_SGW" SG_ 498 EVSE_OfferedEnergyTransferType 0;
BA_ "GenSigTimeoutTime_PBWM" SG_ 498 EVSE_OfferedEnergyTransferType 0;
BA_ "GenSigTimeoutTime_IDCM" SG_ 498 EVSE_OfferedEnergyTransferType 0;
BA_ "GenSigTimeoutTime_ECM" SG_ 498 EVSE_OfferedEnergyTransferType 0;
BA_ "GenSigTimeoutTime_DMPI" SG_ 498 EVSE_OfferedEnergyTransferType 0;
BA_ "GenSigTimeoutTime_BPCM" SG_ 498 EVSE_OfferedEnergyTransferType 0;
BA_ "GenSigTimeoutTime_AGSM" SG_ 498 EVSE_OfferedEnergyTransferType 0;
BA_ "GenSigTimeoutTime_SGW" SG_ 498 HVCMS_EVSEPresentCurrent 0;
BA_ "GenSigTimeoutTime_PBWM" SG_ 498 HVCMS_EVSEPresentCurrent 0;
BA_ "GenSigTimeoutTime_IDCM" SG_ 498 HVCMS_EVSEPresentCurrent 0;
BA_ "GenSigTimeoutTime_ECM" SG_ 498 HVCMS_EVSEPresentCurrent 0;
BA_ "GenSigTimeoutTime_DMPI" SG_ 498 HVCMS_EVSEPresentCurrent 0;
BA_ "GenSigTimeoutTime_BPCM" SG_ 498 HVCMS_EVSEPresentCurrent 0;
BA_ "GenSigTimeoutTime_AGSM" SG_ 498 HVCMS_EVSEPresentCurrent 0;
BA_ "GenSigTimeoutTime_SGW" SG_ 498 EVSE_Notification 0;
BA_ "GenSigTimeoutTime_PBWM" SG_ 498 EVSE_Notification 0;
BA_ "GenSigTimeoutTime_IDCM" SG_ 498 EVSE_Notification 0;
BA_ "GenSigTimeoutTime_ECM" SG_ 498 EVSE_Notification 0;
BA_ "GenSigTimeoutTime_DMPI" SG_ 498 EVSE_Notification 0;
BA_ "GenSigTimeoutTime_BPCM" SG_ 498 EVSE_Notification 0;
BA_ "GenSigTimeoutTime_AGSM" SG_ 498 EVSE_Notification 0;
BA_ "GenSigTimeoutTime_SGW" SG_ 498 EVSE_Supported_ISO1 0;
BA_ "GenSigTimeoutTime_PBWM" SG_ 498 EVSE_Supported_ISO1 0;
BA_ "GenSigTimeoutTime_IDCM" SG_ 498 EVSE_Supported_ISO1 0;
BA_ "GenSigTimeoutTime_ECM" SG_ 498 EVSE_Supported_ISO1 0;
BA_ "GenSigTimeoutTime_DMPI" SG_ 498 EVSE_Supported_ISO1 0;
BA_ "GenSigTimeoutTime_BPCM" SG_ 498 EVSE_Supported_ISO1 0;
BA_ "GenSigTimeoutTime_AGSM" SG_ 498 EVSE_Supported_ISO1 0;
BA_ "GenSigTimeoutTime_SGW" SG_ 498 CRC_OBCM_VDCM 0;
BA_ "GenSigTimeoutTime_PBWM" SG_ 498 CRC_OBCM_VDCM 0;
BA_ "GenSigTimeoutTime_IDCM" SG_ 498 CRC_OBCM_VDCM 0;
BA_ "GenSigTimeoutTime_ECM" SG_ 498 CRC_OBCM_VDCM 0;
BA_ "GenSigTimeoutTime_SGW" SG_ 498 EVSE_Supported_DIN 0;
BA_ "GenSigTimeoutTime_PBWM" SG_ 498 EVSE_Supported_DIN 0;
BA_ "GenSigTimeoutTime_IDCM" SG_ 498 EVSE_Supported_DIN 0;
BA_ "GenSigTimeoutTime_ECM" SG_ 498 EVSE_Supported_DIN 0;
BA_ "GenSigTimeoutTime_DMPI" SG_ 498 EVSE_Supported_DIN 0;
BA_ "GenSigTimeoutTime_BPCM" SG_ 498 EVSE_Supported_DIN 0;
BA_ "GenSigTimeoutTime_AGSM" SG_ 498 EVSE_Supported_DIN 0;
BA_ "GenSigTimeoutTime_SGW" SG_ 498 EVSE_Service2_Certificate 0;
BA_ "GenSigTimeoutTime_PBWM" SG_ 498 EVSE_Service2_Certificate 0;
BA_ "GenSigTimeoutTime_IDCM" SG_ 498 EVSE_Service2_Certificate 0;
BA_ "GenSigTimeoutTime_ECM" SG_ 498 EVSE_Service2_Certificate 0;
BA_ "GenSigTimeoutTime_DMPI" SG_ 498 EVSE_Service2_Certificate 0;
BA_ "GenSigTimeoutTime_BPCM" SG_ 498 EVSE_Service2_Certificate 0;
BA_ "GenSigTimeoutTime_AGSM" SG_ 498 EVSE_Service2_Certificate 0;
BA_ "GenSigTimeoutTime_SGW" SG_ 498 EVSE_OfferedPaymentContract 0;
BA_ "GenSigTimeoutTime_PBWM" SG_ 498 EVSE_OfferedPaymentContract 0;
BA_ "GenSigTimeoutTime_IDCM" SG_ 498 EVSE_OfferedPaymentContract 0;
BA_ "GenSigTimeoutTime_ECM" SG_ 498 EVSE_OfferedPaymentContract 0;
BA_ "GenSigTimeoutTime_DMPI" SG_ 498 EVSE_OfferedPaymentContract 0;
BA_ "GenSigTimeoutTime_BPCM" SG_ 498 EVSE_OfferedPaymentContract 0;
BA_ "GenSigTimeoutTime_AGSM" SG_ 498 EVSE_OfferedPaymentContract 0;
BA_ "GenSigTimeoutTime_SGW" SG_ 498 EVSE_OfferedPaymentEIM 0;
BA_ "GenSigTimeoutTime_PBWM" SG_ 498 EVSE_OfferedPaymentEIM 0;
BA_ "GenSigTimeoutTime_IDCM" SG_ 498 EVSE_OfferedPaymentEIM 0;
BA_ "GenSigTimeoutTime_ECM" SG_ 498 EVSE_OfferedPaymentEIM 0;
BA_ "GenSigTimeoutTime_DMPI" SG_ 498 EVSE_OfferedPaymentEIM 0;
BA_ "GenSigTimeoutTime_BPCM" SG_ 498 EVSE_OfferedPaymentEIM 0;
BA_ "GenSigTimeoutTime_AGSM" SG_ 498 EVSE_OfferedPaymentEIM 0;
BA_ "GenSigTimeoutTime_DMPI" SG_ 498 CRC_OBCM_VDCM 0;
BA_ "GenSigTimeoutTime_BPCM" SG_ 498 CRC_OBCM_VDCM 0;
BA_ "GenSigTimeoutTime_AGSM" SG_ 498 CRC_OBCM_VDCM 0;
BA_ "GenSigTimeoutTime_SGW" SG_ 1062 MCPA_Rotor_Temperature 0;
BA_ "GenSigTimeoutTime_PBWM" SG_ 1062 MCPA_Temp 0;
BA_ "GenSigTimeoutTime_IDCM" SG_ 1062 MCPA_Temp 0;
BA_ "GenSigTimeoutTime_ECM" SG_ 1062 MCPA_Temp 0;
BA_ "GenSigTimeoutTime_DMPI" SG_ 1062 MCPA_Temp 0;
BA_ "GenSigTimeoutTime_BPCM" SG_ 1062 MCPA_Temp 0;
BA_ "GenSigTimeoutTime_AGSM" SG_ 1062 MCPA_Temp 0;
BA_ "GenSigStartValue" SG_ 1062 MCPA_Temp 40;
BA_ "GenSigTimeoutTime_SGW" SG_ 1454 MCPB_Service_Lamp_Request 0;
BA_ "GenSigTimeoutTime_PBWM" SG_ 1454 MCPB_Service_Lamp_Request 0;
BA_ "GenSigTimeoutTime_IDCM" SG_ 1454 MCPB_Service_Lamp_Request 0;
BA_ "GenSigTimeoutTime_ECM" SG_ 1454 MCPB_Service_Lamp_Request 0;
BA_ "GenSigTimeoutTime_DMPI" SG_ 1454 MCPB_Service_Lamp_Request 0;
BA_ "GenSigTimeoutTime_BPCM" SG_ 1454 MCPB_Service_Lamp_Request 0;
BA_ "GenSigTimeoutTime_AGSM" SG_ 1454 MCPB_Service_Lamp_Request 0;
VAL_ 502 HVCMS_ServiceScope 65535 "SNA";
VAL_ 502 HVCMS_ReadyToChargeState 0 "Not_Ready" 1 "Ready";
VAL_ 502 HVCMS_Protocol_Entry3 65535 "SNA";
VAL_ 502 HVCMS_Protocol_Entry2 65535 "SNA";
VAL_ 502 HVCMS_Protocol_Entry1 65535 "SNA";
VAL_ 502 HVCMS_EVTargetVoltage 16383 "SNA";
VAL_ 502 HVCMS_EVTargetCurrent 1023 "SNA";
VAL_ 502 HVCMS_EVRESS_SOC 4095 "SNA";
VAL_ 502 HVCMS_EVReady 0 "Not_Ready" 1 "Ready";
VAL_ 502 HVCMS_EVMax_V_Limit 16383 "SNA";
VAL_ 502 HVCMS_EVMax_P_Limit 16777215 "SNA";
VAL_ 502 HVCMS_EVMax_I_Limit 1023 "SNA";
VAL_ 502 HVCMS_EVEnergyCapacity 131071 "SNA";
VAL_ 502 HVCMS_ChargingComplete 0 "Not_Completed" 1 "Completed";
VAL_ 502 HVCMS_BulkChargingComplete 0 "Not_Completed" 1 "Completed";
VAL_ 498 HVCMS_EVSEPresentVoltage 16383 "SNA";
VAL_ 498 HVCMS_EVSEPeakCurrentRipple 1023 "SNA";
VAL_ 498 HVCMS_EVSEMinCurrentLimit 1023 "SNA";
VAL_ 498 HVCMS_EVSEMaxPowerLimit 16777215 "SNA";
VAL_ 498 HVCMS_EVSEMaxCurrentLimit 1023 "SNA";
VAL_ 498 HVCMS_EVSECurrRegulationTol 1023 "SNA";
VAL_ 498 HVCMS_EnergyToBeDelivered 131071 "SNA";
VAL_ 498 EVSE_IsolationSts 0 "GFD_Not_Performed" 1 "GFD_Ok" 2 "GFD_Fail" 3 "GFD_Invalid" 4 "GFD_Warning" 7 "SNA";
VAL_ 498 DC_TimeOut 0 "FALSE" 1 "TRUE";
VAL_ 498 DC_Isolation_Disable_Cmd 0 "FALSE" 1 "TRUE";
VAL_ 244 BMS_HV_Current 32767 "SNA";
VAL_ 244 BMS_HV_Battery_GFD_Sts 0 "GFD_Not_Performed" 1 "GFD_OK" 2 "GFD_Fail" 3 "GFD_INVALID_meas_noise" 4 "Disabled";
VAL_ 500 BMS_HV_NumCellMinTemp 511 "SNA";
VAL_ 500 BMS_HV_NumCellMaxTemp 511 "SNA";
VAL_ 500 BMS_Cell_Volt_Min 8191 "SNA";
VAL_ 500 BMS_Cell_Volt_Max 8191 "SNA";
VAL_ 250 APM_Water_Temp 255 "SNA";
VAL_ 250 APM_RecoveryAction 1 "APM_Not_working" 2 "APM_safe_state" 3 "APM_safe_state_and_not_working" 4 "APM_voltage_control_mode" 5 "APM_wake_up_loss" 6 "APM_safe_state_and_voltage_control_mode" 8 "Wake_up_loss" 16 "Eeprom_loss";
VAL_ 250 APM_PSFB_Temp2 4095 "SNA";
VAL_ 250 APM_PSFB_Temp1 4095 "SNA";
VAL_ 250 APM_LV_V_Fbk 4095 "SNA";
VAL_ 250 APM_LV_I_Fbk 4095 "SNA";
VAL_ 250 APM_HV_V_Fbk 4095 "SNA";
VAL_ 250 APM_HV_I_Fbk 4095 "SNA";
VAL_ 250 APM_Buck_Temp 4095 "SNA";
VAL_ 546 VDCM_EV_Batt_Max_T_Limit 255 "SNA";
VAL_ 546 VDCM_ChrgMode_Req 0 "init" 1 "constant voltage charge" 2 "constant curent charge" 255 "SNA";
VAL_ 546 VDCM_ChrgCurrDeviationErr 0 "Charge Current  OK" 1 "Charge current in error";
VAL_ 546 VDCM_ChrgCompleteReason 0 "SOC_tgt_reached" 1 "Vcell_tgt_reached" 2 "Vbat_tgt_reached" 3 "User_req";
VAL_ 546 VDCM_BattUnderVolt 0 "Voltage OK" 1 "Battery Under Voltage";
VAL_ 546 VDCM_BattOverVolt 0 "Voltage OK" 1 "Battery Over Voltage";
VAL_ 546 VDCM_BattFullSOC_prc 255 "SNA";
VAL_ 546 CPIM_Over_Temperature 0 "Battery_OK" 1 "Over_temperature";
VAL_ 546 CPIM_Error 0 "CPIM_OK" 1 "CPIM_error";
VAL_ 502 VDCM_TypeCNegotiationSts 0 "Not_Requested" 1 "Ongoing" 2 "OK" 3 "Not_OK";
VAL_ 502 HVCMS_EVEnergyRequest 131071 "SNA";
VAL_ 544 Plug_Locked_by_EVSE 0 "EVSE_Not_Locked" 1 "EVSE_Locked" 2 "Init" 3 "SNA";
VAL_ 544 HVCMS_EVSEID 4294967295 "SNA";
VAL_ 544 ExtChargerSts 0 "Standby" 1 "Charging" 2 "Init" 3 "SNA";
VAL_ 544 EVSE_Error 0 "No_Error" 1 "Error" 2 "Init" 3 "SNA";
VAL_ 544 EVSE_ChrgStopControl 0 "No_Chrg_Stp_Cntrl" 1 "Chrg_Stop_Cntrl" 2 "Init" 3 "SNA";
VAL_ 544 Charger_WeldingDetectAvail 0 "Not_Available" 1 "Available" 2 "Init" 3 "SNA";
VAL_ 544 Charger_StndbyReqReason 0 "SetUpCond_Reached" 1 "BMS_Req" 2 "Charger_Fault" 3 "User_Req" 6 "Init" 7 "SNA";
VAL_ 544 Charger_StndbyReq 0 "Stnby_Not_Requested" 1 "Stnby_Requested" 2 "Init" 3 "SNA";
VAL_ 544 Charger_FaultStates 0 "NoFault" 1 "EmergencyShdwnFault" 2 "UnableToSupplyReqPower" 3 "OverTemperature" 4 "InnerOverTemperature" 5 "AbnormalVoltage" 6 "CurrentNotMatching" 7 "ConnectorFault" 8 "OtherFault" 14 "Init" 15 "SNA";
VAL_ 544 CC2VoltDetError 0 "Volt_Det_ok" 1 "Volt_Det_Error" 2 "Init" 3 "SNA";
VAL_ 498 OBCM_PLCTypeSts 0 "Not determinated" 1 "Basic signaling communication" 2 "HLC" 7 "SNA";
VAL_ 498 HVCMS_EVSEVoltageLimitAchieved 0 "No_limit_ach" 1 "Limit_ach" 2 "Init" 3 "SNA";
VAL_ 498 HVCMS_EVSEPowerLimitAchieved 0 "No_limit_ach" 1 "Limit_ach" 2 "Init" 3 "SNA";
VAL_ 498 HVCMS_EVSEMinimumVoltageLimit 65535 "SNA";
VAL_ 498 HVCMS_EVSEMaximumVoltageLimit 65535 "SNA";
VAL_ 498 HVCMS_EVSECurrentLimitAchieved 0 "No_limit_ach" 1 "Limit_ach" 2 "Init" 3 "SNA";
VAL_ 1790 BMS_HV_SOC_AccuracySts 0 "Invalid" 1 "High_Accuracy_SOC" 2 "Low_Accuracy_SOC" 3 "SNA";
VAL_ 105 PIMF_CoolantFlowVldty 0 "Valid" 1 "Not_Valid";
VAL_ 105 ClrLgsDiagInfo 0 "FALSE" 1 "TRUE";
VAL_ 546 WeldCheck_Complete 0 "FALSE" 1 "TRUE";
VAL_ 546 VDCM_SOCIsOOR 0 "Normal" 1 "Too_Low" 2 "Too High" 3 "SNA";
VAL_ 546 VDCM_ChargeCurrIsOOR 0 "Normal" 1 "Too_Low" 2 "Too High" 3 "SNA";
VAL_ 546 VDCM_CellVoltIsOOR 0 "Normal" 1 "Too_Low" 2 "Too High" 3 "SNA";
VAL_ 546 VDCM_BattTempIsOOR 0 "Normal" 1 "Too_Low" 2 "Too High" 3 "SNA";
VAL_ 546 ReadyToChargeState 0 "FALSE" 1 "TRUE";
VAL_ 546 HCP_SessionStopCmd 0 "FALSE" 1 "TRUE";
VAL_ 546 HCP_DC_Retry 0 "No_Rety_Command" 1 "SupportedAppProtocolReq" 2 "SessionSetupRrq" 3 "ServiceDiscoveryReq." 4 "ServicePaymentSelectionReq" 5 "Contract_AuthenticationReq" 6 "ChargeParameterDiscoveryReq" 7 "CableCheckReq" 8 "Pre_ChargeReq" 9 "PowerDeliveryReq_Precharge" 10 "CurrentDemandReq" 11 "PowerDeliveryReq_EnergyTransfer" 12 "WeldingDetectionReq" 13 "SessionStopReq" 31 "SNA";
VAL_ 546 BMS_Max_Pk_Volt_Allowed_VDCM 1023 "SNA";
VAL_ 546 BMS_Max_Cell_Volt_Allowed_Vldty 0 "Valid" 1 "Not_Valid";
VAL_ 546 BMS_Max_Cell_Volt_Allowed_VDCM 8191 "SNA";
VAL_ 546 BMS_HV_Trac_PreCha_Contac_Sts_V 0 "Open" 1 "Closed" 3 "Error_Stuck_Open" 4 "Error_Stuck_Closed" 7 "SNA";
VAL_ 546 BMS_HV_Trac_Main_Contac_Sts_VDCM 0 "Open" 1 "Closed" 3 "Error_Stuck_Open" 4 "Error_Stuck_Closed" 7 "SNA";
VAL_ 546 BMS_HV_Temperature_Min_VDCM 2047 "SNA";
VAL_ 546 BMS_HV_Temperature_Max_VDCM 2047 "SNA";
VAL_ 546 BMS_HV_SOC_AccuracySts_VDCM 0 "Invalid" 1 "High_Accuracy_SOC" 2 "Low_Accuracy_SOC" 3 "SNA";
VAL_ 546 BMS_HV_NumCellMinTemp_VDCM 511 "SNA";
VAL_ 546 BMS_HV_NumCellMaxVolt_VDCM 255 "SNA";
VAL_ 546 BMS_HV_NumCellMaxTemp_VDCM 511 "SNA";
VAL_ 546 BMS_HV_InternalVoltage_VDCM 8191 "SNA";
VAL_ 546 BMS_HV_Common_Contactor_Sts_VDCM 0 "Open" 1 "Closed" 2 "Error_Stuck_Open" 3 "Error_Stuck_Closed" 7 "SNA";
VAL_ 546 BMS_HV_Battery_GFD_Sts_VDCM 0 "GFD_Not_Performed" 1 "GFD_OK" 2 "GFD_Fail" 3 "GFD_INVALID_meas_noise";
VAL_ 546 BMS_HV_BatIntrlk_InternalStat_V 0 "Not_Performed" 1 "OK" 2 "Fail" 3 "Invalid";
VAL_ 546 BMS_HV_AC_Char_Main_Contac_Sts_ 0 "Open" 1 "Closed" 3 "Error_Stuck_Open" 4 "Error_Stuck_Closed" 7 "SNA";
VAL_ 546 BMS_Cell_Volt_Min_Vldty_VDCM 0 "Valid" 1 "Not_Valid";
VAL_ 546 BMS_Cell_Volt_Min_VDCM 8191 "SNA";
VAL_ 546 BMS_Cell_Volt_Max_Vldty_VDCM 0 "Valid" 1 "Not_Valid";
VAL_ 546 BMS_Cell_Volt_Max_VDCM 8191 "SNA";
VAL_ 502 OBCM_OutVoltageSyncTgt 1023 "SNA";
VAL_ 496 PlockFailSts 0 "Fault_Not_Present" 1 "Derating" 2 "Retrying" 3 "Non recoverable critical fault" 7 "SNA";
VAL_ 496 Plock_PosSensor 0 "Init" 1 "Unknown" 2 "Engaged" 3 "Between Engaged and Disengaged" 4 "Tooth to Tooth" 5 "Disengaged" 7 "SNA";
VAL_ 496 Plock_MotorPosSts 0 "Init" 1 "Unknown" 2 "Engaged Endstop" 3 "Engaged" 4 "Between Engaged and Disengaged" 5 "Disengaged" 6 "Disengaged Endstop" 7 "SNA";
VAL_ 544 OBCM_CSSts 0 "CS_IN" 1 "CS_OUT" 2 "CS_FAIL";
VAL_ 544 OBCM_CP3Sts 0 "Charge permission disabled" 1 "Charge permission enabled" 3 "HW_Fault";
VAL_ 544 OBCM_CP2Sts 0 "EVSE_not_ready" 1 "EVSE_ready" 2 "VOOR" 3 "HW_Fault";
VAL_ 544 OBCM_CCSts 0 "CC_LO" 1 "CC_OUT" 2 "CC_IN" 3 "CC_HI" 4 "CC_FAIL";
VAL_ 544 OBCM_APAMSts 0 "APAM_Off" 1 "APAM_On" 2 "HW_Failure";
VAL_ 498 HVCMS_EVSEPresentCurrent 65535 "SNA";
VAL_ 498 EVSE_OfferedEnergyTransferType 0 "NotAvailable" 1 "AC_single_phase_core" 2 "AC_three_phase_core" 3 "DC_core" 4 "DC_extended" 5 "DC_combo_core" 6 "DC_unique";
VAL_ 1454 MCPB_Service_Lamp_Request 0 "False" 1 "True";
VAL_ 1062 MCPA_Temp 255 "SNA";
VAL_ 1062 MCPA_Rotor_Temperature 255 "SNA";
VAL_ 1062 MCPA_Inverter_Temp 255 "SNA";
VAL_ 1062 CLrDiagInfo_MCPA 0 "False" 1 "True";
VAL_ 1444 MCPA_Service_Lamp_Request 0 "False" 1 "True";
VAL_ 1893 HVBatModuleTemp_66 255 "SNA";
VAL_ 1893 HVBatModuleTemp_65 255 "SNA";
VAL_ 1893 HVBatModuleTemp_64 255 "SNA";
VAL_ 1893 HVBatModuleTemp_63 255 "SNA";
VAL_ 1893 HVBatModuleTemp_62 255 "SNA";
VAL_ 1893 HVBatModuleTemp_61 255 "SNA";
VAL_ 1893 HVBatModuleTemp_60 255 "SNA";
VAL_ 1893 HVBatModuleTemp_59 255 "SNA";
VAL_ 1893 HVBatModuleTemp_58 255 "SNA";
VAL_ 1893 HVBatModuleTemp_57 255 "SNA";
VAL_ 1893 HVBatModuleTemp_56 255 "SNA";
VAL_ 1893 HVBatModuleTemp_55 255 "SNA";
VAL_ 1893 HVBatModuleTemp_54 255 "SNA";
VAL_ 1893 HVBatModuleTemp_41 255 "SNA";
VAL_ 1893 HVBatModuleTemp_40 255 "SNA";
VAL_ 1893 HVBatModuleTemp_39 255 "SNA";
VAL_ 1790 HEV_OnRq_BPCM 0 "FALSE" 1 "TRUE";
VAL_ 244 BMS_HV_Temperature_Min 2047 "SNA";
VAL_ 244 BMS_HV_Temperature_Max 2047 "SNA";
VAL_ 250 APM_UtilPctOfDCDC 127 "SNA";
VAL_ 250 APM_TempColdPlate 254 "Failure" 255 "SNA";
VAL_ 250 APM_OutputPower 1023 "SNA";
VAL_ 250 APM_InputPower 1023 "SNA";
VAL_ 250 APM_IdcHvSetPFdbk 1023 "SNA";
VAL_ 250 APM_HvVsetPFdbk 511 "SNA";
VAL_ 250 APM_FailureType 0 "No_failure" 1 "Failure_chargingInhibited" 2 "Failure_chargingAllowed" 3 "SNA";
VAL_ 250 APM_FailureReason 0 "No_Failure" 1 "Fail_high_voltage_at_HV" 2 "Fail_low_voltage_at_HV" 3 "Fail_high_voltage_at_LV" 4 "Fail_low_voltage_at_LV" 5 "Fail_high_PCB_temperature" 6 "Fail_high_DCB_temperature" 7 "Fail_high_cur_at_LV" 8 "Fail_high_cur_at_HV" 9 "Fail_short_circ_at_LV" 10 "Fail_short_circ_at_HV" 11 "Fail_open_circ_at_LV" 12 "Fail_open_circ_at_HV" 13 "Fail_init_failure" 14 "Fail_wake_up_issue" 15 "Fail_internal_hardware" 16 "Fail_bat_feed_low" 17 "Fail_bat_feed_high" 18 "Fail_Aux_OV" 19 "Fail_Aux_UV" 20 "Fail_HVIL_fault" 21 "Fail_LOC_with_HCP" 22 "Fail_LOC_with_BPCM" 23 "Fail_cont_not_closed" 24 "Fail_SBC_fault" 25 "Memory_Fail" 26 "Implausible_data_from_HCP" 27 "Implausible_data_from_BPCM" 28 "CAN_bus_off" 29 "Fail_temp_diff_is_high" 30 "Fail_high_voltage_diff_is_high" 31 "Fail_for_other_reason" 32 "LOC_ORC" 33 "Implausble_data_ORC" 63 "SNA";
VAL_ 250 APM_EstPwrLoss 255 "SNA";
VAL_ 250 APM_DeratingReason 0 "No_derating" 1 "high_temp_De_rating" 2 "low_temp_De_rating" 3 "OverVolt_HV_De_rating" 4 "lowVolt_HV_De_rating" 5 "highVolt_LV_De_rating" 6 "lowVolt_LV_De_rating" 7 "highCurrent_LV_Current_limit" 8 "internal_HD_fail_De_rating" 9 "high_current_HV_De_rating" 31 "SNA";
VAL_ 250 APM_DeratingModeStatus 0 "No_derating" 1 "Derating_Initialized" 2 "Derating_Initialized_Failure" 3 "Derating_Mode" 7 "SNA";
VAL_ 250 APM_CtrlSts_Fbk 0 "IDLE" 1 "Buck_CV_voltage" 2 "Buck_CC_current_control" 3 "APM_Temporary_Fault" 4 "Buck_Special" 6 "PreCharge" 7 "DisCharge" 8 "OFF" 9 "Derating" 10 "APM_Critical_Fault" 15 "SNA";
VAL_ 546 BMS_HV_Char_PreCha_Contac_Sts_V 0 "Open" 1 "Closed" 3 "Error_Stuck_Open" 4 "Error_Stuck_Closed" 7 "SNA";
VAL_ 546 BMS_HV_Char_Main_Contac_Sts_VDCM 0 "Open" 1 "Closed" 3 "Error_Stuck_Open" 4 "Error_Stuck_Closed" 7 "SNA";
VAL_ 546 BMS_HV_TractionBusVoltage_VDCM 1023 "SNA";
VAL_ 546 BMS_HV_Trac_Bus_Sts_VDCM 0 "OPEN" 1 "CLOSED" 2 "PRECHARGING" 3 "PRECHARGING FAILED" 4 "PRECHARGING INHIBITED" 7 "SNA";
VAL_ 546 BMS_HV_ChargingBusVoltage_VDCM 1023 "SNA";
VAL_ 546 BMS_HV_Char_Bus_Sts_VDCM 0 "OPEN" 1 "CLOSED" 2 "PRECHARGING" 3 "PRECHARGING FAILED" 4 "PRECHARGING INHIBITED" 7 "SNA";
VAL_ 546 BMS_HV_BatState_VDCM 0 "Sleep" 1 "Initialization" 2 "Idle" 3 "Bus_Acv_Deac" 5 "Ready_Main" 6 "Ready_Aux" 7 "Ready_Full" 10 "Deactivation" 13 "Powerlatch" 14 "Service_Mode" 15 "CRITICAL_ERROR";
VAL_ 546 BMS_HV_BatActualPower_VDCM 32767 "SNA";
VAL_ 544 TCP_Communication_Terminated 0 "FALSE" 1 "TRUE";
VAL_ 544 OBCM_CP1Sts 0 "NO_EVSE" 1 "CP_DET" 2 "VOOR" 3 "EVSE_NO_AC" 4 "HW_FAULT";
VAL_ 498 HVCMS_TxMessageStat 0 "NoRequest" 1 "SupportedAppProtocolReq" 2 "SessionSetupReq" 3 "ServiceDiscoveryReq" 4 "ServiceDetailReq" 5 "PaymentServiceSelectionReq" 6 "PaymentDetailsReq" 7 "AuthorizationReq" 8 "ChargeParameterDiscoveryReq" 9 "PowerDeliveryReq" 10 "CertificateUpdateReq" 11 "CertificateInstallationReq" 12 "SessionStopReq" 13 "MeteringReceiptReq" 14 "ChargingStatusReq" 15 "CableCheckReq" 16 "PreChargeReq" 17 "CurrentDemandReq" 18 "WeldingDetectionReq" 19 "Contract_AuthenticationReq" 20 "PowerDeliveryReq_Precharge" 21 "PowerDeliveryReq_EnergyTransfer" 22 "DC_BidirectionalControlReq" 23 "PowerDeliveryReq_Renegotiation" 24 "ChargeParameterDiscovery_Reneg" 31 "SNA";
VAL_ 498 HVCMS_ResponseCode 0 "OK" 1 "OK_CertificateExpiresSoon" 2 "OK_NewSessionEstablished" 3 "OK_OldSessionJoined" 4 "FAILED" 5 "FAILED_SequenceError" 6 "FAILED_SignatureError" 7 "FAILED_UnknownSession" 8 "FAILED_ServiceIDInvalid" 9 "FAILED_PaymentSelectionInvalid" 10 "FAILED_ServiceSelectionInvalid" 11 "FAILED_CertificateExpired" 12 "FAILED_NoCertificateAvailable" 13 "FAILED_CertChainError" 14 "FAILED_ContractCanceled" 15 "FAILED_ChallengeInvalid" 16 "FAILED_WrongEnergyTransferType" 17 "FAILED_WrongChargeParameter" 18 "FAILED_ChargingProfileInvalid" 19 "FAILED_TariffSelectionInvalid" 20 "FAILED_EVSEPresentVoltageToLow" 21 "FAILED_PowerDeliveryNotApplied" 22 "FAILED_MeteringSignatureNotValid" 23 "OK_SuccessfullNegotiation" 24 "OK_SucceedNegotiatnMinorDeviatn" 25 "Failed_NoNegotiation" 31 "SNA";
VAL_ 498 HVCMS_EVSEProcessing 0 "Ongoing" 1 "Finished";
VAL_ 498 EVSE_FreeService 0 "Paid_Service" 1 "Free_Service";
VAL_ 1893 HVBatModuleVoltage_NumMin 63 "SNA";
VAL_ 1893 HVBatModuleVoltage_NumMax 63 "SNA";
VAL_ 1893 HVBatModuleTemp_53 255 "SNA";
VAL_ 1893 HVBatModuleTemp_52 255 "SNA";
VAL_ 1893 HVBatModuleTemp_51 255 "SNA";
VAL_ 1893 HVBatModuleTemp_50 255 "SNA";
VAL_ 1893 HVBatModuleTemp_49 255 "SNA";
VAL_ 1893 HVBatModuleTemp_48 255 "SNA";
VAL_ 1893 HVBatModuleTemp_47 255 "SNA";
VAL_ 1893 HVBatModuleTemp_46 255 "SNA";
VAL_ 1893 HVBatModuleTemp_45 255 "SNA";
VAL_ 1893 HVBatModuleTemp_44 255 "SNA";
VAL_ 1893 HVBatModuleTemp_43 255 "SNA";
VAL_ 1893 HVBatModuleTemp_42 255 "SNA";
VAL_ 244 ImpactHardwireV 0 "Fail_Not_Present" 1 "Fail_Present";
VAL_ 244 ImpactHardwire 0 "Not_Actuate" 1 "Actuate";
VAL_ 502 HVCMS_ServiceCategory 0 "No_Service" 1 "EV_charging" 2 "Internet" 3 "VAS" 4 "BPT_Service" 5 "WPT_Service" 6 "ACDC_Service" 7 "Contract_Certificate" 8 "EVSEInformation" 15 "SNA";
VAL_ 502 HVCMS_SelectedPaymentOptn 0 "No payment selected" 1 "External Payment" 2 "Contract" 3 "SNA";
VAL_ 502 HVCMS_SelectedEnergyTransferType 0 "No_energy_transfer_type" 1 "AC_single_phase_core" 2 "AC_three_phase_core" 3 "DC_core" 4 "DC_Extended" 5 "DC_combo_core" 6 "DC_unique" 15 "SNA";
VAL_ 502 HVCMS_RemaningTimeToFullSOC 65535 "SNA";
VAL_ 502 HVCMS_RemaningTimeToBulkSOC 65535 "SNA";
VAL_ 502 HVCMS_EVErrorCode 0 "No_error" 1 "FAILED_RESSTTemperatureInhibit" 2 "FAILED_EVShiftPosition" 3 "FAILED_ChargerConnectorLockFault" 4 "FAILED_EVRESSMalfunction" 5 "FAILED_ChargingCurrentDifferential" 6 "FAILED_ChargingcurrentvoltageOutOfRange" 7 "Failed_InletHot" 8 "FAILED_ChargingSystemIncompatibility" 15 "SNA";
VAL_ 544 TxGBTMessageResponse 0 "EVSE_Not_Connected" 1 "CHM" 2 "CRM.BMS cant be recognized" 3 "CRM.BMS recognized" 4 "CML" 5 "CRO.Charger not ready" 6 "CRO.Charger ready" 7 "CCS" 8 "CST" 9 "CSD" 31 "SNA";
VAL_ 544 TxGBTMessageRequest 0 "EVSE_Not_Connected" 1 "BHM" 2 "BRM" 3 "BCP" 4 "BRO_BMS_Not_Ready" 5 "BRO_BMS_Ready" 6 "BCL" 7 "BCS" 8 "BSM" 9 "BST" 10 "BSD" 31 "SNA";
VAL_ 544 OBCM_Timeout 0 "False" 1 "True";
VAL_ 544 EVCC_FailureSts 0 "No_Failure" 1 "Failure";
VAL_ 544 CC2_VoltageValue 255 "SNA";
VAL_ 498 TxMessageResponse 0 "No_V2G_communication_initialized" 1 "SupportedAppProtocolRes" 2 "SessionSetupRes" 3 "ServiceDiscoveryRes" 4 "ServicePaymentSelectionRes" 5 "Contract_AuthenticationRes" 6 "ChargeParameterDiscoveryRes" 7 "CableCheckRes" 8 "Pre_chargeRes" 9 "PowerDeliveryRes_Precharge" 10 "CurrentDemandRes" 11 "PowerDeliveryRes_EnergyTransfer" 12 "WeldingDetectionRes" 13 "SessionStopRes" 14 "DC_BidirectionalControlRes" 15 "ServiceDetailRes" 16 "PaymentDetailsRes" 17 "AuthorizationRes" 18 "CertificateInstallationRes" 19 "CertificateUpdateRes" 20 "MeteringReceiptRes" 21 "PowerDeliveryReq_Renegotiation" 22 "ChargeParameterDiscovery_Reneg" 31 "SNA";
VAL_ 498 HVCMS_EVSEStatusCode 0 "Charger_standby not ready" 1 "Charger ready charging" 2 "Charger prepaid limits exceeded" 3 "Charger shutdown" 4 "Utility interrupt event" 5 "Isolation monitoring internal" 6 "Isolation monitoring active" 7 "Charger emergency shutdown" 8 "Reserved" 9 "Reserved" 10 "Reserved" 11 "Reserved" 12 "Reserved" 13 "Charging system incompatibility" 14 "Charger malfunction" 15 "No_Data";
VAL_ 498 EVSE_OfferedService 0 "None" 1 "AC_DC_Charging" 2 "Certificate" 3 "InternetAccess" 4 "UseCaseInformation" 5 "Other";
VAL_ 498 EVSE_OfferedPaymentOptn 0 "No payment selected" 1 "External Payment" 2 "Contract" 3 "SNA";
VAL_ 546 VDCM_ChargingPermitting 0 "Forbidden" 1 "Permissive";
VAL_ 546 GBT_Target_Voltage_Reached 0 "Not_Reached" 1 "Reached" 2 "SNA";
VAL_ 546 GBT_Target_Cell_Voltage_Reached 0 "Not_Reached" 1 "Reached" 2 "SNA";
VAL_ 546 GBT_Ready_to_Charge 0 "False" 1 "True";
VAL_ 546 GBT_Desired_SOC_Reached 0 "Not_Reached" 1 "Reached" 2 "SNA";
VAL_ 546 GBT_Charger_Active_Interruption 0 "No_Charger_Interruption" 1 "Charger_Interruption" 2 "SNA";
VAL_ 544 GBT_EVSE_Charge_Permitting 0 "Pause" 1 "Permissive";
VAL_ 250 APM_DeratingPower 63 "SNA";
VAL_ 496 Plock_fdbk_sts 0 "Init" 1 "Engaging" 2 "Engaged" 3 "Disengaging" 4 "Disengaged" 5 "Fault" 7 "SNA";
VAL_ 1062 MCPA_ROL_STATUS 0 "Not_Learned" 1 "Standby" 2 "Exe" 3 "FBend" 4 "End" 5 "OFF";
VAL_ 498 EVSE_Supported_ISO1 0 "FALSE" 1 "TRUE";
VAL_ 498 EVSE_Supported_DIN 0 "FALSE" 1 "TRUE";
VAL_ 1062 MCPA_ROL_Request 0 "No_Request" 1 "ROL_Request";
VAL_ 498 EVSE_Service2_Certificate 0 "Not_Available" 1 "Available";
VAL_ 498 EVSE_OfferedPaymentEIM 0 "FALSE" 1 "TRUE";
VAL_ 498 EVSE_OfferedPaymentContract 0 "FALSE" 1 "TRUE";
VAL_ 498 EVSE_Notification 0 "None" 1 "StopCharging" 2 "ReNegotiation";
VAL_ 546 SelectedSecurityProtocol 0 "No_TLS" 1 "TLS";
VAL_ 546 SelectedAppProtocol 0 "DIN" 1 "ISO_Gen1";
VAL_ 498 ReceiptRequired 0 "FALSE" 1 "TRUE";
VAL_ 544 CdM_ExtFun_Reset_Max_Time 0 "enable" 1 "disable";
VAL_ 544 CdM_ExtFun_Relia_Design 0 "NOT_CAPABLE" 1 "CAPABLE";
VAL_ 544 CdM_ExtFun_Over_Temp_Trotec_Conn 0 "NOT_COMPATIBLE" 1 "COMPATIBLE";
VAL_ 544 CdM_ExtFun_Oper_Cond 0 "Ext_I_is_less_or_same_as_rated_I" 1 "Ext_I_exceeds_rated_I_of_cable";
VAL_ 544 CdM_ExtFun_Cur_Lim_Conn 0 "NOT_COMPATIBLE" 1 "COMPATIBLE";
VAL_ 544 CdM_ExtFun_Cur_Lim_Cable 0 "NOT_COMPATIBLE" 1 "COMPATIBLE";
VAL_ 544 CdM_ExtFun_Cool_Func_Conn 0 "NOT_COMPATIBLE" 1 "COMPATIBLE";
VAL_ 544 CdM_ExtFun_Cool_Func_Cable 0 "NOT_COMPATIBLE" 1 "COMPATIBLE";
VAL_ 544 CdM_ExtFun_Chr_Dyn_Control_Comp 0 "No_dyn_cntrl_of_extd_function" 1 "Dyn_cntrl_of_extd_function";
VAL_ 544 CdM_ExtFun_Char_HC_Control_Comp 0 "High_current_cntrl_not_applied" 1 "High_current_cntrl_is_applied";
SIG_GROUP_ 546 VDCM_OBCM2_Pkt 1 : VDCM_MaxChrgTime_sec VDCM_MaxChrgTime_min VDCM_EV_Batt_Max_T_Limit VDCM_EstChrgTime_min VDCM_ChrgMode_Req VDCM_ChrgCurrDeviationErr VDCM_ChrgCompleteReason VDCM_BattUnderVolt VDCM_BattOverVolt VDCM_BattFullSOC_prc CPIM_Over_Temperature CPIM_Error WeldCheck_Complete VDCM_SOCIsOOR VDCM_ChargeCurrIsOOR VDCM_CellVoltIsOOR VDCM_BattTempIsOOR ReadyToChargeState HCP_SessionStopCmd HCP_DC_Retry DCChrg_BatSideCurrent_VDCM BMS_Max_Pk_Volt_Allowed_VDCM BMS_Max_Cell_Volt_Allowed_Vldty BMS_Max_Cell_Volt_Allowed_VDCM BMS_HV_Trac_PreCha_Contac_Sts_V BMS_HV_Trac_Main_Contac_Sts_VDCM BMS_HV_Temperature_Min_VDCM BMS_HV_Temperature_Max_VDCM BMS_HV_SOC_AccuracySts_VDCM BMS_HV_NumCellMinTemp_VDCM BMS_HV_NumCellMaxVolt_VDCM BMS_HV_NumCellMaxTemp_VDCM BMS_HV_Low_Temp_Thrsh_VDCM BMS_HV_InternalVoltage_VDCM BMS_HV_High_Temp_Thrsh_VDCM BMS_HV_Common_Contactor_Sts_VDCM BMS_HV_Battery_GFD_Sts_VDCM BMS_HV_BatIntrlk_InternalStat_V BMS_HV_AC_Char_Main_Contac_Sts_ BMS_Cell_Volt_Min_Vldty_VDCM BMS_Cell_Volt_Min_VDCM BMS_Cell_Volt_Max_Vldty_VDCM BMS_Cell_Volt_Max_VDCM AC_Chrg_Branch_Voltage_VDCM BMS_HV_Char_PreCha_Contac_Sts_V BMS_HV_Char_Main_Contac_Sts_VDCM BMS_HV_TractionBusVoltage_VDCM BMS_HV_Trac_Bus_Sts_VDCM BMS_HV_ChargingBusVoltage_VDCM BMS_HV_Char_Bus_Sts_VDCM BMS_HV_BatState_VDCM BMS_HV_BatActualPower_VDCM VDCM_ChargingPermitting GBT_Target_Voltage_Reached GBT_Target_Cell_Voltage_Reached GBT_Ready_to_Charge GBT_Desired_SOC_Reached GBT_Charger_Active_Interruption MessageCounter_VO2 CRC_VO2 SelectedSecurityProtocol SelectedAppProtocol;
SIG_GROUP_ 498 OBCM_VDCM_Pkt 1 : HVCMS_EVSEPresentVoltage HVCMS_EVSEPeakCurrentRipple HVCMS_EVSEMinCurrentLimit HVCMS_EVSEMaxPowerLimit HVCMS_EVSEMaxCurrentLimit HVCMS_EVSECurrRegulationTol HVCMS_EnergyToBeDelivered EVSE_IsolationSts EVSE_Accepted_Protocol DC_TimeOut DC_Isolation_Disable_Cmd OBCM_PLCTypeSts HVCMS_EVSEVoltageLimitAchieved HVCMS_EVSEPowerLimitAchieved HVCMS_EVSEMinimumVoltageLimit HVCMS_EVSEMaximumVoltageLimit HVCMS_EVSECurrentLimitAchieved HVCMS_EVSEPresentCurrent EVSE_OfferedEnergyTransferType HVCMS_TxMessageStat HVCMS_ResponseCode HVCMS_EVSEProcessing EVSE_FreeService TxMessageResponse HVCMS_EVSEStatusCode EVSE_ServiceId EVSE_OfferedService EVSE_OfferedPaymentOptn MC_OBCM_VDCM EVSE_Supported_ISO1 EVSE_Supported_DIN CRC_OBCM_VDCM EVSE_Service2_Certificate EVSE_OfferedPaymentEIM EVSE_OfferedPaymentContract EVSE_Notification ReceiptRequired;
SIG_GROUP_ 244 BATTERY_HV_Pkt 1 : CRC_BHV1 MC_BHV1 BMS_HV_InternalVoltage BMS_HV_Current BMS_HV_Battery_GFD_Sts BMS_HV_Temperature_Min BMS_HV_Temperature_Max ImpactHardwireV ImpactHardwire;
SIG_GROUP_ 500 BATT_PACK_DEV_Pkt 1 : BMS_HV_NumCellMinTemp BMS_HV_NumCellMaxVolt BMS_HV_NumCellMaxTemp BMS_Cell_Volt_Min BMS_Cell_Volt_Max;
SIG_GROUP_ 250 APM_VDCM_Pkt 1 : APM_Water_Temp APM_RecoveryAction APM_PSFB_Temp2 APM_PSFB_Temp1 APM_LV_V_Fbk APM_LV_I_Fbk APM_HV_V_Fbk APM_HV_I_Fbk APM_Buck_Temp APM_UtilPctOfDCDC APM_TempColdPlate APM_PowerLimitMode APM_OutputPower APM_InputPower APM_IdcHvSetPFdbk APM_HvVsetPFdbk APM_HvOverVStatus APM_FailureType APM_FailureReason APM_EstPwrLoss APM_DeratingReason APM_DeratingModeStatus APM_CurrentLimitMode APM_CtrlSts_Fbk MessageCounter_APM_VDCM CRC_APM_VDCM APM_DeratingPower;
SIG_GROUP_ 496 PARK_DATA_Pkt 1 : MessageCounter_PARK_DATA CRC_PARK_DATA PlockFailSts Plock_PosSensor Plock_MotorPosSts Plock_fdbk_sts;
SIG_GROUP_ 544 OBCM_VDCM2_Pkt 1 : Plug_Locked_by_EVSE HVCMS_EVSEID ExtChargerSts EVSE_Error EVSE_ChrgStopControl Charger_WeldingDetectAvail Charger_StndbyReqReason Charger_StndbyReq Charger_FaultStates CC2VoltDetError OBCM_CSSts OBCM_CP3Sts OBCM_CP2Sts OBCM_CCSts OBCM_APAMSts TCP_Communication_Terminated OBCM_CP1Sts TxGBTMessageResponse TxGBTMessageRequest OBCM_Timeout EVCC_FailureSts CC2_VoltageValue GBT_EVSE_Charge_Permitting MessageCounter_OV2 CRC_OV2 EVSE_NotificationMaxDelay CdM_ExtFun_Reset_Max_Time CdM_ExtFun_Relia_Design CdM_ExtFun_Over_Temp_Trotec_Conn CdM_ExtFun_Oper_Cond CdM_ExtFun_Cur_Lim_Conn CdM_ExtFun_Cur_Lim_Cable CdM_ExtFun_Cool_Func_Conn CdM_ExtFun_Cool_Func_Cable CdM_ExtFun_Chr_Dyn_Control_Comp CdM_ExtFun_Char_HC_Control_Comp;
SIG_GROUP_ 1454 MCPB_DATA_Pkt 1 : CRC_MCPB_DATA MC_MCPB_DATA MCPB_Service_Lamp_Request;
SIG_GROUP_ 1444 MCPA_DATA_Pkt 1 : CRC_MCPA_DATA MC_MCPA_DATA MCPA_Service_Lamp_Request;
SIG_GROUP_ 1790 BATTERY_HV2_Pkt 1 : MC_BATHV2 CRC_BATHV2 BMS_HV_SOC_AccuracySts BMS_HV_Low_Temp_Thrsh BMS_HV_High_Temp_Thrsh HVBatCell_Voltage_Low_Thrsh HVBatCell_Voltage_High_Thrsh HEV_OnRq_BPCM BMS_HV_SOC_Min BMS_HV_SOC_Max;
SIG_GROUP_ 1062 MCPA_DATA2_Pkt 1 : MCPA_Temp MCPA_Rotor_Temperature MCPA_Inverter_Temp CLrDiagInfo_MCPA MessageCounter_MCPA_DATA2 MCPA_ROL_STATUS MAC_MCPA_DATA2 CRC_MCPA_DATA2 Cntr_MCPA_DATA2 MCPA_ROL_Request;

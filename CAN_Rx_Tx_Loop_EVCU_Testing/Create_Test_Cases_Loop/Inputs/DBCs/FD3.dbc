VERSION ""

NS_ :

BS_:

BU_: SGW RFHM MPAD IPC GNMM EVCU2 ESL ECM DTCM DMSM BSM BCM AGSM ADCAM

BO_ 1459 CHARGE_SCHEDULE_NEXT: 32 EVCU2
 SG_ Next_SchCabin_Temp : 4|5@0+ (0.5,16) [16|31] "°C"  SGW
 SG_ Next_Climate_Time_Min : 163|4@0+ (5,0) [0|55] "min"  SGW
 SG_ Next_Climate_Time_Hr : 172|5@0+ (1,0) [0|23] "Hours"  SGW
 SG_ Next_Climate_Day : 183|4@0+ (1,0) [0|15] "" SGW
 SG_ Next_Charge_StartDay : 27|4@0+ (1,0) [0|15] "-"  SGW,IPC
 SG_ Next_Charge_Start_Time_Min : 35|4@0+ (5,0) [0|55] "min"  SGW,IPC
 SG_ Next_Charge_Start_Time_Hr : 20|5@0+ (1,0) [0|23] "Hours"  SGW,IPC
 SG_ Next_Charge_EndDay : 31|4@0+ (1,0) [0|15] "-"  SGW,IPC
 SG_ Next_Charge_End_Time_Min : 39|4@0+ (5,0) [0|55] "min"  SGW,IPC
 SG_ Next_Charge_End_Time_Hr : 12|5@0+ (1,0) [0|30] "Hours"  SGW,IPC
 SG_ Nxt_External_Charge_ImmediateTgt : 47|4@0+ (5,0) [0|75] "%"  SGW
 SG_ Nxt_External_Charge_ExternalTgt : 43|4@0+ (5,50) [50|125] "%"  SGW
 SG_ Nxt_External_Charge_EndDay : 55|4@0+ (1,0) [0|15] "" SGW
 SG_ Nxt_Ext_Charge_End_Time_Min : 51|4@0+ (5,0) [0|75] "minutes"  SGW
 SG_ Nxt_Ext_Charge_End_Time_Hr : 63|5@0+ (1,0) [0|31] "hours"  SGW
 SG_ Nxt_Charge_Schedule_Type : 58|2@0+ (1,0) [0|3] "" SGW

BO_ 1464 CHARGE_SCHEDULE_HU1: 32 SGW
 SG_ Submit_Schedule2 : 48|1@0+ (1,0) [0|1] "-"  EVCU2
 SG_ Submit_Schedule1 : 16|1@0+ (1,0) [0|1] "-"  EVCU2
 SG_ Start_Time_Min2 : 63|4@0+ (5,0) [0|55] "min"  EVCU2
 SG_ Start_Time_Min1 : 31|4@0+ (5,0) [0|55] "min"  EVCU2
 SG_ Start_Time_Hr2 : 54|5@0+ (1,0) [0|23] "Hours"  EVCU2
 SG_ Start_Time_Hr1 : 22|5@0+ (1,0) [0|23] "Hours"  EVCU2
 SG_ Schedule_Day2 : 47|8@0+ (1,0) [0|255] "-"  EVCU2
 SG_ Schedule_Day1 : 7|8@0+ (1,0) [0|255] "-"  EVCU2
 SG_ End_Time_Min2 : 79|4@0+ (5,0) [0|55] "min"  EVCU2
 SG_ End_Time_Min1 : 27|4@0+ (5,0) [0|55] "min"  EVCU2
 SG_ End_Time_Hr2 : 71|5@0+ (1,0) [0|23] "Hours"  EVCU2
 SG_ End_Time_Hr1 : 39|5@0+ (1,0) [0|23] "Hours"  EVCU2
 SG_ Enable_Schedule2 : 73|1@0+ (1,0) [0|1] "-"  EVCU2
 SG_ Enable_Schedule1 : 72|1@0+ (1,0) [0|1] "-"  EVCU2
 SG_ ChargeUntilFull2 : 32|1@0+ (1,0) [0|1] "-"  EVCU2
 SG_ ChargeUntilFull1 : 8|1@0+ (1,0) [0|1] "-"  EVCU2
 SG_ Immediate_ChargeTarget2 : 131|4@0+ (5,0) [0|75] "%"  EVCU2
 SG_ Immediate_ChargeTarget1 : 135|4@0+ (5,0) [0|75] "%"  EVCU2
 SG_ External_ChargeTarget2 : 139|4@0+ (5,50) [50|125] "%"  EVCU2
 SG_ External_ChargeTarget1 : 143|4@0+ (5,50) [50|125] "%"  EVCU2
 SG_ Charge_Schedule_Type2 : 106|2@0+ (1,0) [0|3] "" EVCU2
 SG_ Charge_Schedule_Type1 : 98|2@0+ (1,0) [0|3] "" EVCU2

BO_ 1457 CHARGE_SCHEDULE_HCP1: 32 EVCU2
 SG_ Schedule_Day1_Sts : 7|8@0+ (1,0) [0|255] "-"  SGW
 SG_ Start_Time_Min2_Sts : 63|4@0+ (5,0) [0|55] "min"  SGW
 SG_ Start_Time_Min1_Sts : 31|4@0+ (5,0) [0|55] "min"  SGW
 SG_ Start_Time_Hr2_Sts : 54|5@0+ (1,0) [0|23] "Hours"  SGW
 SG_ Start_Time_Hr1_Sts : 22|5@0+ (1,0) [0|23] "Hours"  SGW
 SG_ Schedule_Day2_Sts : 47|8@0+ (1,0) [0|255] "-"  SGW
 SG_ Schedule_Confirmed2 : 48|1@0+ (1,0) [0|1] "-"  SGW
 SG_ Schedule_Confirmed1 : 16|1@0+ (1,0) [0|1] "-"  SGW
 SG_ End_Time_Min2_Sts : 79|4@0+ (5,0) [0|55] "min"  SGW
 SG_ End_Time_Min1_Sts : 27|4@0+ (5,0) [0|55] "min"  SGW
 SG_ End_Time_Hr2_Sts : 71|5@0+ (1,0) [0|23] "Hours"  SGW
 SG_ End_Time_Hr1_Sts : 39|5@0+ (1,0) [0|23] "Hours"  SGW
 SG_ ChargeUntilFull2_Sts : 32|1@0+ (1,0) [0|1] "-"  SGW
 SG_ ChargeUntilFull1_Sts : 8|1@0+ (1,0) [0|1] "-"  SGW
 SG_ Immediate_ChargeTarget2_Sts : 124|4@0+ (5,0) [0|15] "%"  SGW
 SG_ Immediate_ChargeTarget1_Sts : 117|4@0+ (5,0) [0|15] "%"  SGW
 SG_ External_ChargeTarget2_Sts : 132|4@0+ (5,50) [50|125] "%"  SGW
 SG_ External_ChargeTarget1_Sts : 120|4@0+ (5,50) [50|125] "%"  SGW
 SG_ Charge_Schedule_Type2_Sts : 107|2@0+ (1,0) [0|3] "" SGW
 SG_ Charge_Schedule_Type1_Sts : 98|2@0+ (1,0) [0|3] "" SGW

BO_ 750 BCM_FD_3: 32 BCM
 SG_ MessageCounter_BCM3 : 179|4@0+ (1,0) [0|15] "-"  ADCAM,MPAD,DMSM,BSM
 SG_ FronWiperFailSts : 7|1@0+ (1,0) [0|1] "" ADCAM,MPAD,DTCM
 SG_ CRC_BCM3 : 191|8@0+ (1,0) [0|255] "-"  ADCAM,MPAD,DMSM,BSM
 SG_ Battery_Volt_2 : 49|9@0+ (0.025,5) [5|17.75] "Volt"  MPAD,EVCU2,SGW,BSM
 SG_ Battery_Volt_1 : 56|9@0+ (0.025,5) [5|17.75] "Volt"  ADCAM,MPAD,EVCU2,DMSM,GNMM,SGW,AGSM,ESL,BSM,IPC,RFHM,ECM,DTCM

BO_ 1436 BCM_FD_27: 32 BCM
 SG_ TrailerStopLightFailSts : 109|1@0+ (1,0) [0|1] "" IPC
 SG_ TrailerRHTurnSignalFailSts : 96|1@0+ (1,0) [0|1] "" IPC
 SG_ TrailerRHParkingLightFailSts : 97|1@0+ (1,0) [0|1] "" IPC
 SG_ TrailerLHTurnSignalFailSts : 98|1@0+ (1,0) [0|1] "" IPC
 SG_ TrailerLHParkingLightFailSts : 99|1@0+ (1,0) [0|1] "" IPC
 SG_ TrailerGenericFailSts : 108|1@0+ (1,0) [0|1] "" IPC
 SG_ TrailerConnectionSts : 106|2@0+ (1,0) [0|3] "" ADCAM,MPAD,EVCU2,SGW,BSM,IPC
 SG_ PANEL_INTS_DISP : 15|8@0+ (0.5,0) [0|100] "%"  SGW,IPC
 SG_ MOOD_LGT_INTS : 47|8@0+ (0.5,0) [0|100] "%"  SGW
 SG_ MEM_RC_STAT : 125|2@0+ (1,0) [0|3] "" IPC
 SG_ Mem_D_Sv_Rq : 116|1@0+ (1,0) [0|1] "" IPC
 SG_ Mem_D_Rc_Rq : 117|1@0+ (1,0) [0|1] "" IPC
 SG_ Mem_D_Pos_Rq : 119|2@0+ (1,0) [0|3] "" IPC
 SG_ Internal_Fault : 74|1@0+ (1,0) [0|1] "" IPC
 SG_ EBL_Stat : 87|2@0+ (1,0) [0|2] "" EVCU2,SGW
 SG_ DAY_LGT_MD_DISP : 7|1@0+ (1,0) [0|0] "" SGW,IPC
 SG_ COMM_Fault : 75|1@0+ (1,0) [0|1] "" IPC
 SG_ Blower_Speed : 136|9@0+ (1,0) [0|350] "Hz"  ECM
 SG_ Blower_Diagnostics : 121|10@0+ (0.1,0) [0|100] "%"  ECM
 SG_ U_Call_Button : 83|2@0+ (1,0) [0|3] "" SGW
 SG_ E_Call_Button : 85|2@0+ (1,0) [0|3] "" SGW
 SG_ MessageCounter_BCM27 : 179|4@0+ (1,0) [0|15] "-"  ADCAM,MPAD,BSM,IPC,EVCU2
 SG_ CRC_BCM27 : 191|8@0+ (1,0) [0|255] "-"  ADCAM,MPAD,BSM,IPC,EVCU2
 SG_ Comfort_Enable_Time : 55|16@0+ (1,0) [0|65534] "sec"  SGW
 SG_ PLG_Stat : 71|4@0+ (1,0) [0|14] "-"  IPC
 SG_ WinPos_RearR_Sts : 172|5@0+ (5,0) [0|100] "%"  SGW
 SG_ WinPos_RearL_Sts : 161|5@0+ (5,0) [0|100] "%"  SGW
 SG_ WinPos_P_Sts : 152|7@0+ (1,0) [0|100] "%"  SGW
 SG_ WinPos_D_Sts : 159|7@0+ (1,0) [0|100] "%"  SGW
 SG_ Turn_Lever_Unlatch_Resp : 25|2@0+ (1,0) [0|2] "-"  MPAD
 SG_ Comfort_Enable_Act : 5|1@0+ (1,0) [0|1] "" SGW,IPC

BO_ 1435 BCM_FD_26: 32 BCM
 SG_ VEH_INT_TEMP : 31|16@0+ (0.01,-40) [-40|85] "°C"  EVCU2
 SG_ DRV_TEMP_DR_POS : 22|7@0+ (1,0) [0|100] "%"  EVCU2
 SG_ RRTurnLampFault : 151|1@0+ (1,0) [0|1] "" MPAD,IPC
 SG_ RLTurnLampFault : 136|1@0+ (1,0) [0|1] "" MPAD,IPC
 SG_ RearFogPressed : 129|1@0+ (1,0) [0|1] "" ADCAM
 SG_ R_TurnCluster : 139|1@0+ (1,0) [0|1] "" IPC
 SG_ PAS_TEMP_DR_POS : 63|7@0+ (1,0) [0|100] "%"  EVCU2
 SG_ MessageCounter_BCM26 : 179|4@0+ (1,0) [0|15] "-"  ADCAM,MPAD,IPC,EVCU2
 SG_ LKA_RequestSts : 121|1@0+ (1,0) [0|1] "" ADCAM,MPAD
 SG_ L_TurnCluster : 140|1@0+ (1,0) [0|1] "" IPC
 SG_ HVAC_Blwr_Perct : 87|7@0+ (1,0) [0|100] "%"  EVCU2
 SG_ HtrCorTmp_InTgt : 15|8@0+ (1,-40) [-40|214] "°C"  EVCU2
 SG_ HLSPosition : 143|3@0+ (1,0) [0|6] "" ADCAM,MPAD,IPC
 SG_ HazardSwitchPressed : 128|1@0+ (1,0) [0|1] "" ADCAM,MPAD,SGW,BCM
 SG_ FRTurnLampFault : 137|1@0+ (1,0) [0|1] "" MPAD,IPC
 SG_ FrontFogPressed : 120|1@0+ (1,0) [0|1] "" ADCAM
 SG_ FLTurnLampFault : 138|1@0+ (1,0) [0|1] "" MPAD,IPC
 SG_ EvapTempTar : 7|8@0+ (0.5,-20) [-20|107] "°C"  EVCU2
 SG_ DEFROST_SEL : 23|1@0+ (1,0) [0|1] "" EVCU2
 SG_ CRC_BCM26 : 191|8@0+ (1,0) [0|255] "-"  ADCAM,MPAD,IPC,EVCU2
 SG_ PssgrScreenOn_Off_RequestSts : 147|1@0+ (1,0) [0|1] "" SGW
 SG_ HAS_OnOffSts : 122|1@0+ (1,0) [0|1] "" ADCAM,MPAD,EVCU2
 SG_ BSD_FAIL_P : 148|1@0+ (1,0) [0|1] "" ADCAM
 SG_ BSD_FAIL_D : 149|1@0+ (1,0) [0|1] "" ADCAM
 SG_ HeadlightsDelayModeActive : 80|1@0+ (1,0) [0|1] "" SGW
 SG_ Paddles_DrvMd_CfgSts_TMI : 105|2@0+ (1,0) [0|2] "" SGW
 SG_ AHP_EnblReq : 127|2@0+ (1,0) [0|2] "" EVCU2
 SG_ HMI_FrontTrunkRegulatoryRelease : 162|1@0+ (1,0) [0|1] "" IPC
 SG_ Tri_Level_HSW_StatSts : 161|3@0+ (1,0) [0|7] "" EVCU2

BO_ 603 BCM_FD_25: 32 BCM
 SG_ HVACPSNTemp : 87|6@0+ (1,0) [0|63] "°"  SGW
 SG_ HVACDRVTemp : 79|6@0+ (1,0) [0|63] "°"  SGW

BO_ 1069 BCM_FD_24: 32 BCM
 SG_ ReverseLamp : 137|1@0+ (1,0) [0|1] "" SGW
 SG_ HazardCluster : 148|1@0+ (1,0) [0|1] "" IPC
 SG_ FronWasherSts : 147|1@0+ (1,0) [0|1] "" Vector__XXX
 SG_ AVHSwitchSts : 151|2@0+ (1,0) [0|2] "" BSM
 SG_ MessageCounter_BCM24 : 179|4@0+ (1,0) [0|15] "-"  BSM
 SG_ CRC_BCM24 : 191|8@0+ (1,0) [0|255] "-"  BSM

BO_ 1434 BCM_FD_23: 32 BCM
 SG_ NV_Telltale_Stat : 163|2@0+ (1,0) [0|2] "" IPC
 SG_ NV_ScreenDisp_Info : 47|4@0+ (1,0) [0|15] "" IPC
 SG_ NV_Screen_Reqst : 50|2@0+ (1,0) [0|3] "" IPC
 SG_ NV_PopupDisp_Info : 43|4@0+ (1,0) [0|15] "" IPC
 SG_ NV_Detection_Stat : 53|3@0+ (1,0) [0|7] "" IPC
 SG_ HRLS_Ambient_Light_Level : 23|8@0+ (20,0) [0|5080] "LUX"  IPC

BO_ 602 BCM_FD_22: 32 BCM
 SG_ HiBmLvr_Stat : 10|2@0+ (1,0) [0|2] "" ADCAM,EVCU2
 SG_ FR_HS_STATSts : 18|2@0+ (1,0) [0|3] "" EVCU2,SGW
 SG_ FR_HS_STATFailSts : 16|1@0+ (1,0) [0|1] "" EVCU2,SGW
 SG_ FL_HS_STATSts : 23|2@0+ (1,0) [0|3] "" EVCU2,SGW
 SG_ FL_HS_STATFailSts : 21|1@0+ (1,0) [0|1] "" EVCU2,SGW
 SG_ WprSw6Posn : 5|4@0+ (1,0) [0|14] "" ADCAM
 SG_ TurnLeverLatched : 8|1@0+ (1,0) [0|1] "" MPAD
 SG_ MessageCounter_BCM22 : 179|4@0+ (1,0) [0|15] "-"  ADCAM,MPAD,EVCU2
 SG_ CRC_BCM22 : 191|8@0+ (1,0) [0|255] "-"  ADCAM,MPAD,EVCU2

BO_ 1327 ASCM_FD_1: 32 BCM
 SG_ RR_Lvl : 127|8@0+ (1,-100) [-100|153] "mm"  MPAD
 SG_ RL_Lvl : 119|8@0+ (1,-100) [-100|153] "mm"  MPAD
 SG_ FR_Lvl : 111|8@0+ (1,-100) [-100|153] "mm"  MPAD
 SG_ FL_Lvl : 103|8@0+ (1,-100) [-100|153] "mm"  MPAD

CM_ SG_ 1459 Next_Charge_End_Time_Hr "End time of next charge schedule window (hours, in 24hr format).";
CM_ SG_ 1459 Next_Charge_End_Time_Min "End time of next charge schedule window (in minutes).";
CM_ SG_ 1459 Next_Charge_EndDay "Next schedule end day to stop charging.";
CM_ SG_ 1459 Next_Charge_Start_Time_Hr "Start time of next charge schedule window (hours, in 24hr format).";
CM_ SG_ 1459 Next_Charge_Start_Time_Min "Start time of next charge schedule window (in minutes).";
CM_ SG_ 1459 Nxt_External_Charge_EndDay "End Day for Next available External Charge";
CM_ SG_ 1459 Nxt_External_Charge_ExternalTgt "Next Charge Display for Customer set External Target Display 50 to 100% with 5% Increment";
CM_ SG_ 1459 Nxt_External_Charge_ImmediateTgt "Next Charge Display for Customer set Immediate Target Display";
CM_ SG_ 1459 Next_Climate_Day "Next climate scheduled departure day";
CM_ SG_ 1459 Next_Charge_StartDay "Next schedule start day for charging.";
CM_ SG_ 1459 Next_Climate_Time_Hr "Next climate scheduled departure time (hours, in 24hr format).";
CM_ SG_ 1459 Next_Climate_Time_Min "Next climate scheduled departure time (minutes).";
CM_ SG_ 1459 Next_SchCabin_Temp "Next Schedule cabin temperature";
CM_ SG_ 1459 Nxt_Charge_Schedule_Type "Standard, External or Both Charging of the Next Schedule";
CM_ SG_ 1459 Nxt_Ext_Charge_End_Time_Hr "End Hour for Next available External Charge";
CM_ SG_ 1459 Nxt_Ext_Charge_End_Time_Min "End Min for Next available External Charge";
CM_ SG_ 1464 Start_Time_Min2 "Start Time of schedule  2 (minutes)";
CM_ SG_ 1464 Submit_Schedule1 "Schedule 1 submitted";
CM_ SG_ 1464 Submit_Schedule2 "Schedule 2 submitted";
CM_ SG_ 1464 Charge_Schedule_Type1 "HU Schedule 1 Setter Signal for Changing the Current Charge Schedule Type";
CM_ SG_ 1464 Charge_Schedule_Type2 "HU Schedule 2 Setter Signal for Changing the Current Charge Schedule Type";
CM_ SG_ 1464 ChargeUntilFull1 "Charge until battery is fully charged with schedule 1";
CM_ SG_ 1464 ChargeUntilFull2 "Charge until battery is fully charged with schedule 2";
CM_ SG_ 1464 End_Time_Hr2 "End Time of schedule  2 (hours in 24 hrs. format)";
CM_ SG_ 1464 End_Time_Min1 "End Time of schedule 1(Minutes)";
CM_ SG_ 1464 End_Time_Min2 "End Time of schedule  2(Minutes)";
CM_ SG_ 1464 External_ChargeTarget1 "HU Schedule 1 Setter Signal for Changing the Current External Charge Target Value 50 to 100% with 5% Increment";
CM_ SG_ 1464 External_ChargeTarget2 "HU Schedule 2 Setter Signal for Changing the Current External Charge Target Value";
CM_ SG_ 1464 Immediate_ChargeTarget1 "HU Schedule 1 Setter Signal for Changing the Current Immediate Charge Target Value";
CM_ SG_ 1464 Immediate_ChargeTarget2 "HU Schedule 2 Setter Signal for Changing the Current Immediate Charge Target Value";
CM_ SG_ 1464 Schedule_Day1 "Schedule#1 Day for charging or cabin conditioning";
CM_ SG_ 1464 Schedule_Day2 "Schedule#2 Day for charging or cabin conditioning";
CM_ SG_ 1464 Start_Time_Hr1 "Start Time of schedule  1 (hours in 24 hrs. format)";
CM_ SG_ 1464 Start_Time_Hr2 "Start Time of schedule  2(hours in 24 hrs. format)";
CM_ SG_ 1464 Start_Time_Min1 "Start Time of schedule  1 (minutes)";
CM_ SG_ 1464 Enable_Schedule1 "Schedule 1 checkbox enabled";
CM_ SG_ 1464 Enable_Schedule2 "Schedule 2 checkbox enabled";
CM_ SG_ 1464 End_Time_Hr1 "End Time of schedule 1 (hours in 24 hrs. format)";
CM_ SG_ 1457 External_ChargeTarget1_Sts "ECVU/HCP Schedule 1 Currently Set External Charge Target Value";
CM_ SG_ 1457 External_ChargeTarget2_Sts "ECVU/HCP Schedule 2 Currently Set External Charge Target Value";
CM_ SG_ 1457 Immediate_ChargeTarget1_Sts "ECVU/HCP Schedule 1 Currently Set Immediate Charge Target Value";
CM_ SG_ 1457 Immediate_ChargeTarget2_Sts "ECVU/HCP Schedule 2 Currently Set Immediate Charge Target Value0 to 50% with 5% Increment";
CM_ SG_ 1457 Schedule_Confirmed1 "Confirm the requested schedule 1";
CM_ SG_ 1457 Schedule_Confirmed2 "Confirm the requested schedule 2";
CM_ SG_ 1457 Schedule_Day1_Sts "Schedule#1 Day for charging or cabin conditioning";
CM_ SG_ 1457 Schedule_Day2_Sts "Scheduled#2 Day for charging or cabin conditioning confirmation";
CM_ SG_ 1457 Start_Time_Hr1_Sts "Start Time of schedule  1 (hours in 24 hrs. format)";
CM_ SG_ 1457 Start_Time_Hr2_Sts "Start Time of schedule  2(hours in 24 hrs. format) feedback";
CM_ SG_ 1457 Start_Time_Min1_Sts "Start Time of schedule  1 (minutes)";
CM_ SG_ 1457 Start_Time_Min2_Sts "Start Time of schedule  2 (minutes) feedback";
CM_ SG_ 1457 Charge_Schedule_Type1_Sts "ECVU/HCP Schedule 1 Currently Set Charge Schedule Type";
CM_ SG_ 1457 Charge_Schedule_Type2_Sts "ECVU/HCP Schedule 2 Currently Set Charge Schedule Type";
CM_ SG_ 1457 ChargeUntilFull1_Sts "Charge until battery is fully charged with schedule 1";
CM_ SG_ 1457 ChargeUntilFull2_Sts "Charge until battery is fully charged with schedule 2 confirmation";
CM_ SG_ 1457 End_Time_Hr1_Sts "End Time of schedule 1 (hours in 24 hrs. format)";
CM_ SG_ 1457 End_Time_Hr2_Sts "End Time of schedule  2 (hours in 24 hrs. format) feedback";
CM_ SG_ 1457 End_Time_Min1_Sts "End Time of schedule 1(Minutes)";
CM_ SG_ 1457 End_Time_Min2_Sts "End Time of schedule  2 (Minutes) feedback";
CM_ SG_ 750 Battery_Volt_2 "Battery Volt 2 signal";
CM_ SG_ 750 MessageCounter_BCM3 "This signal is a counter used for safety checks strategies. This counter is incremented of 1 (one) unit at each frame transmission.";
CM_ SG_ 750 FronWiperFailSts "Wiper System fault Present.";
CM_ SG_ 750 CRC_BCM3 "CRC according to SAE J1850 standard at each frame transmission.";
CM_ SG_ 750 Battery_Volt_1 "Battery Volt 1 signal";
CM_ SG_ 1436 WinPos_RearR_Sts "Rear right window position";
CM_ SG_ 1436 WinPos_RearL_Sts "Rear left window position";
CM_ SG_ 1436 WinPos_P_Sts "Values 0 to 100 represent the percentage open for the window. 0 being completely closed and 100 being completely open. Values are in Binary Coded Decimal, values 101 to 126 are not used.";
CM_ SG_ 1436 WinPos_D_Sts "Drivers window position";
CM_ SG_ 1436 U_Call_Button "U-Call Button Status";
CM_ SG_ 1436 Turn_Lever_Unlatch_Resp "L2+ turn stalk unlatch response";
CM_ SG_ 1436 TrailerStopLightFailSts "Status of Fail of Trailer Stop Lights";
CM_ SG_ 1436 TrailerRHTurnSignalFailSts "Status of Fail of Trailer Right Turn Light";
CM_ SG_ 1436 TrailerRHParkingLightFailSts "Status of Fail of Trailer Right Parking Light";
CM_ SG_ 1436 TrailerLHTurnSignalFailSts "Status of Fail of Trailer Left Turn Light";
CM_ SG_ 1436 TrailerLHParkingLightFailSts "Status of Fail of Trailer Left Parking Light";
CM_ SG_ 1436 TrailerConnectionSts "Connection status of TTM";
CM_ SG_ 1436 PLG_Stat "This signal is used to indicate to the customer a reason for or a solution to  the power lift gate not operating normally.";
CM_ SG_ 1436 PANEL_INTS_DISP "Panel-/display intensity display";
CM_ SG_ 1436 TrailerGenericFailSts "Status of Fail of TTM";
CM_ SG_ 1436 MOOD_LGT_INTS "Mood lighting intensity (ambient & glow rings)";
CM_ SG_ 1436 MessageCounter_BCM27 "This signal is a counter used for safety checks strategies. This counter is incremented of 1 (one) unit at each frame transmission.";
CM_ SG_ 1436 MEM_RC_STAT "Memory recall status";
CM_ SG_ 1436 Mem_D_Sv_Rq "Memory driver - save position";
CM_ SG_ 1436 Mem_D_Rc_Rq "Memory driver - recall position";
CM_ SG_ 1436 Mem_D_Pos_Rq "Memory driver - position request";
CM_ SG_ 1436 Internal_Fault "Camera wash repsonse";
CM_ SG_ 1436 EBL_Stat "Rear Defrost Status";
CM_ SG_ 1436 E_Call_Button "E-Call Button Status";
CM_ SG_ 1436 CRC_BCM27 "CRC according to SAE J1850 standard at each frame transmission.";
CM_ SG_ 1436 COMM_Fault "Camera wash repsonse";
CM_ SG_ 1436 Comfort_Enable_Time "Power accessory delay time";
CM_ SG_ 1436 Comfort_Enable_Act "Accessory Delay Active";
CM_ SG_ 1436 Blower_Speed "Frequency Feedback received from the Blower";
CM_ SG_ 1436 Blower_Diagnostics "Duty cycle Feedback received from the Blower";
CM_ SG_ 1436 DAY_LGT_MD_DISP "Day light brightness mode display; Night=[0], Day=[1]";
CM_ SG_ 1435 Paddles_DrvMd_CfgSts_TMI "Paddles_DrvMd_CfgSts_TMI";
CM_ SG_ 1435 MessageCounter_BCM26 "This signal is a counter used for safety checks strategies. This counter is incremented of 1 (one) unit at each frame transmission.";
CM_ SG_ 1435 LKA_RequestSts "LKA request signal";
CM_ SG_ 1435 L_TurnCluster "Left Turn Signal Cluster Telltale";
CM_ SG_ 1435 HVAC_Blwr_Perct "HVAC blower PWM percentage for service mode";
CM_ SG_ 1435 HtrCorTmp_InTgt "Heater core temp target";
CM_ SG_ 1435 HLSPosition "Indicate current Headlamp Switch Position";
CM_ SG_ 1435 HMI_FrontTrunkRegulatoryRelease "Used for HMI Indications";
CM_ SG_ 1435 HAS_OnOffSts "HAS request signal";
CM_ SG_ 1435 FRTurnLampFault "Front Right Turn Lamp Faulted";
CM_ SG_ 1435 FrontFogPressed "Indicate Front Fog button is currently pressed";
CM_ SG_ 1435 FLTurnLampFault "Front Left Turn Lamp Faulted";
CM_ SG_ 1435 EvapTempTar "Evaporator temperature target";
CM_ SG_ 1435 DRV_TEMP_DR_POS "Driver temperature door postion";
CM_ SG_ 1435 HazardSwitchPressed "Indicate Hazard Switch is currently latched";
CM_ SG_ 1435 DEFROST_SEL "Defrost select switch";
CM_ SG_ 1435 CRC_BCM26 "CRC according to SAE J1850 standard at each frame transmission.";
CM_ SG_ 1435 BSD_FAIL_P "Blind spot detection indicator failure - passenger side";
CM_ SG_ 1435 BSD_FAIL_D "Blind spot detection indicator failure - driver side";
CM_ SG_ 1435 AHP_EnblReq "Used to require the activation of Auxiliary Heater Pump";
CM_ SG_ 1435 VEH_INT_TEMP "Vehicle interior temperature";
CM_ SG_ 1435 Tri_Level_HSW_StatSts "Heated Steering Wheel On/Off Status";
CM_ SG_ 1435 RRTurnLampFault "Rear Right Turn Lamp Faulted";
CM_ SG_ 1435 RLTurnLampFault "Rear Left Turn Lamp Faulted";
CM_ SG_ 1435 RearFogPressed "Indicate Rear Fog button is currently pressed";
CM_ SG_ 1435 R_TurnCluster "Right Turn Signal Cluster Telltale";
CM_ SG_ 1435 PssgrScreenOn_Off_RequestSts "PssgrScreenOn_Off request signal";
CM_ SG_ 1435 PAS_TEMP_DR_POS "Passenger temperature door postion";
CM_ SG_ 603 HVACPSNTemp "Front passenger temperature status";
CM_ SG_ 603 HVACDRVTemp "Front driver temperature status";
CM_ SG_ 1069 ReverseLamp "Indicate if Reverse Lamps is active";
CM_ SG_ 1069 MessageCounter_BCM24 "This signal is a counter used for safety checks strategies. This counter is incremented of 1 (one) unit at each frame transmission.";
CM_ SG_ 1069 HazardCluster "Request Hazard Cluster Telltale";
CM_ SG_ 1069 FronWasherSts "Wiper System Wash.";
CM_ SG_ 1069 CRC_BCM24 "CRC according to SAE J1850 standard at each frame transmission.";
CM_ SG_ 1069 AVHSwitchSts "Gatewayed Hold n Go Switch Activation Status from BCM";
CM_ SG_ 1434 NV_Telltale_Stat "Night Vision Telltale display information";
CM_ SG_ 1434 NV_ScreenDisp_Info "Night Vision page display information";
CM_ SG_ 1434 NV_Screen_Reqst "Night Vision page request";
CM_ SG_ 1434 NV_PopupDisp_Info "Night Vision pop up display information";
CM_ SG_ 1434 NV_Detection_Stat "Night Vision pesestrian and animal detection status";
CM_ SG_ 1434 HRLS_Ambient_Light_Level "HRLS Ambient Light Level";
CM_ SG_ 602 WprSw6Posn "Wiper switch (6 stages) position";
CM_ SG_ 602 TurnLeverLatched "Indicate if Turn Lever is in a Latched Position";
CM_ SG_ 602 MessageCounter_BCM22 "This signal is a counter used for safety checks strategies. This counter is incremented of 1 (one) unit at each frame transmission.";
CM_ SG_ 602 HiBmLvr_Stat "Indicate High Beam Lever Position";
CM_ SG_ 602 FR_HS_STATSts "Front right heated seat status";
CM_ SG_ 602 FR_HS_STATFailSts "It indicates a fail in Front Right heated seat";
CM_ SG_ 602 FL_HS_STATSts "Front left heated seat status";
CM_ SG_ 602 FL_HS_STATFailSts "It indicates a fail in Front Left heated seat";
CM_ SG_ 602 CRC_BCM22 "CRC according to SAE J1850 standard at each frame transmission.";
CM_ SG_ 1327 FL_Lvl "Front left level";
CM_ SG_ 1327 FR_Lvl "Front right level";
CM_ SG_ 1327 RL_Lvl "Rear left level";
CM_ SG_ 1327 RR_Lvl "Rear right level";
BA_DEF_ BO_ "CANFD_BRS" ENUM "0","1";
BA_DEF_ BO_ "VFrameFormat" ENUM "StandardCAN","ExtendedCAN","reserved","reserved","reserved","reserved","reserved","reserved","reserved","reserved","reserved","reserved","reserved","reserved","StandardCAN_FD","ExtendedCAN_FD";
BA_DEF_ BO_ "DiagConnection" HEX 0 65535;
BA_DEF_ BO_ "DiagState" ENUM "No","Yes";
BA_DEF_ BO_ "NmAsrMessage" ENUM "No","Yes";
BA_DEF_ BO_ "GenMsgDelayTime" INT 0 65535;
BA_DEF_ BO_ "GenMsgCycleTime" INT 0 65535;
BA_DEF_ BO_ "GenMsgCycleTimeFast" INT 0 65535;
BA_DEF_ BO_ "GenMsgStartDelayTime" INT 0 65535;
BA_DEF_ BO_ "GenMsgILSupport" ENUM "No","Yes";
BA_DEF_ BO_ "GenMsgNrOfRepetition" INT 0 255;
BA_DEF_ BO_ "GenMsgSendType" ENUM "Cyclic","NotUsed","NotUsed","NotUsed","NotUsed","NotUsed","NotUsed","NotUsed","NoMsgSendType";
BA_DEF_ BO_ "NmMessage" ENUM "No","Yes";
BA_DEF_ BO_ "DiagResponse" ENUM "No","Yes";
BA_DEF_ BO_ "Type" ENUM "P","C","PE","COC","PE_Cntrl","E","E_Cntrl","OC","S","BAF","DC","EM","MM","ISO-TP","-";
BA_DEF_ BO_ "DiagRequest" ENUM "No","Yes";
BA_DEF_ SG_ "GenSigTimeoutTime_SGW" INT 0 65535;
BA_DEF_ SG_ "GenSigTimeoutTime_RFHM" INT 0 65535;
BA_DEF_ SG_ "GenSigTimeoutTime_MPAD" INT 0 65535;
BA_DEF_ SG_ "GenSigTimeoutTime_IPC" INT 0 65535;
BA_DEF_ SG_ "GenSigTimeoutTime_GNMM" INT 0 65535;
BA_DEF_ SG_ "GenSigTimeoutTime_EVCU2" INT 0 65535;
BA_DEF_ SG_ "GenSigTimeoutTime_ESL" INT 0 65535;
BA_DEF_ SG_ "GenSigTimeoutTime_ECM" INT 0 65535;
BA_DEF_ SG_ "GenSigTimeoutTime_DTCM" INT 0 65535;
BA_DEF_ SG_ "GenSigTimeoutTime_DMSM" INT 0 65535;
BA_DEF_ SG_ "GenSigTimeoutTime_BSM" INT 0 65535;
BA_DEF_ SG_ "GenSigTimeoutTime_BCM" INT 0 65535;
BA_DEF_ SG_ "GenSigTimeoutTime_AGSM" INT 0 65535;
BA_DEF_ SG_ "GenSigTimeoutTime_ADCAM" INT 0 65535;
BA_DEF_ SG_ "SystemSignalLongSymbol" STRING ;
BA_DEF_ SG_ "GenSigSendType" ENUM "NotUsed","OnWrite","OnWriteWithRepetition","OnChange","OnChangeWithRepetition","IfActive","IfActiveWithRepetition","NoSigSendType";
BA_DEF_ SG_ "GenSigInactiveValue" INT 0 2147483647;
BA_DEF_ SG_ "GenSigStartValue" INT 0 2147483647;
BA_DEF_DEF_ "CANFD_BRS" "0";
BA_DEF_DEF_ "VFrameFormat" "StandardCAN_FD";
BA_DEF_DEF_ "DiagConnection" 0;
BA_DEF_DEF_ "DiagState" "No";
BA_DEF_DEF_ "NmAsrMessage" "No";
BA_DEF_DEF_ "GenMsgDelayTime" 0;
BA_DEF_DEF_ "GenMsgCycleTime" 0;
BA_DEF_DEF_ "GenMsgCycleTimeFast" 0;
BA_DEF_DEF_ "GenMsgStartDelayTime" 0;
BA_DEF_DEF_ "GenMsgILSupport" "No";
BA_DEF_DEF_ "GenMsgNrOfRepetition" 0;
BA_DEF_DEF_ "GenMsgSendType" "NoMsgSendType";
BA_DEF_DEF_ "NmMessage" "No";
BA_DEF_DEF_ "DiagResponse" "No";
BA_DEF_DEF_ "Type" "-";
BA_DEF_DEF_ "DiagRequest" "No";
BA_DEF_DEF_ "GenSigTimeoutTime_SGW" 2500;
BA_DEF_DEF_ "GenSigTimeoutTime_RFHM" 2500;
BA_DEF_DEF_ "GenSigTimeoutTime_MPAD" 2500;
BA_DEF_DEF_ "GenSigTimeoutTime_IPC" 2500;
BA_DEF_DEF_ "GenSigTimeoutTime_GNMM" 2500;
BA_DEF_DEF_ "GenSigTimeoutTime_EVCU2" 2500;
BA_DEF_DEF_ "GenSigTimeoutTime_ESL" 2500;
BA_DEF_DEF_ "GenSigTimeoutTime_ECM" 2500;
BA_DEF_DEF_ "GenSigTimeoutTime_DTCM" 2500;
BA_DEF_DEF_ "GenSigTimeoutTime_DMSM" 2500;
BA_DEF_DEF_ "GenSigTimeoutTime_BSM" 2500;
BA_DEF_DEF_ "GenSigTimeoutTime_BCM" 2500;
BA_DEF_DEF_ "GenSigTimeoutTime_AGSM" 2500;
BA_DEF_DEF_ "GenSigTimeoutTime_ADCAM" 2500;
BA_DEF_DEF_ "SystemSignalLongSymbol" "";
BA_DEF_DEF_ "GenSigSendType" "NoSigSendType";
BA_DEF_DEF_ "GenSigInactiveValue" 0;
BA_DEF_DEF_ "GenSigStartValue" 0;
BA_ "CANFD_BRS" BO_ 1459 1;
BA_ "GenMsgDelayTime" BO_ 1459 20;
BA_ "GenMsgCycleTime" BO_ 1459 1000;
BA_ "GenMsgILSupport" BO_ 1459 1;
BA_ "GenMsgSendType" BO_ 1459 0;
BA_ "Type" BO_ 1459 3;
BA_ "CANFD_BRS" BO_ 1464 1;
BA_ "GenMsgDelayTime" BO_ 1464 20;
BA_ "GenMsgCycleTime" BO_ 1464 1000;
BA_ "GenMsgILSupport" BO_ 1464 1;
BA_ "GenMsgSendType" BO_ 1464 0;
BA_ "Type" BO_ 1464 3;
BA_ "CANFD_BRS" BO_ 1457 1;
BA_ "GenMsgDelayTime" BO_ 1457 20;
BA_ "GenMsgCycleTime" BO_ 1457 1000;
BA_ "GenMsgILSupport" BO_ 1457 1;
BA_ "GenMsgSendType" BO_ 1457 0;
BA_ "Type" BO_ 1457 3;
BA_ "CANFD_BRS" BO_ 750 1;
BA_ "GenMsgCycleTime" BO_ 750 50;
BA_ "GenMsgStartDelayTime" BO_ 750 35;
BA_ "GenMsgILSupport" BO_ 750 1;
BA_ "GenMsgSendType" BO_ 750 0;
BA_ "Type" BO_ 750 1;
BA_ "CANFD_BRS" BO_ 1436 1;
BA_ "GenMsgDelayTime" BO_ 1436 20;
BA_ "GenMsgCycleTime" BO_ 1436 1000;
BA_ "GenMsgCycleTimeFast" BO_ 1436 20;
BA_ "GenMsgStartDelayTime" BO_ 1436 400;
BA_ "GenMsgILSupport" BO_ 1436 1;
BA_ "GenMsgNrOfRepetition" BO_ 1436 2;
BA_ "GenMsgSendType" BO_ 1436 0;
BA_ "Type" BO_ 1436 3;
BA_ "CANFD_BRS" BO_ 1435 1;
BA_ "GenMsgDelayTime" BO_ 1435 20;
BA_ "GenMsgCycleTime" BO_ 1435 1000;
BA_ "GenMsgCycleTimeFast" BO_ 1435 20;
BA_ "GenMsgStartDelayTime" BO_ 1435 395;
BA_ "GenMsgILSupport" BO_ 1435 1;
BA_ "GenMsgNrOfRepetition" BO_ 1435 2;
BA_ "GenMsgSendType" BO_ 1435 0;
BA_ "Type" BO_ 1435 3;
BA_ "CANFD_BRS" BO_ 603 1;
BA_ "GenMsgDelayTime" BO_ 603 20;
BA_ "GenMsgCycleTime" BO_ 603 100;
BA_ "GenMsgCycleTimeFast" BO_ 603 20;
BA_ "GenMsgStartDelayTime" BO_ 603 60;
BA_ "GenMsgILSupport" BO_ 603 1;
BA_ "GenMsgNrOfRepetition" BO_ 603 2;
BA_ "GenMsgSendType" BO_ 603 0;
BA_ "Type" BO_ 603 3;
BA_ "CANFD_BRS" BO_ 1069 1;
BA_ "GenMsgCycleTime" BO_ 1069 100;
BA_ "GenMsgStartDelayTime" BO_ 1069 55;
BA_ "GenMsgILSupport" BO_ 1069 1;
BA_ "GenMsgSendType" BO_ 1069 0;
BA_ "Type" BO_ 1069 3;
BA_ "CANFD_BRS" BO_ 1434 1;
BA_ "GenMsgDelayTime" BO_ 1434 20;
BA_ "GenMsgCycleTime" BO_ 1434 1000;
BA_ "GenMsgCycleTimeFast" BO_ 1434 20;
BA_ "GenMsgStartDelayTime" BO_ 1434 390;
BA_ "GenMsgILSupport" BO_ 1434 1;
BA_ "GenMsgNrOfRepetition" BO_ 1434 2;
BA_ "GenMsgSendType" BO_ 1434 0;
BA_ "Type" BO_ 1434 3;
BA_ "CANFD_BRS" BO_ 602 1;
BA_ "GenMsgDelayTime" BO_ 602 20;
BA_ "GenMsgCycleTime" BO_ 602 100;
BA_ "GenMsgCycleTimeFast" BO_ 602 20;
BA_ "GenMsgStartDelayTime" BO_ 602 50;
BA_ "GenMsgILSupport" BO_ 602 1;
BA_ "GenMsgNrOfRepetition" BO_ 602 2;
BA_ "GenMsgSendType" BO_ 602 0;
BA_ "Type" BO_ 602 3;
BA_ "CANFD_BRS" BO_ 1327 1;
BA_ "GenMsgCycleTime" BO_ 1327 200;
BA_ "GenMsgStartDelayTime" BO_ 1327 95;
BA_ "GenMsgILSupport" BO_ 1327 1;
BA_ "GenMsgSendType" BO_ 1327 0;
BA_ "Type" BO_ 1327 1;
BA_ "GenSigTimeoutTime_SGW" SG_ 1464 Submit_Schedule2 0;
BA_ "GenSigTimeoutTime_RFHM" SG_ 1464 Submit_Schedule2 0;
BA_ "GenSigTimeoutTime_MPAD" SG_ 1464 Submit_Schedule2 0;
BA_ "GenSigTimeoutTime_IPC" SG_ 1464 Submit_Schedule2 0;
BA_ "GenSigTimeoutTime_GNMM" SG_ 1464 Submit_Schedule2 0;
BA_ "GenSigTimeoutTime_ESL" SG_ 1464 Submit_Schedule2 0;
BA_ "GenSigTimeoutTime_ECM" SG_ 1464 Submit_Schedule2 0;
BA_ "GenSigTimeoutTime_DTCM" SG_ 1464 Submit_Schedule2 0;
BA_ "GenSigTimeoutTime_DMSM" SG_ 1464 Submit_Schedule2 0;
BA_ "GenSigTimeoutTime_BSM" SG_ 1464 Submit_Schedule2 0;
BA_ "GenSigTimeoutTime_BCM" SG_ 1464 Submit_Schedule2 0;
BA_ "GenSigTimeoutTime_AGSM" SG_ 1464 Submit_Schedule2 0;
BA_ "GenSigTimeoutTime_ADCAM" SG_ 1464 Submit_Schedule2 0;
BA_ "GenSigSendType" SG_ 1464 Submit_Schedule2 3;
BA_ "GenSigTimeoutTime_SGW" SG_ 1464 Submit_Schedule1 0;
BA_ "GenSigTimeoutTime_RFHM" SG_ 1464 Submit_Schedule1 0;
BA_ "GenSigTimeoutTime_MPAD" SG_ 1464 Submit_Schedule1 0;
BA_ "GenSigTimeoutTime_IPC" SG_ 1464 Submit_Schedule1 0;
BA_ "GenSigTimeoutTime_GNMM" SG_ 1464 Submit_Schedule1 0;
BA_ "GenSigTimeoutTime_ESL" SG_ 1464 Submit_Schedule1 0;
BA_ "GenSigTimeoutTime_ECM" SG_ 1464 Submit_Schedule1 0;
BA_ "GenSigTimeoutTime_DTCM" SG_ 1464 Submit_Schedule1 0;
BA_ "GenSigTimeoutTime_DMSM" SG_ 1464 Submit_Schedule1 0;
BA_ "GenSigTimeoutTime_BSM" SG_ 1464 Submit_Schedule1 0;
BA_ "GenSigTimeoutTime_BCM" SG_ 1464 Submit_Schedule1 0;
BA_ "GenSigTimeoutTime_AGSM" SG_ 1464 Submit_Schedule1 0;
BA_ "GenSigTimeoutTime_ADCAM" SG_ 1464 Submit_Schedule1 0;
BA_ "GenSigSendType" SG_ 1464 Submit_Schedule1 3;
BA_ "GenSigTimeoutTime_SGW" SG_ 1464 Start_Time_Min2 0;
BA_ "GenSigTimeoutTime_RFHM" SG_ 1464 Start_Time_Min2 0;
BA_ "GenSigTimeoutTime_MPAD" SG_ 1464 Start_Time_Min2 0;
BA_ "GenSigTimeoutTime_IPC" SG_ 1464 Start_Time_Min2 0;
BA_ "GenSigTimeoutTime_GNMM" SG_ 1464 Start_Time_Min2 0;
BA_ "GenSigTimeoutTime_ESL" SG_ 1464 Start_Time_Min2 0;
BA_ "GenSigTimeoutTime_ECM" SG_ 1464 Start_Time_Min2 0;
BA_ "GenSigTimeoutTime_DTCM" SG_ 1464 Start_Time_Min2 0;
BA_ "GenSigTimeoutTime_DMSM" SG_ 1464 Start_Time_Min2 0;
BA_ "GenSigTimeoutTime_BSM" SG_ 1464 Start_Time_Min2 0;
BA_ "GenSigTimeoutTime_BCM" SG_ 1464 Start_Time_Min2 0;
BA_ "GenSigTimeoutTime_AGSM" SG_ 1464 Start_Time_Min2 0;
BA_ "GenSigTimeoutTime_ADCAM" SG_ 1464 Start_Time_Min2 0;
BA_ "GenSigSendType" SG_ 1464 Start_Time_Min2 3;
BA_ "GenSigTimeoutTime_SGW" SG_ 1464 Start_Time_Min1 0;
BA_ "GenSigTimeoutTime_RFHM" SG_ 1464 Start_Time_Min1 0;
BA_ "GenSigTimeoutTime_MPAD" SG_ 1464 Start_Time_Min1 0;
BA_ "GenSigTimeoutTime_IPC" SG_ 1464 Start_Time_Min1 0;
BA_ "GenSigTimeoutTime_GNMM" SG_ 1464 Start_Time_Min1 0;
BA_ "GenSigTimeoutTime_ESL" SG_ 1464 Start_Time_Min1 0;
BA_ "GenSigTimeoutTime_ECM" SG_ 1464 Start_Time_Min1 0;
BA_ "GenSigTimeoutTime_DTCM" SG_ 1464 Start_Time_Min1 0;
BA_ "GenSigTimeoutTime_DMSM" SG_ 1464 Start_Time_Min1 0;
BA_ "GenSigTimeoutTime_BSM" SG_ 1464 Start_Time_Min1 0;
BA_ "GenSigTimeoutTime_BCM" SG_ 1464 Start_Time_Min1 0;
BA_ "GenSigTimeoutTime_AGSM" SG_ 1464 Start_Time_Min1 0;
BA_ "GenSigTimeoutTime_ADCAM" SG_ 1464 Start_Time_Min1 0;
BA_ "GenSigSendType" SG_ 1464 Start_Time_Min1 3;
BA_ "GenSigTimeoutTime_SGW" SG_ 1464 Start_Time_Hr2 0;
BA_ "GenSigTimeoutTime_RFHM" SG_ 1464 Start_Time_Hr2 0;
BA_ "GenSigTimeoutTime_MPAD" SG_ 1464 Start_Time_Hr2 0;
BA_ "GenSigTimeoutTime_IPC" SG_ 1464 Start_Time_Hr2 0;
BA_ "GenSigTimeoutTime_GNMM" SG_ 1464 Start_Time_Hr2 0;
BA_ "GenSigTimeoutTime_ESL" SG_ 1464 Start_Time_Hr2 0;
BA_ "GenSigTimeoutTime_ECM" SG_ 1464 Start_Time_Hr2 0;
BA_ "GenSigTimeoutTime_DTCM" SG_ 1464 Start_Time_Hr2 0;
BA_ "GenSigTimeoutTime_DMSM" SG_ 1464 Start_Time_Hr2 0;
BA_ "GenSigTimeoutTime_BSM" SG_ 1464 Start_Time_Hr2 0;
BA_ "GenSigTimeoutTime_BCM" SG_ 1464 Start_Time_Hr2 0;
BA_ "GenSigTimeoutTime_AGSM" SG_ 1464 Start_Time_Hr2 0;
BA_ "GenSigTimeoutTime_ADCAM" SG_ 1464 Start_Time_Hr2 0;
BA_ "GenSigSendType" SG_ 1464 Start_Time_Hr2 3;
BA_ "GenSigTimeoutTime_SGW" SG_ 1464 Start_Time_Hr1 0;
BA_ "GenSigTimeoutTime_RFHM" SG_ 1464 Start_Time_Hr1 0;
BA_ "GenSigTimeoutTime_MPAD" SG_ 1464 Start_Time_Hr1 0;
BA_ "GenSigTimeoutTime_IPC" SG_ 1464 Start_Time_Hr1 0;
BA_ "GenSigTimeoutTime_GNMM" SG_ 1464 Start_Time_Hr1 0;
BA_ "GenSigTimeoutTime_ESL" SG_ 1464 Start_Time_Hr1 0;
BA_ "GenSigTimeoutTime_ECM" SG_ 1464 Start_Time_Hr1 0;
BA_ "GenSigTimeoutTime_DTCM" SG_ 1464 Start_Time_Hr1 0;
BA_ "GenSigTimeoutTime_DMSM" SG_ 1464 Start_Time_Hr1 0;
BA_ "GenSigTimeoutTime_BSM" SG_ 1464 Start_Time_Hr1 0;
BA_ "GenSigTimeoutTime_BCM" SG_ 1464 Start_Time_Hr1 0;
BA_ "GenSigTimeoutTime_AGSM" SG_ 1464 Start_Time_Hr1 0;
BA_ "GenSigTimeoutTime_ADCAM" SG_ 1464 Start_Time_Hr1 0;
BA_ "GenSigSendType" SG_ 1464 Start_Time_Hr1 3;
BA_ "GenSigTimeoutTime_SGW" SG_ 1464 Schedule_Day2 0;
BA_ "GenSigTimeoutTime_RFHM" SG_ 1464 Schedule_Day2 0;
BA_ "GenSigTimeoutTime_MPAD" SG_ 1464 Schedule_Day2 0;
BA_ "GenSigTimeoutTime_IPC" SG_ 1464 Schedule_Day2 0;
BA_ "GenSigTimeoutTime_GNMM" SG_ 1464 Schedule_Day2 0;
BA_ "GenSigTimeoutTime_ESL" SG_ 1464 Schedule_Day2 0;
BA_ "GenSigTimeoutTime_ECM" SG_ 1464 Schedule_Day2 0;
BA_ "GenSigTimeoutTime_DTCM" SG_ 1464 Schedule_Day2 0;
BA_ "GenSigTimeoutTime_DMSM" SG_ 1464 Schedule_Day2 0;
BA_ "GenSigTimeoutTime_BSM" SG_ 1464 Schedule_Day2 0;
BA_ "GenSigTimeoutTime_BCM" SG_ 1464 Schedule_Day2 0;
BA_ "GenSigTimeoutTime_AGSM" SG_ 1464 Schedule_Day2 0;
BA_ "GenSigTimeoutTime_ADCAM" SG_ 1464 Schedule_Day2 0;
BA_ "GenSigSendType" SG_ 1464 Schedule_Day2 3;
BA_ "GenSigTimeoutTime_SGW" SG_ 1464 Schedule_Day1 0;
BA_ "GenSigTimeoutTime_RFHM" SG_ 1464 Schedule_Day1 0;
BA_ "GenSigTimeoutTime_MPAD" SG_ 1464 Schedule_Day1 0;
BA_ "GenSigTimeoutTime_IPC" SG_ 1464 Schedule_Day1 0;
BA_ "GenSigTimeoutTime_GNMM" SG_ 1464 Schedule_Day1 0;
BA_ "GenSigTimeoutTime_ESL" SG_ 1464 Schedule_Day1 0;
BA_ "GenSigTimeoutTime_ECM" SG_ 1464 Schedule_Day1 0;
BA_ "GenSigTimeoutTime_DTCM" SG_ 1464 Schedule_Day1 0;
BA_ "GenSigTimeoutTime_DMSM" SG_ 1464 Schedule_Day1 0;
BA_ "GenSigTimeoutTime_BSM" SG_ 1464 Schedule_Day1 0;
BA_ "GenSigTimeoutTime_BCM" SG_ 1464 Schedule_Day1 0;
BA_ "GenSigTimeoutTime_AGSM" SG_ 1464 Schedule_Day1 0;
BA_ "GenSigTimeoutTime_ADCAM" SG_ 1464 Schedule_Day1 0;
BA_ "GenSigSendType" SG_ 1464 Schedule_Day1 3;
BA_ "GenSigTimeoutTime_SGW" SG_ 1436 TrailerRHParkingLightFailSts 0;
BA_ "GenSigTimeoutTime_RFHM" SG_ 1436 TrailerRHParkingLightFailSts 0;
BA_ "GenSigTimeoutTime_MPAD" SG_ 1436 TrailerRHParkingLightFailSts 0;
BA_ "GenSigTimeoutTime_GNMM" SG_ 1436 TrailerRHParkingLightFailSts 0;
BA_ "GenSigTimeoutTime_EVCU2" SG_ 1436 TrailerRHParkingLightFailSts 0;
BA_ "GenSigTimeoutTime_ESL" SG_ 1436 TrailerRHParkingLightFailSts 0;
BA_ "GenSigTimeoutTime_ECM" SG_ 1436 TrailerRHParkingLightFailSts 0;
BA_ "GenSigTimeoutTime_DTCM" SG_ 1436 TrailerRHParkingLightFailSts 0;
BA_ "GenSigTimeoutTime_DMSM" SG_ 1436 TrailerRHParkingLightFailSts 0;
BA_ "GenSigTimeoutTime_BSM" SG_ 1436 TrailerRHParkingLightFailSts 0;
BA_ "GenSigTimeoutTime_BCM" SG_ 1436 TrailerRHParkingLightFailSts 0;
BA_ "GenSigTimeoutTime_AGSM" SG_ 1436 TrailerRHParkingLightFailSts 0;
BA_ "GenSigTimeoutTime_ADCAM" SG_ 1436 TrailerRHParkingLightFailSts 0;
BA_ "GenSigTimeoutTime_SGW" SG_ 1436 TrailerRHTurnSignalFailSts 0;
BA_ "GenSigTimeoutTime_RFHM" SG_ 1436 TrailerRHTurnSignalFailSts 0;
BA_ "GenSigTimeoutTime_MPAD" SG_ 1436 TrailerRHTurnSignalFailSts 0;
BA_ "GenSigTimeoutTime_GNMM" SG_ 1436 TrailerRHTurnSignalFailSts 0;
BA_ "GenSigTimeoutTime_EVCU2" SG_ 1436 TrailerRHTurnSignalFailSts 0;
BA_ "GenSigTimeoutTime_ESL" SG_ 1436 TrailerRHTurnSignalFailSts 0;
BA_ "GenSigTimeoutTime_ECM" SG_ 1436 TrailerRHTurnSignalFailSts 0;
BA_ "GenSigTimeoutTime_DTCM" SG_ 1436 TrailerRHTurnSignalFailSts 0;
BA_ "GenSigTimeoutTime_DMSM" SG_ 1436 TrailerRHTurnSignalFailSts 0;
BA_ "GenSigTimeoutTime_BSM" SG_ 1436 TrailerRHTurnSignalFailSts 0;
BA_ "GenSigTimeoutTime_BCM" SG_ 1436 TrailerRHTurnSignalFailSts 0;
BA_ "GenSigTimeoutTime_AGSM" SG_ 1436 TrailerRHTurnSignalFailSts 0;
BA_ "GenSigTimeoutTime_ADCAM" SG_ 1436 TrailerRHTurnSignalFailSts 0;
BA_ "GenSigTimeoutTime_SGW" SG_ 1436 TrailerStopLightFailSts 0;
BA_ "GenSigTimeoutTime_RFHM" SG_ 1436 TrailerStopLightFailSts 0;
BA_ "GenSigTimeoutTime_MPAD" SG_ 1436 TrailerStopLightFailSts 0;
BA_ "GenSigTimeoutTime_GNMM" SG_ 1436 TrailerStopLightFailSts 0;
BA_ "GenSigTimeoutTime_EVCU2" SG_ 1436 TrailerStopLightFailSts 0;
BA_ "GenSigTimeoutTime_ESL" SG_ 1436 TrailerStopLightFailSts 0;
BA_ "GenSigTimeoutTime_ECM" SG_ 1436 TrailerStopLightFailSts 0;
BA_ "GenSigTimeoutTime_DTCM" SG_ 1436 TrailerStopLightFailSts 0;
BA_ "GenSigTimeoutTime_DMSM" SG_ 1436 TrailerStopLightFailSts 0;
BA_ "GenSigTimeoutTime_BSM" SG_ 1436 TrailerStopLightFailSts 0;
BA_ "GenSigTimeoutTime_BCM" SG_ 1436 TrailerStopLightFailSts 0;
BA_ "GenSigTimeoutTime_AGSM" SG_ 1436 TrailerStopLightFailSts 0;
BA_ "GenSigTimeoutTime_ADCAM" SG_ 1436 TrailerStopLightFailSts 0;
BA_ "GenSigTimeoutTime_RFHM" SG_ 1436 MOOD_LGT_INTS 0;
BA_ "GenSigTimeoutTime_MPAD" SG_ 1436 MOOD_LGT_INTS 0;
BA_ "GenSigTimeoutTime_IPC" SG_ 1436 MOOD_LGT_INTS 0;
BA_ "GenSigTimeoutTime_GNMM" SG_ 1436 MOOD_LGT_INTS 0;
BA_ "GenSigTimeoutTime_EVCU2" SG_ 1436 MOOD_LGT_INTS 0;
BA_ "GenSigTimeoutTime_ESL" SG_ 1436 MOOD_LGT_INTS 0;
BA_ "GenSigTimeoutTime_ECM" SG_ 1436 MOOD_LGT_INTS 0;
BA_ "GenSigTimeoutTime_DTCM" SG_ 1436 MOOD_LGT_INTS 0;
BA_ "GenSigTimeoutTime_DMSM" SG_ 1436 MOOD_LGT_INTS 0;
BA_ "GenSigTimeoutTime_BSM" SG_ 1436 MOOD_LGT_INTS 0;
BA_ "GenSigTimeoutTime_BCM" SG_ 1436 MOOD_LGT_INTS 0;
BA_ "GenSigTimeoutTime_AGSM" SG_ 1436 MOOD_LGT_INTS 0;
BA_ "GenSigTimeoutTime_ADCAM" SG_ 1436 MOOD_LGT_INTS 0;
BA_ "GenSigSendType" SG_ 1436 MOOD_LGT_INTS 3;
BA_ "GenSigTimeoutTime_RFHM" SG_ 1436 PANEL_INTS_DISP 0;
BA_ "GenSigTimeoutTime_MPAD" SG_ 1436 PANEL_INTS_DISP 0;
BA_ "GenSigTimeoutTime_GNMM" SG_ 1436 PANEL_INTS_DISP 0;
BA_ "GenSigTimeoutTime_EVCU2" SG_ 1436 PANEL_INTS_DISP 0;
BA_ "GenSigTimeoutTime_ESL" SG_ 1436 PANEL_INTS_DISP 0;
BA_ "GenSigTimeoutTime_ECM" SG_ 1436 PANEL_INTS_DISP 0;
BA_ "GenSigTimeoutTime_DTCM" SG_ 1436 PANEL_INTS_DISP 0;
BA_ "GenSigTimeoutTime_DMSM" SG_ 1436 PANEL_INTS_DISP 0;
BA_ "GenSigTimeoutTime_BSM" SG_ 1436 PANEL_INTS_DISP 0;
BA_ "GenSigTimeoutTime_BCM" SG_ 1436 PANEL_INTS_DISP 0;
BA_ "GenSigTimeoutTime_AGSM" SG_ 1436 PANEL_INTS_DISP 0;
BA_ "GenSigTimeoutTime_ADCAM" SG_ 1436 PANEL_INTS_DISP 0;
BA_ "GenSigSendType" SG_ 1436 PANEL_INTS_DISP 3;
BA_ "GenSigTimeoutTime_SGW" SG_ 1436 TrailerLHParkingLightFailSts 0;
BA_ "GenSigTimeoutTime_RFHM" SG_ 1436 TrailerLHParkingLightFailSts 0;
BA_ "GenSigTimeoutTime_MPAD" SG_ 1436 TrailerLHParkingLightFailSts 0;
BA_ "GenSigTimeoutTime_GNMM" SG_ 1436 TrailerLHParkingLightFailSts 0;
BA_ "GenSigTimeoutTime_EVCU2" SG_ 1436 TrailerLHParkingLightFailSts 0;
BA_ "GenSigTimeoutTime_ESL" SG_ 1436 TrailerLHParkingLightFailSts 0;
BA_ "GenSigTimeoutTime_ECM" SG_ 1436 TrailerLHParkingLightFailSts 0;
BA_ "GenSigTimeoutTime_DTCM" SG_ 1436 TrailerLHParkingLightFailSts 0;
BA_ "GenSigTimeoutTime_DMSM" SG_ 1436 TrailerLHParkingLightFailSts 0;
BA_ "GenSigTimeoutTime_BSM" SG_ 1436 TrailerLHParkingLightFailSts 0;
BA_ "GenSigTimeoutTime_BCM" SG_ 1436 TrailerLHParkingLightFailSts 0;
BA_ "GenSigTimeoutTime_AGSM" SG_ 1436 TrailerLHParkingLightFailSts 0;
BA_ "GenSigTimeoutTime_ADCAM" SG_ 1436 TrailerLHParkingLightFailSts 0;
BA_ "GenSigTimeoutTime_SGW" SG_ 1436 TrailerLHTurnSignalFailSts 0;
BA_ "GenSigTimeoutTime_RFHM" SG_ 1436 TrailerLHTurnSignalFailSts 0;
BA_ "GenSigTimeoutTime_MPAD" SG_ 1436 TrailerLHTurnSignalFailSts 0;
BA_ "GenSigTimeoutTime_GNMM" SG_ 1436 TrailerLHTurnSignalFailSts 0;
BA_ "GenSigTimeoutTime_EVCU2" SG_ 1436 TrailerLHTurnSignalFailSts 0;
BA_ "GenSigTimeoutTime_ESL" SG_ 1436 TrailerLHTurnSignalFailSts 0;
BA_ "GenSigTimeoutTime_ECM" SG_ 1436 TrailerLHTurnSignalFailSts 0;
BA_ "GenSigTimeoutTime_DTCM" SG_ 1436 TrailerLHTurnSignalFailSts 0;
BA_ "GenSigTimeoutTime_DMSM" SG_ 1436 TrailerLHTurnSignalFailSts 0;
BA_ "GenSigTimeoutTime_BSM" SG_ 1436 TrailerLHTurnSignalFailSts 0;
BA_ "GenSigTimeoutTime_BCM" SG_ 1436 TrailerLHTurnSignalFailSts 0;
BA_ "GenSigTimeoutTime_AGSM" SG_ 1436 TrailerLHTurnSignalFailSts 0;
BA_ "GenSigTimeoutTime_ADCAM" SG_ 1436 TrailerLHTurnSignalFailSts 0;
BA_ "GenSigTimeoutTime_SGW" SG_ 1436 TrailerGenericFailSts 0;
BA_ "GenSigTimeoutTime_RFHM" SG_ 1436 TrailerGenericFailSts 0;
BA_ "GenSigTimeoutTime_MPAD" SG_ 1436 TrailerGenericFailSts 0;
BA_ "GenSigTimeoutTime_GNMM" SG_ 1436 TrailerGenericFailSts 0;
BA_ "GenSigTimeoutTime_EVCU2" SG_ 1436 TrailerGenericFailSts 0;
BA_ "GenSigTimeoutTime_ESL" SG_ 1436 TrailerGenericFailSts 0;
BA_ "GenSigTimeoutTime_ECM" SG_ 1436 TrailerGenericFailSts 0;
BA_ "GenSigTimeoutTime_DTCM" SG_ 1436 TrailerGenericFailSts 0;
BA_ "GenSigTimeoutTime_DMSM" SG_ 1436 TrailerGenericFailSts 0;
BA_ "GenSigTimeoutTime_BSM" SG_ 1436 TrailerGenericFailSts 0;
BA_ "GenSigTimeoutTime_BCM" SG_ 1436 TrailerGenericFailSts 0;
BA_ "GenSigTimeoutTime_AGSM" SG_ 1436 TrailerGenericFailSts 0;
BA_ "GenSigTimeoutTime_ADCAM" SG_ 1436 TrailerGenericFailSts 0;
BA_ "GenSigTimeoutTime_RFHM" SG_ 1436 TrailerConnectionSts 0;
BA_ "GenSigTimeoutTime_GNMM" SG_ 1436 TrailerConnectionSts 0;
BA_ "GenSigTimeoutTime_ESL" SG_ 1436 TrailerConnectionSts 0;
BA_ "GenSigTimeoutTime_ECM" SG_ 1436 TrailerConnectionSts 0;
BA_ "GenSigTimeoutTime_DTCM" SG_ 1436 TrailerConnectionSts 0;
BA_ "GenSigTimeoutTime_DMSM" SG_ 1436 TrailerConnectionSts 0;
BA_ "GenSigTimeoutTime_BCM" SG_ 1436 TrailerConnectionSts 0;
BA_ "GenSigTimeoutTime_AGSM" SG_ 1436 TrailerConnectionSts 0;
BA_ "GenSigTimeoutTime_RFHM" SG_ 1436 U_Call_Button 0;
BA_ "GenSigTimeoutTime_MPAD" SG_ 1436 U_Call_Button 0;
BA_ "GenSigTimeoutTime_IPC" SG_ 1436 U_Call_Button 0;
BA_ "GenSigTimeoutTime_GNMM" SG_ 1436 U_Call_Button 0;
BA_ "GenSigTimeoutTime_EVCU2" SG_ 1436 U_Call_Button 0;
BA_ "GenSigTimeoutTime_ESL" SG_ 1436 U_Call_Button 0;
BA_ "GenSigTimeoutTime_ECM" SG_ 1436 U_Call_Button 0;
BA_ "GenSigTimeoutTime_DTCM" SG_ 1436 U_Call_Button 0;
BA_ "GenSigTimeoutTime_DMSM" SG_ 1436 U_Call_Button 0;
BA_ "GenSigTimeoutTime_BSM" SG_ 1436 U_Call_Button 0;
BA_ "GenSigTimeoutTime_BCM" SG_ 1436 U_Call_Button 0;
BA_ "GenSigTimeoutTime_AGSM" SG_ 1436 U_Call_Button 0;
BA_ "GenSigTimeoutTime_ADCAM" SG_ 1436 U_Call_Button 0;
BA_ "GenSigSendType" SG_ 1436 U_Call_Button 3;
BA_ "GenSigTimeoutTime_RFHM" SG_ 1436 E_Call_Button 0;
BA_ "GenSigTimeoutTime_MPAD" SG_ 1436 E_Call_Button 0;
BA_ "GenSigTimeoutTime_IPC" SG_ 1436 E_Call_Button 0;
BA_ "GenSigTimeoutTime_GNMM" SG_ 1436 E_Call_Button 0;
BA_ "GenSigTimeoutTime_EVCU2" SG_ 1436 E_Call_Button 0;
BA_ "GenSigTimeoutTime_ESL" SG_ 1436 E_Call_Button 0;
BA_ "GenSigTimeoutTime_ECM" SG_ 1436 E_Call_Button 0;
BA_ "GenSigTimeoutTime_DTCM" SG_ 1436 E_Call_Button 0;
BA_ "GenSigTimeoutTime_DMSM" SG_ 1436 E_Call_Button 0;
BA_ "GenSigTimeoutTime_BSM" SG_ 1436 E_Call_Button 0;
BA_ "GenSigTimeoutTime_BCM" SG_ 1436 E_Call_Button 0;
BA_ "GenSigTimeoutTime_AGSM" SG_ 1436 E_Call_Button 0;
BA_ "GenSigTimeoutTime_ADCAM" SG_ 1436 E_Call_Button 0;
BA_ "GenSigSendType" SG_ 1436 E_Call_Button 3;
BA_ "GenSigTimeoutTime_SGW" SG_ 1436 Mem_D_Sv_Rq 0;
BA_ "GenSigTimeoutTime_RFHM" SG_ 1436 Mem_D_Sv_Rq 0;
BA_ "GenSigTimeoutTime_MPAD" SG_ 1436 Mem_D_Sv_Rq 0;
BA_ "GenSigTimeoutTime_GNMM" SG_ 1436 Mem_D_Sv_Rq 0;
BA_ "GenSigTimeoutTime_EVCU2" SG_ 1436 Mem_D_Sv_Rq 0;
BA_ "GenSigTimeoutTime_ESL" SG_ 1436 Mem_D_Sv_Rq 0;
BA_ "GenSigTimeoutTime_ECM" SG_ 1436 Mem_D_Sv_Rq 0;
BA_ "GenSigTimeoutTime_DTCM" SG_ 1436 Mem_D_Sv_Rq 0;
BA_ "GenSigTimeoutTime_DMSM" SG_ 1436 Mem_D_Sv_Rq 0;
BA_ "GenSigTimeoutTime_BSM" SG_ 1436 Mem_D_Sv_Rq 0;
BA_ "GenSigTimeoutTime_BCM" SG_ 1436 Mem_D_Sv_Rq 0;
BA_ "GenSigTimeoutTime_AGSM" SG_ 1436 Mem_D_Sv_Rq 0;
BA_ "GenSigTimeoutTime_ADCAM" SG_ 1436 Mem_D_Sv_Rq 0;
BA_ "GenSigSendType" SG_ 1436 Mem_D_Sv_Rq 3;
BA_ "GenSigTimeoutTime_SGW" SG_ 1436 MEM_RC_STAT 0;
BA_ "GenSigTimeoutTime_RFHM" SG_ 1436 MEM_RC_STAT 0;
BA_ "GenSigTimeoutTime_MPAD" SG_ 1436 MEM_RC_STAT 0;
BA_ "GenSigTimeoutTime_GNMM" SG_ 1436 MEM_RC_STAT 0;
BA_ "GenSigTimeoutTime_EVCU2" SG_ 1436 MEM_RC_STAT 0;
BA_ "GenSigTimeoutTime_ESL" SG_ 1436 MEM_RC_STAT 0;
BA_ "GenSigTimeoutTime_ECM" SG_ 1436 MEM_RC_STAT 0;
BA_ "GenSigTimeoutTime_DTCM" SG_ 1436 MEM_RC_STAT 0;
BA_ "GenSigTimeoutTime_DMSM" SG_ 1436 MEM_RC_STAT 0;
BA_ "GenSigTimeoutTime_BSM" SG_ 1436 MEM_RC_STAT 0;
BA_ "GenSigTimeoutTime_BCM" SG_ 1436 MEM_RC_STAT 0;
BA_ "GenSigTimeoutTime_AGSM" SG_ 1436 MEM_RC_STAT 0;
BA_ "GenSigTimeoutTime_ADCAM" SG_ 1436 MEM_RC_STAT 0;
BA_ "GenSigSendType" SG_ 1436 MEM_RC_STAT 3;
BA_ "GenSigTimeoutTime_SGW" SG_ 1436 Blower_Diagnostics 0;
BA_ "GenSigTimeoutTime_RFHM" SG_ 1436 Blower_Diagnostics 0;
BA_ "GenSigTimeoutTime_MPAD" SG_ 1436 Blower_Diagnostics 0;
BA_ "GenSigTimeoutTime_IPC" SG_ 1436 Blower_Diagnostics 0;
BA_ "GenSigTimeoutTime_GNMM" SG_ 1436 Blower_Diagnostics 0;
BA_ "GenSigTimeoutTime_EVCU2" SG_ 1436 Blower_Diagnostics 0;
BA_ "GenSigTimeoutTime_ESL" SG_ 1436 Blower_Diagnostics 0;
BA_ "GenSigTimeoutTime_DTCM" SG_ 1436 Blower_Diagnostics 0;
BA_ "GenSigTimeoutTime_DMSM" SG_ 1436 Blower_Diagnostics 0;
BA_ "GenSigTimeoutTime_BSM" SG_ 1436 Blower_Diagnostics 0;
BA_ "GenSigTimeoutTime_BCM" SG_ 1436 Blower_Diagnostics 0;
BA_ "GenSigTimeoutTime_AGSM" SG_ 1436 Blower_Diagnostics 0;
BA_ "GenSigTimeoutTime_ADCAM" SG_ 1436 Blower_Diagnostics 0;
BA_ "GenSigSendType" SG_ 1436 Blower_Diagnostics 3;
BA_ "GenSigTimeoutTime_SGW" SG_ 1436 Blower_Speed 0;
BA_ "GenSigTimeoutTime_RFHM" SG_ 1436 Blower_Speed 0;
BA_ "GenSigTimeoutTime_MPAD" SG_ 1436 Blower_Speed 0;
BA_ "GenSigTimeoutTime_IPC" SG_ 1436 Blower_Speed 0;
BA_ "GenSigTimeoutTime_GNMM" SG_ 1436 Blower_Speed 0;
BA_ "GenSigTimeoutTime_EVCU2" SG_ 1436 Blower_Speed 0;
BA_ "GenSigTimeoutTime_ESL" SG_ 1436 Blower_Speed 0;
BA_ "GenSigTimeoutTime_DTCM" SG_ 1436 Blower_Speed 0;
BA_ "GenSigTimeoutTime_DMSM" SG_ 1436 Blower_Speed 0;
BA_ "GenSigTimeoutTime_BSM" SG_ 1436 Blower_Speed 0;
BA_ "GenSigTimeoutTime_BCM" SG_ 1436 Blower_Speed 0;
BA_ "GenSigTimeoutTime_AGSM" SG_ 1436 Blower_Speed 0;
BA_ "GenSigTimeoutTime_ADCAM" SG_ 1436 Blower_Speed 0;
BA_ "GenSigSendType" SG_ 1436 Blower_Speed 3;
BA_ "GenSigTimeoutTime_SGW" SG_ 1436 COMM_Fault 0;
BA_ "GenSigTimeoutTime_RFHM" SG_ 1436 COMM_Fault 0;
BA_ "GenSigTimeoutTime_MPAD" SG_ 1436 COMM_Fault 0;
BA_ "GenSigTimeoutTime_GNMM" SG_ 1436 COMM_Fault 0;
BA_ "GenSigTimeoutTime_EVCU2" SG_ 1436 COMM_Fault 0;
BA_ "GenSigTimeoutTime_ESL" SG_ 1436 COMM_Fault 0;
BA_ "GenSigTimeoutTime_ECM" SG_ 1436 COMM_Fault 0;
BA_ "GenSigTimeoutTime_DTCM" SG_ 1436 COMM_Fault 0;
BA_ "GenSigTimeoutTime_DMSM" SG_ 1436 COMM_Fault 0;
BA_ "GenSigTimeoutTime_BSM" SG_ 1436 COMM_Fault 0;
BA_ "GenSigTimeoutTime_BCM" SG_ 1436 COMM_Fault 0;
BA_ "GenSigTimeoutTime_AGSM" SG_ 1436 COMM_Fault 0;
BA_ "GenSigTimeoutTime_ADCAM" SG_ 1436 COMM_Fault 0;
BA_ "GenSigSendType" SG_ 1436 COMM_Fault 3;
BA_ "GenSigTimeoutTime_RFHM" SG_ 1436 DAY_LGT_MD_DISP 0;
BA_ "GenSigTimeoutTime_MPAD" SG_ 1436 DAY_LGT_MD_DISP 0;
BA_ "GenSigTimeoutTime_GNMM" SG_ 1436 DAY_LGT_MD_DISP 0;
BA_ "GenSigTimeoutTime_EVCU2" SG_ 1436 DAY_LGT_MD_DISP 0;
BA_ "GenSigTimeoutTime_ESL" SG_ 1436 DAY_LGT_MD_DISP 0;
BA_ "GenSigTimeoutTime_ECM" SG_ 1436 DAY_LGT_MD_DISP 0;
BA_ "GenSigTimeoutTime_DTCM" SG_ 1436 DAY_LGT_MD_DISP 0;
BA_ "GenSigTimeoutTime_DMSM" SG_ 1436 DAY_LGT_MD_DISP 0;
BA_ "GenSigTimeoutTime_BSM" SG_ 1436 DAY_LGT_MD_DISP 0;
BA_ "GenSigTimeoutTime_BCM" SG_ 1436 DAY_LGT_MD_DISP 0;
BA_ "GenSigTimeoutTime_AGSM" SG_ 1436 DAY_LGT_MD_DISP 0;
BA_ "GenSigTimeoutTime_ADCAM" SG_ 1436 DAY_LGT_MD_DISP 0;
BA_ "GenSigSendType" SG_ 1436 DAY_LGT_MD_DISP 3;
BA_ "GenSigTimeoutTime_RFHM" SG_ 1436 EBL_Stat 0;
BA_ "GenSigTimeoutTime_MPAD" SG_ 1436 EBL_Stat 0;
BA_ "GenSigTimeoutTime_IPC" SG_ 1436 EBL_Stat 0;
BA_ "GenSigTimeoutTime_GNMM" SG_ 1436 EBL_Stat 0;
BA_ "GenSigTimeoutTime_ESL" SG_ 1436 EBL_Stat 0;
BA_ "GenSigTimeoutTime_ECM" SG_ 1436 EBL_Stat 0;
BA_ "GenSigTimeoutTime_DTCM" SG_ 1436 EBL_Stat 0;
BA_ "GenSigTimeoutTime_DMSM" SG_ 1436 EBL_Stat 0;
BA_ "GenSigTimeoutTime_BSM" SG_ 1436 EBL_Stat 0;
BA_ "GenSigTimeoutTime_BCM" SG_ 1436 EBL_Stat 0;
BA_ "GenSigTimeoutTime_AGSM" SG_ 1436 EBL_Stat 0;
BA_ "GenSigTimeoutTime_ADCAM" SG_ 1436 EBL_Stat 0;
BA_ "GenSigSendType" SG_ 1436 EBL_Stat 3;
BA_ "GenSigTimeoutTime_SGW" SG_ 1436 Internal_Fault 0;
BA_ "GenSigTimeoutTime_RFHM" SG_ 1436 Internal_Fault 0;
BA_ "GenSigTimeoutTime_MPAD" SG_ 1436 Internal_Fault 0;
BA_ "GenSigTimeoutTime_GNMM" SG_ 1436 Internal_Fault 0;
BA_ "GenSigTimeoutTime_EVCU2" SG_ 1436 Internal_Fault 0;
BA_ "GenSigTimeoutTime_ESL" SG_ 1436 Internal_Fault 0;
BA_ "GenSigTimeoutTime_ECM" SG_ 1436 Internal_Fault 0;
BA_ "GenSigTimeoutTime_DTCM" SG_ 1436 Internal_Fault 0;
BA_ "GenSigTimeoutTime_DMSM" SG_ 1436 Internal_Fault 0;
BA_ "GenSigTimeoutTime_BSM" SG_ 1436 Internal_Fault 0;
BA_ "GenSigTimeoutTime_BCM" SG_ 1436 Internal_Fault 0;
BA_ "GenSigTimeoutTime_AGSM" SG_ 1436 Internal_Fault 0;
BA_ "GenSigTimeoutTime_ADCAM" SG_ 1436 Internal_Fault 0;
BA_ "GenSigSendType" SG_ 1436 Internal_Fault 3;
BA_ "GenSigTimeoutTime_SGW" SG_ 1436 Mem_D_Pos_Rq 0;
BA_ "GenSigTimeoutTime_RFHM" SG_ 1436 Mem_D_Pos_Rq 0;
BA_ "GenSigTimeoutTime_MPAD" SG_ 1436 Mem_D_Pos_Rq 0;
BA_ "GenSigTimeoutTime_GNMM" SG_ 1436 Mem_D_Pos_Rq 0;
BA_ "GenSigTimeoutTime_EVCU2" SG_ 1436 Mem_D_Pos_Rq 0;
BA_ "GenSigTimeoutTime_ESL" SG_ 1436 Mem_D_Pos_Rq 0;
BA_ "GenSigTimeoutTime_ECM" SG_ 1436 Mem_D_Pos_Rq 0;
BA_ "GenSigTimeoutTime_DTCM" SG_ 1436 Mem_D_Pos_Rq 0;
BA_ "GenSigTimeoutTime_DMSM" SG_ 1436 Mem_D_Pos_Rq 0;
BA_ "GenSigTimeoutTime_BSM" SG_ 1436 Mem_D_Pos_Rq 0;
BA_ "GenSigTimeoutTime_BCM" SG_ 1436 Mem_D_Pos_Rq 0;
BA_ "GenSigTimeoutTime_AGSM" SG_ 1436 Mem_D_Pos_Rq 0;
BA_ "GenSigTimeoutTime_ADCAM" SG_ 1436 Mem_D_Pos_Rq 0;
BA_ "GenSigSendType" SG_ 1436 Mem_D_Pos_Rq 3;
BA_ "GenSigTimeoutTime_SGW" SG_ 1436 Mem_D_Rc_Rq 0;
BA_ "GenSigTimeoutTime_RFHM" SG_ 1436 Mem_D_Rc_Rq 0;
BA_ "GenSigTimeoutTime_MPAD" SG_ 1436 Mem_D_Rc_Rq 0;
BA_ "GenSigTimeoutTime_GNMM" SG_ 1436 Mem_D_Rc_Rq 0;
BA_ "GenSigTimeoutTime_EVCU2" SG_ 1436 Mem_D_Rc_Rq 0;
BA_ "GenSigTimeoutTime_ESL" SG_ 1436 Mem_D_Rc_Rq 0;
BA_ "GenSigTimeoutTime_ECM" SG_ 1436 Mem_D_Rc_Rq 0;
BA_ "GenSigTimeoutTime_DTCM" SG_ 1436 Mem_D_Rc_Rq 0;
BA_ "GenSigTimeoutTime_DMSM" SG_ 1436 Mem_D_Rc_Rq 0;
BA_ "GenSigTimeoutTime_BSM" SG_ 1436 Mem_D_Rc_Rq 0;
BA_ "GenSigTimeoutTime_BCM" SG_ 1436 Mem_D_Rc_Rq 0;
BA_ "GenSigTimeoutTime_AGSM" SG_ 1436 Mem_D_Rc_Rq 0;
BA_ "GenSigTimeoutTime_ADCAM" SG_ 1436 Mem_D_Rc_Rq 0;
BA_ "GenSigSendType" SG_ 1436 Mem_D_Rc_Rq 3;
BA_ "GenSigTimeoutTime_SGW" SG_ 1435 RearFogPressed 0;
BA_ "GenSigTimeoutTime_RFHM" SG_ 1435 RearFogPressed 0;
BA_ "GenSigTimeoutTime_MPAD" SG_ 1435 RearFogPressed 0;
BA_ "GenSigTimeoutTime_IPC" SG_ 1435 RearFogPressed 0;
BA_ "GenSigTimeoutTime_GNMM" SG_ 1435 RearFogPressed 0;
BA_ "GenSigTimeoutTime_EVCU2" SG_ 1435 RearFogPressed 0;
BA_ "GenSigTimeoutTime_ESL" SG_ 1435 RearFogPressed 0;
BA_ "GenSigTimeoutTime_ECM" SG_ 1435 RearFogPressed 0;
BA_ "GenSigTimeoutTime_DTCM" SG_ 1435 RearFogPressed 0;
BA_ "GenSigTimeoutTime_DMSM" SG_ 1435 RearFogPressed 0;
BA_ "GenSigTimeoutTime_BSM" SG_ 1435 RearFogPressed 0;
BA_ "GenSigTimeoutTime_BCM" SG_ 1435 RearFogPressed 0;
BA_ "GenSigTimeoutTime_SGW" SG_ 1435 RLTurnLampFault 0;
BA_ "GenSigTimeoutTime_RFHM" SG_ 1435 RLTurnLampFault 0;
BA_ "GenSigTimeoutTime_GNMM" SG_ 1435 RLTurnLampFault 0;
BA_ "GenSigTimeoutTime_EVCU2" SG_ 1435 RLTurnLampFault 0;
BA_ "GenSigTimeoutTime_ESL" SG_ 1435 RLTurnLampFault 0;
BA_ "GenSigTimeoutTime_ECM" SG_ 1435 RLTurnLampFault 0;
BA_ "GenSigTimeoutTime_DTCM" SG_ 1435 RLTurnLampFault 0;
BA_ "GenSigTimeoutTime_DMSM" SG_ 1435 RLTurnLampFault 0;
BA_ "GenSigTimeoutTime_BSM" SG_ 1435 RLTurnLampFault 0;
BA_ "GenSigTimeoutTime_BCM" SG_ 1435 RLTurnLampFault 0;
BA_ "GenSigTimeoutTime_AGSM" SG_ 1435 RLTurnLampFault 0;
BA_ "GenSigTimeoutTime_ADCAM" SG_ 1435 RLTurnLampFault 0;
BA_ "GenSigSendType" SG_ 1435 RLTurnLampFault 3;
BA_ "GenSigTimeoutTime_GNMM" SG_ 1435 RRTurnLampFault 0;
BA_ "GenSigTimeoutTime_EVCU2" SG_ 1435 RRTurnLampFault 0;
BA_ "GenSigTimeoutTime_ESL" SG_ 1435 RRTurnLampFault 0;
BA_ "GenSigTimeoutTime_ECM" SG_ 1435 RRTurnLampFault 0;
BA_ "GenSigTimeoutTime_DTCM" SG_ 1435 RRTurnLampFault 0;
BA_ "GenSigTimeoutTime_DMSM" SG_ 1435 RRTurnLampFault 0;
BA_ "GenSigTimeoutTime_BSM" SG_ 1435 RRTurnLampFault 0;
BA_ "GenSigTimeoutTime_BCM" SG_ 1435 RRTurnLampFault 0;
BA_ "GenSigTimeoutTime_AGSM" SG_ 1435 RRTurnLampFault 0;
BA_ "GenSigTimeoutTime_ADCAM" SG_ 1435 RRTurnLampFault 0;
BA_ "GenSigSendType" SG_ 1435 RRTurnLampFault 3;
BA_ "GenSigTimeoutTime_SGW" SG_ 1435 RRTurnLampFault 0;
BA_ "GenSigTimeoutTime_RFHM" SG_ 1435 RRTurnLampFault 0;
BA_ "GenSigTimeoutTime_SGW" SG_ 1435 VEH_INT_TEMP 0;
BA_ "GenSigTimeoutTime_RFHM" SG_ 1435 VEH_INT_TEMP 0;
BA_ "GenSigTimeoutTime_MPAD" SG_ 1435 VEH_INT_TEMP 0;
BA_ "GenSigTimeoutTime_IPC" SG_ 1435 VEH_INT_TEMP 0;
BA_ "GenSigTimeoutTime_GNMM" SG_ 1435 VEH_INT_TEMP 0;
BA_ "GenSigTimeoutTime_ESL" SG_ 1435 VEH_INT_TEMP 0;
BA_ "GenSigTimeoutTime_ECM" SG_ 1435 VEH_INT_TEMP 0;
BA_ "GenSigTimeoutTime_DTCM" SG_ 1435 VEH_INT_TEMP 0;
BA_ "GenSigTimeoutTime_DMSM" SG_ 1435 VEH_INT_TEMP 0;
BA_ "GenSigTimeoutTime_BSM" SG_ 1435 VEH_INT_TEMP 0;
BA_ "GenSigTimeoutTime_BCM" SG_ 1435 VEH_INT_TEMP 0;
BA_ "GenSigTimeoutTime_AGSM" SG_ 1435 VEH_INT_TEMP 0;
BA_ "GenSigTimeoutTime_ADCAM" SG_ 1435 VEH_INT_TEMP 0;
BA_ "GenSigTimeoutTime_SGW" SG_ 1435 DRV_TEMP_DR_POS 0;
BA_ "GenSigTimeoutTime_RFHM" SG_ 1435 DRV_TEMP_DR_POS 0;
BA_ "GenSigTimeoutTime_MPAD" SG_ 1435 DRV_TEMP_DR_POS 0;
BA_ "GenSigTimeoutTime_IPC" SG_ 1435 DRV_TEMP_DR_POS 0;
BA_ "GenSigTimeoutTime_GNMM" SG_ 1435 DRV_TEMP_DR_POS 0;
BA_ "GenSigTimeoutTime_ESL" SG_ 1435 DRV_TEMP_DR_POS 0;
BA_ "GenSigTimeoutTime_ECM" SG_ 1435 DRV_TEMP_DR_POS 0;
BA_ "GenSigTimeoutTime_DTCM" SG_ 1435 DRV_TEMP_DR_POS 0;
BA_ "GenSigTimeoutTime_DMSM" SG_ 1435 DRV_TEMP_DR_POS 0;
BA_ "GenSigTimeoutTime_BSM" SG_ 1435 DRV_TEMP_DR_POS 0;
BA_ "GenSigTimeoutTime_BCM" SG_ 1435 DRV_TEMP_DR_POS 0;
BA_ "GenSigTimeoutTime_AGSM" SG_ 1435 DRV_TEMP_DR_POS 0;
BA_ "GenSigTimeoutTime_ADCAM" SG_ 1435 DRV_TEMP_DR_POS 0;
BA_ "GenSigStartValue" SG_ 1435 DRV_TEMP_DR_POS 127;
BA_ "GenSigTimeoutTime_AGSM" SG_ 1435 RearFogPressed 0;
BA_ "GenSigSendType" SG_ 1435 RearFogPressed 3;
BA_ "GenSigTimeoutTime_SGW" SG_ 1435 R_TurnCluster 0;
BA_ "GenSigTimeoutTime_RFHM" SG_ 1435 R_TurnCluster 0;
BA_ "GenSigTimeoutTime_MPAD" SG_ 1435 R_TurnCluster 0;
BA_ "GenSigTimeoutTime_GNMM" SG_ 1435 R_TurnCluster 0;
BA_ "GenSigTimeoutTime_EVCU2" SG_ 1435 R_TurnCluster 0;
BA_ "GenSigTimeoutTime_ESL" SG_ 1435 R_TurnCluster 0;
BA_ "GenSigTimeoutTime_ECM" SG_ 1435 R_TurnCluster 0;
BA_ "GenSigTimeoutTime_DTCM" SG_ 1435 R_TurnCluster 0;
BA_ "GenSigTimeoutTime_DMSM" SG_ 1435 R_TurnCluster 0;
BA_ "GenSigTimeoutTime_BSM" SG_ 1435 R_TurnCluster 0;
BA_ "GenSigTimeoutTime_BCM" SG_ 1435 R_TurnCluster 0;
BA_ "GenSigTimeoutTime_AGSM" SG_ 1435 R_TurnCluster 0;
BA_ "GenSigTimeoutTime_ADCAM" SG_ 1435 R_TurnCluster 0;
BA_ "GenSigSendType" SG_ 1435 R_TurnCluster 3;
BA_ "GenSigTimeoutTime_SGW" SG_ 1435 HVAC_Blwr_Perct 0;
BA_ "GenSigTimeoutTime_RFHM" SG_ 1435 HVAC_Blwr_Perct 0;
BA_ "GenSigTimeoutTime_MPAD" SG_ 1435 HVAC_Blwr_Perct 0;
BA_ "GenSigTimeoutTime_IPC" SG_ 1435 HVAC_Blwr_Perct 0;
BA_ "GenSigTimeoutTime_GNMM" SG_ 1435 HVAC_Blwr_Perct 0;
BA_ "GenSigTimeoutTime_ESL" SG_ 1435 HVAC_Blwr_Perct 0;
BA_ "GenSigTimeoutTime_ECM" SG_ 1435 HVAC_Blwr_Perct 0;
BA_ "GenSigTimeoutTime_DTCM" SG_ 1435 HVAC_Blwr_Perct 0;
BA_ "GenSigTimeoutTime_DMSM" SG_ 1435 HVAC_Blwr_Perct 0;
BA_ "GenSigTimeoutTime_BSM" SG_ 1435 HVAC_Blwr_Perct 0;
BA_ "GenSigTimeoutTime_BCM" SG_ 1435 HVAC_Blwr_Perct 0;
BA_ "GenSigTimeoutTime_AGSM" SG_ 1435 HVAC_Blwr_Perct 0;
BA_ "GenSigTimeoutTime_ADCAM" SG_ 1435 HVAC_Blwr_Perct 0;
BA_ "GenSigStartValue" SG_ 1435 HVAC_Blwr_Perct 127;
BA_ "GenSigTimeoutTime_SGW" SG_ 1435 L_TurnCluster 0;
BA_ "GenSigTimeoutTime_RFHM" SG_ 1435 L_TurnCluster 0;
BA_ "GenSigTimeoutTime_MPAD" SG_ 1435 L_TurnCluster 0;
BA_ "GenSigTimeoutTime_GNMM" SG_ 1435 L_TurnCluster 0;
BA_ "GenSigTimeoutTime_EVCU2" SG_ 1435 L_TurnCluster 0;
BA_ "GenSigTimeoutTime_ESL" SG_ 1435 L_TurnCluster 0;
BA_ "GenSigTimeoutTime_ECM" SG_ 1435 L_TurnCluster 0;
BA_ "GenSigTimeoutTime_DTCM" SG_ 1435 L_TurnCluster 0;
BA_ "GenSigTimeoutTime_DMSM" SG_ 1435 L_TurnCluster 0;
BA_ "GenSigTimeoutTime_BSM" SG_ 1435 L_TurnCluster 0;
BA_ "GenSigTimeoutTime_RFHM" SG_ 1459 Next_Climate_Time_Min 0;
BA_ "GenSigTimeoutTime_MPAD" SG_ 1459 Next_Climate_Time_Min 0;
BA_ "GenSigTimeoutTime_IPC" SG_ 1459 Next_Climate_Time_Min 0;
BA_ "GenSigTimeoutTime_GNMM" SG_ 1459 Next_Climate_Time_Min 0;
BA_ "GenSigTimeoutTime_EVCU2" SG_ 1459 Next_Climate_Time_Min 0;
BA_ "GenSigTimeoutTime_ESL" SG_ 1459 Next_Climate_Time_Min 0;
BA_ "GenSigTimeoutTime_ECM" SG_ 1459 Next_Climate_Time_Min 0;
BA_ "GenSigTimeoutTime_DTCM" SG_ 1459 Next_Climate_Time_Min 0;
BA_ "GenSigTimeoutTime_DMSM" SG_ 1459 Next_Climate_Time_Min 0;
BA_ "GenSigTimeoutTime_BSM" SG_ 1459 Next_Climate_Time_Min 0;
BA_ "GenSigTimeoutTime_BCM" SG_ 1459 Next_Climate_Time_Min 0;
BA_ "GenSigTimeoutTime_AGSM" SG_ 1459 Next_Climate_Time_Min 0;
BA_ "GenSigTimeoutTime_ADCAM" SG_ 1459 Next_Climate_Time_Min 0;
BA_ "GenSigTimeoutTime_RFHM" SG_ 1459 Next_Climate_Time_Hr 0;
BA_ "GenSigTimeoutTime_MPAD" SG_ 1459 Next_Climate_Time_Hr 0;
BA_ "GenSigTimeoutTime_IPC" SG_ 1459 Next_Climate_Time_Hr 0;
BA_ "GenSigTimeoutTime_GNMM" SG_ 1459 Next_Climate_Time_Hr 0;
BA_ "GenSigTimeoutTime_EVCU2" SG_ 1459 Next_Climate_Time_Hr 0;
BA_ "GenSigTimeoutTime_ESL" SG_ 1459 Next_Climate_Time_Hr 0;
BA_ "GenSigTimeoutTime_RFHM" SG_ 1459 Nxt_External_Charge_ImmediateTgt 0;
BA_ "GenSigTimeoutTime_MPAD" SG_ 1459 Nxt_External_Charge_ImmediateTgt 0;
BA_ "GenSigTimeoutTime_IPC" SG_ 1459 Nxt_External_Charge_ImmediateTgt 0;
BA_ "GenSigTimeoutTime_GNMM" SG_ 1459 Nxt_External_Charge_ImmediateTgt 0;
BA_ "GenSigTimeoutTime_EVCU2" SG_ 1459 Nxt_External_Charge_ImmediateTgt 0;
BA_ "GenSigTimeoutTime_ESL" SG_ 1459 Nxt_External_Charge_ImmediateTgt 0;
BA_ "GenSigTimeoutTime_ECM" SG_ 1459 Nxt_External_Charge_ImmediateTgt 0;
BA_ "GenSigTimeoutTime_DTCM" SG_ 1459 Nxt_External_Charge_ImmediateTgt 0;
BA_ "GenSigTimeoutTime_DMSM" SG_ 1459 Nxt_External_Charge_ImmediateTgt 0;
BA_ "GenSigTimeoutTime_BSM" SG_ 1459 Nxt_External_Charge_ImmediateTgt 0;
BA_ "GenSigTimeoutTime_BCM" SG_ 1459 Nxt_External_Charge_ImmediateTgt 0;
BA_ "GenSigTimeoutTime_AGSM" SG_ 1459 Nxt_External_Charge_ImmediateTgt 0;
BA_ "GenSigTimeoutTime_ADCAM" SG_ 1459 Nxt_External_Charge_ImmediateTgt 0;
BA_ "GenSigSendType" SG_ 1459 Nxt_External_Charge_ImmediateTgt 3;
BA_ "GenSigStartValue" SG_ 1459 Nxt_External_Charge_ImmediateTgt 15;
BA_ "GenSigTimeoutTime_RFHM" SG_ 1459 Nxt_External_Charge_ExternalTgt 0;
BA_ "GenSigTimeoutTime_MPAD" SG_ 1459 Nxt_External_Charge_ExternalTgt 0;
BA_ "GenSigTimeoutTime_IPC" SG_ 1459 Nxt_External_Charge_ExternalTgt 0;
BA_ "GenSigTimeoutTime_GNMM" SG_ 1459 Nxt_External_Charge_ExternalTgt 0;
BA_ "GenSigTimeoutTime_EVCU2" SG_ 1459 Nxt_External_Charge_ExternalTgt 0;
BA_ "GenSigTimeoutTime_ESL" SG_ 1459 Nxt_External_Charge_ExternalTgt 0;
BA_ "GenSigTimeoutTime_ECM" SG_ 1459 Nxt_External_Charge_ExternalTgt 0;
BA_ "GenSigTimeoutTime_DTCM" SG_ 1459 Nxt_External_Charge_ExternalTgt 0;
BA_ "GenSigTimeoutTime_DMSM" SG_ 1459 Nxt_External_Charge_ExternalTgt 0;
BA_ "GenSigTimeoutTime_BSM" SG_ 1459 Nxt_External_Charge_ExternalTgt 0;
BA_ "GenSigTimeoutTime_BCM" SG_ 1459 Nxt_External_Charge_ExternalTgt 0;
BA_ "GenSigTimeoutTime_AGSM" SG_ 1459 Nxt_External_Charge_ExternalTgt 0;
BA_ "GenSigTimeoutTime_ADCAM" SG_ 1459 Nxt_External_Charge_ExternalTgt 0;
BA_ "GenSigSendType" SG_ 1459 Nxt_External_Charge_ExternalTgt 3;
BA_ "GenSigStartValue" SG_ 1459 Nxt_External_Charge_ExternalTgt 15;
BA_ "GenSigTimeoutTime_RFHM" SG_ 1459 Nxt_External_Charge_EndDay 0;
BA_ "GenSigTimeoutTime_MPAD" SG_ 1459 Nxt_External_Charge_EndDay 0;
BA_ "GenSigTimeoutTime_IPC" SG_ 1459 Nxt_External_Charge_EndDay 0;
BA_ "GenSigTimeoutTime_GNMM" SG_ 1459 Nxt_External_Charge_EndDay 0;
BA_ "GenSigTimeoutTime_EVCU2" SG_ 1459 Nxt_External_Charge_EndDay 0;
BA_ "GenSigTimeoutTime_ESL" SG_ 1459 Nxt_External_Charge_EndDay 0;
BA_ "GenSigTimeoutTime_ECM" SG_ 1459 Nxt_External_Charge_EndDay 0;
BA_ "GenSigTimeoutTime_DTCM" SG_ 1459 Nxt_External_Charge_EndDay 0;
BA_ "GenSigTimeoutTime_DMSM" SG_ 1459 Nxt_External_Charge_EndDay 0;
BA_ "GenSigTimeoutTime_BSM" SG_ 1459 Nxt_External_Charge_EndDay 0;
BA_ "GenSigTimeoutTime_BCM" SG_ 1459 Nxt_External_Charge_EndDay 0;
BA_ "GenSigTimeoutTime_AGSM" SG_ 1459 Nxt_External_Charge_EndDay 0;
BA_ "GenSigTimeoutTime_ADCAM" SG_ 1459 Nxt_External_Charge_EndDay 0;
BA_ "GenSigSendType" SG_ 1459 Nxt_External_Charge_EndDay 3;
BA_ "GenSigStartValue" SG_ 1459 Nxt_External_Charge_EndDay 15;
BA_ "GenSigTimeoutTime_RFHM" SG_ 1459 Nxt_Ext_Charge_End_Time_Min 0;
BA_ "GenSigTimeoutTime_MPAD" SG_ 1459 Nxt_Ext_Charge_End_Time_Min 0;
BA_ "GenSigTimeoutTime_IPC" SG_ 1459 Nxt_Ext_Charge_End_Time_Min 0;
BA_ "GenSigTimeoutTime_GNMM" SG_ 1459 Nxt_Ext_Charge_End_Time_Min 0;
BA_ "GenSigTimeoutTime_EVCU2" SG_ 1459 Nxt_Ext_Charge_End_Time_Min 0;
BA_ "GenSigTimeoutTime_ESL" SG_ 1459 Nxt_Ext_Charge_End_Time_Min 0;
BA_ "GenSigTimeoutTime_ECM" SG_ 1459 Nxt_Ext_Charge_End_Time_Min 0;
BA_ "GenSigTimeoutTime_DTCM" SG_ 1459 Nxt_Ext_Charge_End_Time_Min 0;
BA_ "GenSigTimeoutTime_DMSM" SG_ 1459 Nxt_Ext_Charge_End_Time_Min 0;
BA_ "GenSigTimeoutTime_BSM" SG_ 1459 Nxt_Ext_Charge_End_Time_Min 0;
BA_ "GenSigTimeoutTime_BCM" SG_ 1459 Nxt_Ext_Charge_End_Time_Min 0;
BA_ "GenSigTimeoutTime_AGSM" SG_ 1459 Nxt_Ext_Charge_End_Time_Min 0;
BA_ "GenSigTimeoutTime_ADCAM" SG_ 1459 Nxt_Ext_Charge_End_Time_Min 0;
BA_ "GenSigSendType" SG_ 1459 Nxt_Ext_Charge_End_Time_Min 3;
BA_ "GenSigStartValue" SG_ 1459 Nxt_Ext_Charge_End_Time_Min 15;
BA_ "GenSigTimeoutTime_RFHM" SG_ 1459 Nxt_Ext_Charge_End_Time_Hr 0;
BA_ "GenSigTimeoutTime_MPAD" SG_ 1459 Nxt_Ext_Charge_End_Time_Hr 0;
BA_ "GenSigTimeoutTime_IPC" SG_ 1459 Nxt_Ext_Charge_End_Time_Hr 0;
BA_ "GenSigTimeoutTime_GNMM" SG_ 1459 Nxt_Ext_Charge_End_Time_Hr 0;
BA_ "GenSigTimeoutTime_EVCU2" SG_ 1459 Nxt_Ext_Charge_End_Time_Hr 0;
BA_ "GenSigTimeoutTime_BCM" SG_ 750 Battery_Volt_1 0;
BA_ "GenSigTimeoutTime_RFHM" SG_ 750 Battery_Volt_2 0;
BA_ "GenSigTimeoutTime_IPC" SG_ 750 Battery_Volt_2 0;
BA_ "GenSigTimeoutTime_GNMM" SG_ 750 Battery_Volt_2 0;
BA_ "GenSigTimeoutTime_ESL" SG_ 750 Battery_Volt_2 0;
BA_ "GenSigTimeoutTime_ECM" SG_ 750 Battery_Volt_2 0;
BA_ "GenSigTimeoutTime_DTCM" SG_ 750 Battery_Volt_2 0;
BA_ "GenSigTimeoutTime_DMSM" SG_ 750 Battery_Volt_2 0;
BA_ "GenSigTimeoutTime_BCM" SG_ 750 Battery_Volt_2 0;
BA_ "GenSigTimeoutTime_AGSM" SG_ 750 Battery_Volt_2 0;
BA_ "GenSigTimeoutTime_ADCAM" SG_ 750 Battery_Volt_2 0;
BA_ "GenSigTimeoutTime_SGW" SG_ 750 CRC_BCM3 0;
BA_ "GenSigTimeoutTime_RFHM" SG_ 750 CRC_BCM3 0;
BA_ "GenSigTimeoutTime_IPC" SG_ 750 CRC_BCM3 0;
BA_ "GenSigTimeoutTime_GNMM" SG_ 750 CRC_BCM3 0;
BA_ "GenSigTimeoutTime_EVCU2" SG_ 750 CRC_BCM3 0;
BA_ "GenSigTimeoutTime_ESL" SG_ 750 CRC_BCM3 0;
BA_ "GenSigTimeoutTime_ECM" SG_ 750 CRC_BCM3 0;
BA_ "GenSigTimeoutTime_DTCM" SG_ 750 CRC_BCM3 0;
BA_ "GenSigTimeoutTime_BCM" SG_ 750 CRC_BCM3 0;
BA_ "GenSigTimeoutTime_AGSM" SG_ 750 CRC_BCM3 0;
BA_ "GenSigTimeoutTime_SGW" SG_ 750 FronWiperFailSts 0;
BA_ "GenSigTimeoutTime_RFHM" SG_ 750 FronWiperFailSts 0;
BA_ "GenSigTimeoutTime_IPC" SG_ 750 FronWiperFailSts 0;
BA_ "GenSigTimeoutTime_GNMM" SG_ 750 FronWiperFailSts 0;
BA_ "GenSigTimeoutTime_EVCU2" SG_ 750 FronWiperFailSts 0;
BA_ "GenSigTimeoutTime_ESL" SG_ 750 FronWiperFailSts 0;
BA_ "GenSigTimeoutTime_ECM" SG_ 750 FronWiperFailSts 0;
BA_ "GenSigTimeoutTime_DMSM" SG_ 750 FronWiperFailSts 0;
BA_ "GenSigTimeoutTime_BSM" SG_ 750 FronWiperFailSts 0;
BA_ "GenSigTimeoutTime_BCM" SG_ 750 FronWiperFailSts 0;
BA_ "GenSigTimeoutTime_AGSM" SG_ 750 FronWiperFailSts 0;
BA_ "GenSigTimeoutTime_SGW" SG_ 750 MessageCounter_BCM3 0;
BA_ "GenSigTimeoutTime_RFHM" SG_ 750 MessageCounter_BCM3 0;
BA_ "GenSigTimeoutTime_IPC" SG_ 750 MessageCounter_BCM3 0;
BA_ "GenSigTimeoutTime_GNMM" SG_ 750 MessageCounter_BCM3 0;
BA_ "GenSigTimeoutTime_EVCU2" SG_ 750 MessageCounter_BCM3 0;
BA_ "GenSigTimeoutTime_ESL" SG_ 750 MessageCounter_BCM3 0;
BA_ "GenSigTimeoutTime_ECM" SG_ 750 MessageCounter_BCM3 0;
BA_ "GenSigTimeoutTime_DTCM" SG_ 750 MessageCounter_BCM3 0;
BA_ "GenSigTimeoutTime_BCM" SG_ 750 MessageCounter_BCM3 0;
BA_ "GenSigTimeoutTime_AGSM" SG_ 750 MessageCounter_BCM3 0;
BA_ "GenSigTimeoutTime_ESL" SG_ 1459 Nxt_Ext_Charge_End_Time_Hr 0;
BA_ "GenSigTimeoutTime_ECM" SG_ 1459 Nxt_Ext_Charge_End_Time_Hr 0;
BA_ "GenSigTimeoutTime_DTCM" SG_ 1459 Nxt_Ext_Charge_End_Time_Hr 0;
BA_ "GenSigTimeoutTime_DMSM" SG_ 1459 Nxt_Ext_Charge_End_Time_Hr 0;
BA_ "GenSigTimeoutTime_BSM" SG_ 1459 Nxt_Ext_Charge_End_Time_Hr 0;
BA_ "GenSigTimeoutTime_BCM" SG_ 1459 Nxt_Ext_Charge_End_Time_Hr 0;
BA_ "GenSigTimeoutTime_AGSM" SG_ 1459 Nxt_Ext_Charge_End_Time_Hr 0;
BA_ "GenSigTimeoutTime_ADCAM" SG_ 1459 Nxt_Ext_Charge_End_Time_Hr 0;
BA_ "GenSigSendType" SG_ 1459 Nxt_Ext_Charge_End_Time_Hr 3;
BA_ "GenSigTimeoutTime_RFHM" SG_ 1459 Nxt_Charge_Schedule_Type 0;
BA_ "GenSigTimeoutTime_MPAD" SG_ 1459 Nxt_Charge_Schedule_Type 0;
BA_ "GenSigTimeoutTime_IPC" SG_ 1459 Nxt_Charge_Schedule_Type 0;
BA_ "GenSigTimeoutTime_GNMM" SG_ 1459 Nxt_Charge_Schedule_Type 0;
BA_ "GenSigTimeoutTime_EVCU2" SG_ 1459 Nxt_Charge_Schedule_Type 0;
BA_ "GenSigTimeoutTime_ESL" SG_ 1459 Nxt_Charge_Schedule_Type 0;
BA_ "GenSigTimeoutTime_ECM" SG_ 1459 Nxt_Charge_Schedule_Type 0;
BA_ "GenSigTimeoutTime_DTCM" SG_ 1459 Nxt_Charge_Schedule_Type 0;
BA_ "GenSigTimeoutTime_DMSM" SG_ 1459 Nxt_Charge_Schedule_Type 0;
BA_ "GenSigTimeoutTime_BSM" SG_ 1459 Nxt_Charge_Schedule_Type 0;
BA_ "GenSigTimeoutTime_BCM" SG_ 1459 Nxt_Charge_Schedule_Type 0;
BA_ "GenSigTimeoutTime_AGSM" SG_ 1459 Nxt_Charge_Schedule_Type 0;
BA_ "GenSigTimeoutTime_ADCAM" SG_ 1459 Nxt_Charge_Schedule_Type 0;
BA_ "GenSigSendType" SG_ 1459 Nxt_Charge_Schedule_Type 3;
BA_ "GenSigTimeoutTime_GNMM" SG_ 1464 External_ChargeTarget1 0;
BA_ "GenSigTimeoutTime_ESL" SG_ 1464 External_ChargeTarget1 0;
BA_ "GenSigTimeoutTime_ECM" SG_ 1464 External_ChargeTarget1 0;
BA_ "GenSigTimeoutTime_DTCM" SG_ 1464 External_ChargeTarget1 0;
BA_ "GenSigTimeoutTime_DMSM" SG_ 1464 External_ChargeTarget1 0;
BA_ "GenSigTimeoutTime_BSM" SG_ 1464 External_ChargeTarget1 0;
BA_ "GenSigTimeoutTime_BCM" SG_ 1464 External_ChargeTarget1 0;
BA_ "GenSigTimeoutTime_AGSM" SG_ 1464 External_ChargeTarget1 0;
BA_ "GenSigTimeoutTime_ADCAM" SG_ 1464 External_ChargeTarget1 0;
BA_ "GenSigSendType" SG_ 1464 External_ChargeTarget1 3;
BA_ "GenSigStartValue" SG_ 1464 External_ChargeTarget1 15;
BA_ "GenSigTimeoutTime_SGW" SG_ 1464 Charge_Schedule_Type2 0;
BA_ "GenSigTimeoutTime_RFHM" SG_ 1464 Charge_Schedule_Type2 0;
BA_ "GenSigTimeoutTime_MPAD" SG_ 1464 Charge_Schedule_Type2 0;
BA_ "GenSigTimeoutTime_IPC" SG_ 1464 Charge_Schedule_Type2 0;
BA_ "GenSigTimeoutTime_GNMM" SG_ 1464 Charge_Schedule_Type2 0;
BA_ "GenSigTimeoutTime_ESL" SG_ 1464 Charge_Schedule_Type2 0;
BA_ "GenSigTimeoutTime_ECM" SG_ 1464 Charge_Schedule_Type2 0;
BA_ "GenSigTimeoutTime_DTCM" SG_ 1464 Charge_Schedule_Type2 0;
BA_ "GenSigTimeoutTime_DMSM" SG_ 1464 Charge_Schedule_Type2 0;
BA_ "GenSigTimeoutTime_BSM" SG_ 1464 Charge_Schedule_Type2 0;
BA_ "GenSigTimeoutTime_BCM" SG_ 1464 Charge_Schedule_Type2 0;
BA_ "GenSigTimeoutTime_AGSM" SG_ 1464 Charge_Schedule_Type2 0;
BA_ "GenSigTimeoutTime_ADCAM" SG_ 1464 Charge_Schedule_Type2 0;
BA_ "GenSigSendType" SG_ 1464 Charge_Schedule_Type2 3;
BA_ "GenSigTimeoutTime_SGW" SG_ 1464 Charge_Schedule_Type1 0;
BA_ "GenSigTimeoutTime_RFHM" SG_ 1464 Charge_Schedule_Type1 0;
BA_ "GenSigTimeoutTime_MPAD" SG_ 1464 Charge_Schedule_Type1 0;
BA_ "GenSigTimeoutTime_IPC" SG_ 1464 Charge_Schedule_Type1 0;
BA_ "GenSigTimeoutTime_GNMM" SG_ 1464 Charge_Schedule_Type1 0;
BA_ "GenSigTimeoutTime_ESL" SG_ 1464 Charge_Schedule_Type1 0;
BA_ "GenSigTimeoutTime_ECM" SG_ 1464 Charge_Schedule_Type1 0;
BA_ "GenSigTimeoutTime_DTCM" SG_ 1464 Charge_Schedule_Type1 0;
BA_ "GenSigTimeoutTime_DMSM" SG_ 1464 Charge_Schedule_Type1 0;
BA_ "GenSigTimeoutTime_BSM" SG_ 1464 Charge_Schedule_Type1 0;
BA_ "GenSigTimeoutTime_BCM" SG_ 1464 Charge_Schedule_Type1 0;
BA_ "GenSigTimeoutTime_AGSM" SG_ 1464 Charge_Schedule_Type1 0;
BA_ "GenSigTimeoutTime_ADCAM" SG_ 1464 Charge_Schedule_Type1 0;
BA_ "GenSigSendType" SG_ 1464 Charge_Schedule_Type1 3;
BA_ "GenSigTimeoutTime_RFHM" SG_ 1457 Start_Time_Min2_Sts 0;
BA_ "GenSigTimeoutTime_MPAD" SG_ 1457 Start_Time_Min2_Sts 0;
BA_ "GenSigTimeoutTime_IPC" SG_ 1457 Start_Time_Min2_Sts 0;
BA_ "GenSigTimeoutTime_GNMM" SG_ 1457 Start_Time_Min2_Sts 0;
BA_ "GenSigTimeoutTime_EVCU2" SG_ 1457 Start_Time_Min2_Sts 0;
BA_ "GenSigTimeoutTime_ESL" SG_ 1457 Start_Time_Min2_Sts 0;
BA_ "GenSigTimeoutTime_ECM" SG_ 1457 Start_Time_Min2_Sts 0;
BA_ "GenSigTimeoutTime_DTCM" SG_ 1457 Start_Time_Min2_Sts 0;
BA_ "GenSigTimeoutTime_DMSM" SG_ 1457 Start_Time_Min2_Sts 0;
BA_ "GenSigTimeoutTime_BSM" SG_ 1457 Start_Time_Min2_Sts 0;
BA_ "GenSigTimeoutTime_BCM" SG_ 1457 Start_Time_Min2_Sts 0;
BA_ "GenSigTimeoutTime_AGSM" SG_ 1457 Start_Time_Min2_Sts 0;
BA_ "GenSigTimeoutTime_ADCAM" SG_ 1457 Start_Time_Min2_Sts 0;
BA_ "GenSigSendType" SG_ 1457 Start_Time_Min2_Sts 3;
BA_ "GenSigTimeoutTime_RFHM" SG_ 1457 Start_Time_Min1_Sts 0;
BA_ "GenSigTimeoutTime_MPAD" SG_ 1457 Start_Time_Min1_Sts 0;
BA_ "GenSigTimeoutTime_IPC" SG_ 1457 Start_Time_Min1_Sts 0;
BA_ "GenSigTimeoutTime_GNMM" SG_ 1457 Start_Time_Min1_Sts 0;
BA_ "GenSigTimeoutTime_EVCU2" SG_ 1457 Start_Time_Min1_Sts 0;
BA_ "GenSigTimeoutTime_ESL" SG_ 1457 Start_Time_Min1_Sts 0;
BA_ "GenSigTimeoutTime_ECM" SG_ 1457 Start_Time_Min1_Sts 0;
BA_ "GenSigTimeoutTime_DTCM" SG_ 1457 Start_Time_Min1_Sts 0;
BA_ "GenSigTimeoutTime_DMSM" SG_ 1457 Start_Time_Min1_Sts 0;
BA_ "GenSigTimeoutTime_BSM" SG_ 1457 Start_Time_Min1_Sts 0;
BA_ "GenSigTimeoutTime_BCM" SG_ 1457 Start_Time_Min1_Sts 0;
BA_ "GenSigTimeoutTime_AGSM" SG_ 1457 Start_Time_Min1_Sts 0;
BA_ "GenSigTimeoutTime_ADCAM" SG_ 1457 Start_Time_Min1_Sts 0;
BA_ "GenSigSendType" SG_ 1457 Start_Time_Min1_Sts 3;
BA_ "GenSigTimeoutTime_RFHM" SG_ 1457 Start_Time_Hr2_Sts 0;
BA_ "GenSigTimeoutTime_MPAD" SG_ 1457 Start_Time_Hr2_Sts 0;
BA_ "GenSigTimeoutTime_IPC" SG_ 1457 Start_Time_Hr2_Sts 0;
BA_ "GenSigTimeoutTime_GNMM" SG_ 1457 Start_Time_Hr2_Sts 0;
BA_ "GenSigTimeoutTime_EVCU2" SG_ 1457 Start_Time_Hr2_Sts 0;
BA_ "GenSigTimeoutTime_ESL" SG_ 1457 Start_Time_Hr2_Sts 0;
BA_ "GenSigTimeoutTime_ECM" SG_ 1457 Start_Time_Hr2_Sts 0;
BA_ "GenSigTimeoutTime_DTCM" SG_ 1457 Start_Time_Hr2_Sts 0;
BA_ "GenSigTimeoutTime_DMSM" SG_ 1457 Start_Time_Hr2_Sts 0;
BA_ "GenSigTimeoutTime_BSM" SG_ 1457 Start_Time_Hr2_Sts 0;
BA_ "GenSigTimeoutTime_BCM" SG_ 1457 Start_Time_Hr2_Sts 0;
BA_ "GenSigTimeoutTime_AGSM" SG_ 1457 Start_Time_Hr2_Sts 0;
BA_ "GenSigTimeoutTime_ADCAM" SG_ 1457 Start_Time_Hr2_Sts 0;
BA_ "GenSigSendType" SG_ 1457 Start_Time_Hr2_Sts 3;
BA_ "GenSigTimeoutTime_RFHM" SG_ 1457 Start_Time_Hr1_Sts 0;
BA_ "GenSigTimeoutTime_MPAD" SG_ 1457 Start_Time_Hr1_Sts 0;
BA_ "GenSigTimeoutTime_IPC" SG_ 1457 Start_Time_Hr1_Sts 0;
BA_ "GenSigTimeoutTime_GNMM" SG_ 1457 Start_Time_Hr1_Sts 0;
BA_ "GenSigTimeoutTime_EVCU2" SG_ 1457 Start_Time_Hr1_Sts 0;
BA_ "GenSigTimeoutTime_ESL" SG_ 1457 Start_Time_Hr1_Sts 0;
BA_ "GenSigTimeoutTime_ECM" SG_ 1457 Start_Time_Hr1_Sts 0;
BA_ "GenSigTimeoutTime_DTCM" SG_ 1457 Start_Time_Hr1_Sts 0;
BA_ "GenSigTimeoutTime_DMSM" SG_ 1457 Start_Time_Hr1_Sts 0;
BA_ "GenSigTimeoutTime_BSM" SG_ 1457 Start_Time_Hr1_Sts 0;
BA_ "GenSigTimeoutTime_BCM" SG_ 1457 Start_Time_Hr1_Sts 0;
BA_ "GenSigTimeoutTime_AGSM" SG_ 1457 Start_Time_Hr1_Sts 0;
BA_ "GenSigTimeoutTime_ADCAM" SG_ 1457 Start_Time_Hr1_Sts 0;
BA_ "GenSigSendType" SG_ 1457 Start_Time_Hr1_Sts 3;
BA_ "GenSigTimeoutTime_RFHM" SG_ 1457 Schedule_Day2_Sts 0;
BA_ "GenSigTimeoutTime_MPAD" SG_ 1457 Schedule_Day2_Sts 0;
BA_ "GenSigTimeoutTime_IPC" SG_ 1457 Schedule_Day2_Sts 0;
BA_ "GenSigTimeoutTime_GNMM" SG_ 1457 Schedule_Day2_Sts 0;
BA_ "GenSigTimeoutTime_EVCU2" SG_ 1457 Schedule_Day2_Sts 0;
BA_ "GenSigTimeoutTime_ESL" SG_ 1457 Schedule_Day2_Sts 0;
BA_ "GenSigTimeoutTime_ECM" SG_ 1457 Schedule_Day2_Sts 0;
BA_ "GenSigTimeoutTime_DTCM" SG_ 1457 Schedule_Day2_Sts 0;
BA_ "GenSigTimeoutTime_DMSM" SG_ 1457 Schedule_Day2_Sts 0;
BA_ "GenSigTimeoutTime_BSM" SG_ 1457 Schedule_Day2_Sts 0;
BA_ "GenSigTimeoutTime_BCM" SG_ 1457 Schedule_Day2_Sts 0;
BA_ "GenSigTimeoutTime_AGSM" SG_ 1457 Schedule_Day2_Sts 0;
BA_ "GenSigTimeoutTime_ADCAM" SG_ 1457 Schedule_Day2_Sts 0;
BA_ "GenSigSendType" SG_ 1457 Schedule_Day2_Sts 3;
BA_ "GenSigTimeoutTime_RFHM" SG_ 1457 Schedule_Confirmed2 0;
BA_ "GenSigTimeoutTime_MPAD" SG_ 1457 Schedule_Confirmed2 0;
BA_ "GenSigTimeoutTime_IPC" SG_ 1457 Schedule_Confirmed2 0;
BA_ "GenSigTimeoutTime_GNMM" SG_ 1457 Schedule_Confirmed2 0;
BA_ "GenSigTimeoutTime_EVCU2" SG_ 1457 Schedule_Confirmed2 0;
BA_ "GenSigTimeoutTime_ESL" SG_ 1457 Schedule_Confirmed2 0;
BA_ "GenSigTimeoutTime_ECM" SG_ 1457 Schedule_Confirmed2 0;
BA_ "GenSigTimeoutTime_DTCM" SG_ 1457 Schedule_Confirmed2 0;
BA_ "GenSigTimeoutTime_DMSM" SG_ 1457 Schedule_Confirmed2 0;
BA_ "GenSigTimeoutTime_BSM" SG_ 1457 Schedule_Confirmed2 0;
BA_ "GenSigTimeoutTime_BCM" SG_ 1457 Schedule_Confirmed2 0;
BA_ "GenSigTimeoutTime_AGSM" SG_ 1457 Schedule_Confirmed2 0;
BA_ "GenSigTimeoutTime_ADCAM" SG_ 1457 Schedule_Confirmed2 0;
BA_ "GenSigSendType" SG_ 1457 Schedule_Confirmed2 3;
BA_ "GenSigTimeoutTime_RFHM" SG_ 1457 Schedule_Confirmed1 0;
BA_ "GenSigTimeoutTime_MPAD" SG_ 1457 Schedule_Confirmed1 0;
BA_ "GenSigTimeoutTime_IPC" SG_ 1457 Schedule_Confirmed1 0;
BA_ "GenSigTimeoutTime_GNMM" SG_ 1457 Schedule_Confirmed1 0;
BA_ "GenSigTimeoutTime_EVCU2" SG_ 1457 Schedule_Confirmed1 0;
BA_ "GenSigTimeoutTime_ESL" SG_ 1457 Schedule_Confirmed1 0;
BA_ "GenSigTimeoutTime_ECM" SG_ 1457 Schedule_Confirmed1 0;
BA_ "GenSigTimeoutTime_DTCM" SG_ 1457 Schedule_Confirmed1 0;
BA_ "GenSigTimeoutTime_DMSM" SG_ 1457 Schedule_Confirmed1 0;
BA_ "GenSigTimeoutTime_BSM" SG_ 1457 Schedule_Confirmed1 0;
BA_ "GenSigTimeoutTime_BCM" SG_ 1457 Schedule_Confirmed1 0;
BA_ "GenSigTimeoutTime_AGSM" SG_ 1457 Schedule_Confirmed1 0;
BA_ "GenSigTimeoutTime_ADCAM" SG_ 1457 Schedule_Confirmed1 0;
BA_ "GenSigSendType" SG_ 1457 Schedule_Confirmed1 3;
BA_ "GenSigTimeoutTime_RFHM" SG_ 1457 ChargeUntilFull2_Sts 0;
BA_ "GenSigTimeoutTime_MPAD" SG_ 1457 ChargeUntilFull2_Sts 0;
BA_ "GenSigTimeoutTime_IPC" SG_ 1457 ChargeUntilFull2_Sts 0;
BA_ "GenSigTimeoutTime_GNMM" SG_ 1457 ChargeUntilFull2_Sts 0;
BA_ "GenSigTimeoutTime_EVCU2" SG_ 1457 ChargeUntilFull2_Sts 0;
BA_ "GenSigTimeoutTime_ESL" SG_ 1457 ChargeUntilFull2_Sts 0;
BA_ "GenSigTimeoutTime_ECM" SG_ 1457 ChargeUntilFull2_Sts 0;
BA_ "GenSigTimeoutTime_DTCM" SG_ 1457 ChargeUntilFull2_Sts 0;
BA_ "GenSigTimeoutTime_DMSM" SG_ 1457 ChargeUntilFull2_Sts 0;
BA_ "GenSigTimeoutTime_BSM" SG_ 1457 ChargeUntilFull2_Sts 0;
BA_ "GenSigTimeoutTime_BCM" SG_ 1457 ChargeUntilFull2_Sts 0;
BA_ "GenSigTimeoutTime_AGSM" SG_ 1457 ChargeUntilFull2_Sts 0;
BA_ "GenSigTimeoutTime_ADCAM" SG_ 1457 ChargeUntilFull2_Sts 0;
BA_ "GenSigSendType" SG_ 1457 ChargeUntilFull2_Sts 3;
BA_ "GenSigTimeoutTime_RFHM" SG_ 1457 ChargeUntilFull1_Sts 0;
BA_ "GenSigTimeoutTime_MPAD" SG_ 1457 ChargeUntilFull1_Sts 0;
BA_ "GenSigTimeoutTime_IPC" SG_ 1457 ChargeUntilFull1_Sts 0;
BA_ "GenSigTimeoutTime_GNMM" SG_ 1457 ChargeUntilFull1_Sts 0;
BA_ "GenSigTimeoutTime_EVCU2" SG_ 1457 ChargeUntilFull1_Sts 0;
BA_ "GenSigTimeoutTime_ESL" SG_ 1457 ChargeUntilFull1_Sts 0;
BA_ "GenSigTimeoutTime_ECM" SG_ 1457 ChargeUntilFull1_Sts 0;
BA_ "GenSigTimeoutTime_DTCM" SG_ 1457 ChargeUntilFull1_Sts 0;
BA_ "GenSigTimeoutTime_DMSM" SG_ 1457 ChargeUntilFull1_Sts 0;
BA_ "GenSigTimeoutTime_BSM" SG_ 1457 ChargeUntilFull1_Sts 0;
BA_ "GenSigTimeoutTime_BCM" SG_ 1457 ChargeUntilFull1_Sts 0;
BA_ "GenSigTimeoutTime_AGSM" SG_ 1457 ChargeUntilFull1_Sts 0;
BA_ "GenSigTimeoutTime_ADCAM" SG_ 1457 ChargeUntilFull1_Sts 0;
BA_ "GenSigSendType" SG_ 1457 ChargeUntilFull1_Sts 3;
BA_ "GenSigTimeoutTime_RFHM" SG_ 1457 End_Time_Min2_Sts 0;
BA_ "GenSigTimeoutTime_MPAD" SG_ 1457 End_Time_Min2_Sts 0;
BA_ "GenSigTimeoutTime_IPC" SG_ 1457 End_Time_Min2_Sts 0;
BA_ "GenSigTimeoutTime_GNMM" SG_ 1457 End_Time_Min2_Sts 0;
BA_ "GenSigTimeoutTime_EVCU2" SG_ 1457 End_Time_Min2_Sts 0;
BA_ "GenSigTimeoutTime_ESL" SG_ 1457 End_Time_Min2_Sts 0;
BA_ "GenSigTimeoutTime_ECM" SG_ 1457 End_Time_Min2_Sts 0;
BA_ "GenSigTimeoutTime_DTCM" SG_ 1457 End_Time_Min2_Sts 0;
BA_ "GenSigTimeoutTime_DMSM" SG_ 1457 End_Time_Min2_Sts 0;
BA_ "GenSigTimeoutTime_BSM" SG_ 1457 End_Time_Min2_Sts 0;
BA_ "GenSigTimeoutTime_BCM" SG_ 1457 End_Time_Min2_Sts 0;
BA_ "GenSigTimeoutTime_AGSM" SG_ 1457 End_Time_Min2_Sts 0;
BA_ "GenSigTimeoutTime_ADCAM" SG_ 1457 End_Time_Min2_Sts 0;
BA_ "GenSigSendType" SG_ 1457 End_Time_Min2_Sts 3;
BA_ "GenSigTimeoutTime_RFHM" SG_ 1457 End_Time_Min1_Sts 0;
BA_ "GenSigTimeoutTime_MPAD" SG_ 1457 End_Time_Min1_Sts 0;
BA_ "GenSigTimeoutTime_IPC" SG_ 1457 End_Time_Min1_Sts 0;
BA_ "GenSigTimeoutTime_GNMM" SG_ 1457 End_Time_Min1_Sts 0;
BA_ "GenSigTimeoutTime_EVCU2" SG_ 1457 End_Time_Min1_Sts 0;
BA_ "GenSigTimeoutTime_ESL" SG_ 1457 End_Time_Min1_Sts 0;
BA_ "GenSigTimeoutTime_ECM" SG_ 1457 End_Time_Min1_Sts 0;
BA_ "GenSigTimeoutTime_DTCM" SG_ 1457 End_Time_Min1_Sts 0;
BA_ "GenSigTimeoutTime_DMSM" SG_ 1457 End_Time_Min1_Sts 0;
BA_ "GenSigTimeoutTime_BSM" SG_ 1457 End_Time_Min1_Sts 0;
BA_ "GenSigTimeoutTime_BCM" SG_ 1457 End_Time_Min1_Sts 0;
BA_ "GenSigTimeoutTime_AGSM" SG_ 1457 End_Time_Min1_Sts 0;
BA_ "GenSigTimeoutTime_ADCAM" SG_ 1457 End_Time_Min1_Sts 0;
BA_ "GenSigSendType" SG_ 1457 End_Time_Min1_Sts 3;
BA_ "GenSigTimeoutTime_RFHM" SG_ 1457 End_Time_Hr2_Sts 0;
BA_ "GenSigTimeoutTime_MPAD" SG_ 1457 End_Time_Hr2_Sts 0;
BA_ "GenSigTimeoutTime_IPC" SG_ 1457 End_Time_Hr2_Sts 0;
BA_ "GenSigTimeoutTime_GNMM" SG_ 1457 End_Time_Hr2_Sts 0;
BA_ "GenSigTimeoutTime_EVCU2" SG_ 1457 End_Time_Hr2_Sts 0;
BA_ "GenSigTimeoutTime_ESL" SG_ 1457 End_Time_Hr2_Sts 0;
BA_ "GenSigTimeoutTime_ECM" SG_ 1457 End_Time_Hr2_Sts 0;
BA_ "GenSigTimeoutTime_DTCM" SG_ 1457 End_Time_Hr2_Sts 0;
BA_ "GenSigTimeoutTime_DMSM" SG_ 1457 End_Time_Hr2_Sts 0;
BA_ "GenSigTimeoutTime_BSM" SG_ 1457 End_Time_Hr2_Sts 0;
BA_ "GenSigTimeoutTime_BCM" SG_ 1457 End_Time_Hr2_Sts 0;
BA_ "GenSigTimeoutTime_AGSM" SG_ 1457 End_Time_Hr2_Sts 0;
BA_ "GenSigTimeoutTime_ADCAM" SG_ 1457 End_Time_Hr2_Sts 0;
BA_ "GenSigSendType" SG_ 1457 End_Time_Hr2_Sts 3;
BA_ "GenSigTimeoutTime_RFHM" SG_ 1457 End_Time_Hr1_Sts 0;
BA_ "GenSigTimeoutTime_MPAD" SG_ 1457 End_Time_Hr1_Sts 0;
BA_ "GenSigTimeoutTime_IPC" SG_ 1457 End_Time_Hr1_Sts 0;
BA_ "GenSigTimeoutTime_GNMM" SG_ 1457 End_Time_Hr1_Sts 0;
BA_ "GenSigTimeoutTime_EVCU2" SG_ 1457 End_Time_Hr1_Sts 0;
BA_ "GenSigTimeoutTime_ESL" SG_ 1457 End_Time_Hr1_Sts 0;
BA_ "GenSigTimeoutTime_ECM" SG_ 1457 End_Time_Hr1_Sts 0;
BA_ "GenSigTimeoutTime_DTCM" SG_ 1457 End_Time_Hr1_Sts 0;
BA_ "GenSigTimeoutTime_DMSM" SG_ 1457 End_Time_Hr1_Sts 0;
BA_ "GenSigTimeoutTime_BSM" SG_ 1457 End_Time_Hr1_Sts 0;
BA_ "GenSigTimeoutTime_BCM" SG_ 1457 End_Time_Hr1_Sts 0;
BA_ "GenSigTimeoutTime_AGSM" SG_ 1457 End_Time_Hr1_Sts 0;
BA_ "GenSigTimeoutTime_ADCAM" SG_ 1457 End_Time_Hr1_Sts 0;
BA_ "GenSigSendType" SG_ 1457 End_Time_Hr1_Sts 3;
BA_ "GenSigTimeoutTime_RFHM" SG_ 1457 Immediate_ChargeTarget2_Sts 0;
BA_ "GenSigTimeoutTime_MPAD" SG_ 1457 Immediate_ChargeTarget2_Sts 0;
BA_ "GenSigTimeoutTime_IPC" SG_ 1457 Immediate_ChargeTarget2_Sts 0;
BA_ "GenSigTimeoutTime_GNMM" SG_ 1457 Immediate_ChargeTarget2_Sts 0;
BA_ "GenSigTimeoutTime_EVCU2" SG_ 1457 Immediate_ChargeTarget2_Sts 0;
BA_ "GenSigTimeoutTime_ESL" SG_ 1457 Immediate_ChargeTarget2_Sts 0;
BA_ "GenSigTimeoutTime_ECM" SG_ 1457 Immediate_ChargeTarget2_Sts 0;
BA_ "GenSigTimeoutTime_DTCM" SG_ 1457 Immediate_ChargeTarget2_Sts 0;
BA_ "GenSigTimeoutTime_DMSM" SG_ 1457 Immediate_ChargeTarget2_Sts 0;
BA_ "GenSigTimeoutTime_BSM" SG_ 1457 Immediate_ChargeTarget2_Sts 0;
BA_ "GenSigTimeoutTime_BCM" SG_ 1457 Immediate_ChargeTarget2_Sts 0;
BA_ "GenSigTimeoutTime_AGSM" SG_ 1457 Immediate_ChargeTarget2_Sts 0;
BA_ "GenSigTimeoutTime_ADCAM" SG_ 1457 Immediate_ChargeTarget2_Sts 0;
BA_ "GenSigSendType" SG_ 1457 Immediate_ChargeTarget2_Sts 3;
BA_ "GenSigStartValue" SG_ 1457 Immediate_ChargeTarget2_Sts 15;
BA_ "GenSigTimeoutTime_RFHM" SG_ 1457 Immediate_ChargeTarget1_Sts 0;
BA_ "GenSigTimeoutTime_MPAD" SG_ 1457 Immediate_ChargeTarget1_Sts 0;
BA_ "GenSigTimeoutTime_IPC" SG_ 1457 Immediate_ChargeTarget1_Sts 0;
BA_ "GenSigTimeoutTime_GNMM" SG_ 1457 Immediate_ChargeTarget1_Sts 0;
BA_ "GenSigTimeoutTime_EVCU2" SG_ 1457 Immediate_ChargeTarget1_Sts 0;
BA_ "GenSigTimeoutTime_ESL" SG_ 1457 Immediate_ChargeTarget1_Sts 0;
BA_ "GenSigTimeoutTime_ECM" SG_ 1457 Immediate_ChargeTarget1_Sts 0;
BA_ "GenSigTimeoutTime_DTCM" SG_ 1457 Immediate_ChargeTarget1_Sts 0;
BA_ "GenSigTimeoutTime_DMSM" SG_ 1457 Immediate_ChargeTarget1_Sts 0;
BA_ "GenSigTimeoutTime_BSM" SG_ 1457 Immediate_ChargeTarget1_Sts 0;
BA_ "GenSigTimeoutTime_BCM" SG_ 1457 Immediate_ChargeTarget1_Sts 0;
BA_ "GenSigTimeoutTime_AGSM" SG_ 1457 Immediate_ChargeTarget1_Sts 0;
BA_ "GenSigTimeoutTime_ADCAM" SG_ 1457 Immediate_ChargeTarget1_Sts 0;
BA_ "GenSigSendType" SG_ 1457 Immediate_ChargeTarget1_Sts 3;
BA_ "GenSigStartValue" SG_ 1457 Immediate_ChargeTarget1_Sts 15;
BA_ "GenSigTimeoutTime_RFHM" SG_ 1457 External_ChargeTarget2_Sts 0;
BA_ "GenSigTimeoutTime_MPAD" SG_ 1457 External_ChargeTarget2_Sts 0;
BA_ "GenSigTimeoutTime_IPC" SG_ 1457 External_ChargeTarget2_Sts 0;
BA_ "GenSigTimeoutTime_GNMM" SG_ 1457 External_ChargeTarget2_Sts 0;
BA_ "GenSigTimeoutTime_EVCU2" SG_ 1457 External_ChargeTarget2_Sts 0;
BA_ "GenSigTimeoutTime_ESL" SG_ 1457 External_ChargeTarget2_Sts 0;
BA_ "GenSigTimeoutTime_ECM" SG_ 1457 External_ChargeTarget2_Sts 0;
BA_ "GenSigTimeoutTime_DTCM" SG_ 1457 External_ChargeTarget2_Sts 0;
BA_ "GenSigTimeoutTime_DMSM" SG_ 1457 External_ChargeTarget2_Sts 0;
BA_ "GenSigTimeoutTime_BSM" SG_ 1457 External_ChargeTarget2_Sts 0;
BA_ "GenSigTimeoutTime_BCM" SG_ 1457 External_ChargeTarget2_Sts 0;
BA_ "GenSigTimeoutTime_AGSM" SG_ 1457 External_ChargeTarget2_Sts 0;
BA_ "GenSigTimeoutTime_ADCAM" SG_ 1457 External_ChargeTarget2_Sts 0;
BA_ "GenSigSendType" SG_ 1457 External_ChargeTarget2_Sts 3;
BA_ "GenSigStartValue" SG_ 1457 External_ChargeTarget2_Sts 15;
BA_ "GenSigTimeoutTime_RFHM" SG_ 1457 External_ChargeTarget1_Sts 0;
BA_ "GenSigTimeoutTime_MPAD" SG_ 1457 External_ChargeTarget1_Sts 0;
BA_ "GenSigTimeoutTime_IPC" SG_ 1457 External_ChargeTarget1_Sts 0;
BA_ "GenSigTimeoutTime_GNMM" SG_ 1457 External_ChargeTarget1_Sts 0;
BA_ "GenSigTimeoutTime_EVCU2" SG_ 1457 External_ChargeTarget1_Sts 0;
BA_ "GenSigTimeoutTime_ESL" SG_ 1457 External_ChargeTarget1_Sts 0;
BA_ "GenSigTimeoutTime_ECM" SG_ 1457 External_ChargeTarget1_Sts 0;
BA_ "GenSigTimeoutTime_DTCM" SG_ 1457 External_ChargeTarget1_Sts 0;
BA_ "GenSigTimeoutTime_DMSM" SG_ 1457 External_ChargeTarget1_Sts 0;
BA_ "GenSigTimeoutTime_BSM" SG_ 1457 External_ChargeTarget1_Sts 0;
BA_ "GenSigTimeoutTime_BCM" SG_ 1457 External_ChargeTarget1_Sts 0;
BA_ "GenSigTimeoutTime_AGSM" SG_ 1457 External_ChargeTarget1_Sts 0;
BA_ "GenSigTimeoutTime_ADCAM" SG_ 1457 External_ChargeTarget1_Sts 0;
BA_ "GenSigSendType" SG_ 1457 External_ChargeTarget1_Sts 3;
BA_ "GenSigTimeoutTime_RFHM" SG_ 1457 Charge_Schedule_Type2_Sts 0;
BA_ "GenSigTimeoutTime_MPAD" SG_ 1457 Charge_Schedule_Type2_Sts 0;
BA_ "GenSigTimeoutTime_IPC" SG_ 1457 Charge_Schedule_Type2_Sts 0;
BA_ "GenSigTimeoutTime_GNMM" SG_ 1457 Charge_Schedule_Type2_Sts 0;
BA_ "GenSigTimeoutTime_EVCU2" SG_ 1457 Charge_Schedule_Type2_Sts 0;
BA_ "GenSigTimeoutTime_ESL" SG_ 1457 Charge_Schedule_Type2_Sts 0;
BA_ "GenSigTimeoutTime_ECM" SG_ 1457 Charge_Schedule_Type2_Sts 0;
BA_ "GenSigTimeoutTime_DTCM" SG_ 1457 Charge_Schedule_Type2_Sts 0;
BA_ "GenSigTimeoutTime_DMSM" SG_ 1457 Charge_Schedule_Type2_Sts 0;
BA_ "GenSigTimeoutTime_BSM" SG_ 1457 Charge_Schedule_Type2_Sts 0;
BA_ "GenSigTimeoutTime_BCM" SG_ 1457 Charge_Schedule_Type2_Sts 0;
BA_ "GenSigTimeoutTime_AGSM" SG_ 1457 Charge_Schedule_Type2_Sts 0;
BA_ "GenSigTimeoutTime_ADCAM" SG_ 1457 Charge_Schedule_Type2_Sts 0;
BA_ "GenSigSendType" SG_ 1457 Charge_Schedule_Type2_Sts 3;
BA_ "GenSigTimeoutTime_RFHM" SG_ 1457 Charge_Schedule_Type1_Sts 0;
BA_ "GenSigTimeoutTime_MPAD" SG_ 1457 Charge_Schedule_Type1_Sts 0;
BA_ "GenSigTimeoutTime_IPC" SG_ 1457 Charge_Schedule_Type1_Sts 0;
BA_ "GenSigTimeoutTime_GNMM" SG_ 1457 Charge_Schedule_Type1_Sts 0;
BA_ "GenSigTimeoutTime_EVCU2" SG_ 1457 Charge_Schedule_Type1_Sts 0;
BA_ "GenSigTimeoutTime_ESL" SG_ 1457 Charge_Schedule_Type1_Sts 0;
BA_ "GenSigTimeoutTime_ECM" SG_ 1457 Charge_Schedule_Type1_Sts 0;
BA_ "GenSigTimeoutTime_DTCM" SG_ 1457 Charge_Schedule_Type1_Sts 0;
BA_ "GenSigTimeoutTime_DMSM" SG_ 1457 Charge_Schedule_Type1_Sts 0;
BA_ "GenSigTimeoutTime_BSM" SG_ 1457 Charge_Schedule_Type1_Sts 0;
BA_ "GenSigTimeoutTime_BCM" SG_ 1457 Charge_Schedule_Type1_Sts 0;
BA_ "GenSigTimeoutTime_AGSM" SG_ 1457 Charge_Schedule_Type1_Sts 0;
BA_ "GenSigTimeoutTime_ADCAM" SG_ 1457 Charge_Schedule_Type1_Sts 0;
BA_ "GenSigSendType" SG_ 1457 Charge_Schedule_Type1_Sts 3;
BA_ "GenSigTimeoutTime_RFHM" SG_ 1459 Next_SchCabin_Temp 0;
BA_ "GenSigTimeoutTime_MPAD" SG_ 1459 Next_SchCabin_Temp 0;
BA_ "GenSigTimeoutTime_IPC" SG_ 1459 Next_SchCabin_Temp 0;
BA_ "GenSigTimeoutTime_GNMM" SG_ 1459 Next_SchCabin_Temp 0;
BA_ "GenSigTimeoutTime_EVCU2" SG_ 1459 Next_SchCabin_Temp 0;
BA_ "GenSigTimeoutTime_ESL" SG_ 1459 Next_SchCabin_Temp 0;
BA_ "GenSigTimeoutTime_ECM" SG_ 1459 Next_SchCabin_Temp 0;
BA_ "GenSigTimeoutTime_DTCM" SG_ 1459 Next_SchCabin_Temp 0;
BA_ "GenSigTimeoutTime_DMSM" SG_ 1459 Next_SchCabin_Temp 0;
BA_ "GenSigTimeoutTime_BSM" SG_ 1459 Next_SchCabin_Temp 0;
BA_ "GenSigTimeoutTime_BCM" SG_ 1459 Next_SchCabin_Temp 0;
BA_ "GenSigTimeoutTime_AGSM" SG_ 1459 Next_SchCabin_Temp 0;
BA_ "GenSigTimeoutTime_ADCAM" SG_ 1459 Next_SchCabin_Temp 0;
BA_ "GenSigStartValue" SG_ 1459 Next_SchCabin_Temp 12;
BA_ "GenSigTimeoutTime_EVCU2" SG_ 1457 Schedule_Day1_Sts 0;
BA_ "GenSigTimeoutTime_ESL" SG_ 1457 Schedule_Day1_Sts 0;
BA_ "GenSigTimeoutTime_ECM" SG_ 1457 Schedule_Day1_Sts 0;
BA_ "GenSigTimeoutTime_DTCM" SG_ 1457 Schedule_Day1_Sts 0;
BA_ "GenSigTimeoutTime_DMSM" SG_ 1457 Schedule_Day1_Sts 0;
BA_ "GenSigTimeoutTime_BSM" SG_ 1457 Schedule_Day1_Sts 0;
BA_ "GenSigTimeoutTime_BCM" SG_ 1457 Schedule_Day1_Sts 0;
BA_ "GenSigTimeoutTime_AGSM" SG_ 1457 Schedule_Day1_Sts 0;
BA_ "GenSigTimeoutTime_ADCAM" SG_ 1457 Schedule_Day1_Sts 0;
BA_ "GenSigSendType" SG_ 1457 Schedule_Day1_Sts 3;
BA_ "GenSigTimeoutTime_RFHM" SG_ 1457 Schedule_Day1_Sts 0;
BA_ "GenSigTimeoutTime_MPAD" SG_ 1457 Schedule_Day1_Sts 0;
BA_ "GenSigTimeoutTime_IPC" SG_ 1457 Schedule_Day1_Sts 0;
BA_ "GenSigTimeoutTime_GNMM" SG_ 1457 Schedule_Day1_Sts 0;
BA_ "GenSigTimeoutTime_SGW" SG_ 1464 End_Time_Min2 0;
BA_ "GenSigTimeoutTime_RFHM" SG_ 1464 End_Time_Min2 0;
BA_ "GenSigTimeoutTime_MPAD" SG_ 1464 End_Time_Min2 0;
BA_ "GenSigTimeoutTime_IPC" SG_ 1464 End_Time_Min2 0;
BA_ "GenSigTimeoutTime_GNMM" SG_ 1464 End_Time_Min2 0;
BA_ "GenSigTimeoutTime_ESL" SG_ 1464 End_Time_Min2 0;
BA_ "GenSigTimeoutTime_ECM" SG_ 1464 End_Time_Min2 0;
BA_ "GenSigTimeoutTime_DTCM" SG_ 1464 End_Time_Min2 0;
BA_ "GenSigTimeoutTime_DMSM" SG_ 1464 End_Time_Min2 0;
BA_ "GenSigTimeoutTime_BSM" SG_ 1464 End_Time_Min2 0;
BA_ "GenSigTimeoutTime_BCM" SG_ 1464 End_Time_Min2 0;
BA_ "GenSigTimeoutTime_AGSM" SG_ 1464 End_Time_Min2 0;
BA_ "GenSigTimeoutTime_ADCAM" SG_ 1464 End_Time_Min2 0;
BA_ "GenSigSendType" SG_ 1464 End_Time_Min2 3;
BA_ "GenSigTimeoutTime_SGW" SG_ 1464 End_Time_Hr2 0;
BA_ "GenSigTimeoutTime_RFHM" SG_ 1464 End_Time_Hr2 0;
BA_ "GenSigTimeoutTime_MPAD" SG_ 1464 End_Time_Hr2 0;
BA_ "GenSigTimeoutTime_IPC" SG_ 1464 End_Time_Hr2 0;
BA_ "GenSigTimeoutTime_GNMM" SG_ 1464 End_Time_Hr2 0;
BA_ "GenSigTimeoutTime_ESL" SG_ 1464 End_Time_Hr2 0;
BA_ "GenSigTimeoutTime_ECM" SG_ 1464 End_Time_Hr2 0;
BA_ "GenSigTimeoutTime_DTCM" SG_ 1464 End_Time_Hr2 0;
BA_ "GenSigTimeoutTime_DMSM" SG_ 1464 End_Time_Hr2 0;
BA_ "GenSigTimeoutTime_BSM" SG_ 1464 End_Time_Hr2 0;
BA_ "GenSigTimeoutTime_BCM" SG_ 1464 End_Time_Hr2 0;
BA_ "GenSigTimeoutTime_AGSM" SG_ 1464 End_Time_Hr2 0;
BA_ "GenSigTimeoutTime_ADCAM" SG_ 1464 End_Time_Hr2 0;
BA_ "GenSigSendType" SG_ 1464 End_Time_Hr2 3;
BA_ "GenSigTimeoutTime_SGW" SG_ 1464 End_Time_Hr1 0;
BA_ "GenSigTimeoutTime_RFHM" SG_ 1464 End_Time_Hr1 0;
BA_ "GenSigTimeoutTime_MPAD" SG_ 1464 End_Time_Hr1 0;
BA_ "GenSigTimeoutTime_IPC" SG_ 1464 End_Time_Hr1 0;
BA_ "GenSigTimeoutTime_GNMM" SG_ 1464 End_Time_Hr1 0;
BA_ "GenSigTimeoutTime_ESL" SG_ 1464 End_Time_Hr1 0;
BA_ "GenSigTimeoutTime_ECM" SG_ 1464 End_Time_Hr1 0;
BA_ "GenSigTimeoutTime_DTCM" SG_ 1464 End_Time_Hr1 0;
BA_ "GenSigTimeoutTime_DMSM" SG_ 1464 End_Time_Hr1 0;
BA_ "GenSigTimeoutTime_BSM" SG_ 1464 End_Time_Hr1 0;
BA_ "GenSigTimeoutTime_BCM" SG_ 1464 End_Time_Hr1 0;
BA_ "GenSigTimeoutTime_AGSM" SG_ 1464 End_Time_Hr1 0;
BA_ "GenSigTimeoutTime_ADCAM" SG_ 1464 End_Time_Hr1 0;
BA_ "GenSigSendType" SG_ 1464 End_Time_Hr1 3;
BA_ "GenSigTimeoutTime_SGW" SG_ 1464 ChargeUntilFull1 0;
BA_ "GenSigTimeoutTime_RFHM" SG_ 1464 ChargeUntilFull1 0;
BA_ "GenSigTimeoutTime_MPAD" SG_ 1464 ChargeUntilFull1 0;
BA_ "GenSigTimeoutTime_IPC" SG_ 1464 ChargeUntilFull1 0;
BA_ "GenSigTimeoutTime_GNMM" SG_ 1464 ChargeUntilFull1 0;
BA_ "GenSigTimeoutTime_ESL" SG_ 1464 ChargeUntilFull1 0;
BA_ "GenSigTimeoutTime_ECM" SG_ 1464 ChargeUntilFull1 0;
BA_ "GenSigTimeoutTime_DTCM" SG_ 1464 ChargeUntilFull1 0;
BA_ "GenSigTimeoutTime_DMSM" SG_ 1464 ChargeUntilFull1 0;
BA_ "GenSigTimeoutTime_BSM" SG_ 1464 ChargeUntilFull1 0;
BA_ "GenSigTimeoutTime_BCM" SG_ 1464 ChargeUntilFull1 0;
BA_ "GenSigTimeoutTime_AGSM" SG_ 1464 ChargeUntilFull1 0;
BA_ "GenSigTimeoutTime_ADCAM" SG_ 1464 ChargeUntilFull1 0;
BA_ "GenSigSendType" SG_ 1464 ChargeUntilFull1 3;
BA_ "GenSigTimeoutTime_SGW" SG_ 1464 End_Time_Min1 0;
BA_ "GenSigTimeoutTime_RFHM" SG_ 1464 End_Time_Min1 0;
BA_ "GenSigTimeoutTime_MPAD" SG_ 1464 End_Time_Min1 0;
BA_ "GenSigTimeoutTime_IPC" SG_ 1464 End_Time_Min1 0;
BA_ "GenSigTimeoutTime_GNMM" SG_ 1464 End_Time_Min1 0;
BA_ "GenSigTimeoutTime_ESL" SG_ 1464 End_Time_Min1 0;
BA_ "GenSigTimeoutTime_ECM" SG_ 1464 End_Time_Min1 0;
BA_ "GenSigTimeoutTime_DTCM" SG_ 1464 End_Time_Min1 0;
BA_ "GenSigTimeoutTime_DMSM" SG_ 1464 End_Time_Min1 0;
BA_ "GenSigTimeoutTime_BSM" SG_ 1464 End_Time_Min1 0;
BA_ "GenSigTimeoutTime_BCM" SG_ 1464 End_Time_Min1 0;
BA_ "GenSigTimeoutTime_AGSM" SG_ 1464 End_Time_Min1 0;
BA_ "GenSigTimeoutTime_ADCAM" SG_ 1464 End_Time_Min1 0;
BA_ "GenSigSendType" SG_ 1464 End_Time_Min1 3;
BA_ "GenSigTimeoutTime_SGW" SG_ 1464 Enable_Schedule2 0;
BA_ "GenSigTimeoutTime_RFHM" SG_ 1464 Enable_Schedule2 0;
BA_ "GenSigTimeoutTime_MPAD" SG_ 1464 Enable_Schedule2 0;
BA_ "GenSigTimeoutTime_IPC" SG_ 1464 Enable_Schedule2 0;
BA_ "GenSigTimeoutTime_GNMM" SG_ 1464 Enable_Schedule2 0;
BA_ "GenSigTimeoutTime_ESL" SG_ 1464 Enable_Schedule2 0;
BA_ "GenSigTimeoutTime_ECM" SG_ 1464 Enable_Schedule2 0;
BA_ "GenSigTimeoutTime_DTCM" SG_ 1464 Enable_Schedule2 0;
BA_ "GenSigTimeoutTime_DMSM" SG_ 1464 Enable_Schedule2 0;
BA_ "GenSigTimeoutTime_BSM" SG_ 1464 Enable_Schedule2 0;
BA_ "GenSigTimeoutTime_BCM" SG_ 1464 Enable_Schedule2 0;
BA_ "GenSigTimeoutTime_AGSM" SG_ 1464 Enable_Schedule2 0;
BA_ "GenSigTimeoutTime_ADCAM" SG_ 1464 Enable_Schedule2 0;
BA_ "GenSigSendType" SG_ 1464 Enable_Schedule2 3;
BA_ "GenSigTimeoutTime_SGW" SG_ 1464 Enable_Schedule1 0;
BA_ "GenSigTimeoutTime_RFHM" SG_ 1464 Enable_Schedule1 0;
BA_ "GenSigTimeoutTime_MPAD" SG_ 1464 Enable_Schedule1 0;
BA_ "GenSigTimeoutTime_IPC" SG_ 1464 Enable_Schedule1 0;
BA_ "GenSigTimeoutTime_GNMM" SG_ 1464 Enable_Schedule1 0;
BA_ "GenSigTimeoutTime_ESL" SG_ 1464 Enable_Schedule1 0;
BA_ "GenSigTimeoutTime_ECM" SG_ 1464 Enable_Schedule1 0;
BA_ "GenSigTimeoutTime_DTCM" SG_ 1464 Enable_Schedule1 0;
BA_ "GenSigTimeoutTime_DMSM" SG_ 1464 Enable_Schedule1 0;
BA_ "GenSigTimeoutTime_BSM" SG_ 1464 Enable_Schedule1 0;
BA_ "GenSigTimeoutTime_BCM" SG_ 1464 Enable_Schedule1 0;
BA_ "GenSigTimeoutTime_AGSM" SG_ 1464 Enable_Schedule1 0;
BA_ "GenSigTimeoutTime_ADCAM" SG_ 1464 Enable_Schedule1 0;
BA_ "GenSigSendType" SG_ 1464 Enable_Schedule1 3;
BA_ "GenSigTimeoutTime_SGW" SG_ 1464 ChargeUntilFull2 0;
BA_ "GenSigTimeoutTime_RFHM" SG_ 1464 ChargeUntilFull2 0;
BA_ "GenSigTimeoutTime_MPAD" SG_ 1464 ChargeUntilFull2 0;
BA_ "GenSigTimeoutTime_IPC" SG_ 1464 ChargeUntilFull2 0;
BA_ "GenSigTimeoutTime_GNMM" SG_ 1464 ChargeUntilFull2 0;
BA_ "GenSigTimeoutTime_ESL" SG_ 1464 ChargeUntilFull2 0;
BA_ "GenSigTimeoutTime_ECM" SG_ 1464 ChargeUntilFull2 0;
BA_ "GenSigTimeoutTime_DTCM" SG_ 1464 ChargeUntilFull2 0;
BA_ "GenSigTimeoutTime_DMSM" SG_ 1464 ChargeUntilFull2 0;
BA_ "GenSigTimeoutTime_BSM" SG_ 1464 ChargeUntilFull2 0;
BA_ "GenSigTimeoutTime_BCM" SG_ 1464 ChargeUntilFull2 0;
BA_ "GenSigTimeoutTime_AGSM" SG_ 1464 ChargeUntilFull2 0;
BA_ "GenSigTimeoutTime_ADCAM" SG_ 1464 ChargeUntilFull2 0;
BA_ "GenSigSendType" SG_ 1464 ChargeUntilFull2 3;
BA_ "GenSigTimeoutTime_SGW" SG_ 1436 MessageCounter_BCM27 0;
BA_ "GenSigTimeoutTime_RFHM" SG_ 1436 MessageCounter_BCM27 0;
BA_ "GenSigTimeoutTime_GNMM" SG_ 1436 MessageCounter_BCM27 0;
BA_ "GenSigTimeoutTime_EVCU2" SG_ 1436 MessageCounter_BCM27 0;
BA_ "GenSigTimeoutTime_ESL" SG_ 1436 MessageCounter_BCM27 0;
BA_ "GenSigTimeoutTime_ECM" SG_ 1436 MessageCounter_BCM27 0;
BA_ "GenSigTimeoutTime_DTCM" SG_ 1436 MessageCounter_BCM27 0;
BA_ "GenSigTimeoutTime_DMSM" SG_ 1436 MessageCounter_BCM27 0;
BA_ "GenSigTimeoutTime_BCM" SG_ 1436 MessageCounter_BCM27 0;
BA_ "GenSigTimeoutTime_SGW" SG_ 1436 PLG_Stat 0;
BA_ "GenSigTimeoutTime_RFHM" SG_ 1436 PLG_Stat 0;
BA_ "GenSigTimeoutTime_MPAD" SG_ 1436 PLG_Stat 0;
BA_ "GenSigTimeoutTime_GNMM" SG_ 1436 PLG_Stat 0;
BA_ "GenSigTimeoutTime_EVCU2" SG_ 1436 PLG_Stat 0;
BA_ "GenSigTimeoutTime_ESL" SG_ 1436 PLG_Stat 0;
BA_ "GenSigTimeoutTime_ECM" SG_ 1436 PLG_Stat 0;
BA_ "GenSigTimeoutTime_DTCM" SG_ 1436 PLG_Stat 0;
BA_ "GenSigTimeoutTime_DMSM" SG_ 1436 PLG_Stat 0;
BA_ "GenSigTimeoutTime_BSM" SG_ 1436 PLG_Stat 0;
BA_ "GenSigTimeoutTime_BCM" SG_ 1436 PLG_Stat 0;
BA_ "GenSigTimeoutTime_AGSM" SG_ 1436 PLG_Stat 0;
BA_ "GenSigTimeoutTime_ADCAM" SG_ 1436 PLG_Stat 0;
BA_ "GenSigSendType" SG_ 1436 PLG_Stat 3;
BA_ "GenSigTimeoutTime_RFHM" SG_ 1436 WinPos_RearR_Sts 0;
BA_ "GenSigTimeoutTime_MPAD" SG_ 1436 WinPos_RearR_Sts 0;
BA_ "GenSigTimeoutTime_IPC" SG_ 1436 WinPos_RearR_Sts 0;
BA_ "GenSigTimeoutTime_GNMM" SG_ 1436 WinPos_RearR_Sts 0;
BA_ "GenSigTimeoutTime_EVCU2" SG_ 1436 WinPos_RearR_Sts 0;
BA_ "GenSigTimeoutTime_ESL" SG_ 1436 WinPos_RearR_Sts 0;
BA_ "GenSigTimeoutTime_ECM" SG_ 1436 WinPos_RearR_Sts 0;
BA_ "GenSigTimeoutTime_DTCM" SG_ 1436 WinPos_RearR_Sts 0;
BA_ "GenSigTimeoutTime_DMSM" SG_ 1436 WinPos_RearR_Sts 0;
BA_ "GenSigTimeoutTime_BSM" SG_ 1436 WinPos_RearR_Sts 0;
BA_ "GenSigTimeoutTime_BCM" SG_ 1436 WinPos_RearR_Sts 0;
BA_ "GenSigTimeoutTime_AGSM" SG_ 1436 WinPos_RearR_Sts 0;
BA_ "GenSigTimeoutTime_ADCAM" SG_ 1436 WinPos_RearR_Sts 0;
BA_ "GenSigSendType" SG_ 1436 WinPos_RearR_Sts 3;
BA_ "GenSigTimeoutTime_RFHM" SG_ 1436 WinPos_D_Sts 0;
BA_ "GenSigTimeoutTime_MPAD" SG_ 1436 WinPos_D_Sts 0;
BA_ "GenSigTimeoutTime_IPC" SG_ 1436 WinPos_D_Sts 0;
BA_ "GenSigTimeoutTime_GNMM" SG_ 1436 WinPos_D_Sts 0;
BA_ "GenSigTimeoutTime_EVCU2" SG_ 1436 WinPos_D_Sts 0;
BA_ "GenSigTimeoutTime_ESL" SG_ 1436 WinPos_D_Sts 0;
BA_ "GenSigTimeoutTime_ECM" SG_ 1436 WinPos_D_Sts 0;
BA_ "GenSigTimeoutTime_DTCM" SG_ 1436 WinPos_D_Sts 0;
BA_ "GenSigTimeoutTime_DMSM" SG_ 1436 WinPos_D_Sts 0;
BA_ "GenSigTimeoutTime_BSM" SG_ 1436 WinPos_D_Sts 0;
BA_ "GenSigTimeoutTime_BCM" SG_ 1436 WinPos_D_Sts 0;
BA_ "GenSigTimeoutTime_AGSM" SG_ 1436 WinPos_D_Sts 0;
BA_ "GenSigTimeoutTime_ADCAM" SG_ 1436 WinPos_D_Sts 0;
BA_ "GenSigSendType" SG_ 1436 WinPos_D_Sts 3;
BA_ "GenSigStartValue" SG_ 1436 WinPos_D_Sts 127;
BA_ "GenSigTimeoutTime_RFHM" SG_ 1436 WinPos_P_Sts 0;
BA_ "GenSigTimeoutTime_MPAD" SG_ 1436 WinPos_P_Sts 0;
BA_ "GenSigTimeoutTime_IPC" SG_ 1436 WinPos_P_Sts 0;
BA_ "GenSigTimeoutTime_GNMM" SG_ 1436 WinPos_P_Sts 0;
BA_ "GenSigTimeoutTime_EVCU2" SG_ 1436 WinPos_P_Sts 0;
BA_ "GenSigTimeoutTime_ESL" SG_ 1436 WinPos_P_Sts 0;
BA_ "GenSigTimeoutTime_ECM" SG_ 1436 WinPos_P_Sts 0;
BA_ "GenSigTimeoutTime_DTCM" SG_ 1436 WinPos_P_Sts 0;
BA_ "GenSigTimeoutTime_DMSM" SG_ 1436 WinPos_P_Sts 0;
BA_ "GenSigTimeoutTime_BSM" SG_ 1436 WinPos_P_Sts 0;
BA_ "GenSigTimeoutTime_BCM" SG_ 1436 WinPos_P_Sts 0;
BA_ "GenSigTimeoutTime_AGSM" SG_ 1436 WinPos_P_Sts 0;
BA_ "GenSigTimeoutTime_ADCAM" SG_ 1436 WinPos_P_Sts 0;
BA_ "GenSigSendType" SG_ 1436 WinPos_P_Sts 3;
BA_ "GenSigStartValue" SG_ 1436 WinPos_P_Sts 127;
BA_ "GenSigTimeoutTime_RFHM" SG_ 1436 WinPos_RearL_Sts 0;
BA_ "GenSigTimeoutTime_MPAD" SG_ 1436 WinPos_RearL_Sts 0;
BA_ "GenSigTimeoutTime_IPC" SG_ 1436 WinPos_RearL_Sts 0;
BA_ "GenSigTimeoutTime_GNMM" SG_ 1436 WinPos_RearL_Sts 0;
BA_ "GenSigTimeoutTime_EVCU2" SG_ 1436 WinPos_RearL_Sts 0;
BA_ "GenSigTimeoutTime_ESL" SG_ 1436 WinPos_RearL_Sts 0;
BA_ "GenSigTimeoutTime_ECM" SG_ 1436 WinPos_RearL_Sts 0;
BA_ "GenSigTimeoutTime_DTCM" SG_ 1436 WinPos_RearL_Sts 0;
BA_ "GenSigTimeoutTime_DMSM" SG_ 1436 WinPos_RearL_Sts 0;
BA_ "GenSigTimeoutTime_BSM" SG_ 1436 WinPos_RearL_Sts 0;
BA_ "GenSigTimeoutTime_BCM" SG_ 1436 WinPos_RearL_Sts 0;
BA_ "GenSigTimeoutTime_AGSM" SG_ 1436 WinPos_RearL_Sts 0;
BA_ "GenSigTimeoutTime_ADCAM" SG_ 1436 WinPos_RearL_Sts 0;
BA_ "GenSigSendType" SG_ 1436 WinPos_RearL_Sts 3;
BA_ "GenSigTimeoutTime_SGW" SG_ 1436 Turn_Lever_Unlatch_Resp 0;
BA_ "GenSigTimeoutTime_RFHM" SG_ 1436 Turn_Lever_Unlatch_Resp 0;
BA_ "GenSigTimeoutTime_IPC" SG_ 1436 Turn_Lever_Unlatch_Resp 0;
BA_ "GenSigTimeoutTime_GNMM" SG_ 1436 Turn_Lever_Unlatch_Resp 0;
BA_ "GenSigTimeoutTime_EVCU2" SG_ 1436 Turn_Lever_Unlatch_Resp 0;
BA_ "GenSigTimeoutTime_ESL" SG_ 1436 Turn_Lever_Unlatch_Resp 0;
BA_ "GenSigTimeoutTime_ECM" SG_ 1436 Turn_Lever_Unlatch_Resp 0;
BA_ "GenSigTimeoutTime_DTCM" SG_ 1436 Turn_Lever_Unlatch_Resp 0;
BA_ "GenSigTimeoutTime_DMSM" SG_ 1436 Turn_Lever_Unlatch_Resp 0;
BA_ "GenSigTimeoutTime_BSM" SG_ 1436 Turn_Lever_Unlatch_Resp 0;
BA_ "GenSigTimeoutTime_BCM" SG_ 1436 Turn_Lever_Unlatch_Resp 0;
BA_ "GenSigTimeoutTime_AGSM" SG_ 1436 Turn_Lever_Unlatch_Resp 0;
BA_ "GenSigTimeoutTime_ADCAM" SG_ 1436 Turn_Lever_Unlatch_Resp 0;
BA_ "GenSigSendType" SG_ 1436 Turn_Lever_Unlatch_Resp 4;
BA_ "GenSigTimeoutTime_AGSM" SG_ 1436 MessageCounter_BCM27 0;
BA_ "GenSigTimeoutTime_RFHM" SG_ 1436 Comfort_Enable_Time 0;
BA_ "GenSigTimeoutTime_MPAD" SG_ 1436 Comfort_Enable_Time 0;
BA_ "GenSigTimeoutTime_IPC" SG_ 1436 Comfort_Enable_Time 0;
BA_ "GenSigTimeoutTime_GNMM" SG_ 1436 Comfort_Enable_Time 0;
BA_ "GenSigTimeoutTime_EVCU2" SG_ 1436 Comfort_Enable_Time 0;
BA_ "GenSigTimeoutTime_ESL" SG_ 1436 Comfort_Enable_Time 0;
BA_ "GenSigTimeoutTime_ECM" SG_ 1436 Comfort_Enable_Time 0;
BA_ "GenSigTimeoutTime_DTCM" SG_ 1436 Comfort_Enable_Time 0;
BA_ "GenSigTimeoutTime_DMSM" SG_ 1436 Comfort_Enable_Time 0;
BA_ "GenSigTimeoutTime_BSM" SG_ 1436 Comfort_Enable_Time 0;
BA_ "GenSigTimeoutTime_BCM" SG_ 1436 Comfort_Enable_Time 0;
BA_ "GenSigTimeoutTime_AGSM" SG_ 1436 Comfort_Enable_Time 0;
BA_ "GenSigTimeoutTime_ADCAM" SG_ 1436 Comfort_Enable_Time 0;
BA_ "GenSigSendType" SG_ 1436 Comfort_Enable_Time 3;
BA_ "GenSigStartValue" SG_ 1436 Comfort_Enable_Time 65535;
BA_ "GenSigTimeoutTime_SGW" SG_ 1436 CRC_BCM27 0;
BA_ "GenSigTimeoutTime_RFHM" SG_ 1436 CRC_BCM27 0;
BA_ "GenSigTimeoutTime_GNMM" SG_ 1436 CRC_BCM27 0;
BA_ "GenSigTimeoutTime_EVCU2" SG_ 1436 CRC_BCM27 0;
BA_ "GenSigTimeoutTime_ESL" SG_ 1436 CRC_BCM27 0;
BA_ "GenSigTimeoutTime_ECM" SG_ 1436 CRC_BCM27 0;
BA_ "GenSigTimeoutTime_DTCM" SG_ 1436 CRC_BCM27 0;
BA_ "GenSigTimeoutTime_DMSM" SG_ 1436 CRC_BCM27 0;
BA_ "GenSigTimeoutTime_BCM" SG_ 1436 CRC_BCM27 0;
BA_ "GenSigTimeoutTime_AGSM" SG_ 1436 CRC_BCM27 0;
BA_ "GenSigTimeoutTime_SGW" SG_ 1435 Tri_Level_HSW_StatSts 0;
BA_ "GenSigTimeoutTime_RFHM" SG_ 1435 Tri_Level_HSW_StatSts 0;
BA_ "GenSigTimeoutTime_MPAD" SG_ 1435 Tri_Level_HSW_StatSts 0;
BA_ "GenSigTimeoutTime_IPC" SG_ 1435 Tri_Level_HSW_StatSts 0;
BA_ "GenSigTimeoutTime_GNMM" SG_ 1435 Tri_Level_HSW_StatSts 0;
BA_ "GenSigTimeoutTime_ESL" SG_ 1435 Tri_Level_HSW_StatSts 0;
BA_ "GenSigTimeoutTime_ECM" SG_ 1435 Tri_Level_HSW_StatSts 0;
BA_ "GenSigTimeoutTime_DTCM" SG_ 1435 Tri_Level_HSW_StatSts 0;
BA_ "GenSigTimeoutTime_DMSM" SG_ 1435 Tri_Level_HSW_StatSts 0;
BA_ "GenSigTimeoutTime_BSM" SG_ 1435 Tri_Level_HSW_StatSts 0;
BA_ "GenSigTimeoutTime_BCM" SG_ 1435 Tri_Level_HSW_StatSts 0;
BA_ "GenSigTimeoutTime_AGSM" SG_ 1435 Tri_Level_HSW_StatSts 0;
BA_ "GenSigTimeoutTime_ADCAM" SG_ 1435 Tri_Level_HSW_StatSts 0;
BA_ "GenSigTimeoutTime_RFHM" SG_ 1436 Comfort_Enable_Act 0;
BA_ "GenSigTimeoutTime_MPAD" SG_ 1436 Comfort_Enable_Act 0;
BA_ "GenSigTimeoutTime_GNMM" SG_ 1436 Comfort_Enable_Act 0;
BA_ "GenSigTimeoutTime_EVCU2" SG_ 1436 Comfort_Enable_Act 0;
BA_ "GenSigTimeoutTime_ESL" SG_ 1436 Comfort_Enable_Act 0;
BA_ "GenSigTimeoutTime_ECM" SG_ 1436 Comfort_Enable_Act 0;
BA_ "GenSigTimeoutTime_DTCM" SG_ 1436 Comfort_Enable_Act 0;
BA_ "GenSigTimeoutTime_DMSM" SG_ 1436 Comfort_Enable_Act 0;
BA_ "GenSigTimeoutTime_BSM" SG_ 1436 Comfort_Enable_Act 0;
BA_ "GenSigTimeoutTime_BCM" SG_ 1436 Comfort_Enable_Act 0;
BA_ "GenSigTimeoutTime_AGSM" SG_ 1436 Comfort_Enable_Act 0;
BA_ "GenSigTimeoutTime_ADCAM" SG_ 1436 Comfort_Enable_Act 0;
BA_ "GenSigSendType" SG_ 1436 Comfort_Enable_Act 3;
BA_ "GenSigTimeoutTime_SGW" SG_ 1435 HMI_FrontTrunkRegulatoryRelease 0;
BA_ "GenSigTimeoutTime_RFHM" SG_ 1435 HMI_FrontTrunkRegulatoryRelease 0;
BA_ "GenSigTimeoutTime_MPAD" SG_ 1435 HMI_FrontTrunkRegulatoryRelease 0;
BA_ "GenSigTimeoutTime_GNMM" SG_ 1435 HMI_FrontTrunkRegulatoryRelease 0;
BA_ "GenSigTimeoutTime_EVCU2" SG_ 1435 HMI_FrontTrunkRegulatoryRelease 0;
BA_ "GenSigTimeoutTime_ESL" SG_ 1435 HMI_FrontTrunkRegulatoryRelease 0;
BA_ "GenSigTimeoutTime_ECM" SG_ 1435 HMI_FrontTrunkRegulatoryRelease 0;
BA_ "GenSigTimeoutTime_DTCM" SG_ 1435 HMI_FrontTrunkRegulatoryRelease 0;
BA_ "GenSigTimeoutTime_DMSM" SG_ 1435 HMI_FrontTrunkRegulatoryRelease 0;
BA_ "GenSigTimeoutTime_BSM" SG_ 1435 HMI_FrontTrunkRegulatoryRelease 0;
BA_ "GenSigTimeoutTime_BCM" SG_ 1435 HMI_FrontTrunkRegulatoryRelease 0;
BA_ "GenSigTimeoutTime_AGSM" SG_ 1435 HMI_FrontTrunkRegulatoryRelease 0;
BA_ "GenSigTimeoutTime_ADCAM" SG_ 1435 HMI_FrontTrunkRegulatoryRelease 0;
BA_ "GenSigSendType" SG_ 1435 HMI_FrontTrunkRegulatoryRelease 3;
BA_ "GenSigTimeoutTime_SGW" SG_ 1435 HAS_OnOffSts 0;
BA_ "GenSigTimeoutTime_RFHM" SG_ 1435 HAS_OnOffSts 0;
BA_ "GenSigTimeoutTime_IPC" SG_ 1435 HAS_OnOffSts 0;
BA_ "GenSigTimeoutTime_GNMM" SG_ 1435 HAS_OnOffSts 0;
BA_ "GenSigTimeoutTime_ESL" SG_ 1435 HAS_OnOffSts 0;
BA_ "GenSigTimeoutTime_ECM" SG_ 1435 HAS_OnOffSts 0;
BA_ "GenSigTimeoutTime_DTCM" SG_ 1435 HAS_OnOffSts 0;
BA_ "GenSigTimeoutTime_DMSM" SG_ 1435 HAS_OnOffSts 0;
BA_ "GenSigTimeoutTime_BSM" SG_ 1435 HAS_OnOffSts 0;
BA_ "GenSigTimeoutTime_BCM" SG_ 1435 HAS_OnOffSts 0;
BA_ "GenSigTimeoutTime_AGSM" SG_ 1435 HAS_OnOffSts 0;
BA_ "GenSigSendType" SG_ 1435 HAS_OnOffSts 3;
BA_ "GenSigTimeoutTime_RFHM" SG_ 1435 PssgrScreenOn_Off_RequestSts 0;
BA_ "GenSigTimeoutTime_MPAD" SG_ 1435 PssgrScreenOn_Off_RequestSts 0;
BA_ "GenSigTimeoutTime_IPC" SG_ 1435 PssgrScreenOn_Off_RequestSts 0;
BA_ "GenSigTimeoutTime_GNMM" SG_ 1435 PssgrScreenOn_Off_RequestSts 0;
BA_ "GenSigTimeoutTime_EVCU2" SG_ 1435 PssgrScreenOn_Off_RequestSts 0;
BA_ "GenSigTimeoutTime_ESL" SG_ 1435 PssgrScreenOn_Off_RequestSts 0;
BA_ "GenSigTimeoutTime_ECM" SG_ 1435 PssgrScreenOn_Off_RequestSts 0;
BA_ "GenSigTimeoutTime_DTCM" SG_ 1435 PssgrScreenOn_Off_RequestSts 0;
BA_ "GenSigTimeoutTime_DMSM" SG_ 1435 PssgrScreenOn_Off_RequestSts 0;
BA_ "GenSigTimeoutTime_BSM" SG_ 1435 PssgrScreenOn_Off_RequestSts 0;
BA_ "GenSigTimeoutTime_BCM" SG_ 1435 PssgrScreenOn_Off_RequestSts 0;
BA_ "GenSigTimeoutTime_AGSM" SG_ 1435 PssgrScreenOn_Off_RequestSts 0;
BA_ "GenSigTimeoutTime_ADCAM" SG_ 1435 PssgrScreenOn_Off_RequestSts 0;
BA_ "GenSigSendType" SG_ 1435 PssgrScreenOn_Off_RequestSts 3;
BA_ "GenSigTimeoutTime_RFHM" SG_ 1435 Paddles_DrvMd_CfgSts_TMI 0;
BA_ "GenSigTimeoutTime_MPAD" SG_ 1435 Paddles_DrvMd_CfgSts_TMI 0;
BA_ "GenSigTimeoutTime_IPC" SG_ 1435 Paddles_DrvMd_CfgSts_TMI 0;
BA_ "GenSigTimeoutTime_GNMM" SG_ 1435 Paddles_DrvMd_CfgSts_TMI 0;
BA_ "GenSigTimeoutTime_EVCU2" SG_ 1435 Paddles_DrvMd_CfgSts_TMI 0;
BA_ "GenSigTimeoutTime_ESL" SG_ 1435 Paddles_DrvMd_CfgSts_TMI 0;
BA_ "GenSigTimeoutTime_ECM" SG_ 1435 Paddles_DrvMd_CfgSts_TMI 0;
BA_ "GenSigTimeoutTime_DTCM" SG_ 1435 Paddles_DrvMd_CfgSts_TMI 0;
BA_ "GenSigTimeoutTime_DMSM" SG_ 1435 Paddles_DrvMd_CfgSts_TMI 0;
BA_ "GenSigTimeoutTime_BSM" SG_ 1435 Paddles_DrvMd_CfgSts_TMI 0;
BA_ "GenSigTimeoutTime_BCM" SG_ 1435 Paddles_DrvMd_CfgSts_TMI 0;
BA_ "GenSigTimeoutTime_AGSM" SG_ 1435 Paddles_DrvMd_CfgSts_TMI 0;
BA_ "GenSigTimeoutTime_ADCAM" SG_ 1435 Paddles_DrvMd_CfgSts_TMI 0;
BA_ "GenSigSendType" SG_ 1435 Paddles_DrvMd_CfgSts_TMI 4;
BA_ "GenSigTimeoutTime_RFHM" SG_ 1435 HeadlightsDelayModeActive 0;
BA_ "GenSigTimeoutTime_MPAD" SG_ 1435 HeadlightsDelayModeActive 0;
BA_ "GenSigTimeoutTime_IPC" SG_ 1435 HeadlightsDelayModeActive 0;
BA_ "GenSigTimeoutTime_GNMM" SG_ 1435 HeadlightsDelayModeActive 0;
BA_ "GenSigTimeoutTime_EVCU2" SG_ 1435 HeadlightsDelayModeActive 0;
BA_ "GenSigTimeoutTime_ESL" SG_ 1435 HeadlightsDelayModeActive 0;
BA_ "GenSigTimeoutTime_ECM" SG_ 1435 HeadlightsDelayModeActive 0;
BA_ "GenSigTimeoutTime_DTCM" SG_ 1435 HeadlightsDelayModeActive 0;
BA_ "GenSigTimeoutTime_DMSM" SG_ 1435 HeadlightsDelayModeActive 0;
BA_ "GenSigTimeoutTime_BSM" SG_ 1435 HeadlightsDelayModeActive 0;
BA_ "GenSigTimeoutTime_BCM" SG_ 1435 HeadlightsDelayModeActive 0;
BA_ "GenSigTimeoutTime_AGSM" SG_ 1435 HeadlightsDelayModeActive 0;
BA_ "GenSigTimeoutTime_ADCAM" SG_ 1435 HeadlightsDelayModeActive 0;
BA_ "GenSigSendType" SG_ 1435 HeadlightsDelayModeActive 3;
BA_ "GenSigTimeoutTime_SGW" SG_ 1434 HRLS_Ambient_Light_Level 0;
BA_ "GenSigTimeoutTime_RFHM" SG_ 1434 HRLS_Ambient_Light_Level 0;
BA_ "GenSigTimeoutTime_MPAD" SG_ 1434 HRLS_Ambient_Light_Level 0;
BA_ "GenSigTimeoutTime_GNMM" SG_ 1434 HRLS_Ambient_Light_Level 0;
BA_ "GenSigTimeoutTime_EVCU2" SG_ 1434 HRLS_Ambient_Light_Level 0;
BA_ "GenSigTimeoutTime_ESL" SG_ 1434 HRLS_Ambient_Light_Level 0;
BA_ "GenSigTimeoutTime_ECM" SG_ 1434 HRLS_Ambient_Light_Level 0;
BA_ "GenSigTimeoutTime_DTCM" SG_ 1434 HRLS_Ambient_Light_Level 0;
BA_ "GenSigTimeoutTime_DMSM" SG_ 1434 HRLS_Ambient_Light_Level 0;
BA_ "GenSigTimeoutTime_BSM" SG_ 1434 HRLS_Ambient_Light_Level 0;
BA_ "GenSigTimeoutTime_RFHM" SG_ 603 HVACDRVTemp 0;
BA_ "GenSigTimeoutTime_MPAD" SG_ 603 HVACDRVTemp 0;
BA_ "GenSigTimeoutTime_IPC" SG_ 603 HVACDRVTemp 0;
BA_ "GenSigTimeoutTime_GNMM" SG_ 603 HVACDRVTemp 0;
BA_ "GenSigTimeoutTime_EVCU2" SG_ 603 HVACDRVTemp 0;
BA_ "GenSigTimeoutTime_ESL" SG_ 603 HVACDRVTemp 0;
BA_ "GenSigTimeoutTime_ECM" SG_ 603 HVACDRVTemp 0;
BA_ "GenSigTimeoutTime_DTCM" SG_ 603 HVACDRVTemp 0;
BA_ "GenSigTimeoutTime_DMSM" SG_ 603 HVACDRVTemp 0;
BA_ "GenSigTimeoutTime_BSM" SG_ 603 HVACDRVTemp 0;
BA_ "GenSigTimeoutTime_BCM" SG_ 603 HVACDRVTemp 0;
BA_ "GenSigTimeoutTime_AGSM" SG_ 603 HVACDRVTemp 0;
BA_ "GenSigTimeoutTime_ADCAM" SG_ 603 HVACDRVTemp 0;
BA_ "GenSigSendType" SG_ 603 HVACDRVTemp 3;
BA_ "GenSigTimeoutTime_RFHM" SG_ 603 HVACPSNTemp 0;
BA_ "GenSigTimeoutTime_MPAD" SG_ 603 HVACPSNTemp 0;
BA_ "GenSigTimeoutTime_IPC" SG_ 603 HVACPSNTemp 0;
BA_ "GenSigTimeoutTime_GNMM" SG_ 603 HVACPSNTemp 0;
BA_ "GenSigTimeoutTime_EVCU2" SG_ 603 HVACPSNTemp 0;
BA_ "GenSigTimeoutTime_ESL" SG_ 603 HVACPSNTemp 0;
BA_ "GenSigTimeoutTime_ECM" SG_ 603 HVACPSNTemp 0;
BA_ "GenSigTimeoutTime_DTCM" SG_ 603 HVACPSNTemp 0;
BA_ "GenSigTimeoutTime_DMSM" SG_ 603 HVACPSNTemp 0;
BA_ "GenSigTimeoutTime_BSM" SG_ 603 HVACPSNTemp 0;
BA_ "GenSigTimeoutTime_BCM" SG_ 603 HVACPSNTemp 0;
BA_ "GenSigTimeoutTime_AGSM" SG_ 603 HVACPSNTemp 0;
BA_ "GenSigTimeoutTime_ADCAM" SG_ 603 HVACPSNTemp 0;
BA_ "GenSigSendType" SG_ 603 HVACPSNTemp 3;
BA_ "GenSigTimeoutTime_SGW" SG_ 1435 BSD_FAIL_D 0;
BA_ "GenSigTimeoutTime_RFHM" SG_ 1435 BSD_FAIL_D 0;
BA_ "GenSigTimeoutTime_MPAD" SG_ 1435 BSD_FAIL_D 0;
BA_ "GenSigTimeoutTime_IPC" SG_ 1435 BSD_FAIL_D 0;
BA_ "GenSigTimeoutTime_GNMM" SG_ 1435 BSD_FAIL_D 0;
BA_ "GenSigTimeoutTime_EVCU2" SG_ 1435 BSD_FAIL_D 0;
BA_ "GenSigTimeoutTime_ESL" SG_ 1435 BSD_FAIL_D 0;
BA_ "GenSigTimeoutTime_ECM" SG_ 1435 BSD_FAIL_D 0;
BA_ "GenSigTimeoutTime_DTCM" SG_ 1435 BSD_FAIL_D 0;
BA_ "GenSigTimeoutTime_DMSM" SG_ 1435 BSD_FAIL_D 0;
BA_ "GenSigTimeoutTime_BSM" SG_ 1435 BSD_FAIL_D 0;
BA_ "GenSigTimeoutTime_BCM" SG_ 1435 BSD_FAIL_D 0;
BA_ "GenSigTimeoutTime_AGSM" SG_ 1435 BSD_FAIL_D 0;
BA_ "GenSigSendType" SG_ 1435 BSD_FAIL_D 3;
BA_ "GenSigTimeoutTime_SGW" SG_ 1435 BSD_FAIL_P 0;
BA_ "GenSigTimeoutTime_RFHM" SG_ 1435 BSD_FAIL_P 0;
BA_ "GenSigTimeoutTime_MPAD" SG_ 1435 BSD_FAIL_P 0;
BA_ "GenSigTimeoutTime_IPC" SG_ 1435 BSD_FAIL_P 0;
BA_ "GenSigTimeoutTime_GNMM" SG_ 1435 BSD_FAIL_P 0;
BA_ "GenSigTimeoutTime_EVCU2" SG_ 1435 BSD_FAIL_P 0;
BA_ "GenSigTimeoutTime_ESL" SG_ 1435 BSD_FAIL_P 0;
BA_ "GenSigTimeoutTime_ECM" SG_ 1435 BSD_FAIL_P 0;
BA_ "GenSigTimeoutTime_DTCM" SG_ 1435 BSD_FAIL_P 0;
BA_ "GenSigTimeoutTime_DMSM" SG_ 1435 BSD_FAIL_P 0;
BA_ "GenSigTimeoutTime_BSM" SG_ 1435 BSD_FAIL_P 0;
BA_ "GenSigTimeoutTime_BCM" SG_ 1435 BSD_FAIL_P 0;
BA_ "GenSigTimeoutTime_AGSM" SG_ 1435 BSD_FAIL_P 0;
BA_ "GenSigSendType" SG_ 1435 BSD_FAIL_P 3;
BA_ "GenSigTimeoutTime_SGW" SG_ 1435 AHP_EnblReq 0;
BA_ "GenSigTimeoutTime_RFHM" SG_ 1435 AHP_EnblReq 0;
BA_ "GenSigTimeoutTime_MPAD" SG_ 1435 AHP_EnblReq 0;
BA_ "GenSigTimeoutTime_IPC" SG_ 1435 AHP_EnblReq 0;
BA_ "GenSigTimeoutTime_GNMM" SG_ 1435 AHP_EnblReq 0;
BA_ "GenSigTimeoutTime_ESL" SG_ 1435 AHP_EnblReq 0;
BA_ "GenSigTimeoutTime_ECM" SG_ 1435 AHP_EnblReq 0;
BA_ "GenSigTimeoutTime_DTCM" SG_ 1435 AHP_EnblReq 0;
BA_ "GenSigTimeoutTime_DMSM" SG_ 1435 AHP_EnblReq 0;
BA_ "GenSigTimeoutTime_BSM" SG_ 1435 AHP_EnblReq 0;
BA_ "GenSigTimeoutTime_BCM" SG_ 1435 AHP_EnblReq 0;
BA_ "GenSigTimeoutTime_AGSM" SG_ 1435 AHP_EnblReq 0;
BA_ "GenSigTimeoutTime_ADCAM" SG_ 1435 AHP_EnblReq 0;
BA_ "GenSigSendType" SG_ 1435 AHP_EnblReq 3;
BA_ "GenSigTimeoutTime_SGW" SG_ 602 TurnLeverLatched 0;
BA_ "GenSigTimeoutTime_RFHM" SG_ 602 TurnLeverLatched 0;
BA_ "GenSigTimeoutTime_IPC" SG_ 602 TurnLeverLatched 0;
BA_ "GenSigTimeoutTime_GNMM" SG_ 602 TurnLeverLatched 0;
BA_ "GenSigTimeoutTime_EVCU2" SG_ 602 TurnLeverLatched 0;
BA_ "GenSigTimeoutTime_ESL" SG_ 602 TurnLeverLatched 0;
BA_ "GenSigTimeoutTime_ECM" SG_ 602 TurnLeverLatched 0;
BA_ "GenSigTimeoutTime_DTCM" SG_ 602 TurnLeverLatched 0;
BA_ "GenSigTimeoutTime_DMSM" SG_ 602 TurnLeverLatched 0;
BA_ "GenSigTimeoutTime_BSM" SG_ 602 TurnLeverLatched 0;
BA_ "GenSigTimeoutTime_BCM" SG_ 602 TurnLeverLatched 0;
BA_ "GenSigTimeoutTime_AGSM" SG_ 602 TurnLeverLatched 0;
BA_ "GenSigTimeoutTime_ADCAM" SG_ 602 TurnLeverLatched 0;
BA_ "GenSigSendType" SG_ 602 TurnLeverLatched 3;
BA_ "GenSigTimeoutTime_SGW" SG_ 602 WprSw6Posn 0;
BA_ "GenSigTimeoutTime_RFHM" SG_ 602 WprSw6Posn 0;
BA_ "GenSigTimeoutTime_MPAD" SG_ 602 WprSw6Posn 0;
BA_ "GenSigTimeoutTime_IPC" SG_ 602 WprSw6Posn 0;
BA_ "GenSigTimeoutTime_GNMM" SG_ 602 WprSw6Posn 0;
BA_ "GenSigTimeoutTime_EVCU2" SG_ 602 WprSw6Posn 0;
BA_ "GenSigTimeoutTime_ESL" SG_ 602 WprSw6Posn 0;
BA_ "GenSigTimeoutTime_ECM" SG_ 602 WprSw6Posn 0;
BA_ "GenSigTimeoutTime_DTCM" SG_ 602 WprSw6Posn 0;
BA_ "GenSigTimeoutTime_DMSM" SG_ 602 WprSw6Posn 0;
BA_ "GenSigTimeoutTime_BSM" SG_ 602 WprSw6Posn 0;
BA_ "GenSigTimeoutTime_BCM" SG_ 602 WprSw6Posn 0;
BA_ "GenSigTimeoutTime_AGSM" SG_ 602 WprSw6Posn 0;
BA_ "GenSigSendType" SG_ 602 WprSw6Posn 3;
BA_ "GenSigTimeoutTime_SGW" SG_ 602 CRC_BCM22 0;
BA_ "GenSigTimeoutTime_RFHM" SG_ 602 CRC_BCM22 0;
BA_ "GenSigTimeoutTime_IPC" SG_ 602 CRC_BCM22 0;
BA_ "GenSigTimeoutTime_GNMM" SG_ 602 CRC_BCM22 0;
BA_ "GenSigTimeoutTime_EVCU2" SG_ 602 CRC_BCM22 0;
BA_ "GenSigTimeoutTime_ESL" SG_ 602 CRC_BCM22 0;
BA_ "GenSigTimeoutTime_ECM" SG_ 602 CRC_BCM22 0;
BA_ "GenSigTimeoutTime_DTCM" SG_ 602 CRC_BCM22 0;
BA_ "GenSigTimeoutTime_DMSM" SG_ 602 CRC_BCM22 0;
BA_ "GenSigTimeoutTime_BSM" SG_ 602 CRC_BCM22 0;
BA_ "GenSigTimeoutTime_BCM" SG_ 602 CRC_BCM22 0;
BA_ "GenSigTimeoutTime_AGSM" SG_ 602 CRC_BCM22 0;
BA_ "GenSigTimeoutTime_SGW" SG_ 602 MessageCounter_BCM22 0;
BA_ "GenSigTimeoutTime_RFHM" SG_ 602 MessageCounter_BCM22 0;
BA_ "GenSigTimeoutTime_IPC" SG_ 602 MessageCounter_BCM22 0;
BA_ "GenSigTimeoutTime_GNMM" SG_ 602 MessageCounter_BCM22 0;
BA_ "GenSigTimeoutTime_EVCU2" SG_ 602 MessageCounter_BCM22 0;
BA_ "GenSigTimeoutTime_ESL" SG_ 602 MessageCounter_BCM22 0;
BA_ "GenSigTimeoutTime_ECM" SG_ 602 MessageCounter_BCM22 0;
BA_ "GenSigTimeoutTime_DTCM" SG_ 602 MessageCounter_BCM22 0;
BA_ "GenSigTimeoutTime_DMSM" SG_ 602 MessageCounter_BCM22 0;
BA_ "GenSigTimeoutTime_BSM" SG_ 602 MessageCounter_BCM22 0;
BA_ "GenSigTimeoutTime_BCM" SG_ 602 MessageCounter_BCM22 0;
BA_ "GenSigTimeoutTime_AGSM" SG_ 602 MessageCounter_BCM22 0;
BA_ "GenSigTimeoutTime_BCM" SG_ 1434 HRLS_Ambient_Light_Level 0;
BA_ "GenSigTimeoutTime_AGSM" SG_ 1434 HRLS_Ambient_Light_Level 0;
BA_ "GenSigTimeoutTime_ADCAM" SG_ 1434 HRLS_Ambient_Light_Level 0;
BA_ "GenSigSendType" SG_ 1434 HRLS_Ambient_Light_Level 3;
BA_ "GenSigStartValue" SG_ 1434 HRLS_Ambient_Light_Level 255;
BA_ "GenSigTimeoutTime_BCM" SG_ 1435 L_TurnCluster 0;
BA_ "GenSigTimeoutTime_AGSM" SG_ 1435 L_TurnCluster 0;
BA_ "GenSigTimeoutTime_ADCAM" SG_ 1435 L_TurnCluster 0;
BA_ "GenSigSendType" SG_ 1435 L_TurnCluster 3;
BA_ "GenSigTimeoutTime_SGW" SG_ 1435 LKA_RequestSts 0;
BA_ "GenSigTimeoutTime_RFHM" SG_ 1435 LKA_RequestSts 0;
BA_ "GenSigTimeoutTime_IPC" SG_ 1435 LKA_RequestSts 0;
BA_ "GenSigTimeoutTime_GNMM" SG_ 1435 LKA_RequestSts 0;
BA_ "GenSigTimeoutTime_EVCU2" SG_ 1435 LKA_RequestSts 0;
BA_ "GenSigTimeoutTime_ESL" SG_ 1435 LKA_RequestSts 0;
BA_ "GenSigTimeoutTime_ECM" SG_ 1435 LKA_RequestSts 0;
BA_ "GenSigTimeoutTime_DTCM" SG_ 1435 LKA_RequestSts 0;
BA_ "GenSigTimeoutTime_DMSM" SG_ 1435 LKA_RequestSts 0;
BA_ "GenSigTimeoutTime_BSM" SG_ 1435 LKA_RequestSts 0;
BA_ "GenSigTimeoutTime_BCM" SG_ 1435 LKA_RequestSts 0;
BA_ "GenSigTimeoutTime_AGSM" SG_ 1435 LKA_RequestSts 0;
BA_ "GenSigSendType" SG_ 1435 LKA_RequestSts 3;
BA_ "GenSigTimeoutTime_SGW" SG_ 1435 PAS_TEMP_DR_POS 0;
BA_ "GenSigTimeoutTime_RFHM" SG_ 1435 PAS_TEMP_DR_POS 0;
BA_ "GenSigTimeoutTime_MPAD" SG_ 1435 PAS_TEMP_DR_POS 0;
BA_ "GenSigTimeoutTime_IPC" SG_ 1435 PAS_TEMP_DR_POS 0;
BA_ "GenSigTimeoutTime_GNMM" SG_ 1435 PAS_TEMP_DR_POS 0;
BA_ "GenSigTimeoutTime_ESL" SG_ 1435 PAS_TEMP_DR_POS 0;
BA_ "GenSigTimeoutTime_ECM" SG_ 1435 PAS_TEMP_DR_POS 0;
BA_ "GenSigTimeoutTime_DTCM" SG_ 1435 PAS_TEMP_DR_POS 0;
BA_ "GenSigTimeoutTime_DMSM" SG_ 1435 PAS_TEMP_DR_POS 0;
BA_ "GenSigTimeoutTime_BSM" SG_ 1435 PAS_TEMP_DR_POS 0;
BA_ "GenSigTimeoutTime_BCM" SG_ 1435 PAS_TEMP_DR_POS 0;
BA_ "GenSigTimeoutTime_AGSM" SG_ 1435 PAS_TEMP_DR_POS 0;
BA_ "GenSigTimeoutTime_ADCAM" SG_ 1435 PAS_TEMP_DR_POS 0;
BA_ "GenSigStartValue" SG_ 1435 PAS_TEMP_DR_POS 127;
BA_ "GenSigTimeoutTime_RFHM" SG_ 1435 HazardSwitchPressed 0;
BA_ "GenSigTimeoutTime_IPC" SG_ 1435 HazardSwitchPressed 0;
BA_ "GenSigTimeoutTime_GNMM" SG_ 1435 HazardSwitchPressed 0;
BA_ "GenSigTimeoutTime_EVCU2" SG_ 1435 HazardSwitchPressed 0;
BA_ "GenSigTimeoutTime_ESL" SG_ 1435 HazardSwitchPressed 0;
BA_ "GenSigTimeoutTime_ECM" SG_ 1435 HazardSwitchPressed 0;
BA_ "GenSigTimeoutTime_DTCM" SG_ 1435 HazardSwitchPressed 0;
BA_ "GenSigTimeoutTime_DMSM" SG_ 1435 HazardSwitchPressed 0;
BA_ "GenSigTimeoutTime_BSM" SG_ 1435 HazardSwitchPressed 0;
BA_ "GenSigTimeoutTime_AGSM" SG_ 1435 HazardSwitchPressed 0;
BA_ "GenSigSendType" SG_ 1435 HazardSwitchPressed 3;
BA_ "GenSigTimeoutTime_SGW" SG_ 1435 DEFROST_SEL 0;
BA_ "GenSigTimeoutTime_SGW" SG_ 1435 EvapTempTar 0;
BA_ "GenSigTimeoutTime_RFHM" SG_ 1435 EvapTempTar 0;
BA_ "GenSigTimeoutTime_MPAD" SG_ 1435 EvapTempTar 0;
BA_ "GenSigTimeoutTime_IPC" SG_ 1435 EvapTempTar 0;
BA_ "GenSigTimeoutTime_GNMM" SG_ 1435 EvapTempTar 0;
BA_ "GenSigTimeoutTime_ESL" SG_ 1435 EvapTempTar 0;
BA_ "GenSigTimeoutTime_ECM" SG_ 1435 EvapTempTar 0;
BA_ "GenSigTimeoutTime_DTCM" SG_ 1435 EvapTempTar 0;
BA_ "GenSigTimeoutTime_DMSM" SG_ 1435 EvapTempTar 0;
BA_ "GenSigTimeoutTime_BSM" SG_ 1435 EvapTempTar 0;
BA_ "GenSigTimeoutTime_BCM" SG_ 1435 EvapTempTar 0;
BA_ "GenSigTimeoutTime_AGSM" SG_ 1435 EvapTempTar 0;
BA_ "GenSigTimeoutTime_ADCAM" SG_ 1435 EvapTempTar 0;
BA_ "GenSigTimeoutTime_DMSM" SG_ 1435 FLTurnLampFault 0;
BA_ "GenSigTimeoutTime_BSM" SG_ 1435 FLTurnLampFault 0;
BA_ "GenSigTimeoutTime_BCM" SG_ 1435 FLTurnLampFault 0;
BA_ "GenSigTimeoutTime_AGSM" SG_ 1435 FLTurnLampFault 0;
BA_ "GenSigTimeoutTime_ADCAM" SG_ 1435 FLTurnLampFault 0;
BA_ "GenSigSendType" SG_ 1435 FLTurnLampFault 3;
BA_ "GenSigTimeoutTime_SGW" SG_ 1435 FLTurnLampFault 0;
BA_ "GenSigTimeoutTime_RFHM" SG_ 1435 FLTurnLampFault 0;
BA_ "GenSigTimeoutTime_GNMM" SG_ 1435 FLTurnLampFault 0;
BA_ "GenSigTimeoutTime_EVCU2" SG_ 1435 FLTurnLampFault 0;
BA_ "GenSigTimeoutTime_ESL" SG_ 1435 FLTurnLampFault 0;
BA_ "GenSigTimeoutTime_ECM" SG_ 1435 FLTurnLampFault 0;
BA_ "GenSigTimeoutTime_DTCM" SG_ 1435 FLTurnLampFault 0;
BA_ "GenSigTimeoutTime_SGW" SG_ 1435 FrontFogPressed 0;
BA_ "GenSigTimeoutTime_RFHM" SG_ 1435 FrontFogPressed 0;
BA_ "GenSigTimeoutTime_MPAD" SG_ 1435 FrontFogPressed 0;
BA_ "GenSigTimeoutTime_IPC" SG_ 1435 FrontFogPressed 0;
BA_ "GenSigTimeoutTime_GNMM" SG_ 1435 FrontFogPressed 0;
BA_ "GenSigTimeoutTime_EVCU2" SG_ 1435 FrontFogPressed 0;
BA_ "GenSigTimeoutTime_ESL" SG_ 1435 FrontFogPressed 0;
BA_ "GenSigTimeoutTime_ECM" SG_ 1435 FrontFogPressed 0;
BA_ "GenSigTimeoutTime_DTCM" SG_ 1435 FrontFogPressed 0;
BA_ "GenSigTimeoutTime_DMSM" SG_ 1435 FrontFogPressed 0;
BA_ "GenSigTimeoutTime_BSM" SG_ 1435 FrontFogPressed 0;
BA_ "GenSigTimeoutTime_BCM" SG_ 1435 FrontFogPressed 0;
BA_ "GenSigTimeoutTime_AGSM" SG_ 1435 FrontFogPressed 0;
BA_ "GenSigSendType" SG_ 1435 FrontFogPressed 3;
BA_ "GenSigTimeoutTime_SGW" SG_ 1435 FRTurnLampFault 0;
BA_ "GenSigTimeoutTime_RFHM" SG_ 1435 FRTurnLampFault 0;
BA_ "GenSigTimeoutTime_GNMM" SG_ 1435 FRTurnLampFault 0;
BA_ "GenSigTimeoutTime_EVCU2" SG_ 1435 FRTurnLampFault 0;
BA_ "GenSigTimeoutTime_ESL" SG_ 1435 FRTurnLampFault 0;
BA_ "GenSigTimeoutTime_ECM" SG_ 1435 FRTurnLampFault 0;
BA_ "GenSigTimeoutTime_DTCM" SG_ 1435 FRTurnLampFault 0;
BA_ "GenSigTimeoutTime_DMSM" SG_ 1435 FRTurnLampFault 0;
BA_ "GenSigTimeoutTime_BSM" SG_ 1435 FRTurnLampFault 0;
BA_ "GenSigTimeoutTime_BCM" SG_ 1435 FRTurnLampFault 0;
BA_ "GenSigTimeoutTime_AGSM" SG_ 1435 FRTurnLampFault 0;
BA_ "GenSigTimeoutTime_ADCAM" SG_ 1435 FRTurnLampFault 0;
BA_ "GenSigSendType" SG_ 1435 FRTurnLampFault 3;
BA_ "GenSigTimeoutTime_SGW" SG_ 1435 HLSPosition 0;
BA_ "GenSigTimeoutTime_RFHM" SG_ 1435 HLSPosition 0;
BA_ "GenSigTimeoutTime_GNMM" SG_ 1435 HLSPosition 0;
BA_ "GenSigTimeoutTime_EVCU2" SG_ 1435 HLSPosition 0;
BA_ "GenSigTimeoutTime_ESL" SG_ 1435 HLSPosition 0;
BA_ "GenSigTimeoutTime_ECM" SG_ 1435 HLSPosition 0;
BA_ "GenSigTimeoutTime_DTCM" SG_ 1435 HLSPosition 0;
BA_ "GenSigTimeoutTime_DMSM" SG_ 1435 HLSPosition 0;
BA_ "GenSigTimeoutTime_BSM" SG_ 1435 HLSPosition 0;
BA_ "GenSigTimeoutTime_BCM" SG_ 1435 HLSPosition 0;
BA_ "GenSigTimeoutTime_AGSM" SG_ 1435 HLSPosition 0;
BA_ "GenSigSendType" SG_ 1435 HLSPosition 3;
BA_ "GenSigTimeoutTime_SGW" SG_ 1435 MessageCounter_BCM26 0;
BA_ "GenSigTimeoutTime_RFHM" SG_ 1435 MessageCounter_BCM26 0;
BA_ "GenSigTimeoutTime_GNMM" SG_ 1435 MessageCounter_BCM26 0;
BA_ "GenSigTimeoutTime_EVCU2" SG_ 1435 MessageCounter_BCM26 0;
BA_ "GenSigTimeoutTime_ESL" SG_ 1435 MessageCounter_BCM26 0;
BA_ "GenSigTimeoutTime_ECM" SG_ 1435 MessageCounter_BCM26 0;
BA_ "GenSigTimeoutTime_DTCM" SG_ 1435 MessageCounter_BCM26 0;
BA_ "GenSigTimeoutTime_DMSM" SG_ 1435 MessageCounter_BCM26 0;
BA_ "GenSigTimeoutTime_BSM" SG_ 1435 MessageCounter_BCM26 0;
BA_ "GenSigTimeoutTime_BCM" SG_ 1435 MessageCounter_BCM26 0;
BA_ "GenSigTimeoutTime_AGSM" SG_ 1435 MessageCounter_BCM26 0;
BA_ "GenSigTimeoutTime_SGW" SG_ 1435 HtrCorTmp_InTgt 0;
BA_ "GenSigTimeoutTime_RFHM" SG_ 1435 HtrCorTmp_InTgt 0;
BA_ "GenSigTimeoutTime_MPAD" SG_ 1435 HtrCorTmp_InTgt 0;
BA_ "GenSigTimeoutTime_IPC" SG_ 1435 HtrCorTmp_InTgt 0;
BA_ "GenSigTimeoutTime_GNMM" SG_ 1435 HtrCorTmp_InTgt 0;
BA_ "GenSigTimeoutTime_ESL" SG_ 1435 HtrCorTmp_InTgt 0;
BA_ "GenSigTimeoutTime_ECM" SG_ 1435 HtrCorTmp_InTgt 0;
BA_ "GenSigTimeoutTime_DTCM" SG_ 1435 HtrCorTmp_InTgt 0;
BA_ "GenSigTimeoutTime_DMSM" SG_ 1435 HtrCorTmp_InTgt 0;
BA_ "GenSigTimeoutTime_BSM" SG_ 1435 HtrCorTmp_InTgt 0;
BA_ "GenSigTimeoutTime_BCM" SG_ 1435 HtrCorTmp_InTgt 0;
BA_ "GenSigTimeoutTime_AGSM" SG_ 1435 HtrCorTmp_InTgt 0;
BA_ "GenSigTimeoutTime_ADCAM" SG_ 1435 HtrCorTmp_InTgt 0;
BA_ "GenSigStartValue" SG_ 1435 HtrCorTmp_InTgt 255;
BA_ "GenSigTimeoutTime_RFHM" SG_ 1435 DEFROST_SEL 0;
BA_ "GenSigTimeoutTime_MPAD" SG_ 1435 DEFROST_SEL 0;
BA_ "GenSigTimeoutTime_IPC" SG_ 1435 DEFROST_SEL 0;
BA_ "GenSigTimeoutTime_GNMM" SG_ 1435 DEFROST_SEL 0;
BA_ "GenSigTimeoutTime_ESL" SG_ 1435 DEFROST_SEL 0;
BA_ "GenSigTimeoutTime_ECM" SG_ 1435 DEFROST_SEL 0;
BA_ "GenSigTimeoutTime_DTCM" SG_ 1435 DEFROST_SEL 0;
BA_ "GenSigTimeoutTime_DMSM" SG_ 1435 DEFROST_SEL 0;
BA_ "GenSigTimeoutTime_BSM" SG_ 1435 DEFROST_SEL 0;
BA_ "GenSigTimeoutTime_BCM" SG_ 1435 DEFROST_SEL 0;
BA_ "GenSigTimeoutTime_AGSM" SG_ 1435 DEFROST_SEL 0;
BA_ "GenSigTimeoutTime_ADCAM" SG_ 1435 DEFROST_SEL 0;
BA_ "GenSigTimeoutTime_SGW" SG_ 1435 CRC_BCM26 0;
BA_ "GenSigTimeoutTime_RFHM" SG_ 1435 CRC_BCM26 0;
BA_ "GenSigTimeoutTime_GNMM" SG_ 1435 CRC_BCM26 0;
BA_ "GenSigTimeoutTime_EVCU2" SG_ 1435 CRC_BCM26 0;
BA_ "GenSigTimeoutTime_ESL" SG_ 1435 CRC_BCM26 0;
BA_ "GenSigTimeoutTime_ECM" SG_ 1435 CRC_BCM26 0;
BA_ "GenSigTimeoutTime_DTCM" SG_ 1435 CRC_BCM26 0;
BA_ "GenSigTimeoutTime_DMSM" SG_ 1435 CRC_BCM26 0;
BA_ "GenSigTimeoutTime_BSM" SG_ 1435 CRC_BCM26 0;
BA_ "GenSigTimeoutTime_BCM" SG_ 1435 CRC_BCM26 0;
BA_ "GenSigTimeoutTime_AGSM" SG_ 1435 CRC_BCM26 0;
BA_ "GenSigTimeoutTime_SGW" SG_ 1434 NV_Detection_Stat 0;
BA_ "GenSigTimeoutTime_RFHM" SG_ 1434 NV_Detection_Stat 0;
BA_ "GenSigTimeoutTime_MPAD" SG_ 1434 NV_Detection_Stat 0;
BA_ "GenSigTimeoutTime_GNMM" SG_ 1434 NV_Detection_Stat 0;
BA_ "GenSigTimeoutTime_EVCU2" SG_ 1434 NV_Detection_Stat 0;
BA_ "GenSigTimeoutTime_ESL" SG_ 1434 NV_Detection_Stat 0;
BA_ "GenSigTimeoutTime_ECM" SG_ 1434 NV_Detection_Stat 0;
BA_ "GenSigTimeoutTime_DTCM" SG_ 1434 NV_Detection_Stat 0;
BA_ "GenSigTimeoutTime_DMSM" SG_ 1434 NV_Detection_Stat 0;
BA_ "GenSigTimeoutTime_BSM" SG_ 1434 NV_Detection_Stat 0;
BA_ "GenSigTimeoutTime_BCM" SG_ 1434 NV_Detection_Stat 0;
BA_ "GenSigTimeoutTime_AGSM" SG_ 1434 NV_Detection_Stat 0;
BA_ "GenSigTimeoutTime_ADCAM" SG_ 1434 NV_Detection_Stat 0;
BA_ "GenSigSendType" SG_ 1434 NV_Detection_Stat 3;
BA_ "GenSigTimeoutTime_MPAD" SG_ 1434 NV_PopupDisp_Info 0;
BA_ "GenSigTimeoutTime_GNMM" SG_ 1434 NV_PopupDisp_Info 0;
BA_ "GenSigTimeoutTime_EVCU2" SG_ 1434 NV_PopupDisp_Info 0;
BA_ "GenSigTimeoutTime_ESL" SG_ 1434 NV_PopupDisp_Info 0;
BA_ "GenSigTimeoutTime_ECM" SG_ 1434 NV_PopupDisp_Info 0;
BA_ "GenSigTimeoutTime_DTCM" SG_ 1434 NV_PopupDisp_Info 0;
BA_ "GenSigTimeoutTime_DMSM" SG_ 1434 NV_PopupDisp_Info 0;
BA_ "GenSigTimeoutTime_BSM" SG_ 1434 NV_PopupDisp_Info 0;
BA_ "GenSigTimeoutTime_BCM" SG_ 1434 NV_PopupDisp_Info 0;
BA_ "GenSigTimeoutTime_AGSM" SG_ 1434 NV_PopupDisp_Info 0;
BA_ "GenSigTimeoutTime_ADCAM" SG_ 1434 NV_PopupDisp_Info 0;
BA_ "GenSigSendType" SG_ 1434 NV_PopupDisp_Info 3;
BA_ "GenSigTimeoutTime_SGW" SG_ 1434 NV_PopupDisp_Info 0;
BA_ "GenSigTimeoutTime_RFHM" SG_ 1434 NV_PopupDisp_Info 0;
BA_ "GenSigTimeoutTime_SGW" SG_ 1434 NV_Screen_Reqst 0;
BA_ "GenSigTimeoutTime_RFHM" SG_ 1434 NV_Screen_Reqst 0;
BA_ "GenSigTimeoutTime_MPAD" SG_ 1434 NV_Screen_Reqst 0;
BA_ "GenSigTimeoutTime_GNMM" SG_ 1434 NV_Screen_Reqst 0;
BA_ "GenSigTimeoutTime_EVCU2" SG_ 1434 NV_Screen_Reqst 0;
BA_ "GenSigTimeoutTime_ESL" SG_ 1434 NV_Screen_Reqst 0;
BA_ "GenSigTimeoutTime_ECM" SG_ 1434 NV_Screen_Reqst 0;
BA_ "GenSigTimeoutTime_DTCM" SG_ 1434 NV_Screen_Reqst 0;
BA_ "GenSigTimeoutTime_DMSM" SG_ 1434 NV_Screen_Reqst 0;
BA_ "GenSigTimeoutTime_BSM" SG_ 1434 NV_Screen_Reqst 0;
BA_ "GenSigTimeoutTime_BCM" SG_ 1434 NV_Screen_Reqst 0;
BA_ "GenSigTimeoutTime_AGSM" SG_ 1434 NV_Screen_Reqst 0;
BA_ "GenSigTimeoutTime_ADCAM" SG_ 1434 NV_Screen_Reqst 0;
BA_ "GenSigSendType" SG_ 1434 NV_Screen_Reqst 3;
BA_ "GenSigTimeoutTime_SGW" SG_ 1434 NV_ScreenDisp_Info 0;
BA_ "GenSigTimeoutTime_RFHM" SG_ 1434 NV_ScreenDisp_Info 0;
BA_ "GenSigTimeoutTime_MPAD" SG_ 1434 NV_ScreenDisp_Info 0;
BA_ "GenSigTimeoutTime_GNMM" SG_ 1434 NV_ScreenDisp_Info 0;
BA_ "GenSigTimeoutTime_EVCU2" SG_ 1434 NV_ScreenDisp_Info 0;
BA_ "GenSigTimeoutTime_ESL" SG_ 1434 NV_ScreenDisp_Info 0;
BA_ "GenSigTimeoutTime_ECM" SG_ 1434 NV_ScreenDisp_Info 0;
BA_ "GenSigTimeoutTime_DTCM" SG_ 1434 NV_ScreenDisp_Info 0;
BA_ "GenSigTimeoutTime_DMSM" SG_ 1434 NV_ScreenDisp_Info 0;
BA_ "GenSigTimeoutTime_BSM" SG_ 1434 NV_ScreenDisp_Info 0;
BA_ "GenSigTimeoutTime_BCM" SG_ 1434 NV_ScreenDisp_Info 0;
BA_ "GenSigTimeoutTime_AGSM" SG_ 1434 NV_ScreenDisp_Info 0;
BA_ "GenSigTimeoutTime_ADCAM" SG_ 1434 NV_ScreenDisp_Info 0;
BA_ "GenSigSendType" SG_ 1434 NV_ScreenDisp_Info 3;
BA_ "GenSigTimeoutTime_SGW" SG_ 1434 NV_Telltale_Stat 0;
BA_ "GenSigTimeoutTime_RFHM" SG_ 1434 NV_Telltale_Stat 0;
BA_ "GenSigTimeoutTime_MPAD" SG_ 1434 NV_Telltale_Stat 0;
BA_ "GenSigTimeoutTime_GNMM" SG_ 1434 NV_Telltale_Stat 0;
BA_ "GenSigTimeoutTime_EVCU2" SG_ 1434 NV_Telltale_Stat 0;
BA_ "GenSigTimeoutTime_ESL" SG_ 1434 NV_Telltale_Stat 0;
BA_ "GenSigTimeoutTime_ECM" SG_ 1434 NV_Telltale_Stat 0;
BA_ "GenSigTimeoutTime_DTCM" SG_ 1434 NV_Telltale_Stat 0;
BA_ "GenSigTimeoutTime_DMSM" SG_ 1434 NV_Telltale_Stat 0;
BA_ "GenSigTimeoutTime_BSM" SG_ 1434 NV_Telltale_Stat 0;
BA_ "GenSigTimeoutTime_BCM" SG_ 1434 NV_Telltale_Stat 0;
BA_ "GenSigTimeoutTime_AGSM" SG_ 1434 NV_Telltale_Stat 0;
BA_ "GenSigTimeoutTime_ADCAM" SG_ 1434 NV_Telltale_Stat 0;
BA_ "GenSigSendType" SG_ 1434 NV_Telltale_Stat 3;
BA_ "GenSigTimeoutTime_SGW" SG_ 1069 AVHSwitchSts 0;
BA_ "GenSigTimeoutTime_RFHM" SG_ 1069 AVHSwitchSts 0;
BA_ "GenSigTimeoutTime_MPAD" SG_ 1069 AVHSwitchSts 0;
BA_ "GenSigTimeoutTime_IPC" SG_ 1069 AVHSwitchSts 0;
BA_ "GenSigTimeoutTime_GNMM" SG_ 1069 AVHSwitchSts 0;
BA_ "GenSigTimeoutTime_EVCU2" SG_ 1069 AVHSwitchSts 0;
BA_ "GenSigTimeoutTime_ESL" SG_ 1069 AVHSwitchSts 0;
BA_ "GenSigTimeoutTime_ECM" SG_ 1069 AVHSwitchSts 0;
BA_ "GenSigTimeoutTime_DTCM" SG_ 1069 AVHSwitchSts 0;
BA_ "GenSigTimeoutTime_DMSM" SG_ 1069 AVHSwitchSts 0;
BA_ "GenSigTimeoutTime_BCM" SG_ 1069 AVHSwitchSts 0;
BA_ "GenSigTimeoutTime_AGSM" SG_ 1069 AVHSwitchSts 0;
BA_ "GenSigTimeoutTime_ADCAM" SG_ 1069 AVHSwitchSts 0;
BA_ "GenSigSendType" SG_ 1069 AVHSwitchSts 3;
BA_ "GenSigTimeoutTime_SGW" SG_ 1069 FronWasherSts 0;
BA_ "GenSigTimeoutTime_RFHM" SG_ 1069 FronWasherSts 0;
BA_ "GenSigTimeoutTime_MPAD" SG_ 1069 FronWasherSts 0;
BA_ "GenSigTimeoutTime_IPC" SG_ 1069 FronWasherSts 0;
BA_ "GenSigTimeoutTime_GNMM" SG_ 1069 FronWasherSts 0;
BA_ "GenSigTimeoutTime_EVCU2" SG_ 1069 FronWasherSts 0;
BA_ "GenSigTimeoutTime_ESL" SG_ 1069 FronWasherSts 0;
BA_ "GenSigTimeoutTime_ECM" SG_ 1069 FronWasherSts 0;
BA_ "GenSigTimeoutTime_DTCM" SG_ 1069 FronWasherSts 0;
BA_ "GenSigTimeoutTime_DMSM" SG_ 1069 FronWasherSts 0;
BA_ "GenSigTimeoutTime_BSM" SG_ 1069 FronWasherSts 0;
BA_ "GenSigTimeoutTime_BCM" SG_ 1069 FronWasherSts 0;
BA_ "GenSigTimeoutTime_AGSM" SG_ 1069 FronWasherSts 0;
BA_ "GenSigTimeoutTime_ADCAM" SG_ 1069 FronWasherSts 0;
BA_ "GenSigTimeoutTime_SGW" SG_ 1069 HazardCluster 0;
BA_ "GenSigTimeoutTime_RFHM" SG_ 1069 HazardCluster 0;
BA_ "GenSigTimeoutTime_MPAD" SG_ 1069 HazardCluster 0;
BA_ "GenSigTimeoutTime_GNMM" SG_ 1069 HazardCluster 0;
BA_ "GenSigTimeoutTime_EVCU2" SG_ 1069 HazardCluster 0;
BA_ "GenSigTimeoutTime_ESL" SG_ 1069 HazardCluster 0;
BA_ "GenSigTimeoutTime_ECM" SG_ 1069 HazardCluster 0;
BA_ "GenSigTimeoutTime_DTCM" SG_ 1069 HazardCluster 0;
BA_ "GenSigTimeoutTime_DMSM" SG_ 1069 HazardCluster 0;
BA_ "GenSigTimeoutTime_BSM" SG_ 1069 HazardCluster 0;
BA_ "GenSigTimeoutTime_BCM" SG_ 1069 HazardCluster 0;
BA_ "GenSigTimeoutTime_AGSM" SG_ 1069 HazardCluster 0;
BA_ "GenSigTimeoutTime_ADCAM" SG_ 1069 HazardCluster 0;
BA_ "GenSigSendType" SG_ 1069 HazardCluster 3;
BA_ "GenSigTimeoutTime_RFHM" SG_ 1069 ReverseLamp 0;
BA_ "GenSigTimeoutTime_MPAD" SG_ 1069 ReverseLamp 0;
BA_ "GenSigTimeoutTime_IPC" SG_ 1069 ReverseLamp 0;
BA_ "GenSigTimeoutTime_GNMM" SG_ 1069 ReverseLamp 0;
BA_ "GenSigTimeoutTime_EVCU2" SG_ 1069 ReverseLamp 0;
BA_ "GenSigTimeoutTime_ESL" SG_ 1069 ReverseLamp 0;
BA_ "GenSigTimeoutTime_ECM" SG_ 1069 ReverseLamp 0;
BA_ "GenSigTimeoutTime_DTCM" SG_ 1069 ReverseLamp 0;
BA_ "GenSigTimeoutTime_DMSM" SG_ 1069 ReverseLamp 0;
BA_ "GenSigTimeoutTime_BSM" SG_ 1069 ReverseLamp 0;
BA_ "GenSigTimeoutTime_BCM" SG_ 1069 ReverseLamp 0;
BA_ "GenSigTimeoutTime_AGSM" SG_ 1069 ReverseLamp 0;
BA_ "GenSigTimeoutTime_ADCAM" SG_ 1069 ReverseLamp 0;
BA_ "GenSigSendType" SG_ 1069 ReverseLamp 3;
BA_ "GenSigTimeoutTime_SGW" SG_ 1069 CRC_BCM24 0;
BA_ "GenSigTimeoutTime_RFHM" SG_ 1069 CRC_BCM24 0;
BA_ "GenSigTimeoutTime_MPAD" SG_ 1069 CRC_BCM24 0;
BA_ "GenSigTimeoutTime_IPC" SG_ 1069 CRC_BCM24 0;
BA_ "GenSigTimeoutTime_GNMM" SG_ 1069 CRC_BCM24 0;
BA_ "GenSigTimeoutTime_EVCU2" SG_ 1069 CRC_BCM24 0;
BA_ "GenSigTimeoutTime_ESL" SG_ 1069 CRC_BCM24 0;
BA_ "GenSigTimeoutTime_ECM" SG_ 1069 CRC_BCM24 0;
BA_ "GenSigTimeoutTime_DTCM" SG_ 1069 CRC_BCM24 0;
BA_ "GenSigTimeoutTime_DMSM" SG_ 1069 CRC_BCM24 0;
BA_ "GenSigTimeoutTime_BCM" SG_ 1069 CRC_BCM24 0;
BA_ "GenSigTimeoutTime_AGSM" SG_ 1069 CRC_BCM24 0;
BA_ "GenSigTimeoutTime_ADCAM" SG_ 1069 CRC_BCM24 0;
BA_ "GenSigTimeoutTime_SGW" SG_ 1069 MessageCounter_BCM24 0;
BA_ "GenSigTimeoutTime_RFHM" SG_ 1069 MessageCounter_BCM24 0;
BA_ "GenSigTimeoutTime_MPAD" SG_ 1069 MessageCounter_BCM24 0;
BA_ "GenSigTimeoutTime_IPC" SG_ 1069 MessageCounter_BCM24 0;
BA_ "GenSigTimeoutTime_GNMM" SG_ 1069 MessageCounter_BCM24 0;
BA_ "GenSigTimeoutTime_EVCU2" SG_ 1069 MessageCounter_BCM24 0;
BA_ "GenSigTimeoutTime_ESL" SG_ 1069 MessageCounter_BCM24 0;
BA_ "GenSigTimeoutTime_ECM" SG_ 1069 MessageCounter_BCM24 0;
BA_ "GenSigTimeoutTime_DTCM" SG_ 1069 MessageCounter_BCM24 0;
BA_ "GenSigTimeoutTime_DMSM" SG_ 1069 MessageCounter_BCM24 0;
BA_ "GenSigTimeoutTime_BCM" SG_ 1069 MessageCounter_BCM24 0;
BA_ "GenSigTimeoutTime_AGSM" SG_ 1069 MessageCounter_BCM24 0;
BA_ "GenSigTimeoutTime_ADCAM" SG_ 1069 MessageCounter_BCM24 0;
BA_ "GenSigTimeoutTime_SGW" SG_ 602 HiBmLvr_Stat 0;
BA_ "GenSigTimeoutTime_RFHM" SG_ 602 HiBmLvr_Stat 0;
BA_ "GenSigTimeoutTime_MPAD" SG_ 602 HiBmLvr_Stat 0;
BA_ "GenSigTimeoutTime_IPC" SG_ 602 HiBmLvr_Stat 0;
BA_ "GenSigTimeoutTime_GNMM" SG_ 602 HiBmLvr_Stat 0;
BA_ "GenSigTimeoutTime_ESL" SG_ 602 HiBmLvr_Stat 0;
BA_ "GenSigTimeoutTime_ECM" SG_ 602 HiBmLvr_Stat 0;
BA_ "GenSigTimeoutTime_DTCM" SG_ 602 HiBmLvr_Stat 0;
BA_ "GenSigTimeoutTime_DMSM" SG_ 602 HiBmLvr_Stat 0;
BA_ "GenSigTimeoutTime_BSM" SG_ 602 HiBmLvr_Stat 0;
BA_ "GenSigTimeoutTime_BCM" SG_ 602 HiBmLvr_Stat 0;
BA_ "GenSigTimeoutTime_AGSM" SG_ 602 HiBmLvr_Stat 0;
BA_ "GenSigSendType" SG_ 602 HiBmLvr_Stat 3;
BA_ "GenSigTimeoutTime_RFHM" SG_ 602 FR_HS_STATFailSts 0;
BA_ "GenSigTimeoutTime_MPAD" SG_ 602 FR_HS_STATFailSts 0;
BA_ "GenSigTimeoutTime_IPC" SG_ 602 FR_HS_STATFailSts 0;
BA_ "GenSigTimeoutTime_GNMM" SG_ 602 FR_HS_STATFailSts 0;
BA_ "GenSigTimeoutTime_ESL" SG_ 602 FR_HS_STATFailSts 0;
BA_ "GenSigTimeoutTime_ECM" SG_ 602 FR_HS_STATFailSts 0;
BA_ "GenSigTimeoutTime_DTCM" SG_ 602 FR_HS_STATFailSts 0;
BA_ "GenSigTimeoutTime_DMSM" SG_ 602 FR_HS_STATFailSts 0;
BA_ "GenSigTimeoutTime_BSM" SG_ 602 FR_HS_STATFailSts 0;
BA_ "GenSigTimeoutTime_BCM" SG_ 602 FR_HS_STATFailSts 0;
BA_ "GenSigTimeoutTime_AGSM" SG_ 602 FR_HS_STATFailSts 0;
BA_ "GenSigTimeoutTime_ADCAM" SG_ 602 FR_HS_STATFailSts 0;
BA_ "GenSigSendType" SG_ 602 FR_HS_STATFailSts 3;
BA_ "GenSigTimeoutTime_RFHM" SG_ 602 FR_HS_STATSts 0;
BA_ "GenSigTimeoutTime_MPAD" SG_ 602 FR_HS_STATSts 0;
BA_ "GenSigTimeoutTime_IPC" SG_ 602 FR_HS_STATSts 0;
BA_ "GenSigTimeoutTime_GNMM" SG_ 602 FR_HS_STATSts 0;
BA_ "GenSigTimeoutTime_ESL" SG_ 602 FR_HS_STATSts 0;
BA_ "GenSigTimeoutTime_ECM" SG_ 602 FR_HS_STATSts 0;
BA_ "GenSigTimeoutTime_DTCM" SG_ 602 FR_HS_STATSts 0;
BA_ "GenSigTimeoutTime_DMSM" SG_ 602 FR_HS_STATSts 0;
BA_ "GenSigTimeoutTime_BSM" SG_ 602 FR_HS_STATSts 0;
BA_ "GenSigTimeoutTime_BCM" SG_ 602 FR_HS_STATSts 0;
BA_ "GenSigTimeoutTime_AGSM" SG_ 602 FR_HS_STATSts 0;
BA_ "GenSigTimeoutTime_ADCAM" SG_ 602 FR_HS_STATSts 0;
BA_ "GenSigSendType" SG_ 602 FR_HS_STATSts 3;
BA_ "GenSigTimeoutTime_RFHM" SG_ 602 FL_HS_STATFailSts 0;
BA_ "GenSigTimeoutTime_MPAD" SG_ 602 FL_HS_STATFailSts 0;
BA_ "GenSigTimeoutTime_IPC" SG_ 602 FL_HS_STATFailSts 0;
BA_ "GenSigTimeoutTime_GNMM" SG_ 602 FL_HS_STATFailSts 0;
BA_ "GenSigTimeoutTime_ESL" SG_ 602 FL_HS_STATFailSts 0;
BA_ "GenSigTimeoutTime_ECM" SG_ 602 FL_HS_STATFailSts 0;
BA_ "GenSigTimeoutTime_DTCM" SG_ 602 FL_HS_STATFailSts 0;
BA_ "GenSigTimeoutTime_DMSM" SG_ 602 FL_HS_STATFailSts 0;
BA_ "GenSigTimeoutTime_BSM" SG_ 602 FL_HS_STATFailSts 0;
BA_ "GenSigTimeoutTime_BCM" SG_ 602 FL_HS_STATFailSts 0;
BA_ "GenSigTimeoutTime_AGSM" SG_ 602 FL_HS_STATFailSts 0;
BA_ "GenSigTimeoutTime_ADCAM" SG_ 602 FL_HS_STATFailSts 0;
BA_ "GenSigSendType" SG_ 602 FL_HS_STATFailSts 3;
BA_ "GenSigTimeoutTime_RFHM" SG_ 602 FL_HS_STATSts 0;
BA_ "GenSigTimeoutTime_MPAD" SG_ 602 FL_HS_STATSts 0;
BA_ "GenSigTimeoutTime_IPC" SG_ 602 FL_HS_STATSts 0;
BA_ "GenSigTimeoutTime_GNMM" SG_ 602 FL_HS_STATSts 0;
BA_ "GenSigTimeoutTime_ESL" SG_ 602 FL_HS_STATSts 0;
BA_ "GenSigTimeoutTime_ECM" SG_ 602 FL_HS_STATSts 0;
BA_ "GenSigTimeoutTime_DTCM" SG_ 602 FL_HS_STATSts 0;
BA_ "GenSigTimeoutTime_DMSM" SG_ 602 FL_HS_STATSts 0;
BA_ "GenSigTimeoutTime_BSM" SG_ 602 FL_HS_STATSts 0;
BA_ "GenSigTimeoutTime_BCM" SG_ 602 FL_HS_STATSts 0;
BA_ "GenSigTimeoutTime_AGSM" SG_ 602 FL_HS_STATSts 0;
BA_ "GenSigTimeoutTime_ADCAM" SG_ 602 FL_HS_STATSts 0;
BA_ "GenSigSendType" SG_ 602 FL_HS_STATSts 3;
BA_ "GenSigTimeoutTime_SGW" SG_ 1327 RR_Lvl 0;
BA_ "GenSigTimeoutTime_RFHM" SG_ 1327 RR_Lvl 0;
BA_ "GenSigTimeoutTime_IPC" SG_ 1327 RR_Lvl 0;
BA_ "GenSigTimeoutTime_GNMM" SG_ 1327 RR_Lvl 0;
BA_ "GenSigTimeoutTime_EVCU2" SG_ 1327 RR_Lvl 0;
BA_ "GenSigTimeoutTime_ESL" SG_ 1327 RR_Lvl 0;
BA_ "GenSigTimeoutTime_ECM" SG_ 1327 RR_Lvl 0;
BA_ "GenSigTimeoutTime_DTCM" SG_ 1327 RR_Lvl 0;
BA_ "GenSigTimeoutTime_DMSM" SG_ 1327 RR_Lvl 0;
BA_ "GenSigTimeoutTime_BSM" SG_ 1327 RR_Lvl 0;
BA_ "GenSigTimeoutTime_BCM" SG_ 1327 RR_Lvl 0;
BA_ "GenSigTimeoutTime_AGSM" SG_ 1327 RR_Lvl 0;
BA_ "GenSigTimeoutTime_ADCAM" SG_ 1327 RR_Lvl 0;
BA_ "GenSigStartValue" SG_ 1327 RR_Lvl 254;
BA_ "GenSigTimeoutTime_SGW" SG_ 1327 RL_Lvl 0;
BA_ "GenSigTimeoutTime_RFHM" SG_ 1327 RL_Lvl 0;
BA_ "GenSigTimeoutTime_IPC" SG_ 1327 RL_Lvl 0;
BA_ "GenSigTimeoutTime_GNMM" SG_ 1327 RL_Lvl 0;
BA_ "GenSigTimeoutTime_EVCU2" SG_ 1327 RL_Lvl 0;
BA_ "GenSigTimeoutTime_ESL" SG_ 1327 RL_Lvl 0;
BA_ "GenSigTimeoutTime_ECM" SG_ 1327 RL_Lvl 0;
BA_ "GenSigTimeoutTime_DTCM" SG_ 1327 RL_Lvl 0;
BA_ "GenSigTimeoutTime_DMSM" SG_ 1327 RL_Lvl 0;
BA_ "GenSigTimeoutTime_BSM" SG_ 1327 RL_Lvl 0;
BA_ "GenSigTimeoutTime_BCM" SG_ 1327 RL_Lvl 0;
BA_ "GenSigTimeoutTime_AGSM" SG_ 1327 RL_Lvl 0;
BA_ "GenSigTimeoutTime_ADCAM" SG_ 1327 RL_Lvl 0;
BA_ "GenSigStartValue" SG_ 1327 RL_Lvl 254;
BA_ "GenSigTimeoutTime_SGW" SG_ 1327 FR_Lvl 0;
BA_ "GenSigTimeoutTime_RFHM" SG_ 1327 FR_Lvl 0;
BA_ "GenSigTimeoutTime_IPC" SG_ 1327 FR_Lvl 0;
BA_ "GenSigTimeoutTime_GNMM" SG_ 1327 FR_Lvl 0;
BA_ "GenSigTimeoutTime_EVCU2" SG_ 1327 FR_Lvl 0;
BA_ "GenSigTimeoutTime_ESL" SG_ 1327 FR_Lvl 0;
BA_ "GenSigTimeoutTime_ECM" SG_ 1327 FR_Lvl 0;
BA_ "GenSigTimeoutTime_DTCM" SG_ 1327 FR_Lvl 0;
BA_ "GenSigTimeoutTime_DMSM" SG_ 1327 FR_Lvl 0;
BA_ "GenSigTimeoutTime_BSM" SG_ 1327 FR_Lvl 0;
BA_ "GenSigTimeoutTime_BCM" SG_ 1327 FR_Lvl 0;
BA_ "GenSigTimeoutTime_AGSM" SG_ 1327 FR_Lvl 0;
BA_ "GenSigTimeoutTime_ADCAM" SG_ 1327 FR_Lvl 0;
BA_ "GenSigStartValue" SG_ 1327 FR_Lvl 254;
BA_ "GenSigTimeoutTime_SGW" SG_ 1327 FL_Lvl 0;
BA_ "GenSigTimeoutTime_RFHM" SG_ 1327 FL_Lvl 0;
BA_ "GenSigTimeoutTime_IPC" SG_ 1327 FL_Lvl 0;
BA_ "GenSigTimeoutTime_GNMM" SG_ 1327 FL_Lvl 0;
BA_ "GenSigTimeoutTime_EVCU2" SG_ 1327 FL_Lvl 0;
BA_ "GenSigTimeoutTime_ESL" SG_ 1327 FL_Lvl 0;
BA_ "GenSigTimeoutTime_ECM" SG_ 1327 FL_Lvl 0;
BA_ "GenSigTimeoutTime_DTCM" SG_ 1327 FL_Lvl 0;
BA_ "GenSigTimeoutTime_DMSM" SG_ 1327 FL_Lvl 0;
BA_ "GenSigTimeoutTime_BSM" SG_ 1327 FL_Lvl 0;
BA_ "GenSigTimeoutTime_BCM" SG_ 1327 FL_Lvl 0;
BA_ "GenSigTimeoutTime_AGSM" SG_ 1327 FL_Lvl 0;
BA_ "GenSigTimeoutTime_ADCAM" SG_ 1327 FL_Lvl 0;
BA_ "GenSigStartValue" SG_ 1327 FL_Lvl 254;
BA_ "GenSigTimeoutTime_ADCAM" SG_ 1464 Immediate_ChargeTarget2 0;
BA_ "GenSigSendType" SG_ 1464 Immediate_ChargeTarget2 3;
BA_ "GenSigStartValue" SG_ 1464 Immediate_ChargeTarget2 15;
BA_ "GenSigTimeoutTime_SGW" SG_ 1464 Immediate_ChargeTarget2 0;
BA_ "GenSigTimeoutTime_RFHM" SG_ 1464 Immediate_ChargeTarget2 0;
BA_ "GenSigTimeoutTime_MPAD" SG_ 1464 Immediate_ChargeTarget2 0;
BA_ "GenSigTimeoutTime_IPC" SG_ 1464 Immediate_ChargeTarget2 0;
BA_ "GenSigTimeoutTime_GNMM" SG_ 1464 Immediate_ChargeTarget2 0;
BA_ "GenSigTimeoutTime_ESL" SG_ 1464 Immediate_ChargeTarget2 0;
BA_ "GenSigTimeoutTime_ECM" SG_ 1464 Immediate_ChargeTarget2 0;
BA_ "GenSigTimeoutTime_DTCM" SG_ 1464 Immediate_ChargeTarget2 0;
BA_ "GenSigTimeoutTime_DMSM" SG_ 1464 Immediate_ChargeTarget2 0;
BA_ "GenSigTimeoutTime_BSM" SG_ 1464 Immediate_ChargeTarget2 0;
BA_ "GenSigTimeoutTime_BCM" SG_ 1464 Immediate_ChargeTarget2 0;
BA_ "GenSigTimeoutTime_AGSM" SG_ 1464 Immediate_ChargeTarget2 0;
BA_ "GenSigTimeoutTime_SGW" SG_ 1464 Immediate_ChargeTarget1 0;
BA_ "GenSigTimeoutTime_RFHM" SG_ 1464 Immediate_ChargeTarget1 0;
BA_ "GenSigTimeoutTime_MPAD" SG_ 1464 Immediate_ChargeTarget1 0;
BA_ "GenSigTimeoutTime_IPC" SG_ 1464 Immediate_ChargeTarget1 0;
BA_ "GenSigTimeoutTime_GNMM" SG_ 1464 Immediate_ChargeTarget1 0;
BA_ "GenSigTimeoutTime_ESL" SG_ 1464 Immediate_ChargeTarget1 0;
BA_ "GenSigTimeoutTime_ECM" SG_ 1464 Immediate_ChargeTarget1 0;
BA_ "GenSigTimeoutTime_DTCM" SG_ 1464 Immediate_ChargeTarget1 0;
BA_ "GenSigTimeoutTime_DMSM" SG_ 1464 Immediate_ChargeTarget1 0;
BA_ "GenSigTimeoutTime_BSM" SG_ 1464 Immediate_ChargeTarget1 0;
BA_ "GenSigTimeoutTime_BCM" SG_ 1464 Immediate_ChargeTarget1 0;
BA_ "GenSigTimeoutTime_AGSM" SG_ 1464 Immediate_ChargeTarget1 0;
BA_ "GenSigTimeoutTime_ADCAM" SG_ 1464 Immediate_ChargeTarget1 0;
BA_ "GenSigSendType" SG_ 1464 Immediate_ChargeTarget1 3;
BA_ "GenSigStartValue" SG_ 1464 Immediate_ChargeTarget1 15;
BA_ "GenSigTimeoutTime_SGW" SG_ 1464 External_ChargeTarget1 0;
BA_ "GenSigTimeoutTime_RFHM" SG_ 1464 External_ChargeTarget1 0;
BA_ "GenSigTimeoutTime_MPAD" SG_ 1464 External_ChargeTarget1 0;
BA_ "GenSigTimeoutTime_IPC" SG_ 1464 External_ChargeTarget1 0;
BA_ "GenSigTimeoutTime_SGW" SG_ 1464 External_ChargeTarget2 0;
BA_ "GenSigTimeoutTime_RFHM" SG_ 1464 External_ChargeTarget2 0;
BA_ "GenSigTimeoutTime_MPAD" SG_ 1464 External_ChargeTarget2 0;
BA_ "GenSigTimeoutTime_IPC" SG_ 1464 External_ChargeTarget2 0;
BA_ "GenSigTimeoutTime_GNMM" SG_ 1464 External_ChargeTarget2 0;
BA_ "GenSigTimeoutTime_ESL" SG_ 1464 External_ChargeTarget2 0;
BA_ "GenSigTimeoutTime_ECM" SG_ 1464 External_ChargeTarget2 0;
BA_ "GenSigTimeoutTime_DTCM" SG_ 1464 External_ChargeTarget2 0;
BA_ "GenSigTimeoutTime_DMSM" SG_ 1464 External_ChargeTarget2 0;
BA_ "GenSigTimeoutTime_BSM" SG_ 1464 External_ChargeTarget2 0;
BA_ "GenSigTimeoutTime_BCM" SG_ 1464 External_ChargeTarget2 0;
BA_ "GenSigTimeoutTime_AGSM" SG_ 1464 External_ChargeTarget2 0;
BA_ "GenSigTimeoutTime_ADCAM" SG_ 1464 External_ChargeTarget2 0;
BA_ "GenSigSendType" SG_ 1464 External_ChargeTarget2 3;
BA_ "GenSigStartValue" SG_ 1464 External_ChargeTarget2 15;
BA_ "GenSigTimeoutTime_RFHM" SG_ 1459 Next_Charge_End_Time_Hr 0;
BA_ "GenSigTimeoutTime_MPAD" SG_ 1459 Next_Charge_End_Time_Hr 0;
BA_ "GenSigTimeoutTime_GNMM" SG_ 1459 Next_Charge_End_Time_Hr 0;
BA_ "GenSigTimeoutTime_EVCU2" SG_ 1459 Next_Charge_End_Time_Hr 0;
BA_ "GenSigTimeoutTime_ESL" SG_ 1459 Next_Charge_End_Time_Hr 0;
BA_ "GenSigTimeoutTime_ECM" SG_ 1459 Next_Charge_End_Time_Hr 0;
BA_ "GenSigTimeoutTime_DTCM" SG_ 1459 Next_Charge_End_Time_Hr 0;
BA_ "GenSigTimeoutTime_DMSM" SG_ 1459 Next_Charge_End_Time_Hr 0;
BA_ "GenSigTimeoutTime_BSM" SG_ 1459 Next_Charge_End_Time_Hr 0;
BA_ "GenSigTimeoutTime_BCM" SG_ 1459 Next_Charge_End_Time_Hr 0;
BA_ "GenSigTimeoutTime_AGSM" SG_ 1459 Next_Charge_End_Time_Hr 0;
BA_ "GenSigTimeoutTime_ADCAM" SG_ 1459 Next_Charge_End_Time_Hr 0;
BA_ "GenSigSendType" SG_ 1459 Next_Charge_End_Time_Hr 3;
BA_ "GenSigTimeoutTime_RFHM" SG_ 1459 Next_Climate_Day 0;
BA_ "GenSigTimeoutTime_MPAD" SG_ 1459 Next_Climate_Day 0;
BA_ "GenSigTimeoutTime_IPC" SG_ 1459 Next_Climate_Day 0;
BA_ "GenSigTimeoutTime_GNMM" SG_ 1459 Next_Climate_Day 0;
BA_ "GenSigTimeoutTime_EVCU2" SG_ 1459 Next_Climate_Day 0;
BA_ "GenSigTimeoutTime_ESL" SG_ 1459 Next_Climate_Day 0;
BA_ "GenSigTimeoutTime_ECM" SG_ 1459 Next_Climate_Day 0;
BA_ "GenSigTimeoutTime_DTCM" SG_ 1459 Next_Climate_Day 0;
BA_ "GenSigTimeoutTime_DMSM" SG_ 1459 Next_Climate_Day 0;
BA_ "GenSigTimeoutTime_BSM" SG_ 1459 Next_Climate_Day 0;
BA_ "GenSigTimeoutTime_BCM" SG_ 1459 Next_Climate_Day 0;
BA_ "GenSigTimeoutTime_AGSM" SG_ 1459 Next_Climate_Day 0;
BA_ "GenSigTimeoutTime_ADCAM" SG_ 1459 Next_Climate_Day 0;
BA_ "GenSigTimeoutTime_RFHM" SG_ 1459 Next_Charge_StartDay 0;
BA_ "GenSigTimeoutTime_MPAD" SG_ 1459 Next_Charge_StartDay 0;
BA_ "GenSigTimeoutTime_GNMM" SG_ 1459 Next_Charge_StartDay 0;
BA_ "GenSigTimeoutTime_EVCU2" SG_ 1459 Next_Charge_StartDay 0;
BA_ "GenSigTimeoutTime_ESL" SG_ 1459 Next_Charge_StartDay 0;
BA_ "GenSigTimeoutTime_ECM" SG_ 1459 Next_Charge_StartDay 0;
BA_ "GenSigTimeoutTime_DTCM" SG_ 1459 Next_Charge_StartDay 0;
BA_ "GenSigTimeoutTime_DMSM" SG_ 1459 Next_Charge_StartDay 0;
BA_ "GenSigTimeoutTime_BSM" SG_ 1459 Next_Charge_StartDay 0;
BA_ "GenSigTimeoutTime_BCM" SG_ 1459 Next_Charge_StartDay 0;
BA_ "GenSigTimeoutTime_AGSM" SG_ 1459 Next_Charge_StartDay 0;
BA_ "GenSigTimeoutTime_ADCAM" SG_ 1459 Next_Charge_StartDay 0;
BA_ "GenSigTimeoutTime_RFHM" SG_ 1459 Next_Charge_Start_Time_Min 0;
BA_ "GenSigTimeoutTime_MPAD" SG_ 1459 Next_Charge_Start_Time_Min 0;
BA_ "GenSigTimeoutTime_GNMM" SG_ 1459 Next_Charge_Start_Time_Min 0;
BA_ "GenSigTimeoutTime_EVCU2" SG_ 1459 Next_Charge_Start_Time_Min 0;
BA_ "GenSigTimeoutTime_ESL" SG_ 1459 Next_Charge_Start_Time_Min 0;
BA_ "GenSigTimeoutTime_ECM" SG_ 1459 Next_Charge_Start_Time_Min 0;
BA_ "GenSigTimeoutTime_DTCM" SG_ 1459 Next_Charge_Start_Time_Min 0;
BA_ "GenSigTimeoutTime_DMSM" SG_ 1459 Next_Charge_Start_Time_Min 0;
BA_ "GenSigTimeoutTime_BSM" SG_ 1459 Next_Charge_Start_Time_Min 0;
BA_ "GenSigTimeoutTime_BCM" SG_ 1459 Next_Charge_Start_Time_Min 0;
BA_ "GenSigTimeoutTime_AGSM" SG_ 1459 Next_Charge_Start_Time_Min 0;
BA_ "GenSigTimeoutTime_ADCAM" SG_ 1459 Next_Charge_Start_Time_Min 0;
BA_ "GenSigTimeoutTime_RFHM" SG_ 1459 Next_Charge_Start_Time_Hr 0;
BA_ "GenSigTimeoutTime_MPAD" SG_ 1459 Next_Charge_Start_Time_Hr 0;
BA_ "GenSigTimeoutTime_GNMM" SG_ 1459 Next_Charge_Start_Time_Hr 0;
BA_ "GenSigTimeoutTime_EVCU2" SG_ 1459 Next_Charge_Start_Time_Hr 0;
BA_ "GenSigTimeoutTime_ESL" SG_ 1459 Next_Charge_Start_Time_Hr 0;
BA_ "GenSigTimeoutTime_ECM" SG_ 1459 Next_Charge_Start_Time_Hr 0;
BA_ "GenSigTimeoutTime_DTCM" SG_ 1459 Next_Charge_Start_Time_Hr 0;
BA_ "GenSigTimeoutTime_DMSM" SG_ 1459 Next_Charge_Start_Time_Hr 0;
BA_ "GenSigTimeoutTime_BSM" SG_ 1459 Next_Charge_Start_Time_Hr 0;
BA_ "GenSigTimeoutTime_BCM" SG_ 1459 Next_Charge_Start_Time_Hr 0;
BA_ "GenSigTimeoutTime_AGSM" SG_ 1459 Next_Charge_Start_Time_Hr 0;
BA_ "GenSigTimeoutTime_ADCAM" SG_ 1459 Next_Charge_Start_Time_Hr 0;
BA_ "GenSigTimeoutTime_RFHM" SG_ 1459 Next_Charge_EndDay 0;
BA_ "GenSigTimeoutTime_MPAD" SG_ 1459 Next_Charge_EndDay 0;
BA_ "GenSigTimeoutTime_GNMM" SG_ 1459 Next_Charge_EndDay 0;
BA_ "GenSigTimeoutTime_EVCU2" SG_ 1459 Next_Charge_EndDay 0;
BA_ "GenSigTimeoutTime_ESL" SG_ 1459 Next_Charge_EndDay 0;
BA_ "GenSigTimeoutTime_ECM" SG_ 1459 Next_Charge_EndDay 0;
BA_ "GenSigTimeoutTime_DTCM" SG_ 1459 Next_Charge_EndDay 0;
BA_ "GenSigTimeoutTime_DMSM" SG_ 1459 Next_Charge_EndDay 0;
BA_ "GenSigTimeoutTime_BSM" SG_ 1459 Next_Charge_EndDay 0;
BA_ "GenSigTimeoutTime_BCM" SG_ 1459 Next_Charge_EndDay 0;
BA_ "GenSigTimeoutTime_AGSM" SG_ 1459 Next_Charge_EndDay 0;
BA_ "GenSigTimeoutTime_ADCAM" SG_ 1459 Next_Charge_EndDay 0;
BA_ "GenSigTimeoutTime_ECM" SG_ 1459 Next_Climate_Time_Hr 0;
BA_ "GenSigTimeoutTime_DTCM" SG_ 1459 Next_Climate_Time_Hr 0;
BA_ "GenSigTimeoutTime_DMSM" SG_ 1459 Next_Climate_Time_Hr 0;
BA_ "GenSigTimeoutTime_BSM" SG_ 1459 Next_Climate_Time_Hr 0;
BA_ "GenSigTimeoutTime_BCM" SG_ 1459 Next_Climate_Time_Hr 0;
BA_ "GenSigTimeoutTime_AGSM" SG_ 1459 Next_Climate_Time_Hr 0;
BA_ "GenSigTimeoutTime_ADCAM" SG_ 1459 Next_Climate_Time_Hr 0;
BA_ "GenSigTimeoutTime_RFHM" SG_ 1459 Next_Charge_End_Time_Min 0;
BA_ "GenSigTimeoutTime_MPAD" SG_ 1459 Next_Charge_End_Time_Min 0;
BA_ "GenSigTimeoutTime_GNMM" SG_ 1459 Next_Charge_End_Time_Min 0;
BA_ "GenSigTimeoutTime_EVCU2" SG_ 1459 Next_Charge_End_Time_Min 0;
BA_ "GenSigTimeoutTime_ESL" SG_ 1459 Next_Charge_End_Time_Min 0;
BA_ "GenSigTimeoutTime_ECM" SG_ 1459 Next_Charge_End_Time_Min 0;
BA_ "GenSigTimeoutTime_DTCM" SG_ 1459 Next_Charge_End_Time_Min 0;
BA_ "GenSigTimeoutTime_DMSM" SG_ 1459 Next_Charge_End_Time_Min 0;
BA_ "GenSigTimeoutTime_BSM" SG_ 1459 Next_Charge_End_Time_Min 0;
BA_ "GenSigTimeoutTime_BCM" SG_ 1459 Next_Charge_End_Time_Min 0;
BA_ "GenSigTimeoutTime_AGSM" SG_ 1459 Next_Charge_End_Time_Min 0;
BA_ "GenSigTimeoutTime_ADCAM" SG_ 1459 Next_Charge_End_Time_Min 0;
VAL_ 1435 VEH_INT_TEMP 65535 "SNA";
VAL_ 1435 DRV_TEMP_DR_POS 127 "SNA";
VAL_ 1459 Next_SchCabin_Temp 31 "SNA";
VAL_ 1464 Submit_Schedule2 0 "No Change" 1 "Change in schedule 2";
VAL_ 1464 Submit_Schedule1 0 "No Change" 1 "Change in schedule 1";
VAL_ 1464 Start_Time_Min2 15 "SNA";
VAL_ 1464 Start_Time_Min1 15 "SNA";
VAL_ 1464 Start_Time_Hr2 31 "SNA";
VAL_ 1464 Start_Time_Hr1 31 "SNA";
VAL_ 1464 Schedule_Day2 0 "No Selection" 1 "M" 2 "T" 3 "TM" 4 "W" 5 "WM" 6 "WT" 7 "WTM" 8 "Th" 9 "ThM" 10 "ThT" 11 "ThTM" 12 "ThW" 13 "ThWM" 14 "ThWT" 15 "ThWTM" 16 "F" 17 "FM" 18 "FT" 19 "FTM" 20 "FW" 21 "FWM" 22 "FWT" 23 "FWTM" 24 "FTh" 25 "FThM" 26 "FThT" 27 "FThTM" 28 "FThW" 29 "FThWM" 30 "FThWT" 31 "FThWTM" 32 "S" 33 "SM" 34 "ST" 35 "STM" 36 "SW" 37 "SWM" 38 "SWT" 39 "SWTM" 40 "STh" 41 "SThM" 42 "SThT" 43 "SThTM" 44 "SThW" 45 "SThWM" 46 "SThWT" 47 "SThWTM" 48 "SF" 49 "SFM" 50 "SFT" 51 "SFTM" 52 "SFW" 53 "SFWM" 54 "SFWT" 55 "SFWTM" 56 "SFTh" 57 "SFThM" 58 "SFThT" 59 "SFThTM" 60 "SFThW" 61 "SFThWM" 62 "SFThWT" 63 "SFThWTM" 64 "Sa" 65 "SaM" 66 "SaT" 67 "SaTM" 68 "SaW" 69 "SaWM" 70 "SaWT" 71 "SaWTM" 72 "SaTh" 73 "SaThM" 74 "SaThT" 75 "SaThTM" 76 "SaThW" 77 "SaThWM" 78 "SaThWT" 79 "SaThWTM" 80 "SaF" 81 "SaFM" 82 "SaFT" 83 "SaFTM" 84 "SaFW" 85 "SaFWM" 86 "SaFWT" 87 "SaFWTM" 88 "SaFTh" 89 "SaFThM" 90 "SaFThT" 91 "SaFThTM" 92 "SaFThW" 93 "SaFThWM" 94 "SaFThWT" 95 "SaFThWTM" 96 "SaS" 97 "SaSM" 98 "SaST" 99 "SaSTM" 100 "SaSW" 101 "SaSWM" 102 "SaSWT" 103 "SaSWTM" 104 "SaSTh" 105 "SaSThM" 106 "SaSThT" 107 "SaSThTM" 108 "SaSThW" 109 "SaSThWM" 110 "SaSThWT" 111 "SaSThWTM" 112 "SaSF" 113 "SaSFM" 114 "SaSFT" 115 "SaSFTM" 116 "SaSFW" 117 "SaSFWM" 118 "SaSFWT" 119 "SaSFWTM" 120 "SaSFTh" 121 "SaSFThM" 122 "SaSFThT" 123 "SaSFThTM" 124 "SaSFThW" 125 "SaSFThWM" 126 "SaSFThWT" 127 "SaSFThWTM" 255 "SNA";
VAL_ 1464 Schedule_Day1 0 "No Selection" 1 "M" 2 "T" 3 "TM" 4 "W" 5 "WM" 6 "WT" 7 "WTM" 8 "Th" 9 "ThM" 10 "ThT" 11 "ThTM" 12 "ThW" 13 "ThWM" 14 "ThWT" 15 "ThWTM" 16 "F" 17 "FM" 18 "FT" 19 "FTM" 20 "FW" 21 "FWM" 22 "FWT" 23 "FWTM" 24 "FTh" 25 "FThM" 26 "FThT" 27 "FThTM" 28 "FThW" 29 "FThWM" 30 "FThWT" 31 "FThWTM" 32 "S" 33 "SM" 34 "ST" 35 "STM" 36 "SW" 37 "SWM" 38 "SWT" 39 "SWTM" 40 "STh" 41 "SThM" 42 "SThT" 43 "SThTM" 44 "SThW" 45 "SThWM" 46 "SThWT" 47 "SThWTM" 48 "SF" 49 "SFM" 50 "SFT" 51 "SFTM" 52 "SFW" 53 "SFWM" 54 "SFWT" 55 "SFWTM" 56 "SFTh" 57 "SFThM" 58 "SFThT" 59 "SFThTM" 60 "SFThW" 61 "SFThWM" 62 "SFThWT" 63 "SFThWTM" 64 "Sa" 65 "SaM" 66 "SaT" 67 "SaTM" 68 "SaW" 69 "SaWM" 70 "SaWT" 71 "SaWTM" 72 "SaTh" 73 "SaThM" 74 "SaThT" 75 "SaThTM" 76 "SaThW" 77 "SaThWM" 78 "SaThWT" 79 "SaThWTM" 80 "SaF" 81 "SaFM" 82 "SaFT" 83 "SaFTM" 84 "SaFW" 85 "SaFWM" 86 "SaFWT" 87 "SaFWTM" 88 "SaFTh" 89 "SaFThM" 90 "SaFThT" 91 "SaFThTM" 92 "SaFThW" 93 "SaFThWM" 94 "SaFThWT" 95 "SaFThWTM" 96 "SaS" 97 "SaSM" 98 "SaST" 99 "SaSTM" 100 "SaSW" 101 "SaSWM" 102 "SaSWT" 103 "SaSWTM" 104 "SaSTh" 105 "SaSThM" 106 "SaSThT" 107 "SaSThTM" 108 "SaSThW" 109 "SaSThWM" 110 "SaSThWT" 111 "SaSThWTM" 112 "SaSF" 113 "SaSFM" 114 "SaSFT" 115 "SaSFTM" 116 "SaSFW" 117 "SaSFWM" 118 "SaSFWT" 119 "SaSFWTM" 120 "SaSFTh" 121 "SaSFThM" 122 "SaSFThT" 123 "SaSFThTM" 124 "SaSFThW" 125 "SaSFThWM" 126 "SaSFThWT" 127 "SaSFThWTM" 255 "SNA";
VAL_ 1464 End_Time_Min2 15 "SNA";
VAL_ 1464 End_Time_Min1 15 "SNA";
VAL_ 1464 End_Time_Hr2 31 "SNA";
VAL_ 1464 End_Time_Hr1 31 "SNA";
VAL_ 1464 Enable_Schedule2 0 "Disable schedule2" 1 "Enable schedule2";
VAL_ 1464 Enable_Schedule1 0 "Disable schedule1" 1 "Enable schedule1";
VAL_ 1464 ChargeUntilFull2 0 "Charge Until Full Not selected" 1 "Charge Until Full";
VAL_ 1464 ChargeUntilFull1 0 "Charge Until Full Not selected" 1 "Charge Until Full";
VAL_ 750 FronWiperFailSts 0 "Wiper system Fault Not Present" 1 "Wiper system Fault Present";
VAL_ 750 Battery_Volt_2 511 "SNA";
VAL_ 750 Battery_Volt_1 511 "SNA";
VAL_ 1436 TrailerStopLightFailSts 0 "No_fault_present" 1 "Fault_present";
VAL_ 1436 TrailerRHTurnSignalFailSts 0 "No_fault_present" 1 "Fault_present";
VAL_ 1436 TrailerRHParkingLightFailSts 0 "No_fault_present" 1 "Fault_present";
VAL_ 1436 TrailerLHTurnSignalFailSts 0 "No_fault_present" 1 "Fault_present";
VAL_ 1436 TrailerLHParkingLightFailSts 0 "No_fault_present" 1 "Fault_present";
VAL_ 1436 TrailerGenericFailSts 0 "No_fault_present" 1 "Fault_present";
VAL_ 1436 TrailerConnectionSts 0 "Not_Connected" 1 "Connected" 2 "Not_Used" 3 "SNA";
VAL_ 1436 PANEL_INTS_DISP 255 "SNA";
VAL_ 1436 MOOD_LGT_INTS 255 "SNA";
VAL_ 1436 MEM_RC_STAT 0 "Memory_Enabled" 1 "Vehicle_Not_In_Park" 2 "Vehicle_In_Motion" 3 "SNA";
VAL_ 1436 Mem_D_Sv_Rq 0 "Not_Pressed" 1 "Pressed";
VAL_ 1436 Mem_D_Rc_Rq 0 "Not_Pressed" 1 "Pressed";
VAL_ 1436 Mem_D_Pos_Rq 0 "Not_Pressed" 1 "MemPos1_Pressed" 2 "MemPos2_Pressed" 3 "SNA";
VAL_ 1436 Internal_Fault 0 "No_Fault" 1 "Comm_Fault";
VAL_ 1436 EBL_Stat 0 "OFF" 1 "ON" 2 "Blink" 3 "SNA";
VAL_ 1436 DAY_LGT_MD_DISP 0 "Night" 1 "Day";
VAL_ 1436 COMM_Fault 0 "No_Fault" 1 "Comm_Fault";
VAL_ 1436 Blower_Speed 511 "SNA";
VAL_ 1436 Blower_Diagnostics 1023 "SNA";
VAL_ 1435 RRTurnLampFault 0 "NOT_SET" 1 "SET";
VAL_ 1435 RLTurnLampFault 0 "NOT_SET" 1 "SET";
VAL_ 1435 RearFogPressed 0 "NOT_SET" 1 "SET";
VAL_ 1435 R_TurnCluster 0 "NOT_SET" 1 "SET";
VAL_ 1435 PAS_TEMP_DR_POS 127 "SNA";
VAL_ 1435 LKA_RequestSts 0 "Not_Pressed" 1 "Pressed";
VAL_ 1435 L_TurnCluster 0 "NOT_SET" 1 "SET";
VAL_ 1435 HVAC_Blwr_Perct 127 "SNA";
VAL_ 1435 HtrCorTmp_InTgt 255 "SNA";
VAL_ 1435 HLSPosition 0 "Off_DRL" 1 "Position Lamps" 2 "Low Beam" 3 "Auto" 4 "Short Circuit" 5 "Open Circuit" 7 "SNA";
VAL_ 1435 HazardSwitchPressed 0 "NOT_SET" 1 "SET";
VAL_ 1435 FRTurnLampFault 0 "NOT_SET" 1 "SET";
VAL_ 1435 FrontFogPressed 0 "NOT_SET" 1 "SET";
VAL_ 1435 FLTurnLampFault 0 "NOT_SET" 1 "SET";
VAL_ 1435 EvapTempTar 255 "SNA";
VAL_ 1435 DEFROST_SEL 0 "Not_Active" 1 "Active";
VAL_ 1069 ReverseLamp 0 "Not_Set" 1 "Set";
VAL_ 1069 HazardCluster 0 "Not_Set" 1 "Set";
VAL_ 1069 FronWasherSts 0 "None" 1 "Wash Request";
VAL_ 1069 AVHSwitchSts 0 "NotPressed" 1 "Pressed" 2 "Fail" 3 "SNA";
VAL_ 1434 NV_Telltale_Stat 0 "OFF" 1 "Suppressed" 2 "Not_Suppressed" 3 "SNA";
VAL_ 1434 NV_ScreenDisp_Info 0 "DISP_0" 1 "DISP_1" 2 "DISP_2" 3 "DISP_3" 4 "DISP_4" 5 "DISP_5" 6 "DISP_6" 7 "DISP_7";
VAL_ 1434 NV_Screen_Reqst 0 "No_Request" 1 "NV_Screen_Req" 2 "Tempory_NV_Screen_Req";
VAL_ 1434 NV_PopupDisp_Info 0 "DISP_0" 1 "DISP_1" 2 "DISP_2" 3 "DISP_3" 4 "DISP_4" 5 "DISP_5" 6 "DISP_6";
VAL_ 1434 NV_Detection_Stat 0 "OFF" 1 "Pedestrian_Level_2" 2 "Animal_Level_2" 3 "Animal_Level_1" 4 "Pedestrian_Level_1";
VAL_ 602 HiBmLvr_Stat 0 "Idle" 1 "HIBM_ON_PSD" 2 "HIBM_FLASH_ON_PSD" 3 "SNA";
VAL_ 602 FR_HS_STATSts 0 "Heated_seat_off" 1 "Heated_seat_low" 2 "Heated_seat_medium" 3 "Heated_seat_high";
VAL_ 602 FR_HS_STATFailSts 0 "Fail_Not_Present" 1 "Fail_Present";
VAL_ 602 FL_HS_STATSts 0 "Heated_seat_off" 1 "Heated_seat_low" 2 "Heated_seat_medium" 3 "Heated_seat_high";
VAL_ 602 FL_HS_STATFailSts 0 "Fail_Not_Present" 1 "Fail_Present";
VAL_ 1327 RR_Lvl 254 "NOT_INIT" 255 "SNA";
VAL_ 1327 RL_Lvl 254 "NOT_INIT" 255 "SNA";
VAL_ 1327 FR_Lvl 254 "NOT_INIT" 255 "SNA";
VAL_ 1327 FL_Lvl 254 "NOT_INIT" 255 "SNA";
VAL_ 1457 Schedule_Day1_Sts 0 "No Selection" 1 "M" 2 "T" 3 "TM" 4 "W" 5 "WM" 6 "WT" 7 "WTM" 8 "Th" 9 "ThM" 10 "ThT" 11 "ThTM" 12 "ThW" 13 "ThWM" 14 "ThWT" 15 "ThWTM" 16 "F" 17 "FM" 18 "FT" 19 "FTM" 20 "FW" 21 "FWM" 22 "FWT" 23 "FWTM" 24 "FTh" 25 "FThM" 26 "FThT" 27 "FThTM" 28 "FThW" 29 "FThWM" 30 "FThWT" 31 "FThWTM" 32 "S" 33 "SM" 34 "ST" 35 "STM" 36 "SW" 37 "SWM" 38 "SWT" 39 "SWTM" 40 "STh" 41 "SThM" 42 "SThT" 43 "SThTM" 44 "SThW" 45 "SThWM" 46 "SThWT" 47 "SThWTM" 48 "SF" 49 "SFM" 50 "SFT" 51 "SFTM" 52 "SFW" 53 "SFWM" 54 "SFWT" 55 "SFWTM" 56 "SFTh" 57 "SFThM" 58 "SFThT" 59 "SFThTM" 60 "SFThW" 61 "SFThWM" 62 "SFThWT" 63 "SFThWTM" 64 "Sa" 65 "SaM" 66 "SaT" 67 "SaTM" 68 "SaW" 69 "SaWM" 70 "SaWT" 71 "SaWTM" 72 "SaTh" 73 "SaThM" 74 "SaThT" 75 "SaThTM" 76 "SaThW" 77 "SaThWM" 78 "SaThWT" 79 "SaThWTM" 80 "SaF" 81 "SaFM" 82 "SaFT" 83 "SaFTM" 84 "SaFW" 85 "SaFWM" 86 "SaFWT" 87 "SaFWTM" 88 "SaFTh" 89 "SaFThM" 90 "SaFThT" 91 "SaFThTM" 92 "SaFThW" 93 "SaFThWM" 94 "SaFThWT" 95 "SaFThWTM" 96 "SaS" 97 "SaSM" 98 "SaST" 99 "SaSTM" 100 "SaSW" 101 "SaSWM" 102 "SaSWT" 103 "SaSWTM" 104 "SaSTh" 105 "SaSThM" 106 "SaSThT" 107 "SaSThTM" 108 "SaSThW" 109 "SaSThWM" 110 "SaSThWT" 111 "SaSThWTM" 112 "SaSF" 113 "SaSFM" 114 "SaSFT" 115 "SaSFTM" 116 "SaSFW" 117 "SaSFWM" 118 "SaSFWT" 119 "SaSFWTM" 120 "SaSFTh" 121 "SaSFThM" 122 "SaSFThT" 123 "SaSFThTM" 124 "SaSFThW" 125 "SaSFThWM" 126 "SaSFThWT" 127 "SaSFThWTM" 255 "SNA";
VAL_ 1436 E_Call_Button 0 "Not_Pressed" 1 "Pressed" 3 "SNA";
VAL_ 1436 U_Call_Button 0 "Not_Pressed" 1 "Pressed" 3 "SNA";
VAL_ 1459 Next_Climate_Time_Min 15 "SNA";
VAL_ 1459 Next_Climate_Time_Hr 31 "SNA";
VAL_ 1459 Next_Climate_Day 0 "No Selection" 1 "M" 2 "T" 3 "W" 4 "Th" 5 "F" 6 "Sa" 7 "S" 9 "No Schedule Set" 15 "SNA";
VAL_ 1459 Next_Charge_StartDay 0 "No Selection" 1 "M" 2 "T" 3 "W" 4 "Th" 5 "F" 6 "Sa" 7 "S" 9 "No Schedule Set" 15 "SNA";
VAL_ 1459 Next_Charge_Start_Time_Min 15 "SNA";
VAL_ 1459 Next_Charge_Start_Time_Hr 31 "SNA";
VAL_ 1459 Next_Charge_EndDay 0 "No Selection" 1 "M" 2 "T" 3 "W" 4 "Th" 5 "F" 6 "Sa" 7 "S" 15 "SNA";
VAL_ 1459 Next_Charge_End_Time_Min 15 "SNA";
VAL_ 1457 Start_Time_Min2_Sts 15 "SNA";
VAL_ 1457 Start_Time_Min1_Sts 15 "SNA";
VAL_ 1457 Start_Time_Hr2_Sts 31 "SNA";
VAL_ 1457 Start_Time_Hr1_Sts 31 "SNA";
VAL_ 1457 Schedule_Day2_Sts 0 "No Selection" 1 "M" 2 "T" 3 "TM" 4 "W" 5 "WM" 6 "WT" 7 "WTM" 8 "Th" 9 "ThM" 10 "ThT" 11 "ThTM" 12 "ThW" 13 "ThWM" 14 "ThWT" 15 "ThWTM" 16 "F" 17 "FM" 18 "FT" 19 "FTM" 20 "FW" 21 "FWM" 22 "FWT" 23 "FWTM" 24 "FTh" 25 "FThM" 26 "FThT" 27 "FThTM" 28 "FThW" 29 "FThWM" 30 "FThWT" 31 "FThWTM" 32 "S" 33 "SM" 34 "ST" 35 "STM" 36 "SW" 37 "SWM" 38 "SWT" 39 "SWTM" 40 "STh" 41 "SThM" 42 "SThT" 43 "SThTM" 44 "SThW" 45 "SThWM" 46 "SThWT" 47 "SThWTM" 48 "SF" 49 "SFM" 50 "SFT" 51 "SFTM" 52 "SFW" 53 "SFWM" 54 "SFWT" 55 "SFWTM" 56 "SFTh" 57 "SFThM" 58 "SFThT" 59 "SFThTM" 60 "SFThW" 61 "SFThWM" 62 "SFThWT" 63 "SFThWTM" 64 "Sa" 65 "SaM" 66 "SaT" 67 "SaTM" 68 "SaW" 69 "SaWM" 70 "SaWT" 71 "SaWTM" 72 "SaTh" 73 "SaThM" 74 "SaThT" 75 "SaThTM" 76 "SaThW" 77 "SaThWM" 78 "SaThWT" 79 "SaThWTM" 80 "SaF" 81 "SaFM" 82 "SaFT" 83 "SaFTM" 84 "SaFW" 85 "SaFWM" 86 "SaFWT" 87 "SaFWTM" 88 "SaFTh" 89 "SaFThM" 90 "SaFThT" 91 "SaFThTM" 92 "SaFThW" 93 "SaFThWM" 94 "SaFThWT" 95 "SaFThWTM" 96 "SaS" 97 "SaSM" 98 "SaST" 99 "SaSTM" 100 "SaSW" 101 "SaSWM" 102 "SaSWT" 103 "SaSWTM" 104 "SaSTh" 105 "SaSThM" 106 "SaSThT" 107 "SaSThTM" 108 "SaSThW" 109 "SaSThWM" 110 "SaSThWT" 111 "SaSThWTM" 112 "SaSF" 113 "SaSFM" 114 "SaSFT" 115 "SaSFTM" 116 "SaSFW" 117 "SaSFWM" 118 "SaSFWT" 119 "SaSFWTM" 120 "SaSFTh" 121 "SaSFThM" 122 "SaSFThT" 123 "SaSFThTM" 124 "SaSFThW" 125 "SaSFThWM" 126 "SaSFThWT" 127 "SaSFThWTM" 255 "SNA";
VAL_ 1457 Schedule_Confirmed2 0 "Disable" 1 "Enable";
VAL_ 1457 Schedule_Confirmed1 0 "Disable" 1 "Enable";
VAL_ 1457 End_Time_Min2_Sts 15 "SNA";
VAL_ 1457 End_Time_Min1_Sts 15 "SNA";
VAL_ 1457 End_Time_Hr2_Sts 31 "SNA";
VAL_ 1457 End_Time_Hr1_Sts 31 "SNA";
VAL_ 1457 ChargeUntilFull2_Sts 0 "Charge Until Full Not selected" 1 "Charge Until Full";
VAL_ 1457 ChargeUntilFull1_Sts 0 "Charge Until Full Not selected" 1 "Charge Until Full";
VAL_ 1436 Comfort_Enable_Time 65535 "SNA";
VAL_ 1435 PssgrScreenOn_Off_RequestSts 0 "Not_Pressed" 1 "Pressed";
VAL_ 1435 HAS_OnOffSts 0 "Not_Pressed" 1 "Pressed";
VAL_ 1435 BSD_FAIL_P 0 "False" 1 "True";
VAL_ 1435 BSD_FAIL_D 0 "False" 1 "True";
VAL_ 603 HVACPSNTemp 0 "Initialization" 1 "Full Cold" 62 "Full Hot" 63 "SNA";
VAL_ 603 HVACDRVTemp 0 "Initialization" 1 "Full Cold" 62 "Full Hot" 63 "SNA";
VAL_ 602 WprSw6Posn 0 "OFF" 1 "INTERVAL1" 2 "INTERVAL2" 3 "INTERVAL3" 4 "INTERVAL4" 5 "INTERVAL5" 6 "INTERVAL6" 13 "WPR_LOW" 14 "WPR_HI" 15 "SNA";
VAL_ 602 TurnLeverLatched 0 "Not Set" 1 "Set";
VAL_ 1436 Comfort_Enable_Act 0 "Not_Active" 1 "Active";
VAL_ 1435 HMI_FrontTrunkRegulatoryRelease 0 "NO_REQUEST" 1 "REQUEST";
VAL_ 1435 Tri_Level_HSW_StatSts 0 "Heated_steering_wheel_off" 1 "Heated_steering_wheel_low" 2 "Heated_steering_wheel_medium" 3 "Heated_steering_wheel_high" 7 "SNA";
VAL_ 1434 HRLS_Ambient_Light_Level 255 "SNA";
VAL_ 1435 HeadlightsDelayModeActive 0 "Not Active" 1 "Active";
VAL_ 1459 Next_Charge_End_Time_Hr 0 "Hour_0" 1 "Hour_1" 2 "Hour_2" 3 "Hour_3" 4 "Hour_4" 5 "Hour_5" 6 "Hour_6" 7 "Hour_7" 8 "Hour_8" 9 "Hour_9" 10 "Hour_10" 11 "Hour_11" 12 "Hour_12" 13 "Hour_13" 14 "Hour_14" 15 "Hour_15" 16 "Hour_16" 17 "Hour_17" 18 "Hour_18" 19 "Hour_19" 20 "Hour_20" 21 "Hour_21" 22 "Hour_22" 23 "Hour_23" 25 "Charge_Until_Full" 31 "SNA";
VAL_ 1436 PLG_Stat 0 "No Issue" 1 "Unlock to Operate" 2 "Put in Park to Operate" 3 "Function Disabled" 4 "Reserved" 5 "Obstacle Detected" 6 "Manually Close to Operate" 7 "Reserved" 8 "Adjustable Height Unavailable " 9 "Rear_Area_Clear_Press_Again" 10 "Hands-free Contaminated" 15 "SNA";
VAL_ 1435 Paddles_DrvMd_CfgSts_TMI 0 "None" 1 "DIS" 2 "EN" 3 "SNA";
VAL_ 1436 WinPos_RearR_Sts 31 "SNA";
VAL_ 1436 WinPos_RearL_Sts 31 "SNA";
VAL_ 1436 WinPos_P_Sts 127 "SNA";
VAL_ 1436 WinPos_D_Sts 127 "SNA";
VAL_ 1436 Turn_Lever_Unlatch_Resp 0 "Latched" 1 "Unlatched_to_Center" 3 "SNA";
VAL_ 1435 AHP_EnblReq 0 "False" 1 "True" 3 "SNA";
VAL_ 1459 Nxt_External_Charge_ImmediateTgt 15 "No_Selection";
VAL_ 1459 Nxt_External_Charge_ExternalTgt 15 "No_Selection";
VAL_ 1459 Nxt_External_Charge_EndDay 0 "No_Selection" 1 "Monday" 2 "Tuesday" 3 "Wednesday" 4 "Thursday" 5 "Friday" 6 "Saturday" 7 "Sunday" 15 "SNA";
VAL_ 1459 Nxt_Ext_Charge_End_Time_Min 15 "SNA";
VAL_ 1459 Nxt_Ext_Charge_End_Time_Hr 31 "SNA";
VAL_ 1459 Nxt_Charge_Schedule_Type 0 "No_Selection" 1 "Standard_Charge" 2 "External_Charge" 3 "Both";
VAL_ 1464 Immediate_ChargeTarget2 15 "No_Selection";
VAL_ 1464 Immediate_ChargeTarget1 15 "No_Selection";
VAL_ 1464 External_ChargeTarget2 15 "No_Selection";
VAL_ 1464 External_ChargeTarget1 15 "No_Selection";
VAL_ 1464 Charge_Schedule_Type2 0 "No_Selection" 1 "Standard_Charge" 2 "External_Charge" 3 "Reserved";
VAL_ 1464 Charge_Schedule_Type1 0 "No_Selection" 1 "Standard_Charge" 2 "External_Charge" 3 "Reserved";
VAL_ 1457 Immediate_ChargeTarget2_Sts 15 "No_Selection";
VAL_ 1457 Immediate_ChargeTarget1_Sts 15 "No_Selection";
VAL_ 1457 External_ChargeTarget2_Sts 15 "No_Selection";
VAL_ 1457 External_ChargeTarget1_Sts 15 "No_Selection";
VAL_ 1457 Charge_Schedule_Type2_Sts 0 "No_Selection" 1 "Standard_Charge" 2 "External_Charge" 3 "Reserved";
VAL_ 1457 Charge_Schedule_Type1_Sts 0 "No_Selection" 1 "Standard_Charge" 2 "External_Charge" 3 "Reserved";
SIG_GROUP_ 1436 BCM_FD_27_Pkt 1 : TrailerStopLightFailSts TrailerRHTurnSignalFailSts TrailerRHParkingLightFailSts TrailerLHTurnSignalFailSts TrailerLHParkingLightFailSts TrailerGenericFailSts TrailerConnectionSts PANEL_INTS_DISP MOOD_LGT_INTS MEM_RC_STAT Mem_D_Sv_Rq Mem_D_Rc_Rq Mem_D_Pos_Rq Internal_Fault EBL_Stat DAY_LGT_MD_DISP COMM_Fault Blower_Speed Blower_Diagnostics U_Call_Button E_Call_Button MessageCounter_BCM27 CRC_BCM27 Comfort_Enable_Time PLG_Stat WinPos_RearR_Sts WinPos_RearL_Sts WinPos_P_Sts WinPos_D_Sts Turn_Lever_Unlatch_Resp Comfort_Enable_Act;
SIG_GROUP_ 1435 BCM_FD_26_Pkt 1 : VEH_INT_TEMP DRV_TEMP_DR_POS RRTurnLampFault RLTurnLampFault RearFogPressed R_TurnCluster PAS_TEMP_DR_POS MessageCounter_BCM26 LKA_RequestSts L_TurnCluster HVAC_Blwr_Perct HtrCorTmp_InTgt HLSPosition HazardSwitchPressed FRTurnLampFault FrontFogPressed FLTurnLampFault EvapTempTar DEFROST_SEL CRC_BCM26 PssgrScreenOn_Off_RequestSts HAS_OnOffSts BSD_FAIL_P BSD_FAIL_D HeadlightsDelayModeActive Paddles_DrvMd_CfgSts_TMI AHP_EnblReq HMI_FrontTrunkRegulatoryRelease Tri_Level_HSW_StatSts;
SIG_GROUP_ 602 BCM_FD_22_Pkt 1 : HiBmLvr_Stat FR_HS_STATSts FR_HS_STATFailSts FL_HS_STATSts FL_HS_STATFailSts WprSw6Posn TurnLeverLatched MessageCounter_BCM22 CRC_BCM22;

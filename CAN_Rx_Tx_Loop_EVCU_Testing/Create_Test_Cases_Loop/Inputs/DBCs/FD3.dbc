VERSION ""

NS_ :

BS_:

BU_: SGW RFHM MPAD IPC GNMM EVCU2 ESL ECM DTCM DMSM BSM BCM AGSM ADCAM

BO_ 274 ORC_FD_3: 32 BCM
 SG_ YawRate : 163|12@0+ (0.08,-163.84) [-163.84|163.68] "deg/s"  MPAD,EVCU2,DTCM
 SG_ LongAcceleration : 131|12@0+ (0.02,-40.96) [-40.96|40.92] "m/s^2"  MPAD,EVCU2,ECM,DTCM
 SG_ LatAcceleration : 147|12@0+ (0.02,-40.96) [-40.96|40.92] "m/s^2"  MPAD,EVCU2,ECM,DTCM
 SG_ YawRateFailSts : 181|1@0+ (1,0) [0|1] "-"  MPAD,EVCU2,DTCM
 SG_ MessageCounter_ORC3 : 179|4@0+ (1,0) [0|15] "-"  MPAD,EVCU2
 SG_ LongAccelerationFailSts : 183|1@0+ (1,0) [0|1] "-"  MPAD,EVCU2,ECM,DTCM
 SG_ LatAccelerationFailSts : 182|1@0+ (1,0) [0|1] "-"  MPAD,EVCU2,ECM,DTCM
 SG_ CRC_ORC3 : 191|8@0+ (1,0) [0|255] "-"  MPAD,EVCU2
 SG_ StbmTimestampSec_ORC : 79|32@0+ (1,0) [0|4294967295] "sec"  MPAD
 SG_ StbmTimestampNSec_ORC : 47|32@0+ (1,0) [0|4294967295] "nsec"  MPAD
 SG_ StbmSyncState_ORC : 31|8@0+ (1,0) [0|255] "No_Unit"  MPAD
 SG_ IMUTemperature : 23|8@0+ (1,-40) [-40|215] "°C"  MPAD

BO_ 1954 ORC_FD_2: 32 BCM
 SG_ MessageCounter_ORC2 : 179|4@0+ (1,0) [0|15] "-"  MPAD,BSM
 SG_ CRC_ORC2 : 191|8@0+ (1,0) [0|255] "-"  MPAD,BSM
 SG_ DrvSbltUnFltr_1 : 119|8@0+ (0.1,0) [0|25.5] "mA"  BSM,ECM
 SG_ SBR1RowPsngrSeatPPDSts : 127|2@0+ (1,0) [0|3] "-"  MPAD,IPC

BO_ 611 ORC_FD_1: 32 BCM
 SG_ SBR1RowPsngrSeatSts : 98|3@0+ (1,0) [0|6] "-"  MPAD,SGW,IPC
 SG_ SBR1RowPsngrSeatConfigSts : 95|1@0+ (1,0) [0|1] "-"  IPC
 SG_ SBR1RowDriverSeatSts : 94|2@0+ (1,0) [0|2] "-"  EVCU2,SGW,IPC
 SG_ SBR1RowDriverSeatConfigSts : 92|1@0+ (1,0) [0|1] "-"  IPC
 SG_ AirBagFailSts : 137|2@0+ (1,0) [0|3] "-"  IPC
 SG_ SBR2RowRightSeatConfigSts : 101|1@0+ (1,0) [0|1] "-"  IPC
 SG_ SBR2RowLeftSeatConfigSts : 100|1@0+ (1,0) [0|1] "-"  IPC
 SG_ SBR2RowCentralSeatConfigSts : 99|1@0+ (1,0) [0|1] "-"  IPC
 SG_ SBR2ndRowRSeatSts : 15|3@0+ (1,0) [0|7] "-"  MPAD,IPC
 SG_ SBR2ndRowLSeatSts : 4|3@0+ (1,0) [0|7] "-"  MPAD,IPC
 SG_ SBR2ndRowCSeatSts : 7|3@0+ (1,0) [0|7] "-"  MPAD,IPC
 SG_ SBR1RowCentralSeatSts : 91|3@0+ (1,0) [0|6] "-"  EVCU2
 SG_ MessageCounter_ORC1 : 179|4@0+ (1,0) [0|15] "-"  MPAD,IPC,EVCU2
 SG_ CRC_ORC1 : 191|8@0+ (1,0) [0|255] "-"  MPAD,IPC,EVCU2

BO_ 1058 OBD_CONTENT_FRAME: 32 ECM
 SG_ LoadOBD : 87|8@0+ (0.3922,0) [0|100] "%"  Vector__XXX
 SG_ InputsGDFail : 94|1@0+ (1,0) [0|1] "-"  Vector__XXX
 SG_ Inp_ICC_Fail : 117|1@0+ (1,0) [0|1] "-"  Vector__XXX
 SG_ IgnCntrTrue : 118|1@0+ (1,0) [0|1] "-"  Vector__XXX
 SG_ GenDenominator : 95|1@0+ (1,0) [0|1] "-"  Vector__XXX
 SG_ EngineOFFTime : 89|10@0+ (1,0) [0|1022] "min"  Vector__XXX
 SG_ CldStrtDenominator : 116|1@0+ (1,0) [0|1] "-"  Vector__XXX
 SG_ CarbWarmUp : 93|1@0+ (1,0) [0|1] "-"  Vector__XXX
 SG_ CARB_PERM : 119|1@0+ (1,0) [0|1] "-"  Vector__XXX
 SG_ OAT_PT_EstV : 60|1@0+ (1,0) [0|0] "-"  EVCU2
 SG_ OAT_PT_Est : 55|8@0+ (1,-64) [-64|191] "°C"  EVCU2
 SG_ EstCatCnvTmp : 47|8@0+ (5,0) [0|1270] "°C"  EVCU2
 SG_ EngIntAirTmpV : 4|1@0+ (1,0) [0|0] "-"  EVCU2
 SG_ EngIntAirTmp : 23|8@0+ (1,-40) [-40|214] "°C"  EVCU2
 SG_ BarPrsAbsV : 92|1@0+ (1,0) [0|0] "-"  EVCU2
 SG_ BarPrsAbs : 39|8@0+ (0.5,0) [0|127.5] "kPa"  EVCU2
 SG_ MessageCounter_OBDCONTENTFRAME : 179|4@0+ (1,0) [0|15] "-"  EVCU2
 SG_ CRC_OBDCONTENTFRAME : 191|8@0+ (1,0) [0|255] "-"  EVCU2

BO_ 1432 IPC_FD_6: 32 IPC
 SG_ TravelingTimeBPlus_Second : 143|6@0+ (1,0) [0|63] "Second"  SGW
 SG_ TravelingTimeBPlus_Minute : 167|6@0+ (1,0) [0|63] "Minute"  SGW
 SG_ TravelingTimeBPlus_Hour : 161|10@0+ (1,0) [0|1023] "Hour"  SGW
 SG_ TravelingTimeAPlus_Second : 111|6@0+ (1,0) [0|63] "Second"  SGW
 SG_ TravelingTimeAPlus_Minute : 127|6@0+ (1,0) [0|63] "Minute"  SGW
 SG_ TravelingTimeAPlus_Hour : 137|10@0+ (1,0) [0|1023] "Hour"  SGW
 SG_ PartialOdometerAPlus : 75|20@0+ (0.1,0) [0|104857.5] "km or mi."  SGW
 SG_ PartialOdometerBPlus : 27|20@0+ (0.1,0) [0|104857.5] "km or mi."  SGW
 SG_ HAS_SoH_IPC : 76|1@0+ (1,0) [0|1] "" MPAD,BCM
 SG_ MessageCounter_IPC6 : 179|4@0+ (1,0) [0|15] "-"  MPAD,BCM
 SG_ CRC_IPC6 : 191|8@0+ (1,0) [0|255] "-"  MPAD,BCM
 SG_ AverageFuelConsumptionBPlus : 121|10@0+ (0.1,0) [0|102.3] "km/l, l/100km, km/kWh, or kWh/100km"  SGW
 SG_ AverageFuelConsumptionAPlus : 105|10@0+ (0.1,0) [0|102.3] "km/l, l/100km, km/kWh, or kWh/100km"  SGW
 SG_ PowerMode_RQ : 4|3@0+ (1,0) [0|6] "" BCM

BO_ 1154 IPC_FD_5: 32 IPC
 SG_ VehSpdDisp : 103|16@0+ (1,0) [0|65534] "-"  MPAD
 SG_ VehSpd_MPH : 93|1@0+ (1,0) [0|1] "" MPAD
 SG_ Est_Range_Disp : 7|8@0+ (1,0) [0|254] "-"  SGW
 SG_ Est_Range_Disp_Long : 119|11@0+ (1,0) [0|2047] "km,mi"  SGW

BO_ 600 IPC_FD_4: 32 IPC
 SG_ OilChgRst : 162|1@0+ (1,0) [0|1] "" ECM
 SG_ AirBagLamp_FailSts : 143|2@0+ (1,0) [0|3] "-"  SGW,BCM
 SG_ IPC_NV_DISP_STAT : 161|1@0+ (1,0) [0|1] "" BCM
 SG_ DisplayedSpeedLimSts : 119|8@0+ (1,0) [0|255] "" EVCU2,SGW,BCM
 SG_ MessageCounter_IPC4 : 179|4@0+ (1,0) [0|15] "" EVCU2
 SG_ CRC_IPC4 : 191|8@0+ (1,0) [0|255] "" EVCU2

BO_ 1831 IPC_FD_3: 32 IPC
 SG_ WINDSHIELD_FLUID_STAT : 109|2@0+ (1,0) [0|3] "" SGW
 SG_ WATER_IN_FUEL_STAT : 105|2@0+ (1,0) [0|3] "" SGW
 SG_ TORQUE_STAT : 143|2@0+ (1,0) [0|3] "" SGW
 SG_ TIRE_PRESSURE_STAT : 95|2@0+ (1,0) [0|3] "" SGW
 SG_ STOP_START_STAT : 103|2@0+ (1,0) [0|3] "" SGW
 SG_ SPEED_CTRL_STAT : 181|2@0+ (1,0) [0|3] "" SGW
 SG_ SERVICE_STAT : 113|2@0+ (1,0) [0|3] "" SGW
 SG_ SERVICE_ACC_STAT : 107|2@0+ (1,0) [0|3] "" SGW
 SG_ SEAT_BELT_STAT : 183|2@0+ (1,0) [0|3] "" SGW
 SG_ POS_LIGHT_STAT : 169|2@0+ (1,0) [0|3] "" SGW
 SG_ PARK_BRAKE_STAT : 149|2@0+ (1,0) [0|3] "" SGW
 SG_ OVER_TEMP_STAT : 89|2@0+ (1,0) [0|3] "" SGW
 SG_ OIL_TEMP_STAT : 117|2@0+ (1,0) [0|3] "" SGW
 SG_ OIL_PRESSURE_STAT : 87|2@0+ (1,0) [0|3] "" SGW
 SG_ OIL_LEVEL_STAT : 127|2@0+ (1,0) [0|3] "" SGW
 SG_ NAT_GAS_STAT : 173|2@0+ (1,0) [0|3] "" SGW
 SG_ LT_EXH_STAT : 175|2@0+ (1,0) [0|3] "" SGW
 SG_ LIFT_GATE_STAT : 161|2@0+ (1,0) [0|3] "" SGW
 SG_ LANE_SENSE_STAT : 135|2@0+ (1,0) [0|3] "" SGW
 SG_ LANE_DEPART_STAT : 165|2@0+ (1,0) [0|3] "" SGW
 SG_ LANE_DEPART_FAIL_STAT : 163|2@0+ (1,0) [0|3] "" SGW
 SG_ HVY_EXH_STAT : 155|2@0+ (1,0) [0|3] "" SGW
 SG_ HILL_DESCENT_STAT : 167|2@0+ (1,0) [0|3] "" SGW
 SG_ HI_BEAM_STAT : 153|2@0+ (1,0) [0|3] "" SGW
 SG_ HDLT_LVL_STAT : 157|2@0+ (1,0) [0|3] "" SGW
 SG_ FUEL_CUT_OFF_STAT : 159|2@0+ (1,0) [0|3] "" SGW
 SG_ FUEL_CAP_STAT : 97|2@0+ (1,0) [0|3] "" SGW
 SG_ FT_FOG_STAT : 145|2@0+ (1,0) [0|3] "" SGW
 SG_ FOUR_WD_SERVICE_STAT : 121|2@0+ (1,0) [0|3] "" SGW
 SG_ FCW_SYSTEM_STAT : 111|2@0+ (1,0) [0|3] "" SGW
 SG_ EXH_BRK_STAT : 171|2@0+ (1,0) [0|3] "" SGW
 SG_ ETC_CONTROL_STAT : 93|2@0+ (1,0) [0|3] "" SGW
 SG_ ESC_OFF_STAT : 147|2@0+ (1,0) [0|3] "" SGW
 SG_ EPS_STAT : 101|2@0+ (1,0) [0|3] "" SGW
 SG_ EPB_WARN_STAT : 131|2@0+ (1,0) [0|3] "" SGW
 SG_ ENGINE_TEMP_STAT : 75|2@0+ (1,0) [0|3] "" SGW
 SG_ ENGINE_MIL_STAT : 81|2@0+ (1,0) [0|3] "" SGW
 SG_ ELECTRIC_WRENCH_STAT : 129|2@0+ (1,0) [0|3] "" SGW
 SG_ ELEC_STAB_STAT : 91|2@0+ (1,0) [0|3] "" SGW
 SG_ DOORS_STAT : 151|2@0+ (1,0) [0|3] "" SGW
 SG_ DEF_STAT : 119|2@0+ (1,0) [0|3] "" SGW
 SG_ DAMPING_SYSTEM_STAT : 125|2@0+ (1,0) [0|3] "" SGW
 SG_ CRUISE_SET_STAT : 139|2@0+ (1,0) [0|3] "" SGW
 SG_ COOLENT_LEVEL_STAT : 115|2@0+ (1,0) [0|3] "" SGW
 SG_ CATALYST_TEMP_STAT : 99|2@0+ (1,0) [0|3] "" SGW
 SG_ CARGO_LT_STAT : 137|2@0+ (1,0) [0|3] "" SGW
 SG_ BRK_IND_STAT : 85|2@0+ (1,0) [0|3] "" SGW
 SG_ BRAKE_PAD_STAT : 123|2@0+ (1,0) [0|3] "" SGW
 SG_ BATTERY_CHARGE_STAT : 73|2@0+ (1,0) [0|3] "" SGW
 SG_ AWD_SERVICE_STAT : 133|2@0+ (1,0) [0|3] "" SGW
 SG_ AWD_IND_STAT : 141|2@0+ (1,0) [0|3] "" SGW
 SG_ ABS_IND_STAT : 83|2@0+ (1,0) [0|3] "" SGW
 SG_ TRK_OPN_STAT : 1|2@0+ (1,0) [0|3] "" SGW
 SG_ TOW_HAUL_STAT : 3|2@0+ (1,0) [0|3] "" SGW
 SG_ THEFT_ALARM_STAT : 15|2@0+ (1,0) [0|3] "" SGW
 SG_ STR_DIR_LT_STAT : 5|2@0+ (1,0) [0|3] "" SGW
 SG_ SPEED_LMT_STAT : 7|2@0+ (1,0) [0|3] "" SGW
 SG_ ECO_MODE_STAT : 13|2@0+ (1,0) [0|3] "" SGW
 SG_ AIR_BAG_STAT : 11|2@0+ (1,0) [0|3] "" SGW
 SG_ ACC_WARN_STAT : 9|2@0+ (1,0) [0|3] "" SGW

BO_ 1441 IPC_FD_10: 32 IPC
 SG_ DTE_Ave_Fuel_Econ : 161|10@0+ (0.05,0) [0|50] "kmpl"  Vector__XXX

BO_ 1829 IPC_FD_1: 32 IPC
 SG_ TotalOdometer : 75|20@0+ (1,0) [0|1048575] "km"  ADCAM,MPAD,EVCU2,DMSM,GNMM,SGW,AGSM,ESL,BCM,BSM,RFHM,ECM,DTCM
 SG_ InstantaneousFuelConsumption3 : 166|4@0+ (1,0) [0|15] "-"  SGW
 SG_ InstantaneousFuelConsumption2 : 150|4@0+ (1,0) [0|15] "-"  SGW
 SG_ InstantaneousFuelConsumption1 : 134|4@0+ (1,0) [0|15] "-"  SGW
 SG_ MessageCounter_IPC1 : 179|4@0+ (1,0) [0|15] "-"  ADCAM,MPAD,DMSM,BCM,BSM,ECM
 SG_ CRC_IPC1 : 191|8@0+ (1,0) [0|255] "-"  ADCAM,MPAD,DMSM,BCM,BSM,ECM

BO_ 1626 IMPACT_INFO: 32 BCM
 SG_ IMPACTConfirm : 81|1@0+ (1,0) [0|1] "-"  EVCU2,DMSM,ECM
 SG_ IMPACTCommand : 80|1@0+ (1,0) [0|1] "-"  EVCU2,DMSM,ECM
 SG_ IMPACTThreshold : 103|1@0+ (1,0) [0|1] "-"  ECM
 SG_ MessageCounter_IMPACTINFO : 179|4@0+ (1,0) [0|15] "-"  DMSM,EVCU2
 SG_ CRC_IMPACTINFO : 191|8@0+ (1,0) [0|255] "-"  DMSM,EVCU2

BO_ 104 IMMO_CODE_RESPONSE: 32 BCM
 SG_ MKKey2org22 : 103|8@0+ (1,0) [0|255] "-"  EVCU2
 SG_ MKKey1org21 : 95|8@0+ (1,0) [0|255] "-"  EVCU2
 SG_ MKKey_6 : 135|8@0+ (1,0) [0|255] "-"  EVCU2
 SG_ MKKey_5 : 127|8@0+ (1,0) [0|255] "-"  EVCU2
 SG_ MKKey_4 : 119|8@0+ (1,0) [0|255] "-"  EVCU2
 SG_ MKKey_3 : 111|8@0+ (1,0) [0|255] "-"  EVCU2
 SG_ ControlEncodingRsp : 87|8@0+ (1,0) [0|255] "-"  EVCU2
 SG_ ImmoParkReq : 7|1@0+ (1,0) [0|1] "-"  EVCU2

BO_ 100 IMMO_CODE_REQUEST: 32 EVCU2
 SG_ rnd_4 : 135|8@0+ (1,0) [0|255] "-"  BCM
 SG_ rnd_3 : 127|8@0+ (1,0) [0|255] "-"  BCM
 SG_ rnd_2 : 119|8@0+ (1,0) [0|255] "-"  BCM
 SG_ rnd_1 : 111|8@0+ (1,0) [0|255] "-"  BCM
 SG_ f1_2 : 103|8@0+ (1,0) [0|255] "-"  BCM
 SG_ f1_1 : 95|8@0+ (1,0) [0|255] "-"  BCM
 SG_ ControlEncodingReq : 87|8@0+ (1,0) [0|255] "-"  BCM

BO_ 1955 IBS3_DATA_2: 32 BCM
 SG_ IBS3_Tm_Lst_Reset_Sec : 127|16@0+ (2,0) [0|86398] "sec"  EVCU2
 SG_ IBS3_Tm_Lst_Reset_Days : 139|12@0+ (1,0) [0|4094] "Days"  EVCU2
 SG_ IBS3_T_BATT : 95|8@0+ (1,-40) [-40|105] "°C"  EVCU2,SGW,ECM
 SG_ IBS3_SOH_Q : 110|7@0+ (2,0) [0|252] "Ah"  EVCU2,ECM
 SG_ IBS3_SOF_Q : 103|8@0+ (1,0) [0|254] "Ah"  EVCU2
 SG_ IBS3_SOC : 86|7@0+ (1,0) [0|100] "%"  ADCAM,MPAD,EVCU2,SGW,ECM
 SG_ IBS3_Q_received : 159|16@0+ (0.125,0) [0|8191.75] "Ah"  EVCU2
 SG_ IBS3_Q_released : 31|16@0+ (0.125,0) [0|8191.75] "Ah"  EVCU2
 SG_ IBS3_R_Batt_25 : 79|8@0+ (0.1,0) [0|25.4] "mOhm"  EVCU2
 SG_ IBS3_R_Batt : 63|8@0+ (0.1,0) [0|25.4] "mOhm"  EVCU2
 SG_ IBS3_SOH_SUL : 54|7@0+ (1,0) [0|100] "%"  EVCU2
 SG_ IBS3_SOH_COR : 46|7@0+ (1,0) [0|100] "%"  EVCU2
 SG_ IBS3_MC_IBS_2 : 23|4@0+ (1,0) [0|15] "" MPAD
 SG_ IBS3_MC_IBS_1 : 7|4@0+ (1,0) [0|15] "" MPAD
 SG_ IBS3_IBS_ADAS_OK_2 : 19|2@0+ (1,0) [0|2] "" MPAD
 SG_ IBS3_IBS_ADAS_OK : 3|2@0+ (1,0) [0|2] "" MPAD
 SG_ IBS3_FLAG_DISCONNECT_ADAS_2 : 17|2@0+ (1,0) [0|2] "" MPAD
 SG_ IBS3_FLAG_DISCONNECT_ADAS : 1|2@0+ (1,0) [0|2] "" MPAD
 SG_ IBS3_CRC_IBS_2 : 71|8@0+ (1,0) [0|254] "" MPAD
 SG_ IBS3_CRC_IBS_1 : 15|8@0+ (1,0) [0|254] "" MPAD
 SG_ IBS3_TempFailStatus : 111|1@0+ (1,0) [0|1] "" EVCU2,SGW,ECM
 SG_ IBS3_SOH_SUL_Accuracy : 55|1@0+ (1,0) [0|1] "" EVCU2
 SG_ IBS3_SOH_Q_Accuracy : 119|1@0+ (1,0) [0|1] "" EVCU2,ECM
 SG_ IBS3_SOH_COR_Accuracy : 47|1@0+ (1,0) [0|1] "" EVCU2
 SG_ IBS3_SOF_Q_Accuracy : 118|1@0+ (1,0) [0|1] "" EVCU2
 SG_ IBS3_SOC_Accuracy : 87|1@0+ (1,0) [0|1] "" EVCU2,SGW
 SG_ IBS3_FLAG_DISCONNECT : 117|1@0+ (1,0) [0|1] "" EVCU2,ECM
 SG_ MessageCounter_IBS3DATA2 : 179|4@0+ (1,0) [0|15] ""  MPAD,EVCU2
 SG_ CRC_IBS3DATA2 : 191|8@0+ (1,0) [0|255] ""  MPAD,EVCU2

BO_ 248 ESL_CODE_RESPONSE: 32 ESL
 SG_ ProgrammedSts_ESL : 99|1@0+ (1,0) [0|1] "-"  Vector__XXX
 SG_ MiniCryptGCode_ESL_Rsp : 87|16@0+ (1,0) [0|65535] "-"  BCM
 SG_ ESLUnlockFailSts : 96|1@0+ (1,0) [0|1] "-"  BCM
 SG_ ESLLockFailSts : 100|1@0+ (1,0) [0|1] "-"  BCM
 SG_ ESLFeedbackCmd : 103|3@0+ (1,0) [0|7] "-"  BCM
 SG_ ControlEncoding_ESL_Rsp : 111|8@0+ (1,0) [0|255] "-"  BCM
 SG_ CodeCheckSts_ESL : 98|2@0+ (1,0) [0|3] "-"  BCM

CM_ SG_ 274 IMUTemperature "Temperature of Yaw Rate IMU sensor";
CM_ SG_ 274 CRC_ORC3 "CRC according to SAE J1850 standard at each frame transmission.";
CM_ SG_ 274 LatAcceleration "This signal indicates the Lateral Acceleration Value";
CM_ SG_ 274 LatAccelerationFailSts "This signal indicates the status of Lateral Acceleration Signal";
CM_ SG_ 274 LongAcceleration "This signal indicates the Longitudinal Acceleration Value";
CM_ SG_ 274 StbmTimestampSec_ORC "Timestamp in nanoseconds from the ORC Stbm,  [0 - 4294967294].";
CM_ SG_ 274 LongAccelerationFailSts "This signal indicates the status of Longitudinal acceleration signal";
CM_ SG_ 274 MessageCounter_ORC3 "This signal is a counter used for safety checks strategies. This counter is incremented of 1 (one) unit at each frame transmission.";
CM_ SG_ 274 StbmSyncState_ORC "Sync status of the ORC Stbm";
CM_ SG_ 274 StbmTimestampNSec_ORC "Timestamp in nanoseconds from the ORC Stbm, [0 - 999999999].";
CM_ SG_ 274 YawRateFailSts "This signal indicates the Status of Yaw Rate Signal";
CM_ SG_ 274 YawRate "This signal indicates the Yaw Rate Value";
CM_ SG_ 1954 CRC_ORC2 "CRC according to SAE J1850 standard at each frame transmission.";
CM_ SG_ 1954 DrvSbltUnFltr_1 "Driver seatbelt fault status - unfiltered";
CM_ SG_ 1954 MessageCounter_ORC2 "This signal is a counter used for safety checks strategies. This counter is incremented of 1 (one) unit at each frame transmission.";
CM_ SG_ 1954 SBR1RowPsngrSeatPPDSts "Passenger Occupant Detection Sensor Status";
CM_ SG_ 611 SBR1RowPsngrSeatSts "First row passenger seat status";
CM_ SG_ 611 SBR2ndRowCSeatSts "Second row central seatbelt reminder status";
CM_ SG_ 611 SBR2ndRowLSeatSts "Second row left seatbelt reminder status";
CM_ SG_ 611 SBR2ndRowRSeatSts "Second row right seatbelt reminder status";
CM_ SG_ 611 SBR2RowCentralSeatConfigSts "Signal used to show if the second row central seatbelt is under check";
CM_ SG_ 611 SBR2RowLeftSeatConfigSts "Signal used to show if the second row central seatbelt is under check";
CM_ SG_ 611 SBR2RowRightSeatConfigSts "Signal used to show if the second row central seatbelt is under check";
CM_ SG_ 611 SBR1RowDriverSeatSts "First row driver seatbelt switch status";
CM_ SG_ 611 SBR1RowPsngrSeatConfigSts "Signal used to show if the first row passenger seatbelt is under check";
CM_ SG_ 611 MessageCounter_ORC1 "This signal is a counter used for safety checks strategies. This counter is incremented of 1 (one) unit at each frame transmission.";
CM_ SG_ 611 SBR1RowCentralSeatSts "First row central seat status";
CM_ SG_ 611 SBR1RowDriverSeatConfigSts "Signal used to show if the first row driver seatbelt is under check";
CM_ SG_ 611 AirBagFailSts "This signal is used to require the activation/deactivation of airbag warning light";
CM_ SG_ 611 CRC_ORC1 "CRC according to SAE J1850 standard at each frame transmission.";
CM_ SG_ 1058 LoadOBD "Engine calculated load value in percentage of load.";
CM_ SG_ 1058 MessageCounter_OBDCONTENTFRAME "This signal is a counter used for safety checks strategies. This counter is incremented of 1 (one) unit at each frame transmission.";
CM_ SG_ 1058 OAT_PT_Est "Outside air temperature powertrain estimated";
CM_ SG_ 1058 OAT_PT_EstV "Outside air temperature powertrain estimated validity; Invalid = [1]";
CM_ SG_ 1058 EngineOFFTime "The number of minutes the engine was off.";
CM_ SG_ 1058 EngIntAirTmp "Engine Intake Air Temperature";
CM_ SG_ 1058 EngIntAirTmpV "Engine Intake Air Temperature Validity; Invalid = [1]";
CM_ SG_ 1058 EstCatCnvTmp "Estimated catalytic converter temperature";
CM_ SG_ 1058 GenDenominator "General denominator conditions are met.  The engine controller will set this bit when the conditions for setting the General Denominator are met for rate based diagnostics.";
CM_ SG_ 1058 IgnCntrTrue "Ignition cycle counter is true [1]";
CM_ SG_ 1058 Inp_ICC_Fail "Inputs to the Ign Cycle Cntr are in a Pend or MIL cond.";
CM_ SG_ 1058 InputsGDFail "General Denominator Requirements Achieved Validity. The engine controller sets this bit when any of the inputs to the General Denominator are in a pending or MIL fault.";
CM_ SG_ 1058 BarPrsAbs "Barometric pressure absolute";
CM_ SG_ 1058 BarPrsAbsV "Barometric Pressure Absolute Validity; Invalid = [1]";
CM_ SG_ 1058 CARB_PERM "Fault code for diagnostics.";
CM_ SG_ 1058 CarbWarmUp "CARB warmup criteria true.  The engine controller will set this bit when the engine coolant temp achieves the CARB warm-up criteria.";
CM_ SG_ 1058 CldStrtDenominator "Cold start denominator conditions are met [1]";
CM_ SG_ 1058 CRC_OBDCONTENTFRAME "CRC according to SAE J1850 standard at each frame transmission.";
CM_ SG_ 1432 AverageFuelConsumptionAPlus "Used to give information about the average fuel consumption for Trip A.";
CM_ SG_ 1432 AverageFuelConsumptionBPlus "Used to give information about the average fuel consumption for Trip B.";
CM_ SG_ 1432 CRC_IPC6 "CRC according to SAE J1850 standard at each frame transmission.";
CM_ SG_ 1432 HAS_SoH_IPC "HAS SoH IPC";
CM_ SG_ 1432 MessageCounter_IPC6 "This signal is a counter used for safety checks strategies. This counter is incremented of 1 (one) unit at each frame transmission.";
CM_ SG_ 1432 PartialOdometerAPlus "Used to give information about the partial odometer for Trip A";
CM_ SG_ 1432 PartialOdometerBPlus "Used to give information about the partial odometer for Trip B.";
CM_ SG_ 1432 PowerMode_RQ "Power Mode Request";
CM_ SG_ 1432 TravelingTimeAPlus_Hour "Used to give information about hours of travel time for Trip A.";
CM_ SG_ 1432 TravelingTimeAPlus_Minute "Used to give information about minutes of travel time for Trip A.";
CM_ SG_ 1432 TravelingTimeAPlus_Second "Used to give information about seconds of travel time for Trip A";
CM_ SG_ 1432 TravelingTimeBPlus_Hour "Used to give information about hours of travel time for Trip B.";
CM_ SG_ 1432 TravelingTimeBPlus_Minute "Used to give information about minutes of travel time for Trip B.";
CM_ SG_ 1432 TravelingTimeBPlus_Second "Used to give information about seconds of travel time for Trip B";
CM_ SG_ 1154 Est_Range_Disp "Estimated electric range for display";
CM_ SG_ 1154 Est_Range_Disp_Long "Estimate vehicle range";
CM_ SG_ 1154 VehSpd_MPH "Vehicle speed signal is in miles per hour format";
CM_ SG_ 1154 VehSpdDisp "Vehicle speed - displayed";
CM_ SG_ 600 AirBagLamp_FailSts "This signal is used to inform about the airbag warning light status";
CM_ SG_ 600 DisplayedSpeedLimSts "This signal indicates the road sign of vehicle speed limit displayed by IPC";
CM_ SG_ 600 IPC_NV_DISP_STAT "Night Vision display status on the cluster screen";
CM_ SG_ 600 OilChgRst "This signal sends the reset command via the EVIC.";
CM_ SG_ 600 CRC_IPC4 "CRC according to SAE J1850 standard at each frame transmission.";
CM_ SG_ 600 MessageCounter_IPC4 "This signal is a counter used for safety checks strategies. This counter is incremented of 1 (one) unit at each frame transmission.";
CM_ SG_ 1831 TOW_HAUL_STAT "Tow/Haul";
CM_ SG_ 1831 TRK_OPN_STAT "Trunk Open";
CM_ SG_ 1831 WATER_IN_FUEL_STAT "Water In Fuel";
CM_ SG_ 1831 WINDSHIELD_FLUID_STAT "Windshield Water Fluid";
CM_ SG_ 1831 TORQUE_STAT "Torque Limited";
CM_ SG_ 1831 TIRE_PRESSURE_STAT "Tire pressure Monitoring";
CM_ SG_ 1831 THEFT_ALARM_STAT "Vehicle Theft Alarm";
CM_ SG_ 1831 STR_DIR_LT_STAT "Steering Directed Head Lights";
CM_ SG_ 1831 STOP_START_STAT "Stop/Start Service";
CM_ SG_ 1831 SPEED_LMT_STAT "Speed Limiter Indicator";
CM_ SG_ 1831 SPEED_CTRL_STAT "SelectSpeedControlLamp";
CM_ SG_ 1831 SERVICE_STAT "Service";
CM_ SG_ 1831 SERVICE_ACC_STAT "Service ACC System";
CM_ SG_ 1831 SEAT_BELT_STAT "Seat Belt";
CM_ SG_ 1831 POS_LIGHT_STAT "Position Lights";
CM_ SG_ 1831 PARK_BRAKE_STAT "Electronic Park Brake";
CM_ SG_ 1831 OVER_TEMP_STAT "Transmission Over Temperature";
CM_ SG_ 1831 OIL_TEMP_STAT "OilTemperature";
CM_ SG_ 1831 OIL_PRESSURE_STAT "Oil Pressure";
CM_ SG_ 1831 OIL_LEVEL_STAT "Oil Level";
CM_ SG_ 1831 NAT_GAS_STAT "Low Compressed Natural Gas";
CM_ SG_ 1831 LT_EXH_STAT "Light Exhaust Brake Mode";
CM_ SG_ 1831 LIFT_GATE_STAT "Lift Gate Open";
CM_ SG_ 1831 LANE_SENSE_STAT "Lane Sense Failure";
CM_ SG_ 1831 LANE_DEPART_STAT "Lane Departure";
CM_ SG_ 1831 LANE_DEPART_FAIL_STAT "Lane Departure Failure";
CM_ SG_ 1831 HVY_EXH_STAT "Heavy Exhaust Brake mode";
CM_ SG_ 1831 HILL_DESCENT_STAT "Hill Descent Control";
CM_ SG_ 1831 HI_BEAM_STAT "High Beam";
CM_ SG_ 1831 HDLT_LVL_STAT "Headlight Levelling";
CM_ SG_ 1831 FUEL_CUT_OFF_STAT "Fuel  Cut Off";
CM_ SG_ 1831 FUEL_CAP_STAT "Fuel Cap Unfastened";
CM_ SG_ 1831 FT_FOG_STAT "Front Fog Lamps";
CM_ SG_ 1831 FOUR_WD_SERVICE_STAT "Service 4WD";
CM_ SG_ 1831 FCW_SYSTEM_STAT "Service FCW System";
CM_ SG_ 1831 EXH_BRK_STAT "Medium Exhaust Brake Mode";
CM_ SG_ 1831 ETC_CONTROL_STAT "ETC(Electronic Throttle Control)";
CM_ SG_ 1831 ESC_OFF_STAT "Electronic Stability Control off";
CM_ SG_ 1831 EPS_STAT "EPS Fail";
CM_ SG_ 1831 EPB_WARN_STAT "EPB Warning";
CM_ SG_ 1831 ENGINE_TEMP_STAT "Engine Temperature";
CM_ SG_ 1831 ENGINE_MIL_STAT "Check Engine / MIL";
CM_ SG_ 1831 ELECTRIC_WRENCH_STAT "Electric Wrench";
CM_ SG_ 1831 ELEC_STAB_STAT "Electronic Stability Control";
CM_ SG_ 1831 ECO_MODE_STAT "Eco Mode";
CM_ SG_ 1831 DOORS_STAT "Door(s) Open";
CM_ SG_ 1831 DEF_STAT "LowDieselExhaustFuel";
CM_ SG_ 1831 DAMPING_SYSTEM_STAT "Damping System Failure";
CM_ SG_ 1831 CRUISE_SET_STAT "Cruise Set";
CM_ SG_ 1831 COOLENT_LEVEL_STAT "Low Coolent Level";
CM_ SG_ 1831 CATALYST_TEMP_STAT "Catalyst Overtemp";
CM_ SG_ 1831 CARGO_LT_STAT "Cargo Light";
CM_ SG_ 1831 BRK_IND_STAT "Parking Brake and Low Brake Fluid";
CM_ SG_ 1831 BRAKE_PAD_STAT "Brake Pad Failure";
CM_ SG_ 1831 BATTERY_CHARGE_STAT "Battery Charge";
CM_ SG_ 1831 AWD_SERVICE_STAT "Service AWD";
CM_ SG_ 1831 AWD_IND_STAT "4WD Low Indicator";
CM_ SG_ 1831 AIR_BAG_STAT "Air Bag";
CM_ SG_ 1831 ACC_WARN_STAT "ACC Ready";
CM_ SG_ 1831 ABS_IND_STAT "Anti-lock Brake System";
CM_ SG_ 1441 DTE_Ave_Fuel_Econ "Signal for giving average fuel economy used for calculating the distance to empty";
CM_ SG_ 1829 MessageCounter_IPC1 "This signal is a counter used for safety checks strategies. This counter is incremented of 1 (one) unit at each frame transmission.";
CM_ SG_ 1829 InstantaneousFuelConsumption3 "Used to give information about the tenths of the instantaneous fuel consumption value.";
CM_ SG_ 1829 TotalOdometer "Used to give information about the total odometer value in km.";
CM_ SG_ 1829 InstantaneousFuelConsumption2 "Used to give information about the units of the instantaneous fuel consumption value.";
CM_ SG_ 1829 CRC_IPC1 "CRC according to SAE J1850 standard at each frame transmission.";
CM_ SG_ 1829 InstantaneousFuelConsumption1 "Used to give information about the tens of the instantaneous fuel consumption value.";
CM_ SG_ 1626 IMPACTThreshold "Upon a crash, the ORC Calibration Threshold was either \"Met\" or \"Not_Met\".";
CM_ SG_ 1626 IMPACTCommand "This signal is used to indicate that a crash happened";
CM_ SG_ 1626 CRC_IMPACTINFO "CRC according to SAE J1850 standard at each frame transmission.";
CM_ SG_ 1626 MessageCounter_IMPACTINFO "This signal is a counter used for safety checks strategies. This counter is incremented of 1 (one) unit at each frame transmission.";
CM_ SG_ 1626 IMPACTConfirm "This signal is used to confirm that a crash happened";
CM_ SG_ 104 MKKey2org22 "This signal is used for IMMO communication";
CM_ SG_ 104 MKKey1org21 "This signal is used for IMMO communication";
CM_ SG_ 104 MKKey_6 "This signal is used for IMMO communication";
CM_ SG_ 104 MKKey_5 "This signal is used for IMMO communication";
CM_ SG_ 104 MKKey_4 "This signal is used for IMMO communication";
CM_ SG_ 104 MKKey_3 "This signal is used for IMMO communication";
CM_ SG_ 104 ImmoParkReq "Parl lock request for immo code";
CM_ SG_ 104 ControlEncodingRsp "This signal is used for IMMO communication";
CM_ SG_ 100 rnd_4 "This signal is used for IMMO communication";
CM_ SG_ 100 rnd_3 "This signal is used for IMMO communication";
CM_ SG_ 100 rnd_1 "This signal is used for IMMO communication";
CM_ SG_ 100 rnd_2 "This signal is used for IMMO communication";
CM_ SG_ 100 f1_2 "This signal is used for IMMO communication";
CM_ SG_ 100 f1_1 "This signal is used for IMMO communication";
CM_ SG_ 100 ControlEncodingReq "This signal is used for IMMO communication";
CM_ SG_ 1955 MessageCounter_IBS3DATA2 "This signal is a counter used for safety checks strategies. This counter is incremented of 1 (one) unit at each frame transmission.";
CM_ SG_ 1955 IBS3_Tm_Lst_Reset_Sec "Accumulated time since last reset in seconds";
CM_ SG_ 1955 IBS3_Tm_Lst_Reset_Days "Accumulated time since last reset in days";
CM_ SG_ 1955 IBS3_TempFailStatus "Failure of ASIC Temperature meas. (internal defect)";
CM_ SG_ 1955 IBS3_T_BATT "Battery temperature";
CM_ SG_ 1955 IBS3_SOH_SUL_Accuracy "SOH_SUL accuracy status ( Inaccurate = 0 / Accurate = 1)";
CM_ SG_ 1955 IBS3_SOH_SUL "Maximum SOC available due to the fact that the battery could be sulphated";
CM_ SG_ 1955 IBS3_SOH_Q_Accuracy "SOH_Q accuracy status";
CM_ SG_ 1955 IBS3_SOH_Q "State of health related to capacity (energy)";
CM_ SG_ 1955 IBS3_SOH_COR_Accuracy "SOH_COR accuracy status ( Inaccurate = 0 / Accurate = 1)";
CM_ SG_ 1955 IBS3_SOH_COR "Ageing related to voltage drop predicted for -18°C cold crank due to corrosion";
CM_ SG_ 1955 IBS3_SOF_Q_Accuracy "SOF_Q accuracy status";
CM_ SG_ 1955 IBS3_SOF_Q "Residual battery charge in Ah";
CM_ SG_ 1955 IBS3_SOC_Accuracy "SOC accuracy status";
CM_ SG_ 1955 IBS3_R_Batt_25 "Batt resistance at 100% SOC and 25 degC";
CM_ SG_ 1955 IBS3_R_Batt "Calculated battery resistance";
CM_ SG_ 1955 IBS3_Q_released "Lifetime charge released";
CM_ SG_ 1955 IBS3_Q_received "LifeTime charge received";
CM_ SG_ 1955 IBS3_MC_IBS_2 "Message Counter";
CM_ SG_ 1955 IBS3_MC_IBS_1 "Message Counter";
CM_ SG_ 1955 IBS3_IBS_ADAS_OK_2 "IBS indicates that battery is able to support ADAS operation";
CM_ SG_ 1955 IBS3_IBS_ADAS_OK "IBS indicates that battery is able to support ADAS operation";
CM_ SG_ 1955 IBS3_FLAG_DISCONNECT_ADAS_2 "IBS indicates that the reason for unknown values is a recent battery disconnection";
CM_ SG_ 1955 IBS3_FLAG_DISCONNECT_ADAS "IBS indicates that the reason for unknown values is a recent battery disconnection";
CM_ SG_ 1955 IBS3_FLAG_DISCONNECT "Battery disconnection flag";
CM_ SG_ 1955 IBS3_CRC_IBS_2 "CRC";
CM_ SG_ 1955 IBS3_CRC_IBS_1 "CRC";
CM_ SG_ 1955 CRC_IBS3DATA2 "CRC according to SAE J1850 standard at each frame transmission.";
CM_ SG_ 1955 IBS3_SOC "State of charge";
CM_ SG_ 248 CodeCheckSts_ESL "This signal is used to indicate the result of the code check.";
CM_ SG_ 248 ESLFeedbackCmd "This signal is used to give a feedback about ESL activation command.";
CM_ SG_ 248 ESLLockFailSts "This signal is used to give information about a failure of the ESL during a lock procedure.";
CM_ SG_ 248 ESLUnlockFailSts "This signal is used to give information about a failure of the ESL during an unlock procedure.";
CM_ SG_ 248 MiniCryptGCode_ESL_Rsp "-";
CM_ SG_ 248 ProgrammedSts_ESL "This signal  is used to indicate if the ESL is programmed.";
BA_DEF_ BO_ "CANFD_BRS" ENUM "0","1";
BA_DEF_ BO_ "VFrameFormat" ENUM "StandardCAN","ExtendedCAN","reserved","reserved","reserved","reserved","reserved","reserved","reserved","reserved","reserved","reserved","reserved","reserved","StandardCAN_FD","ExtendedCAN_FD";
BA_DEF_ BO_ "DiagConnection" HEX 0 65535;
BA_DEF_ BO_ "DiagState" ENUM "No","Yes";
BA_DEF_ BO_ "NmAsrMessage" ENUM "No","Yes";
BA_DEF_ BO_ "GenMsgDelayTime" INT 0 65535;
BA_DEF_ BO_ "GenMsgCycleTime" INT 0 65535;
BA_DEF_ BO_ "GenMsgCycleTimeFast" INT 0 65535;
BA_DEF_ BO_ "GenMsgStartDelayTime" INT 0 65535;
BA_DEF_ BO_ "GenMsgILSupport" ENUM "No","Yes";
BA_DEF_ BO_ "GenMsgNrOfRepetition" INT 0 255;
BA_DEF_ BO_ "GenMsgSendType" ENUM "Cyclic","NotUsed","NotUsed","NotUsed","NotUsed","NotUsed","NotUsed","NotUsed","NoMsgSendType";
BA_DEF_ BO_ "NmMessage" ENUM "No","Yes";
BA_DEF_ BO_ "DiagResponse" ENUM "No","Yes";
BA_DEF_ BO_ "Type" ENUM "P","C","PE","COC","PE_Cntrl","E","E_Cntrl","OC","S","BAF","DC","EM","MM","ISO-TP","-";
BA_DEF_ BO_ "DiagRequest" ENUM "No","Yes";
BA_DEF_ SG_ "GenSigTimeoutTime_SGW" INT 0 65535;
BA_DEF_ SG_ "GenSigTimeoutTime_RFHM" INT 0 65535;
BA_DEF_ SG_ "GenSigTimeoutTime_MPAD" INT 0 65535;
BA_DEF_ SG_ "GenSigTimeoutTime_IPC" INT 0 65535;
BA_DEF_ SG_ "GenSigTimeoutTime_GNMM" INT 0 65535;
BA_DEF_ SG_ "GenSigTimeoutTime_EVCU2" INT 0 65535;
BA_DEF_ SG_ "GenSigTimeoutTime_ESL" INT 0 65535;
BA_DEF_ SG_ "GenSigTimeoutTime_ECM" INT 0 65535;
BA_DEF_ SG_ "GenSigTimeoutTime_DTCM" INT 0 65535;
BA_DEF_ SG_ "GenSigTimeoutTime_DMSM" INT 0 65535;
BA_DEF_ SG_ "GenSigTimeoutTime_BSM" INT 0 65535;
BA_DEF_ SG_ "GenSigTimeoutTime_BCM" INT 0 65535;
BA_DEF_ SG_ "GenSigTimeoutTime_AGSM" INT 0 65535;
BA_DEF_ SG_ "GenSigTimeoutTime_ADCAM" INT 0 65535;
BA_DEF_ SG_ "SystemSignalLongSymbol" STRING ;
BA_DEF_ SG_ "GenSigSendType" ENUM "NotUsed","OnWrite","OnWriteWithRepetition","OnChange","OnChangeWithRepetition","IfActive","IfActiveWithRepetition","NoSigSendType";
BA_DEF_ SG_ "GenSigInactiveValue" INT 0 2147483647;
BA_DEF_ SG_ "GenSigStartValue" INT 0 2147483647;
BA_DEF_DEF_ "CANFD_BRS" "0";
BA_DEF_DEF_ "VFrameFormat" "StandardCAN_FD";
BA_DEF_DEF_ "DiagConnection" 0;
BA_DEF_DEF_ "DiagState" "No";
BA_DEF_DEF_ "NmAsrMessage" "No";
BA_DEF_DEF_ "GenMsgDelayTime" 0;
BA_DEF_DEF_ "GenMsgCycleTime" 0;
BA_DEF_DEF_ "GenMsgCycleTimeFast" 0;
BA_DEF_DEF_ "GenMsgStartDelayTime" 0;
BA_DEF_DEF_ "GenMsgILSupport" "No";
BA_DEF_DEF_ "GenMsgNrOfRepetition" 0;
BA_DEF_DEF_ "GenMsgSendType" "NoMsgSendType";
BA_DEF_DEF_ "NmMessage" "No";
BA_DEF_DEF_ "DiagResponse" "No";
BA_DEF_DEF_ "Type" "-";
BA_DEF_DEF_ "DiagRequest" "No";
BA_DEF_DEF_ "GenSigTimeoutTime_SGW" 2500;
BA_DEF_DEF_ "GenSigTimeoutTime_RFHM" 2500;
BA_DEF_DEF_ "GenSigTimeoutTime_MPAD" 2500;
BA_DEF_DEF_ "GenSigTimeoutTime_IPC" 2500;
BA_DEF_DEF_ "GenSigTimeoutTime_GNMM" 2500;
BA_DEF_DEF_ "GenSigTimeoutTime_EVCU2" 2500;
BA_DEF_DEF_ "GenSigTimeoutTime_ESL" 2500;
BA_DEF_DEF_ "GenSigTimeoutTime_ECM" 2500;
BA_DEF_DEF_ "GenSigTimeoutTime_DTCM" 2500;
BA_DEF_DEF_ "GenSigTimeoutTime_DMSM" 2500;
BA_DEF_DEF_ "GenSigTimeoutTime_BSM" 2500;
BA_DEF_DEF_ "GenSigTimeoutTime_BCM" 2500;
BA_DEF_DEF_ "GenSigTimeoutTime_AGSM" 2500;
BA_DEF_DEF_ "GenSigTimeoutTime_ADCAM" 2500;
BA_DEF_DEF_ "SystemSignalLongSymbol" "";
BA_DEF_DEF_ "GenSigSendType" "NoSigSendType";
BA_DEF_DEF_ "GenSigInactiveValue" 0;
BA_DEF_DEF_ "GenSigStartValue" 0;
BA_ "CANFD_BRS" BO_ 274 1;
BA_ "GenMsgCycleTime" BO_ 274 10;
BA_ "GenMsgStartDelayTime" BO_ 274 5;
BA_ "GenMsgILSupport" BO_ 274 1;
BA_ "GenMsgSendType" BO_ 274 0;
BA_ "Type" BO_ 274 1;
BA_ "Type" BO_ 1954 3;
BA_ "GenMsgCycleTime" BO_ 1954 1000;
BA_ "GenMsgStartDelayTime" BO_ 1954 425;
BA_ "GenMsgILSupport" BO_ 1954 1;
BA_ "GenMsgSendType" BO_ 1954 0;
BA_ "CANFD_BRS" BO_ 1954 1;
BA_ "CANFD_BRS" BO_ 611 1;
BA_ "GenMsgDelayTime" BO_ 611 20;
BA_ "GenMsgCycleTime" BO_ 611 100;
BA_ "GenMsgStartDelayTime" BO_ 611 75;
BA_ "GenMsgILSupport" BO_ 611 1;
BA_ "GenMsgSendType" BO_ 611 0;
BA_ "Type" BO_ 611 3;
BA_ "CANFD_BRS" BO_ 1058 1;
BA_ "GenMsgCycleTime" BO_ 1058 100;
BA_ "GenMsgILSupport" BO_ 1058 1;
BA_ "GenMsgSendType" BO_ 1058 0;
BA_ "Type" BO_ 1058 1;
BA_ "CANFD_BRS" BO_ 1432 1;
BA_ "GenMsgDelayTime" BO_ 1432 20;
BA_ "GenMsgCycleTime" BO_ 1432 1000;
BA_ "GenMsgCycleTimeFast" BO_ 1432 20;
BA_ "GenMsgILSupport" BO_ 1432 1;
BA_ "GenMsgNrOfRepetition" BO_ 1432 2;
BA_ "GenMsgSendType" BO_ 1432 0;
BA_ "Type" BO_ 1432 3;
BA_ "GenMsgILSupport" BO_ 1154 1;
BA_ "GenMsgNrOfRepetition" BO_ 1154 2;
BA_ "GenMsgSendType" BO_ 1154 0;
BA_ "Type" BO_ 1154 3;
BA_ "CANFD_BRS" BO_ 1154 1;
BA_ "GenMsgDelayTime" BO_ 1154 20;
BA_ "GenMsgCycleTime" BO_ 1154 500;
BA_ "CANFD_BRS" BO_ 600 1;
BA_ "GenMsgDelayTime" BO_ 600 20;
BA_ "GenMsgCycleTime" BO_ 600 100;
BA_ "GenMsgCycleTimeFast" BO_ 600 20;
BA_ "GenMsgILSupport" BO_ 600 1;
BA_ "GenMsgNrOfRepetition" BO_ 600 2;
BA_ "GenMsgSendType" BO_ 600 0;
BA_ "Type" BO_ 600 3;
BA_ "Type" BO_ 1831 1;
BA_ "CANFD_BRS" BO_ 1831 1;
BA_ "GenMsgCycleTime" BO_ 1831 1000;
BA_ "GenMsgILSupport" BO_ 1831 1;
BA_ "GenMsgSendType" BO_ 1831 0;
BA_ "CANFD_BRS" BO_ 1441 1;
BA_ "GenMsgDelayTime" BO_ 1441 20;
BA_ "GenMsgCycleTime" BO_ 1441 1000;
BA_ "GenMsgCycleTimeFast" BO_ 1441 20;
BA_ "GenMsgILSupport" BO_ 1441 1;
BA_ "GenMsgNrOfRepetition" BO_ 1441 2;
BA_ "GenMsgSendType" BO_ 1441 0;
BA_ "Type" BO_ 1441 3;
BA_ "CANFD_BRS" BO_ 1829 1;
BA_ "GenMsgCycleTime" BO_ 1829 1000;
BA_ "GenMsgILSupport" BO_ 1829 1;
BA_ "GenMsgSendType" BO_ 1829 0;
BA_ "Type" BO_ 1829 1;
BA_ "CANFD_BRS" BO_ 1626 1;
BA_ "GenMsgCycleTime" BO_ 1626 500;
BA_ "GenMsgCycleTimeFast" BO_ 1626 10;
BA_ "GenMsgStartDelayTime" BO_ 1626 55;
BA_ "GenMsgILSupport" BO_ 1626 1;
BA_ "GenMsgSendType" BO_ 1626 0;
BA_ "Type" BO_ 1626 10;
BA_ "CANFD_BRS" BO_ 104 1;
BA_ "GenMsgILSupport" BO_ 104 1;
BA_ "Type" BO_ 104 11;
BA_ "CANFD_BRS" BO_ 100 1;
BA_ "GenMsgDelayTime" BO_ 100 20;
BA_ "GenMsgCycleTimeFast" BO_ 100 20;
BA_ "GenMsgILSupport" BO_ 100 1;
BA_ "GenMsgNrOfRepetition" BO_ 100 2;
BA_ "Type" BO_ 100 8;
BA_ "CANFD_BRS" BO_ 1955 1;
BA_ "GenMsgCycleTime" BO_ 1955 1000;
BA_ "GenMsgStartDelayTime" BO_ 1955 420;
BA_ "GenMsgILSupport" BO_ 1955 1;
BA_ "GenMsgSendType" BO_ 1955 0;
BA_ "Type" BO_ 1955 1;
BA_ "CANFD_BRS" BO_ 248 1;
BA_ "GenMsgDelayTime" BO_ 248 20;
BA_ "GenMsgCycleTimeFast" BO_ 248 20;
BA_ "GenMsgILSupport" BO_ 248 1;
BA_ "GenMsgNrOfRepetition" BO_ 248 2;
BA_ "Type" BO_ 248 8;
BA_ "GenSigTimeoutTime_BSM" SG_ 248 ESLLockFailSts 0;
BA_ "GenSigTimeoutTime_AGSM" SG_ 248 ESLLockFailSts 0;
BA_ "GenSigTimeoutTime_ADCAM" SG_ 248 ESLLockFailSts 0;
BA_ "GenSigTimeoutTime_SGW" SG_ 248 ESLFeedbackCmd 0;
BA_ "GenSigTimeoutTime_RFHM" SG_ 248 ESLFeedbackCmd 0;
BA_ "GenSigTimeoutTime_MPAD" SG_ 248 ESLFeedbackCmd 0;
BA_ "GenSigTimeoutTime_IPC" SG_ 248 ESLFeedbackCmd 0;
BA_ "GenSigTimeoutTime_GNMM" SG_ 248 ESLFeedbackCmd 0;
BA_ "GenSigTimeoutTime_EVCU2" SG_ 248 ESLFeedbackCmd 0;
BA_ "GenSigTimeoutTime_ESL" SG_ 248 ESLFeedbackCmd 0;
BA_ "GenSigTimeoutTime_ECM" SG_ 248 ESLFeedbackCmd 0;
BA_ "GenSigTimeoutTime_DTCM" SG_ 248 ESLFeedbackCmd 0;
BA_ "GenSigTimeoutTime_DMSM" SG_ 248 ESLFeedbackCmd 0;
BA_ "GenSigTimeoutTime_BSM" SG_ 248 ESLFeedbackCmd 0;
BA_ "GenSigTimeoutTime_AGSM" SG_ 248 ESLFeedbackCmd 0;
BA_ "GenSigTimeoutTime_ADCAM" SG_ 248 ESLFeedbackCmd 0;
BA_ "GenSigStartValue" SG_ 248 ESLFeedbackCmd 6;
BA_ "GenSigTimeoutTime_SGW" SG_ 248 ControlEncoding_ESL_Rsp 0;
BA_ "GenSigTimeoutTime_RFHM" SG_ 248 ControlEncoding_ESL_Rsp 0;
BA_ "GenSigTimeoutTime_MPAD" SG_ 248 ControlEncoding_ESL_Rsp 0;
BA_ "GenSigTimeoutTime_IPC" SG_ 248 ControlEncoding_ESL_Rsp 0;
BA_ "GenSigTimeoutTime_GNMM" SG_ 248 ControlEncoding_ESL_Rsp 0;
BA_ "GenSigTimeoutTime_EVCU2" SG_ 248 ControlEncoding_ESL_Rsp 0;
BA_ "GenSigTimeoutTime_ESL" SG_ 248 ControlEncoding_ESL_Rsp 0;
BA_ "GenSigTimeoutTime_ECM" SG_ 248 ControlEncoding_ESL_Rsp 0;
BA_ "GenSigTimeoutTime_DTCM" SG_ 248 ControlEncoding_ESL_Rsp 0;
BA_ "GenSigTimeoutTime_DMSM" SG_ 248 ControlEncoding_ESL_Rsp 0;
BA_ "GenSigTimeoutTime_BSM" SG_ 248 ControlEncoding_ESL_Rsp 0;
BA_ "GenSigTimeoutTime_AGSM" SG_ 248 ControlEncoding_ESL_Rsp 0;
BA_ "GenSigTimeoutTime_ADCAM" SG_ 248 ControlEncoding_ESL_Rsp 0;
BA_ "GenSigSendType" SG_ 248 ControlEncoding_ESL_Rsp 1;
BA_ "GenSigTimeoutTime_SGW" SG_ 248 CodeCheckSts_ESL 0;
BA_ "GenSigTimeoutTime_RFHM" SG_ 248 CodeCheckSts_ESL 0;
BA_ "GenSigTimeoutTime_MPAD" SG_ 248 CodeCheckSts_ESL 0;
BA_ "GenSigTimeoutTime_IPC" SG_ 248 CodeCheckSts_ESL 0;
BA_ "GenSigTimeoutTime_GNMM" SG_ 248 CodeCheckSts_ESL 0;
BA_ "GenSigTimeoutTime_EVCU2" SG_ 248 CodeCheckSts_ESL 0;
BA_ "GenSigTimeoutTime_ESL" SG_ 248 CodeCheckSts_ESL 0;
BA_ "GenSigTimeoutTime_ECM" SG_ 248 CodeCheckSts_ESL 0;
BA_ "GenSigTimeoutTime_DTCM" SG_ 248 CodeCheckSts_ESL 0;
BA_ "GenSigTimeoutTime_DMSM" SG_ 248 CodeCheckSts_ESL 0;
BA_ "GenSigTimeoutTime_BSM" SG_ 248 CodeCheckSts_ESL 0;
BA_ "GenSigTimeoutTime_AGSM" SG_ 248 CodeCheckSts_ESL 0;
BA_ "GenSigTimeoutTime_ADCAM" SG_ 248 CodeCheckSts_ESL 0;
BA_ "GenSigTimeoutTime_ADCAM" SG_ 1831 FUEL_CAP_STAT 0;
BA_ "GenSigTimeoutTime_RFHM" SG_ 1831 FUEL_CUT_OFF_STAT 0;
BA_ "GenSigTimeoutTime_MPAD" SG_ 1831 FUEL_CUT_OFF_STAT 0;
BA_ "GenSigTimeoutTime_IPC" SG_ 1831 FUEL_CUT_OFF_STAT 0;
BA_ "GenSigTimeoutTime_GNMM" SG_ 1831 FUEL_CUT_OFF_STAT 0;
BA_ "GenSigTimeoutTime_EVCU2" SG_ 1831 FUEL_CUT_OFF_STAT 0;
BA_ "GenSigTimeoutTime_ESL" SG_ 1831 FUEL_CUT_OFF_STAT 0;
BA_ "GenSigTimeoutTime_ECM" SG_ 1831 FUEL_CUT_OFF_STAT 0;
BA_ "GenSigTimeoutTime_DTCM" SG_ 1831 FUEL_CUT_OFF_STAT 0;
BA_ "GenSigTimeoutTime_DMSM" SG_ 1831 FUEL_CUT_OFF_STAT 0;
BA_ "GenSigTimeoutTime_BSM" SG_ 1831 FUEL_CUT_OFF_STAT 0;
BA_ "GenSigTimeoutTime_BCM" SG_ 1831 FUEL_CUT_OFF_STAT 0;
BA_ "GenSigTimeoutTime_AGSM" SG_ 1831 FUEL_CUT_OFF_STAT 0;
BA_ "GenSigTimeoutTime_ADCAM" SG_ 1831 FUEL_CUT_OFF_STAT 0;
BA_ "GenSigTimeoutTime_RFHM" SG_ 1831 HDLT_LVL_STAT 0;
BA_ "GenSigTimeoutTime_MPAD" SG_ 1831 HDLT_LVL_STAT 0;
BA_ "GenSigTimeoutTime_IPC" SG_ 1831 HDLT_LVL_STAT 0;
BA_ "GenSigTimeoutTime_GNMM" SG_ 1831 HDLT_LVL_STAT 0;
BA_ "GenSigTimeoutTime_EVCU2" SG_ 1831 HDLT_LVL_STAT 0;
BA_ "GenSigTimeoutTime_ESL" SG_ 1831 HDLT_LVL_STAT 0;
BA_ "GenSigTimeoutTime_ECM" SG_ 1831 HDLT_LVL_STAT 0;
BA_ "GenSigTimeoutTime_DTCM" SG_ 1831 HDLT_LVL_STAT 0;
BA_ "GenSigTimeoutTime_DMSM" SG_ 1831 HDLT_LVL_STAT 0;
BA_ "GenSigTimeoutTime_BSM" SG_ 1831 HDLT_LVL_STAT 0;
BA_ "GenSigTimeoutTime_BCM" SG_ 1831 HDLT_LVL_STAT 0;
BA_ "GenSigTimeoutTime_AGSM" SG_ 1831 HDLT_LVL_STAT 0;
BA_ "GenSigTimeoutTime_ADCAM" SG_ 1831 HDLT_LVL_STAT 0;
BA_ "GenSigTimeoutTime_RFHM" SG_ 1831 HI_BEAM_STAT 0;
BA_ "GenSigTimeoutTime_MPAD" SG_ 1831 HI_BEAM_STAT 0;
BA_ "GenSigTimeoutTime_IPC" SG_ 1831 HI_BEAM_STAT 0;
BA_ "GenSigTimeoutTime_GNMM" SG_ 1831 HI_BEAM_STAT 0;
BA_ "GenSigTimeoutTime_EVCU2" SG_ 1831 HI_BEAM_STAT 0;
BA_ "GenSigTimeoutTime_ESL" SG_ 1831 HI_BEAM_STAT 0;
BA_ "GenSigTimeoutTime_ECM" SG_ 1831 HI_BEAM_STAT 0;
BA_ "GenSigTimeoutTime_DTCM" SG_ 1831 HI_BEAM_STAT 0;
BA_ "GenSigTimeoutTime_DMSM" SG_ 1831 HI_BEAM_STAT 0;
BA_ "GenSigTimeoutTime_BSM" SG_ 1831 HI_BEAM_STAT 0;
BA_ "GenSigTimeoutTime_BCM" SG_ 1831 HI_BEAM_STAT 0;
BA_ "GenSigTimeoutTime_AGSM" SG_ 1831 HI_BEAM_STAT 0;
BA_ "GenSigTimeoutTime_ADCAM" SG_ 1831 HI_BEAM_STAT 0;
BA_ "GenSigTimeoutTime_BCM" SG_ 1831 ELEC_STAB_STAT 0;
BA_ "GenSigTimeoutTime_AGSM" SG_ 1831 ELEC_STAB_STAT 0;
BA_ "GenSigTimeoutTime_ADCAM" SG_ 1831 ELEC_STAB_STAT 0;
BA_ "GenSigTimeoutTime_BCM" SG_ 1831 ABS_IND_STAT 0;
BA_ "GenSigTimeoutTime_AGSM" SG_ 1831 ABS_IND_STAT 0;
BA_ "GenSigTimeoutTime_ADCAM" SG_ 1831 ABS_IND_STAT 0;
BA_ "GenSigTimeoutTime_RFHM" SG_ 1831 ABS_IND_STAT 0;
BA_ "GenSigTimeoutTime_MPAD" SG_ 1831 ABS_IND_STAT 0;
BA_ "GenSigTimeoutTime_IPC" SG_ 1831 ABS_IND_STAT 0;
BA_ "GenSigTimeoutTime_GNMM" SG_ 1831 ABS_IND_STAT 0;
BA_ "GenSigTimeoutTime_EVCU2" SG_ 1831 ABS_IND_STAT 0;
BA_ "GenSigTimeoutTime_ESL" SG_ 1831 ABS_IND_STAT 0;
BA_ "GenSigTimeoutTime_ECM" SG_ 1831 ABS_IND_STAT 0;
BA_ "GenSigTimeoutTime_DTCM" SG_ 1831 ABS_IND_STAT 0;
BA_ "GenSigTimeoutTime_DMSM" SG_ 1831 ABS_IND_STAT 0;
BA_ "GenSigTimeoutTime_BSM" SG_ 1831 ABS_IND_STAT 0;
BA_ "GenSigTimeoutTime_RFHM" SG_ 1831 AWD_IND_STAT 0;
BA_ "GenSigTimeoutTime_MPAD" SG_ 1831 AWD_IND_STAT 0;
BA_ "GenSigTimeoutTime_IPC" SG_ 1831 AWD_IND_STAT 0;
BA_ "GenSigTimeoutTime_GNMM" SG_ 1831 AWD_IND_STAT 0;
BA_ "GenSigTimeoutTime_EVCU2" SG_ 1831 AWD_IND_STAT 0;
BA_ "GenSigTimeoutTime_ESL" SG_ 1831 AWD_IND_STAT 0;
BA_ "GenSigTimeoutTime_ECM" SG_ 1831 AWD_IND_STAT 0;
BA_ "GenSigTimeoutTime_DTCM" SG_ 1831 AWD_IND_STAT 0;
BA_ "GenSigTimeoutTime_DMSM" SG_ 1831 AWD_IND_STAT 0;
BA_ "GenSigTimeoutTime_BSM" SG_ 1831 AWD_IND_STAT 0;
BA_ "GenSigTimeoutTime_BCM" SG_ 1831 AWD_IND_STAT 0;
BA_ "GenSigTimeoutTime_AGSM" SG_ 1831 AWD_IND_STAT 0;
BA_ "GenSigTimeoutTime_ADCAM" SG_ 1831 AWD_IND_STAT 0;
BA_ "GenSigTimeoutTime_RFHM" SG_ 1831 AWD_SERVICE_STAT 0;
BA_ "GenSigTimeoutTime_MPAD" SG_ 1831 AWD_SERVICE_STAT 0;
BA_ "GenSigTimeoutTime_IPC" SG_ 1831 AWD_SERVICE_STAT 0;
BA_ "GenSigTimeoutTime_GNMM" SG_ 1831 AWD_SERVICE_STAT 0;
BA_ "GenSigTimeoutTime_EVCU2" SG_ 1831 AWD_SERVICE_STAT 0;
BA_ "GenSigTimeoutTime_ESL" SG_ 1831 AWD_SERVICE_STAT 0;
BA_ "GenSigTimeoutTime_ECM" SG_ 1831 AWD_SERVICE_STAT 0;
BA_ "GenSigTimeoutTime_DTCM" SG_ 1831 AWD_SERVICE_STAT 0;
BA_ "GenSigTimeoutTime_DMSM" SG_ 1831 AWD_SERVICE_STAT 0;
BA_ "GenSigTimeoutTime_BSM" SG_ 1831 AWD_SERVICE_STAT 0;
BA_ "GenSigTimeoutTime_BCM" SG_ 1831 AWD_SERVICE_STAT 0;
BA_ "GenSigTimeoutTime_AGSM" SG_ 1831 AWD_SERVICE_STAT 0;
BA_ "GenSigTimeoutTime_ADCAM" SG_ 1831 AWD_SERVICE_STAT 0;
BA_ "GenSigTimeoutTime_RFHM" SG_ 1831 BATTERY_CHARGE_STAT 0;
BA_ "GenSigTimeoutTime_MPAD" SG_ 1831 BATTERY_CHARGE_STAT 0;
BA_ "GenSigTimeoutTime_IPC" SG_ 1831 BATTERY_CHARGE_STAT 0;
BA_ "GenSigTimeoutTime_GNMM" SG_ 1831 BATTERY_CHARGE_STAT 0;
BA_ "GenSigTimeoutTime_EVCU2" SG_ 1831 BATTERY_CHARGE_STAT 0;
BA_ "GenSigTimeoutTime_ESL" SG_ 1831 BATTERY_CHARGE_STAT 0;
BA_ "GenSigTimeoutTime_ECM" SG_ 1831 BATTERY_CHARGE_STAT 0;
BA_ "GenSigTimeoutTime_DTCM" SG_ 1831 BATTERY_CHARGE_STAT 0;
BA_ "GenSigTimeoutTime_DMSM" SG_ 1831 BATTERY_CHARGE_STAT 0;
BA_ "GenSigTimeoutTime_BSM" SG_ 1831 BATTERY_CHARGE_STAT 0;
BA_ "GenSigTimeoutTime_BCM" SG_ 1831 BATTERY_CHARGE_STAT 0;
BA_ "GenSigTimeoutTime_AGSM" SG_ 1831 BATTERY_CHARGE_STAT 0;
BA_ "GenSigTimeoutTime_ADCAM" SG_ 1831 BATTERY_CHARGE_STAT 0;
BA_ "GenSigTimeoutTime_RFHM" SG_ 1831 BRAKE_PAD_STAT 0;
BA_ "GenSigTimeoutTime_MPAD" SG_ 1831 BRAKE_PAD_STAT 0;
BA_ "GenSigTimeoutTime_IPC" SG_ 1831 BRAKE_PAD_STAT 0;
BA_ "GenSigTimeoutTime_GNMM" SG_ 1831 BRAKE_PAD_STAT 0;
BA_ "GenSigTimeoutTime_EVCU2" SG_ 1831 BRAKE_PAD_STAT 0;
BA_ "GenSigTimeoutTime_ESL" SG_ 1831 BRAKE_PAD_STAT 0;
BA_ "GenSigTimeoutTime_ECM" SG_ 1831 BRAKE_PAD_STAT 0;
BA_ "GenSigTimeoutTime_DTCM" SG_ 1831 BRAKE_PAD_STAT 0;
BA_ "GenSigTimeoutTime_DMSM" SG_ 1831 BRAKE_PAD_STAT 0;
BA_ "GenSigTimeoutTime_BSM" SG_ 1831 BRAKE_PAD_STAT 0;
BA_ "GenSigTimeoutTime_BCM" SG_ 1831 BRAKE_PAD_STAT 0;
BA_ "GenSigTimeoutTime_AGSM" SG_ 1831 BRAKE_PAD_STAT 0;
BA_ "GenSigTimeoutTime_ADCAM" SG_ 1831 BRAKE_PAD_STAT 0;
BA_ "GenSigTimeoutTime_RFHM" SG_ 1831 BRK_IND_STAT 0;
BA_ "GenSigTimeoutTime_MPAD" SG_ 1831 BRK_IND_STAT 0;
BA_ "GenSigTimeoutTime_IPC" SG_ 1831 BRK_IND_STAT 0;
BA_ "GenSigTimeoutTime_GNMM" SG_ 1831 BRK_IND_STAT 0;
BA_ "GenSigTimeoutTime_EVCU2" SG_ 1831 BRK_IND_STAT 0;
BA_ "GenSigTimeoutTime_ESL" SG_ 1831 BRK_IND_STAT 0;
BA_ "GenSigTimeoutTime_ECM" SG_ 1831 BRK_IND_STAT 0;
BA_ "GenSigTimeoutTime_DTCM" SG_ 1831 BRK_IND_STAT 0;
BA_ "GenSigTimeoutTime_DMSM" SG_ 1831 BRK_IND_STAT 0;
BA_ "GenSigTimeoutTime_BSM" SG_ 1831 BRK_IND_STAT 0;
BA_ "GenSigTimeoutTime_BCM" SG_ 1831 BRK_IND_STAT 0;
BA_ "GenSigTimeoutTime_AGSM" SG_ 1831 BRK_IND_STAT 0;
BA_ "GenSigTimeoutTime_ADCAM" SG_ 1831 BRK_IND_STAT 0;
BA_ "GenSigTimeoutTime_RFHM" SG_ 1831 CARGO_LT_STAT 0;
BA_ "GenSigTimeoutTime_MPAD" SG_ 1831 CARGO_LT_STAT 0;
BA_ "GenSigTimeoutTime_IPC" SG_ 1831 CARGO_LT_STAT 0;
BA_ "GenSigTimeoutTime_GNMM" SG_ 1831 CARGO_LT_STAT 0;
BA_ "GenSigTimeoutTime_EVCU2" SG_ 1831 CARGO_LT_STAT 0;
BA_ "GenSigTimeoutTime_ESL" SG_ 1831 CARGO_LT_STAT 0;
BA_ "GenSigTimeoutTime_ECM" SG_ 1831 CARGO_LT_STAT 0;
BA_ "GenSigTimeoutTime_DTCM" SG_ 1831 CARGO_LT_STAT 0;
BA_ "GenSigTimeoutTime_DMSM" SG_ 1831 CARGO_LT_STAT 0;
BA_ "GenSigTimeoutTime_BSM" SG_ 1831 CARGO_LT_STAT 0;
BA_ "GenSigTimeoutTime_BCM" SG_ 1831 CARGO_LT_STAT 0;
BA_ "GenSigTimeoutTime_AGSM" SG_ 1831 CARGO_LT_STAT 0;
BA_ "GenSigTimeoutTime_ADCAM" SG_ 1831 CARGO_LT_STAT 0;
BA_ "GenSigTimeoutTime_RFHM" SG_ 1831 CATALYST_TEMP_STAT 0;
BA_ "GenSigTimeoutTime_MPAD" SG_ 1831 CATALYST_TEMP_STAT 0;
BA_ "GenSigTimeoutTime_IPC" SG_ 1831 CATALYST_TEMP_STAT 0;
BA_ "GenSigTimeoutTime_GNMM" SG_ 1831 CATALYST_TEMP_STAT 0;
BA_ "GenSigTimeoutTime_EVCU2" SG_ 1831 CATALYST_TEMP_STAT 0;
BA_ "GenSigTimeoutTime_ESL" SG_ 1831 CATALYST_TEMP_STAT 0;
BA_ "GenSigTimeoutTime_ECM" SG_ 1831 CATALYST_TEMP_STAT 0;
BA_ "GenSigTimeoutTime_DTCM" SG_ 1831 CATALYST_TEMP_STAT 0;
BA_ "GenSigTimeoutTime_DMSM" SG_ 1831 CATALYST_TEMP_STAT 0;
BA_ "GenSigTimeoutTime_BSM" SG_ 1831 CATALYST_TEMP_STAT 0;
BA_ "GenSigTimeoutTime_BCM" SG_ 1831 CATALYST_TEMP_STAT 0;
BA_ "GenSigTimeoutTime_AGSM" SG_ 1831 CATALYST_TEMP_STAT 0;
BA_ "GenSigTimeoutTime_ADCAM" SG_ 1831 CATALYST_TEMP_STAT 0;
BA_ "GenSigTimeoutTime_RFHM" SG_ 1831 COOLENT_LEVEL_STAT 0;
BA_ "GenSigTimeoutTime_MPAD" SG_ 1831 COOLENT_LEVEL_STAT 0;
BA_ "GenSigTimeoutTime_IPC" SG_ 1831 COOLENT_LEVEL_STAT 0;
BA_ "GenSigTimeoutTime_GNMM" SG_ 1831 COOLENT_LEVEL_STAT 0;
BA_ "GenSigTimeoutTime_EVCU2" SG_ 1831 COOLENT_LEVEL_STAT 0;
BA_ "GenSigTimeoutTime_ESL" SG_ 1831 COOLENT_LEVEL_STAT 0;
BA_ "GenSigTimeoutTime_ECM" SG_ 1831 COOLENT_LEVEL_STAT 0;
BA_ "GenSigTimeoutTime_DTCM" SG_ 1831 COOLENT_LEVEL_STAT 0;
BA_ "GenSigTimeoutTime_DMSM" SG_ 1831 COOLENT_LEVEL_STAT 0;
BA_ "GenSigTimeoutTime_BSM" SG_ 1831 COOLENT_LEVEL_STAT 0;
BA_ "GenSigTimeoutTime_BCM" SG_ 1831 COOLENT_LEVEL_STAT 0;
BA_ "GenSigTimeoutTime_AGSM" SG_ 1831 COOLENT_LEVEL_STAT 0;
BA_ "GenSigTimeoutTime_ADCAM" SG_ 1831 COOLENT_LEVEL_STAT 0;
BA_ "GenSigTimeoutTime_RFHM" SG_ 1831 CRUISE_SET_STAT 0;
BA_ "GenSigTimeoutTime_MPAD" SG_ 1831 CRUISE_SET_STAT 0;
BA_ "GenSigTimeoutTime_IPC" SG_ 1831 CRUISE_SET_STAT 0;
BA_ "GenSigTimeoutTime_GNMM" SG_ 1831 CRUISE_SET_STAT 0;
BA_ "GenSigTimeoutTime_EVCU2" SG_ 1831 CRUISE_SET_STAT 0;
BA_ "GenSigTimeoutTime_ESL" SG_ 1831 CRUISE_SET_STAT 0;
BA_ "GenSigTimeoutTime_ECM" SG_ 1831 CRUISE_SET_STAT 0;
BA_ "GenSigTimeoutTime_DTCM" SG_ 1831 CRUISE_SET_STAT 0;
BA_ "GenSigTimeoutTime_DMSM" SG_ 1831 CRUISE_SET_STAT 0;
BA_ "GenSigTimeoutTime_BSM" SG_ 1831 CRUISE_SET_STAT 0;
BA_ "GenSigTimeoutTime_BCM" SG_ 1831 CRUISE_SET_STAT 0;
BA_ "GenSigTimeoutTime_AGSM" SG_ 1831 CRUISE_SET_STAT 0;
BA_ "GenSigTimeoutTime_ADCAM" SG_ 1831 CRUISE_SET_STAT 0;
BA_ "GenSigTimeoutTime_RFHM" SG_ 1831 DAMPING_SYSTEM_STAT 0;
BA_ "GenSigTimeoutTime_MPAD" SG_ 1831 DAMPING_SYSTEM_STAT 0;
BA_ "GenSigTimeoutTime_IPC" SG_ 1831 DAMPING_SYSTEM_STAT 0;
BA_ "GenSigTimeoutTime_GNMM" SG_ 1831 DAMPING_SYSTEM_STAT 0;
BA_ "GenSigTimeoutTime_EVCU2" SG_ 1831 DAMPING_SYSTEM_STAT 0;
BA_ "GenSigTimeoutTime_ESL" SG_ 1831 DAMPING_SYSTEM_STAT 0;
BA_ "GenSigTimeoutTime_ECM" SG_ 1831 DAMPING_SYSTEM_STAT 0;
BA_ "GenSigTimeoutTime_DTCM" SG_ 1831 DAMPING_SYSTEM_STAT 0;
BA_ "GenSigTimeoutTime_DMSM" SG_ 1831 DAMPING_SYSTEM_STAT 0;
BA_ "GenSigTimeoutTime_BSM" SG_ 1831 DAMPING_SYSTEM_STAT 0;
BA_ "GenSigTimeoutTime_BCM" SG_ 1831 DAMPING_SYSTEM_STAT 0;
BA_ "GenSigTimeoutTime_AGSM" SG_ 1831 DAMPING_SYSTEM_STAT 0;
BA_ "GenSigTimeoutTime_ADCAM" SG_ 1831 DAMPING_SYSTEM_STAT 0;
BA_ "GenSigTimeoutTime_RFHM" SG_ 1831 DEF_STAT 0;
BA_ "GenSigTimeoutTime_MPAD" SG_ 1831 DEF_STAT 0;
BA_ "GenSigTimeoutTime_IPC" SG_ 1831 DEF_STAT 0;
BA_ "GenSigTimeoutTime_GNMM" SG_ 1831 DEF_STAT 0;
BA_ "GenSigTimeoutTime_EVCU2" SG_ 1831 DEF_STAT 0;
BA_ "GenSigTimeoutTime_ESL" SG_ 1831 DEF_STAT 0;
BA_ "GenSigTimeoutTime_ECM" SG_ 1831 DEF_STAT 0;
BA_ "GenSigTimeoutTime_DTCM" SG_ 1831 DEF_STAT 0;
BA_ "GenSigTimeoutTime_DMSM" SG_ 1831 DEF_STAT 0;
BA_ "GenSigTimeoutTime_BSM" SG_ 1831 DEF_STAT 0;
BA_ "GenSigTimeoutTime_BCM" SG_ 1831 DEF_STAT 0;
BA_ "GenSigTimeoutTime_AGSM" SG_ 1831 DEF_STAT 0;
BA_ "GenSigTimeoutTime_ADCAM" SG_ 1831 DEF_STAT 0;
BA_ "GenSigTimeoutTime_RFHM" SG_ 1831 DOORS_STAT 0;
BA_ "GenSigTimeoutTime_MPAD" SG_ 1831 DOORS_STAT 0;
BA_ "GenSigTimeoutTime_IPC" SG_ 1831 DOORS_STAT 0;
BA_ "GenSigTimeoutTime_GNMM" SG_ 1831 DOORS_STAT 0;
BA_ "GenSigTimeoutTime_EVCU2" SG_ 1831 DOORS_STAT 0;
BA_ "GenSigTimeoutTime_ESL" SG_ 1831 DOORS_STAT 0;
BA_ "GenSigTimeoutTime_ECM" SG_ 1831 DOORS_STAT 0;
BA_ "GenSigTimeoutTime_DTCM" SG_ 1831 DOORS_STAT 0;
BA_ "GenSigTimeoutTime_DMSM" SG_ 1831 DOORS_STAT 0;
BA_ "GenSigTimeoutTime_BSM" SG_ 1831 DOORS_STAT 0;
BA_ "GenSigTimeoutTime_BCM" SG_ 1831 DOORS_STAT 0;
BA_ "GenSigTimeoutTime_AGSM" SG_ 1831 DOORS_STAT 0;
BA_ "GenSigTimeoutTime_ADCAM" SG_ 1831 DOORS_STAT 0;
BA_ "GenSigTimeoutTime_RFHM" SG_ 1831 ACC_WARN_STAT 0;
BA_ "GenSigTimeoutTime_MPAD" SG_ 1831 ACC_WARN_STAT 0;
BA_ "GenSigTimeoutTime_IPC" SG_ 1831 ACC_WARN_STAT 0;
BA_ "GenSigTimeoutTime_GNMM" SG_ 1831 ACC_WARN_STAT 0;
BA_ "GenSigTimeoutTime_EVCU2" SG_ 1831 ACC_WARN_STAT 0;
BA_ "GenSigTimeoutTime_ESL" SG_ 1831 ACC_WARN_STAT 0;
BA_ "GenSigTimeoutTime_ECM" SG_ 1831 ACC_WARN_STAT 0;
BA_ "GenSigTimeoutTime_DTCM" SG_ 1831 ACC_WARN_STAT 0;
BA_ "GenSigTimeoutTime_DMSM" SG_ 1831 ACC_WARN_STAT 0;
BA_ "GenSigTimeoutTime_BSM" SG_ 1831 ACC_WARN_STAT 0;
BA_ "GenSigTimeoutTime_BCM" SG_ 1831 ACC_WARN_STAT 0;
BA_ "GenSigTimeoutTime_AGSM" SG_ 1831 ACC_WARN_STAT 0;
BA_ "GenSigTimeoutTime_ADCAM" SG_ 1831 ACC_WARN_STAT 0;
BA_ "GenSigTimeoutTime_RFHM" SG_ 1831 AIR_BAG_STAT 0;
BA_ "GenSigTimeoutTime_MPAD" SG_ 1831 AIR_BAG_STAT 0;
BA_ "GenSigTimeoutTime_IPC" SG_ 1831 AIR_BAG_STAT 0;
BA_ "GenSigTimeoutTime_GNMM" SG_ 1831 AIR_BAG_STAT 0;
BA_ "GenSigTimeoutTime_EVCU2" SG_ 1831 AIR_BAG_STAT 0;
BA_ "GenSigTimeoutTime_ESL" SG_ 1831 AIR_BAG_STAT 0;
BA_ "GenSigTimeoutTime_ECM" SG_ 1831 AIR_BAG_STAT 0;
BA_ "GenSigTimeoutTime_DTCM" SG_ 1831 AIR_BAG_STAT 0;
BA_ "GenSigTimeoutTime_DMSM" SG_ 1831 AIR_BAG_STAT 0;
BA_ "GenSigTimeoutTime_BSM" SG_ 1831 AIR_BAG_STAT 0;
BA_ "GenSigTimeoutTime_BCM" SG_ 1831 AIR_BAG_STAT 0;
BA_ "GenSigTimeoutTime_AGSM" SG_ 1831 AIR_BAG_STAT 0;
BA_ "GenSigTimeoutTime_ADCAM" SG_ 1831 AIR_BAG_STAT 0;
BA_ "GenSigTimeoutTime_RFHM" SG_ 1831 ECO_MODE_STAT 0;
BA_ "GenSigTimeoutTime_MPAD" SG_ 1831 ECO_MODE_STAT 0;
BA_ "GenSigTimeoutTime_IPC" SG_ 1831 ECO_MODE_STAT 0;
BA_ "GenSigTimeoutTime_GNMM" SG_ 1831 ECO_MODE_STAT 0;
BA_ "GenSigTimeoutTime_EVCU2" SG_ 1831 ECO_MODE_STAT 0;
BA_ "GenSigTimeoutTime_ESL" SG_ 1831 ECO_MODE_STAT 0;
BA_ "GenSigTimeoutTime_ECM" SG_ 1831 ECO_MODE_STAT 0;
BA_ "GenSigTimeoutTime_DTCM" SG_ 1831 ECO_MODE_STAT 0;
BA_ "GenSigTimeoutTime_DMSM" SG_ 1831 ECO_MODE_STAT 0;
BA_ "GenSigTimeoutTime_BSM" SG_ 1831 ECO_MODE_STAT 0;
BA_ "GenSigTimeoutTime_BCM" SG_ 1831 ECO_MODE_STAT 0;
BA_ "GenSigTimeoutTime_AGSM" SG_ 1831 ECO_MODE_STAT 0;
BA_ "GenSigTimeoutTime_ADCAM" SG_ 1831 ECO_MODE_STAT 0;
BA_ "GenSigTimeoutTime_SGW" SG_ 1829 MessageCounter_IPC1 0;
BA_ "GenSigTimeoutTime_RFHM" SG_ 1829 MessageCounter_IPC1 0;
BA_ "GenSigTimeoutTime_IPC" SG_ 1829 MessageCounter_IPC1 0;
BA_ "GenSigTimeoutTime_GNMM" SG_ 1829 MessageCounter_IPC1 0;
BA_ "GenSigTimeoutTime_EVCU2" SG_ 1829 MessageCounter_IPC1 0;
BA_ "GenSigTimeoutTime_ESL" SG_ 1829 MessageCounter_IPC1 0;
BA_ "GenSigTimeoutTime_DTCM" SG_ 1829 MessageCounter_IPC1 0;
BA_ "GenSigTimeoutTime_AGSM" SG_ 1829 MessageCounter_IPC1 0;
BA_ "GenSigTimeoutTime_RFHM" SG_ 1829 InstantaneousFuelConsumption3 0;
BA_ "GenSigTimeoutTime_MPAD" SG_ 1829 InstantaneousFuelConsumption3 0;
BA_ "GenSigTimeoutTime_IPC" SG_ 1829 InstantaneousFuelConsumption3 0;
BA_ "GenSigTimeoutTime_GNMM" SG_ 1829 InstantaneousFuelConsumption3 0;
BA_ "GenSigTimeoutTime_EVCU2" SG_ 1829 InstantaneousFuelConsumption3 0;
BA_ "GenSigTimeoutTime_ESL" SG_ 1829 InstantaneousFuelConsumption3 0;
BA_ "GenSigTimeoutTime_ECM" SG_ 1829 InstantaneousFuelConsumption3 0;
BA_ "GenSigTimeoutTime_DTCM" SG_ 1829 InstantaneousFuelConsumption3 0;
BA_ "GenSigTimeoutTime_DMSM" SG_ 1829 InstantaneousFuelConsumption3 0;
BA_ "GenSigTimeoutTime_BSM" SG_ 1829 InstantaneousFuelConsumption3 0;
BA_ "GenSigTimeoutTime_BCM" SG_ 1829 InstantaneousFuelConsumption3 0;
BA_ "GenSigTimeoutTime_AGSM" SG_ 1829 InstantaneousFuelConsumption3 0;
BA_ "GenSigTimeoutTime_ADCAM" SG_ 1829 InstantaneousFuelConsumption3 0;
BA_ "GenSigTimeoutTime_IPC" SG_ 1829 TotalOdometer 0;
BA_ "GenSigTimeoutTime_RFHM" SG_ 1829 InstantaneousFuelConsumption2 0;
BA_ "GenSigTimeoutTime_MPAD" SG_ 1829 InstantaneousFuelConsumption2 0;
BA_ "GenSigTimeoutTime_IPC" SG_ 1829 InstantaneousFuelConsumption2 0;
BA_ "GenSigTimeoutTime_GNMM" SG_ 1829 InstantaneousFuelConsumption2 0;
BA_ "GenSigTimeoutTime_EVCU2" SG_ 1829 InstantaneousFuelConsumption2 0;
BA_ "GenSigTimeoutTime_ESL" SG_ 1829 InstantaneousFuelConsumption2 0;
BA_ "GenSigTimeoutTime_ECM" SG_ 1829 InstantaneousFuelConsumption2 0;
BA_ "GenSigTimeoutTime_DTCM" SG_ 1829 InstantaneousFuelConsumption2 0;
BA_ "GenSigTimeoutTime_DMSM" SG_ 1829 InstantaneousFuelConsumption2 0;
BA_ "GenSigTimeoutTime_BSM" SG_ 1829 InstantaneousFuelConsumption2 0;
BA_ "GenSigTimeoutTime_BCM" SG_ 1829 InstantaneousFuelConsumption2 0;
BA_ "GenSigTimeoutTime_ADCAM" SG_ 100 rnd_1 0;
BA_ "GenSigTimeoutTime_SGW" SG_ 1955 IBS3_Tm_Lst_Reset_Sec 0;
BA_ "GenSigTimeoutTime_RFHM" SG_ 1955 IBS3_Tm_Lst_Reset_Sec 0;
BA_ "GenSigTimeoutTime_MPAD" SG_ 1955 IBS3_Tm_Lst_Reset_Sec 0;
BA_ "GenSigTimeoutTime_IPC" SG_ 1955 IBS3_Tm_Lst_Reset_Sec 0;
BA_ "GenSigTimeoutTime_GNMM" SG_ 1955 IBS3_Tm_Lst_Reset_Sec 0;
BA_ "GenSigTimeoutTime_ESL" SG_ 1955 IBS3_Tm_Lst_Reset_Sec 0;
BA_ "GenSigTimeoutTime_ECM" SG_ 1955 IBS3_Tm_Lst_Reset_Sec 0;
BA_ "GenSigTimeoutTime_DTCM" SG_ 1955 IBS3_Tm_Lst_Reset_Sec 0;
BA_ "GenSigTimeoutTime_DMSM" SG_ 1955 IBS3_Tm_Lst_Reset_Sec 0;
BA_ "GenSigTimeoutTime_BSM" SG_ 1955 IBS3_Tm_Lst_Reset_Sec 0;
BA_ "GenSigTimeoutTime_BCM" SG_ 1955 IBS3_Tm_Lst_Reset_Sec 0;
BA_ "GenSigTimeoutTime_AGSM" SG_ 1955 IBS3_Tm_Lst_Reset_Sec 0;
BA_ "GenSigTimeoutTime_ADCAM" SG_ 1955 IBS3_Tm_Lst_Reset_Sec 0;
BA_ "GenSigTimeoutTime_SGW" SG_ 100 ControlEncodingReq 0;
BA_ "GenSigTimeoutTime_RFHM" SG_ 100 ControlEncodingReq 0;
BA_ "GenSigTimeoutTime_MPAD" SG_ 100 ControlEncodingReq 0;
BA_ "GenSigTimeoutTime_IPC" SG_ 100 ControlEncodingReq 0;
BA_ "GenSigTimeoutTime_GNMM" SG_ 100 ControlEncodingReq 0;
BA_ "GenSigTimeoutTime_EVCU2" SG_ 100 ControlEncodingReq 0;
BA_ "GenSigTimeoutTime_ESL" SG_ 100 ControlEncodingReq 0;
BA_ "GenSigTimeoutTime_ECM" SG_ 100 ControlEncodingReq 0;
BA_ "GenSigTimeoutTime_DTCM" SG_ 100 ControlEncodingReq 0;
BA_ "GenSigTimeoutTime_DMSM" SG_ 100 ControlEncodingReq 0;
BA_ "GenSigTimeoutTime_BSM" SG_ 100 ControlEncodingReq 0;
BA_ "GenSigTimeoutTime_AGSM" SG_ 100 ControlEncodingReq 0;
BA_ "GenSigTimeoutTime_ADCAM" SG_ 100 ControlEncodingReq 0;
BA_ "GenSigSendType" SG_ 100 ControlEncodingReq 1;
BA_ "GenSigTimeoutTime_SGW" SG_ 100 f1_1 0;
BA_ "GenSigTimeoutTime_RFHM" SG_ 100 f1_1 0;
BA_ "GenSigTimeoutTime_MPAD" SG_ 100 f1_1 0;
BA_ "GenSigTimeoutTime_IPC" SG_ 100 f1_1 0;
BA_ "GenSigTimeoutTime_GNMM" SG_ 100 f1_1 0;
BA_ "GenSigTimeoutTime_EVCU2" SG_ 100 f1_1 0;
BA_ "GenSigTimeoutTime_ESL" SG_ 100 f1_1 0;
BA_ "GenSigTimeoutTime_ECM" SG_ 100 f1_1 0;
BA_ "GenSigTimeoutTime_DTCM" SG_ 100 f1_1 0;
BA_ "GenSigTimeoutTime_DMSM" SG_ 100 f1_1 0;
BA_ "GenSigTimeoutTime_BSM" SG_ 100 f1_1 0;
BA_ "GenSigTimeoutTime_AGSM" SG_ 100 f1_1 0;
BA_ "GenSigTimeoutTime_ADCAM" SG_ 100 f1_1 0;
BA_ "GenSigTimeoutTime_SGW" SG_ 100 f1_2 0;
BA_ "GenSigTimeoutTime_RFHM" SG_ 100 f1_2 0;
BA_ "GenSigTimeoutTime_MPAD" SG_ 100 f1_2 0;
BA_ "GenSigTimeoutTime_IPC" SG_ 100 f1_2 0;
BA_ "GenSigTimeoutTime_GNMM" SG_ 100 f1_2 0;
BA_ "GenSigTimeoutTime_EVCU2" SG_ 100 f1_2 0;
BA_ "GenSigTimeoutTime_ESL" SG_ 100 f1_2 0;
BA_ "GenSigTimeoutTime_ECM" SG_ 100 f1_2 0;
BA_ "GenSigTimeoutTime_DTCM" SG_ 100 f1_2 0;
BA_ "GenSigTimeoutTime_DMSM" SG_ 100 f1_2 0;
BA_ "GenSigTimeoutTime_BSM" SG_ 100 f1_2 0;
BA_ "GenSigTimeoutTime_AGSM" SG_ 100 f1_2 0;
BA_ "GenSigTimeoutTime_ADCAM" SG_ 100 f1_2 0;
BA_ "GenSigTimeoutTime_RFHM" SG_ 1955 IBS3_SOC 0;
BA_ "GenSigTimeoutTime_IPC" SG_ 1955 IBS3_SOC 0;
BA_ "GenSigTimeoutTime_GNMM" SG_ 1955 IBS3_SOC 0;
BA_ "GenSigTimeoutTime_ESL" SG_ 1955 IBS3_SOC 0;
BA_ "GenSigTimeoutTime_DTCM" SG_ 1955 IBS3_SOC 0;
BA_ "GenSigTimeoutTime_DMSM" SG_ 1955 IBS3_SOC 0;
BA_ "GenSigTimeoutTime_BSM" SG_ 1955 IBS3_SOC 0;
BA_ "GenSigTimeoutTime_BCM" SG_ 1955 IBS3_SOC 0;
BA_ "GenSigTimeoutTime_AGSM" SG_ 1955 IBS3_SOC 0;
BA_ "GenSigStartValue" SG_ 1955 IBS3_SOC 127;
BA_ "GenSigTimeoutTime_RFHM" SG_ 1955 IBS3_T_BATT 0;
BA_ "GenSigTimeoutTime_MPAD" SG_ 1955 IBS3_T_BATT 0;
BA_ "GenSigTimeoutTime_IPC" SG_ 1955 IBS3_T_BATT 0;
BA_ "GenSigTimeoutTime_GNMM" SG_ 1955 IBS3_T_BATT 0;
BA_ "GenSigTimeoutTime_ESL" SG_ 1955 IBS3_T_BATT 0;
BA_ "GenSigTimeoutTime_DTCM" SG_ 1955 IBS3_T_BATT 0;
BA_ "GenSigTimeoutTime_DMSM" SG_ 1955 IBS3_T_BATT 0;
BA_ "GenSigTimeoutTime_BSM" SG_ 1955 IBS3_T_BATT 0;
BA_ "GenSigTimeoutTime_BCM" SG_ 1955 IBS3_T_BATT 0;
BA_ "GenSigTimeoutTime_AGSM" SG_ 1955 IBS3_T_BATT 0;
BA_ "GenSigTimeoutTime_ADCAM" SG_ 1955 IBS3_T_BATT 0;
BA_ "GenSigStartValue" SG_ 1955 IBS3_T_BATT 255;
BA_ "GenSigTimeoutTime_SGW" SG_ 1955 IBS3_SOF_Q 0;
BA_ "GenSigTimeoutTime_RFHM" SG_ 1955 IBS3_SOF_Q 0;
BA_ "GenSigTimeoutTime_MPAD" SG_ 1955 IBS3_SOF_Q 0;
BA_ "GenSigTimeoutTime_IPC" SG_ 1955 IBS3_SOF_Q 0;
BA_ "GenSigTimeoutTime_GNMM" SG_ 1955 IBS3_SOF_Q 0;
BA_ "GenSigTimeoutTime_ESL" SG_ 1955 IBS3_SOF_Q 0;
BA_ "GenSigTimeoutTime_ECM" SG_ 1955 IBS3_SOF_Q 0;
BA_ "GenSigTimeoutTime_DTCM" SG_ 1955 IBS3_SOF_Q 0;
BA_ "GenSigTimeoutTime_DMSM" SG_ 1955 IBS3_SOF_Q 0;
BA_ "GenSigTimeoutTime_BSM" SG_ 1955 IBS3_SOF_Q 0;
BA_ "GenSigTimeoutTime_BCM" SG_ 1955 IBS3_SOF_Q 0;
BA_ "GenSigTimeoutTime_AGSM" SG_ 1955 IBS3_SOF_Q 0;
BA_ "GenSigTimeoutTime_ADCAM" SG_ 1955 IBS3_SOF_Q 0;
BA_ "GenSigStartValue" SG_ 1955 IBS3_SOF_Q 255;
BA_ "GenSigTimeoutTime_SGW" SG_ 1955 IBS3_SOH_Q 0;
BA_ "GenSigTimeoutTime_RFHM" SG_ 1955 IBS3_SOH_Q 0;
BA_ "GenSigTimeoutTime_MPAD" SG_ 1955 IBS3_SOH_Q 0;
BA_ "GenSigTimeoutTime_IPC" SG_ 1955 IBS3_SOH_Q 0;
BA_ "GenSigTimeoutTime_GNMM" SG_ 1955 IBS3_SOH_Q 0;
BA_ "GenSigTimeoutTime_ESL" SG_ 1955 IBS3_SOH_Q 0;
BA_ "GenSigTimeoutTime_DTCM" SG_ 1955 IBS3_SOH_Q 0;
BA_ "GenSigTimeoutTime_DMSM" SG_ 1955 IBS3_SOH_Q 0;
BA_ "GenSigTimeoutTime_BSM" SG_ 1955 IBS3_SOH_Q 0;
BA_ "GenSigTimeoutTime_BCM" SG_ 1955 IBS3_SOH_Q 0;
BA_ "GenSigTimeoutTime_AGSM" SG_ 1955 IBS3_SOH_Q 0;
BA_ "GenSigTimeoutTime_ADCAM" SG_ 1955 IBS3_SOH_Q 0;
BA_ "GenSigStartValue" SG_ 1955 IBS3_SOH_Q 127;
BA_ "GenSigTimeoutTime_SGW" SG_ 1955 IBS3_Tm_Lst_Reset_Days 0;
BA_ "GenSigTimeoutTime_RFHM" SG_ 1955 IBS3_Tm_Lst_Reset_Days 0;
BA_ "GenSigTimeoutTime_MPAD" SG_ 1955 IBS3_Tm_Lst_Reset_Days 0;
BA_ "GenSigTimeoutTime_IPC" SG_ 1955 IBS3_Tm_Lst_Reset_Days 0;
BA_ "GenSigTimeoutTime_GNMM" SG_ 1955 IBS3_Tm_Lst_Reset_Days 0;
BA_ "GenSigTimeoutTime_ESL" SG_ 1955 IBS3_Tm_Lst_Reset_Days 0;
BA_ "GenSigTimeoutTime_ECM" SG_ 1955 IBS3_Tm_Lst_Reset_Days 0;
BA_ "GenSigTimeoutTime_DTCM" SG_ 1955 IBS3_Tm_Lst_Reset_Days 0;
BA_ "GenSigTimeoutTime_DMSM" SG_ 1955 IBS3_Tm_Lst_Reset_Days 0;
BA_ "GenSigTimeoutTime_BSM" SG_ 1955 IBS3_Tm_Lst_Reset_Days 0;
BA_ "GenSigTimeoutTime_BCM" SG_ 1955 IBS3_Tm_Lst_Reset_Days 0;
BA_ "GenSigTimeoutTime_AGSM" SG_ 1955 IBS3_Tm_Lst_Reset_Days 0;
BA_ "GenSigTimeoutTime_ADCAM" SG_ 1955 IBS3_Tm_Lst_Reset_Days 0;
BA_ "GenSigTimeoutTime_SGW" SG_ 1955 IBS3_R_Batt_25 0;
BA_ "GenSigTimeoutTime_RFHM" SG_ 1955 IBS3_R_Batt_25 0;
BA_ "GenSigTimeoutTime_MPAD" SG_ 1955 IBS3_R_Batt_25 0;
BA_ "GenSigTimeoutTime_IPC" SG_ 1955 IBS3_R_Batt_25 0;
BA_ "GenSigTimeoutTime_GNMM" SG_ 1955 IBS3_R_Batt_25 0;
BA_ "GenSigTimeoutTime_ESL" SG_ 1955 IBS3_R_Batt_25 0;
BA_ "GenSigTimeoutTime_ECM" SG_ 1955 IBS3_R_Batt_25 0;
BA_ "GenSigTimeoutTime_DTCM" SG_ 1955 IBS3_R_Batt_25 0;
BA_ "GenSigTimeoutTime_DMSM" SG_ 1955 IBS3_R_Batt_25 0;
BA_ "GenSigTimeoutTime_BSM" SG_ 1955 IBS3_R_Batt_25 0;
BA_ "GenSigTimeoutTime_BCM" SG_ 1955 IBS3_R_Batt_25 0;
BA_ "GenSigTimeoutTime_AGSM" SG_ 1955 IBS3_R_Batt_25 0;
BA_ "GenSigTimeoutTime_ADCAM" SG_ 1955 IBS3_R_Batt_25 0;
BA_ "GenSigStartValue" SG_ 1955 IBS3_R_Batt_25 255;
BA_ "GenSigTimeoutTime_SGW" SG_ 1955 IBS3_R_Batt 0;
BA_ "GenSigTimeoutTime_RFHM" SG_ 1955 IBS3_R_Batt 0;
BA_ "GenSigTimeoutTime_MPAD" SG_ 1955 IBS3_R_Batt 0;
BA_ "GenSigTimeoutTime_IPC" SG_ 1955 IBS3_R_Batt 0;
BA_ "GenSigTimeoutTime_GNMM" SG_ 1955 IBS3_R_Batt 0;
BA_ "GenSigTimeoutTime_ESL" SG_ 1955 IBS3_R_Batt 0;
BA_ "GenSigTimeoutTime_ECM" SG_ 1955 IBS3_R_Batt 0;
BA_ "GenSigTimeoutTime_DTCM" SG_ 1955 IBS3_R_Batt 0;
BA_ "GenSigTimeoutTime_DMSM" SG_ 1955 IBS3_R_Batt 0;
BA_ "GenSigTimeoutTime_BSM" SG_ 1955 IBS3_R_Batt 0;
BA_ "GenSigTimeoutTime_BCM" SG_ 1955 IBS3_R_Batt 0;
BA_ "GenSigTimeoutTime_AGSM" SG_ 1955 IBS3_R_Batt 0;
BA_ "GenSigTimeoutTime_ADCAM" SG_ 1955 IBS3_R_Batt 0;
BA_ "GenSigStartValue" SG_ 1955 IBS3_R_Batt 255;
BA_ "GenSigTimeoutTime_SGW" SG_ 1955 IBS3_Q_released 0;
BA_ "GenSigTimeoutTime_RFHM" SG_ 1955 IBS3_Q_released 0;
BA_ "GenSigTimeoutTime_MPAD" SG_ 1955 IBS3_Q_released 0;
BA_ "GenSigTimeoutTime_IPC" SG_ 1955 IBS3_Q_released 0;
BA_ "GenSigTimeoutTime_GNMM" SG_ 1955 IBS3_Q_released 0;
BA_ "GenSigTimeoutTime_ESL" SG_ 1955 IBS3_Q_released 0;
BA_ "GenSigTimeoutTime_ECM" SG_ 1955 IBS3_Q_released 0;
BA_ "GenSigTimeoutTime_DTCM" SG_ 1955 IBS3_Q_released 0;
BA_ "GenSigTimeoutTime_DMSM" SG_ 1955 IBS3_Q_released 0;
BA_ "GenSigTimeoutTime_BSM" SG_ 1955 IBS3_Q_released 0;
BA_ "GenSigTimeoutTime_BCM" SG_ 1955 IBS3_Q_released 0;
BA_ "GenSigTimeoutTime_AGSM" SG_ 1955 IBS3_Q_released 0;
BA_ "GenSigTimeoutTime_ADCAM" SG_ 1955 IBS3_Q_released 0;
BA_ "GenSigStartValue" SG_ 1955 IBS3_Q_released 65535;
BA_ "GenSigTimeoutTime_SGW" SG_ 1955 IBS3_Q_received 0;
BA_ "GenSigTimeoutTime_RFHM" SG_ 1955 IBS3_Q_received 0;
BA_ "GenSigTimeoutTime_MPAD" SG_ 1955 IBS3_Q_received 0;
BA_ "GenSigTimeoutTime_IPC" SG_ 1955 IBS3_Q_received 0;
BA_ "GenSigTimeoutTime_GNMM" SG_ 1955 IBS3_Q_received 0;
BA_ "GenSigTimeoutTime_ESL" SG_ 1955 IBS3_Q_received 0;
BA_ "GenSigTimeoutTime_ECM" SG_ 1955 IBS3_Q_received 0;
BA_ "GenSigTimeoutTime_DTCM" SG_ 1955 IBS3_Q_received 0;
BA_ "GenSigTimeoutTime_DMSM" SG_ 1955 IBS3_Q_received 0;
BA_ "GenSigTimeoutTime_BSM" SG_ 1955 IBS3_Q_received 0;
BA_ "GenSigTimeoutTime_BCM" SG_ 1955 IBS3_Q_received 0;
BA_ "GenSigTimeoutTime_AGSM" SG_ 1955 IBS3_Q_received 0;
BA_ "GenSigTimeoutTime_ADCAM" SG_ 1955 IBS3_Q_received 0;
BA_ "GenSigStartValue" SG_ 1955 IBS3_Q_received 65535;
BA_ "GenSigTimeoutTime_SGW" SG_ 104 ImmoParkReq 0;
BA_ "GenSigTimeoutTime_RFHM" SG_ 104 ImmoParkReq 0;
BA_ "GenSigTimeoutTime_MPAD" SG_ 104 ImmoParkReq 0;
BA_ "GenSigTimeoutTime_IPC" SG_ 104 ImmoParkReq 0;
BA_ "GenSigTimeoutTime_GNMM" SG_ 104 ImmoParkReq 0;
BA_ "GenSigTimeoutTime_ESL" SG_ 104 ImmoParkReq 0;
BA_ "GenSigTimeoutTime_ECM" SG_ 104 ImmoParkReq 0;
BA_ "GenSigTimeoutTime_DTCM" SG_ 104 ImmoParkReq 0;
BA_ "GenSigTimeoutTime_DMSM" SG_ 104 ImmoParkReq 0;
BA_ "GenSigTimeoutTime_BSM" SG_ 104 ImmoParkReq 0;
BA_ "GenSigTimeoutTime_BCM" SG_ 104 ImmoParkReq 0;
BA_ "GenSigTimeoutTime_AGSM" SG_ 104 ImmoParkReq 0;
BA_ "GenSigTimeoutTime_ADCAM" SG_ 104 ImmoParkReq 0;
BA_ "GenSigTimeoutTime_SGW" SG_ 248 ProgrammedSts_ESL 0;
BA_ "GenSigTimeoutTime_RFHM" SG_ 248 ProgrammedSts_ESL 0;
BA_ "GenSigTimeoutTime_MPAD" SG_ 248 ProgrammedSts_ESL 0;
BA_ "GenSigTimeoutTime_IPC" SG_ 248 ProgrammedSts_ESL 0;
BA_ "GenSigTimeoutTime_GNMM" SG_ 248 ProgrammedSts_ESL 0;
BA_ "GenSigTimeoutTime_EVCU2" SG_ 248 ProgrammedSts_ESL 0;
BA_ "GenSigTimeoutTime_ESL" SG_ 248 ProgrammedSts_ESL 0;
BA_ "GenSigTimeoutTime_ECM" SG_ 248 ProgrammedSts_ESL 0;
BA_ "GenSigTimeoutTime_DTCM" SG_ 248 ProgrammedSts_ESL 0;
BA_ "GenSigTimeoutTime_DMSM" SG_ 248 ProgrammedSts_ESL 0;
BA_ "GenSigTimeoutTime_BSM" SG_ 248 ProgrammedSts_ESL 0;
BA_ "GenSigTimeoutTime_BCM" SG_ 248 ProgrammedSts_ESL 0;
BA_ "GenSigTimeoutTime_AGSM" SG_ 248 ProgrammedSts_ESL 0;
BA_ "GenSigTimeoutTime_ADCAM" SG_ 248 ProgrammedSts_ESL 0;
BA_ "GenSigTimeoutTime_SGW" SG_ 248 MiniCryptGCode_ESL_Rsp 0;
BA_ "GenSigTimeoutTime_RFHM" SG_ 248 MiniCryptGCode_ESL_Rsp 0;
BA_ "GenSigTimeoutTime_MPAD" SG_ 248 MiniCryptGCode_ESL_Rsp 0;
BA_ "GenSigTimeoutTime_IPC" SG_ 248 MiniCryptGCode_ESL_Rsp 0;
BA_ "GenSigTimeoutTime_GNMM" SG_ 248 MiniCryptGCode_ESL_Rsp 0;
BA_ "GenSigTimeoutTime_EVCU2" SG_ 248 MiniCryptGCode_ESL_Rsp 0;
BA_ "GenSigTimeoutTime_ESL" SG_ 248 MiniCryptGCode_ESL_Rsp 0;
BA_ "GenSigTimeoutTime_ECM" SG_ 248 MiniCryptGCode_ESL_Rsp 0;
BA_ "GenSigTimeoutTime_DTCM" SG_ 248 MiniCryptGCode_ESL_Rsp 0;
BA_ "GenSigTimeoutTime_DMSM" SG_ 248 MiniCryptGCode_ESL_Rsp 0;
BA_ "GenSigTimeoutTime_BSM" SG_ 248 MiniCryptGCode_ESL_Rsp 0;
BA_ "GenSigTimeoutTime_AGSM" SG_ 248 MiniCryptGCode_ESL_Rsp 0;
BA_ "GenSigTimeoutTime_ADCAM" SG_ 248 MiniCryptGCode_ESL_Rsp 0;
BA_ "GenSigTimeoutTime_SGW" SG_ 248 ESLUnlockFailSts 0;
BA_ "GenSigTimeoutTime_RFHM" SG_ 248 ESLUnlockFailSts 0;
BA_ "GenSigTimeoutTime_MPAD" SG_ 248 ESLUnlockFailSts 0;
BA_ "GenSigTimeoutTime_IPC" SG_ 248 ESLUnlockFailSts 0;
BA_ "GenSigTimeoutTime_GNMM" SG_ 248 ESLUnlockFailSts 0;
BA_ "GenSigTimeoutTime_EVCU2" SG_ 248 ESLUnlockFailSts 0;
BA_ "GenSigTimeoutTime_ESL" SG_ 248 ESLUnlockFailSts 0;
BA_ "GenSigTimeoutTime_ECM" SG_ 248 ESLUnlockFailSts 0;
BA_ "GenSigTimeoutTime_DTCM" SG_ 248 ESLUnlockFailSts 0;
BA_ "GenSigTimeoutTime_DMSM" SG_ 248 ESLUnlockFailSts 0;
BA_ "GenSigTimeoutTime_BSM" SG_ 248 ESLUnlockFailSts 0;
BA_ "GenSigTimeoutTime_AGSM" SG_ 248 ESLUnlockFailSts 0;
BA_ "GenSigTimeoutTime_ADCAM" SG_ 248 ESLUnlockFailSts 0;
BA_ "GenSigTimeoutTime_SGW" SG_ 248 ESLLockFailSts 0;
BA_ "GenSigTimeoutTime_RFHM" SG_ 248 ESLLockFailSts 0;
BA_ "GenSigTimeoutTime_MPAD" SG_ 248 ESLLockFailSts 0;
BA_ "GenSigTimeoutTime_IPC" SG_ 248 ESLLockFailSts 0;
BA_ "GenSigTimeoutTime_GNMM" SG_ 248 ESLLockFailSts 0;
BA_ "GenSigTimeoutTime_EVCU2" SG_ 248 ESLLockFailSts 0;
BA_ "GenSigTimeoutTime_ESL" SG_ 248 ESLLockFailSts 0;
BA_ "GenSigTimeoutTime_ECM" SG_ 248 ESLLockFailSts 0;
BA_ "GenSigTimeoutTime_DTCM" SG_ 248 ESLLockFailSts 0;
BA_ "GenSigTimeoutTime_DMSM" SG_ 248 ESLLockFailSts 0;
BA_ "GenSigTimeoutTime_DTCM" SG_ 611 SBR1RowDriverSeatSts 0;
BA_ "GenSigTimeoutTime_DMSM" SG_ 611 SBR1RowDriverSeatSts 0;
BA_ "GenSigTimeoutTime_BSM" SG_ 611 SBR1RowDriverSeatSts 0;
BA_ "GenSigTimeoutTime_BCM" SG_ 611 SBR1RowDriverSeatSts 0;
BA_ "GenSigTimeoutTime_AGSM" SG_ 611 SBR1RowDriverSeatSts 0;
BA_ "GenSigTimeoutTime_ADCAM" SG_ 611 SBR1RowDriverSeatSts 0;
BA_ "GenSigSendType" SG_ 611 SBR1RowDriverSeatSts 3;
BA_ "GenSigStartValue" SG_ 611 SBR1RowDriverSeatSts 3;
BA_ "GenSigTimeoutTime_ESL" SG_ 611 SBR1RowDriverSeatConfigSts 0;
BA_ "GenSigTimeoutTime_ECM" SG_ 611 SBR1RowDriverSeatConfigSts 0;
BA_ "GenSigTimeoutTime_DTCM" SG_ 611 SBR1RowDriverSeatConfigSts 0;
BA_ "GenSigTimeoutTime_DMSM" SG_ 611 SBR1RowDriverSeatConfigSts 0;
BA_ "GenSigTimeoutTime_BSM" SG_ 611 SBR1RowDriverSeatConfigSts 0;
BA_ "GenSigTimeoutTime_BCM" SG_ 611 SBR1RowDriverSeatConfigSts 0;
BA_ "GenSigTimeoutTime_AGSM" SG_ 611 SBR1RowDriverSeatConfigSts 0;
BA_ "GenSigTimeoutTime_ADCAM" SG_ 611 SBR1RowDriverSeatConfigSts 0;
BA_ "GenSigTimeoutTime_SGW" SG_ 611 SBR1RowDriverSeatConfigSts 0;
BA_ "GenSigTimeoutTime_RFHM" SG_ 611 SBR1RowDriverSeatConfigSts 0;
BA_ "GenSigTimeoutTime_MPAD" SG_ 611 SBR1RowDriverSeatConfigSts 0;
BA_ "GenSigTimeoutTime_GNMM" SG_ 611 SBR1RowDriverSeatConfigSts 0;
BA_ "GenSigTimeoutTime_EVCU2" SG_ 611 SBR1RowDriverSeatConfigSts 0;
BA_ "GenSigTimeoutTime_SGW" SG_ 1058 BarPrsAbsV 0;
BA_ "GenSigTimeoutTime_RFHM" SG_ 1058 BarPrsAbsV 0;
BA_ "GenSigTimeoutTime_MPAD" SG_ 1058 BarPrsAbsV 0;
BA_ "GenSigTimeoutTime_IPC" SG_ 1058 BarPrsAbsV 0;
BA_ "GenSigTimeoutTime_GNMM" SG_ 1058 BarPrsAbsV 0;
BA_ "GenSigTimeoutTime_ESL" SG_ 1058 BarPrsAbsV 0;
BA_ "GenSigTimeoutTime_ECM" SG_ 1058 BarPrsAbsV 0;
BA_ "GenSigTimeoutTime_DTCM" SG_ 1058 BarPrsAbsV 0;
BA_ "GenSigTimeoutTime_DMSM" SG_ 1058 BarPrsAbsV 0;
BA_ "GenSigTimeoutTime_BSM" SG_ 1058 BarPrsAbsV 0;
BA_ "GenSigTimeoutTime_BCM" SG_ 1058 BarPrsAbsV 0;
BA_ "GenSigTimeoutTime_AGSM" SG_ 1058 BarPrsAbsV 0;
BA_ "GenSigTimeoutTime_ADCAM" SG_ 1058 BarPrsAbsV 0;
BA_ "GenSigTimeoutTime_SGW" SG_ 1058 BarPrsAbs 0;
BA_ "GenSigTimeoutTime_RFHM" SG_ 1058 BarPrsAbs 0;
BA_ "GenSigTimeoutTime_MPAD" SG_ 1058 BarPrsAbs 0;
BA_ "GenSigTimeoutTime_IPC" SG_ 1058 BarPrsAbs 0;
BA_ "GenSigTimeoutTime_GNMM" SG_ 1058 BarPrsAbs 0;
BA_ "GenSigTimeoutTime_ESL" SG_ 1058 BarPrsAbs 0;
BA_ "GenSigTimeoutTime_ECM" SG_ 1058 BarPrsAbs 0;
BA_ "GenSigTimeoutTime_DTCM" SG_ 1058 BarPrsAbs 0;
BA_ "GenSigTimeoutTime_DMSM" SG_ 1058 BarPrsAbs 0;
BA_ "GenSigTimeoutTime_BSM" SG_ 1058 BarPrsAbs 0;
BA_ "GenSigTimeoutTime_BCM" SG_ 1058 BarPrsAbs 0;
BA_ "GenSigTimeoutTime_AGSM" SG_ 1058 BarPrsAbs 0;
BA_ "GenSigTimeoutTime_ADCAM" SG_ 1058 BarPrsAbs 0;
BA_ "GenSigTimeoutTime_RFHM" SG_ 1432 TravelingTimeBPlus_Second 0;
BA_ "GenSigTimeoutTime_MPAD" SG_ 1432 TravelingTimeBPlus_Second 0;
BA_ "GenSigTimeoutTime_IPC" SG_ 1432 TravelingTimeBPlus_Second 0;
BA_ "GenSigTimeoutTime_GNMM" SG_ 1432 TravelingTimeBPlus_Second 0;
BA_ "GenSigTimeoutTime_EVCU2" SG_ 1432 TravelingTimeBPlus_Second 0;
BA_ "GenSigTimeoutTime_ESL" SG_ 1432 TravelingTimeBPlus_Second 0;
BA_ "GenSigTimeoutTime_ECM" SG_ 1432 TravelingTimeBPlus_Second 0;
BA_ "GenSigTimeoutTime_DTCM" SG_ 1432 TravelingTimeBPlus_Second 0;
BA_ "GenSigTimeoutTime_DMSM" SG_ 1432 TravelingTimeBPlus_Second 0;
BA_ "GenSigTimeoutTime_BSM" SG_ 1432 TravelingTimeBPlus_Second 0;
BA_ "GenSigTimeoutTime_BCM" SG_ 1432 TravelingTimeBPlus_Second 0;
BA_ "GenSigTimeoutTime_AGSM" SG_ 1432 TravelingTimeBPlus_Second 0;
BA_ "GenSigTimeoutTime_ADCAM" SG_ 1432 TravelingTimeBPlus_Second 0;
BA_ "GenSigTimeoutTime_RFHM" SG_ 1432 TravelingTimeBPlus_Minute 0;
BA_ "GenSigTimeoutTime_MPAD" SG_ 1432 TravelingTimeBPlus_Minute 0;
BA_ "GenSigTimeoutTime_IPC" SG_ 1432 TravelingTimeBPlus_Minute 0;
BA_ "GenSigTimeoutTime_GNMM" SG_ 1432 TravelingTimeBPlus_Minute 0;
BA_ "GenSigTimeoutTime_EVCU2" SG_ 1432 TravelingTimeBPlus_Minute 0;
BA_ "GenSigTimeoutTime_ESL" SG_ 1432 TravelingTimeBPlus_Minute 0;
BA_ "GenSigTimeoutTime_ECM" SG_ 1432 TravelingTimeBPlus_Minute 0;
BA_ "GenSigTimeoutTime_DTCM" SG_ 1432 TravelingTimeBPlus_Minute 0;
BA_ "GenSigTimeoutTime_DMSM" SG_ 1432 TravelingTimeBPlus_Minute 0;
BA_ "GenSigTimeoutTime_BSM" SG_ 1432 TravelingTimeBPlus_Minute 0;
BA_ "GenSigTimeoutTime_BCM" SG_ 1432 TravelingTimeBPlus_Minute 0;
BA_ "GenSigTimeoutTime_AGSM" SG_ 1432 TravelingTimeBPlus_Minute 0;
BA_ "GenSigTimeoutTime_ADCAM" SG_ 1432 TravelingTimeBPlus_Minute 0;
BA_ "GenSigSendType" SG_ 1432 TravelingTimeBPlus_Minute 3;
BA_ "GenSigTimeoutTime_RFHM" SG_ 1432 TravelingTimeBPlus_Hour 0;
BA_ "GenSigTimeoutTime_MPAD" SG_ 1432 TravelingTimeBPlus_Hour 0;
BA_ "GenSigTimeoutTime_IPC" SG_ 1432 TravelingTimeBPlus_Hour 0;
BA_ "GenSigTimeoutTime_GNMM" SG_ 1432 TravelingTimeBPlus_Hour 0;
BA_ "GenSigTimeoutTime_EVCU2" SG_ 1432 TravelingTimeBPlus_Hour 0;
BA_ "GenSigTimeoutTime_ESL" SG_ 1432 TravelingTimeBPlus_Hour 0;
BA_ "GenSigTimeoutTime_ECM" SG_ 1432 TravelingTimeBPlus_Hour 0;
BA_ "GenSigTimeoutTime_DTCM" SG_ 1432 TravelingTimeBPlus_Hour 0;
BA_ "GenSigTimeoutTime_DMSM" SG_ 1432 TravelingTimeBPlus_Hour 0;
BA_ "GenSigTimeoutTime_BSM" SG_ 1432 TravelingTimeBPlus_Hour 0;
BA_ "GenSigTimeoutTime_BCM" SG_ 1432 TravelingTimeBPlus_Hour 0;
BA_ "GenSigTimeoutTime_AGSM" SG_ 1432 TravelingTimeBPlus_Hour 0;
BA_ "GenSigTimeoutTime_ADCAM" SG_ 1432 TravelingTimeBPlus_Hour 0;
BA_ "GenSigSendType" SG_ 1432 TravelingTimeBPlus_Hour 3;
BA_ "GenSigTimeoutTime_RFHM" SG_ 1432 TravelingTimeAPlus_Second 0;
BA_ "GenSigTimeoutTime_MPAD" SG_ 1432 TravelingTimeAPlus_Second 0;
BA_ "GenSigTimeoutTime_IPC" SG_ 1432 TravelingTimeAPlus_Second 0;
BA_ "GenSigTimeoutTime_GNMM" SG_ 1432 TravelingTimeAPlus_Second 0;
BA_ "GenSigTimeoutTime_EVCU2" SG_ 1432 TravelingTimeAPlus_Second 0;
BA_ "GenSigTimeoutTime_ESL" SG_ 1432 TravelingTimeAPlus_Second 0;
BA_ "GenSigTimeoutTime_ECM" SG_ 1432 TravelingTimeAPlus_Second 0;
BA_ "GenSigTimeoutTime_DTCM" SG_ 1432 TravelingTimeAPlus_Second 0;
BA_ "GenSigTimeoutTime_DMSM" SG_ 1432 TravelingTimeAPlus_Second 0;
BA_ "GenSigTimeoutTime_BSM" SG_ 1432 TravelingTimeAPlus_Second 0;
BA_ "GenSigTimeoutTime_BCM" SG_ 1432 TravelingTimeAPlus_Second 0;
BA_ "GenSigTimeoutTime_AGSM" SG_ 1432 TravelingTimeAPlus_Second 0;
BA_ "GenSigTimeoutTime_ADCAM" SG_ 1432 TravelingTimeAPlus_Second 0;
BA_ "GenSigTimeoutTime_RFHM" SG_ 1432 TravelingTimeAPlus_Minute 0;
BA_ "GenSigTimeoutTime_MPAD" SG_ 1432 TravelingTimeAPlus_Minute 0;
BA_ "GenSigTimeoutTime_IPC" SG_ 1432 TravelingTimeAPlus_Minute 0;
BA_ "GenSigTimeoutTime_GNMM" SG_ 1432 TravelingTimeAPlus_Minute 0;
BA_ "GenSigTimeoutTime_EVCU2" SG_ 1432 TravelingTimeAPlus_Minute 0;
BA_ "GenSigTimeoutTime_ESL" SG_ 1432 TravelingTimeAPlus_Minute 0;
BA_ "GenSigTimeoutTime_ECM" SG_ 1432 TravelingTimeAPlus_Minute 0;
BA_ "GenSigTimeoutTime_DTCM" SG_ 1432 TravelingTimeAPlus_Minute 0;
BA_ "GenSigTimeoutTime_DMSM" SG_ 1432 TravelingTimeAPlus_Minute 0;
BA_ "GenSigTimeoutTime_BSM" SG_ 1432 TravelingTimeAPlus_Minute 0;
BA_ "GenSigTimeoutTime_BCM" SG_ 1432 TravelingTimeAPlus_Minute 0;
BA_ "GenSigTimeoutTime_AGSM" SG_ 1432 TravelingTimeAPlus_Minute 0;
BA_ "GenSigTimeoutTime_ADCAM" SG_ 1432 TravelingTimeAPlus_Minute 0;
BA_ "GenSigSendType" SG_ 1432 TravelingTimeAPlus_Minute 3;
BA_ "GenSigTimeoutTime_RFHM" SG_ 1432 TravelingTimeAPlus_Hour 0;
BA_ "GenSigTimeoutTime_MPAD" SG_ 1432 TravelingTimeAPlus_Hour 0;
BA_ "GenSigTimeoutTime_IPC" SG_ 1432 TravelingTimeAPlus_Hour 0;
BA_ "GenSigTimeoutTime_GNMM" SG_ 1432 TravelingTimeAPlus_Hour 0;
BA_ "GenSigTimeoutTime_EVCU2" SG_ 1432 TravelingTimeAPlus_Hour 0;
BA_ "GenSigTimeoutTime_ESL" SG_ 1432 TravelingTimeAPlus_Hour 0;
BA_ "GenSigTimeoutTime_ECM" SG_ 1432 TravelingTimeAPlus_Hour 0;
BA_ "GenSigTimeoutTime_DTCM" SG_ 1432 TravelingTimeAPlus_Hour 0;
BA_ "GenSigTimeoutTime_DMSM" SG_ 1432 TravelingTimeAPlus_Hour 0;
BA_ "GenSigTimeoutTime_BSM" SG_ 1432 TravelingTimeAPlus_Hour 0;
BA_ "GenSigTimeoutTime_BCM" SG_ 1432 TravelingTimeAPlus_Hour 0;
BA_ "GenSigTimeoutTime_AGSM" SG_ 1432 TravelingTimeAPlus_Hour 0;
BA_ "GenSigTimeoutTime_ADCAM" SG_ 1432 TravelingTimeAPlus_Hour 0;
BA_ "GenSigSendType" SG_ 1432 TravelingTimeAPlus_Hour 3;
BA_ "GenSigTimeoutTime_RFHM" SG_ 1432 PartialOdometerAPlus 0;
BA_ "GenSigTimeoutTime_MPAD" SG_ 1432 PartialOdometerAPlus 0;
BA_ "GenSigTimeoutTime_IPC" SG_ 1432 PartialOdometerAPlus 0;
BA_ "GenSigTimeoutTime_GNMM" SG_ 1432 PartialOdometerAPlus 0;
BA_ "GenSigTimeoutTime_EVCU2" SG_ 1432 PartialOdometerAPlus 0;
BA_ "GenSigTimeoutTime_ESL" SG_ 1432 PartialOdometerAPlus 0;
BA_ "GenSigTimeoutTime_ECM" SG_ 1432 PartialOdometerAPlus 0;
BA_ "GenSigTimeoutTime_SGW" SG_ 274 StbmTimestampSec_ORC 0;
BA_ "GenSigTimeoutTime_RFHM" SG_ 274 StbmTimestampSec_ORC 0;
BA_ "GenSigTimeoutTime_IPC" SG_ 274 StbmTimestampSec_ORC 0;
BA_ "GenSigTimeoutTime_GNMM" SG_ 274 StbmTimestampSec_ORC 0;
BA_ "GenSigTimeoutTime_EVCU2" SG_ 274 StbmTimestampSec_ORC 0;
BA_ "GenSigTimeoutTime_ESL" SG_ 274 StbmTimestampSec_ORC 0;
BA_ "GenSigTimeoutTime_ECM" SG_ 274 StbmTimestampSec_ORC 0;
BA_ "GenSigTimeoutTime_DTCM" SG_ 274 StbmTimestampSec_ORC 0;
BA_ "GenSigTimeoutTime_DMSM" SG_ 274 StbmTimestampSec_ORC 0;
BA_ "GenSigTimeoutTime_BSM" SG_ 274 StbmTimestampSec_ORC 0;
BA_ "GenSigTimeoutTime_BCM" SG_ 274 StbmTimestampSec_ORC 0;
BA_ "GenSigTimeoutTime_AGSM" SG_ 274 StbmTimestampSec_ORC 0;
BA_ "GenSigTimeoutTime_ADCAM" SG_ 274 StbmTimestampSec_ORC 0;
BA_ "GenSigTimeoutTime_SGW" SG_ 274 StbmTimestampNSec_ORC 0;
BA_ "GenSigTimeoutTime_RFHM" SG_ 274 StbmTimestampNSec_ORC 0;
BA_ "GenSigTimeoutTime_IPC" SG_ 274 StbmTimestampNSec_ORC 0;
BA_ "GenSigTimeoutTime_GNMM" SG_ 274 StbmTimestampNSec_ORC 0;
BA_ "GenSigTimeoutTime_EVCU2" SG_ 274 StbmTimestampNSec_ORC 0;
BA_ "GenSigTimeoutTime_ESL" SG_ 274 StbmTimestampNSec_ORC 0;
BA_ "GenSigTimeoutTime_ECM" SG_ 274 StbmTimestampNSec_ORC 0;
BA_ "GenSigTimeoutTime_DTCM" SG_ 274 StbmTimestampNSec_ORC 0;
BA_ "GenSigTimeoutTime_DMSM" SG_ 274 StbmTimestampNSec_ORC 0;
BA_ "GenSigTimeoutTime_BSM" SG_ 274 StbmTimestampNSec_ORC 0;
BA_ "GenSigTimeoutTime_BCM" SG_ 274 StbmTimestampNSec_ORC 0;
BA_ "GenSigTimeoutTime_AGSM" SG_ 274 StbmTimestampNSec_ORC 0;
BA_ "GenSigTimeoutTime_ADCAM" SG_ 274 StbmTimestampNSec_ORC 0;
BA_ "GenSigTimeoutTime_SGW" SG_ 274 StbmSyncState_ORC 0;
BA_ "GenSigTimeoutTime_RFHM" SG_ 274 StbmSyncState_ORC 0;
BA_ "GenSigTimeoutTime_IPC" SG_ 274 StbmSyncState_ORC 0;
BA_ "GenSigTimeoutTime_GNMM" SG_ 274 StbmSyncState_ORC 0;
BA_ "GenSigTimeoutTime_EVCU2" SG_ 274 StbmSyncState_ORC 0;
BA_ "GenSigTimeoutTime_ESL" SG_ 274 StbmSyncState_ORC 0;
BA_ "GenSigTimeoutTime_ECM" SG_ 274 StbmSyncState_ORC 0;
BA_ "GenSigTimeoutTime_DTCM" SG_ 274 StbmSyncState_ORC 0;
BA_ "GenSigTimeoutTime_DMSM" SG_ 274 StbmSyncState_ORC 0;
BA_ "GenSigTimeoutTime_BSM" SG_ 274 StbmSyncState_ORC 0;
BA_ "GenSigTimeoutTime_BCM" SG_ 274 StbmSyncState_ORC 0;
BA_ "GenSigTimeoutTime_AGSM" SG_ 274 StbmSyncState_ORC 0;
BA_ "GenSigTimeoutTime_ADCAM" SG_ 274 StbmSyncState_ORC 0;
BA_ "GenSigStartValue" SG_ 274 StbmSyncState_ORC 255;
BA_ "GenSigTimeoutTime_SGW" SG_ 1432 MessageCounter_IPC6 0;
BA_ "GenSigTimeoutTime_RFHM" SG_ 1432 MessageCounter_IPC6 0;
BA_ "GenSigTimeoutTime_IPC" SG_ 1432 MessageCounter_IPC6 0;
BA_ "GenSigTimeoutTime_GNMM" SG_ 1432 MessageCounter_IPC6 0;
BA_ "GenSigTimeoutTime_EVCU2" SG_ 1432 MessageCounter_IPC6 0;
BA_ "GenSigTimeoutTime_ESL" SG_ 1432 MessageCounter_IPC6 0;
BA_ "GenSigTimeoutTime_ECM" SG_ 1432 MessageCounter_IPC6 0;
BA_ "GenSigTimeoutTime_DTCM" SG_ 1432 MessageCounter_IPC6 0;
BA_ "GenSigTimeoutTime_DMSM" SG_ 1432 MessageCounter_IPC6 0;
BA_ "GenSigTimeoutTime_BSM" SG_ 1432 MessageCounter_IPC6 0;
BA_ "GenSigTimeoutTime_AGSM" SG_ 1432 MessageCounter_IPC6 0;
BA_ "GenSigTimeoutTime_ADCAM" SG_ 1432 MessageCounter_IPC6 0;
BA_ "GenSigTimeoutTime_SGW" SG_ 1432 PowerMode_RQ 0;
BA_ "GenSigTimeoutTime_RFHM" SG_ 1432 PowerMode_RQ 0;
BA_ "GenSigTimeoutTime_MPAD" SG_ 1432 PowerMode_RQ 0;
BA_ "GenSigTimeoutTime_IPC" SG_ 1432 PowerMode_RQ 0;
BA_ "GenSigTimeoutTime_GNMM" SG_ 1432 PowerMode_RQ 0;
BA_ "GenSigTimeoutTime_EVCU2" SG_ 1432 PowerMode_RQ 0;
BA_ "GenSigTimeoutTime_ESL" SG_ 1432 PowerMode_RQ 0;
BA_ "GenSigTimeoutTime_ECM" SG_ 1432 PowerMode_RQ 0;
BA_ "GenSigTimeoutTime_DTCM" SG_ 1432 PowerMode_RQ 0;
BA_ "GenSigTimeoutTime_DMSM" SG_ 1432 PowerMode_RQ 0;
BA_ "GenSigTimeoutTime_BSM" SG_ 1432 PowerMode_RQ 0;
BA_ "GenSigTimeoutTime_AGSM" SG_ 1432 PowerMode_RQ 0;
BA_ "GenSigTimeoutTime_ADCAM" SG_ 1432 PowerMode_RQ 0;
BA_ "GenSigSendType" SG_ 1432 PowerMode_RQ 3;
BA_ "GenSigTimeoutTime_RFHM" SG_ 1154 Est_Range_Disp_Long 0;
BA_ "GenSigTimeoutTime_MPAD" SG_ 1154 Est_Range_Disp_Long 0;
BA_ "GenSigTimeoutTime_IPC" SG_ 1154 Est_Range_Disp_Long 0;
BA_ "GenSigTimeoutTime_GNMM" SG_ 1154 Est_Range_Disp_Long 0;
BA_ "GenSigTimeoutTime_EVCU2" SG_ 1154 Est_Range_Disp_Long 0;
BA_ "GenSigTimeoutTime_ESL" SG_ 1154 Est_Range_Disp_Long 0;
BA_ "GenSigTimeoutTime_ECM" SG_ 1154 Est_Range_Disp_Long 0;
BA_ "GenSigTimeoutTime_DTCM" SG_ 1154 Est_Range_Disp_Long 0;
BA_ "GenSigTimeoutTime_DMSM" SG_ 1154 Est_Range_Disp_Long 0;
BA_ "GenSigTimeoutTime_BSM" SG_ 1154 Est_Range_Disp_Long 0;
BA_ "GenSigTimeoutTime_BCM" SG_ 1154 Est_Range_Disp_Long 0;
BA_ "GenSigTimeoutTime_AGSM" SG_ 1154 Est_Range_Disp_Long 0;
BA_ "GenSigTimeoutTime_ADCAM" SG_ 1154 Est_Range_Disp_Long 0;
BA_ "GenSigTimeoutTime_RFHM" SG_ 1432 AverageFuelConsumptionBPlus 0;
BA_ "GenSigTimeoutTime_MPAD" SG_ 1432 AverageFuelConsumptionBPlus 0;
BA_ "GenSigTimeoutTime_IPC" SG_ 1432 AverageFuelConsumptionBPlus 0;
BA_ "GenSigTimeoutTime_GNMM" SG_ 1432 AverageFuelConsumptionBPlus 0;
BA_ "GenSigTimeoutTime_EVCU2" SG_ 1432 AverageFuelConsumptionBPlus 0;
BA_ "GenSigTimeoutTime_ESL" SG_ 1432 AverageFuelConsumptionBPlus 0;
BA_ "GenSigTimeoutTime_ECM" SG_ 1432 AverageFuelConsumptionBPlus 0;
BA_ "GenSigTimeoutTime_DTCM" SG_ 1432 AverageFuelConsumptionBPlus 0;
BA_ "GenSigTimeoutTime_DMSM" SG_ 1432 AverageFuelConsumptionBPlus 0;
BA_ "GenSigTimeoutTime_BSM" SG_ 1432 AverageFuelConsumptionBPlus 0;
BA_ "GenSigTimeoutTime_BCM" SG_ 1432 AverageFuelConsumptionBPlus 0;
BA_ "GenSigTimeoutTime_AGSM" SG_ 1432 AverageFuelConsumptionBPlus 0;
BA_ "GenSigTimeoutTime_ADCAM" SG_ 1432 AverageFuelConsumptionBPlus 0;
BA_ "GenSigSendType" SG_ 1432 AverageFuelConsumptionBPlus 3;
BA_ "GenSigTimeoutTime_RFHM" SG_ 1432 AverageFuelConsumptionAPlus 0;
BA_ "GenSigTimeoutTime_MPAD" SG_ 1432 AverageFuelConsumptionAPlus 0;
BA_ "GenSigTimeoutTime_IPC" SG_ 1432 AverageFuelConsumptionAPlus 0;
BA_ "GenSigTimeoutTime_GNMM" SG_ 1432 AverageFuelConsumptionAPlus 0;
BA_ "GenSigTimeoutTime_EVCU2" SG_ 1432 AverageFuelConsumptionAPlus 0;
BA_ "GenSigTimeoutTime_ESL" SG_ 1432 AverageFuelConsumptionAPlus 0;
BA_ "GenSigTimeoutTime_ECM" SG_ 1432 AverageFuelConsumptionAPlus 0;
BA_ "GenSigTimeoutTime_DTCM" SG_ 1432 AverageFuelConsumptionAPlus 0;
BA_ "GenSigTimeoutTime_DMSM" SG_ 1432 AverageFuelConsumptionAPlus 0;
BA_ "GenSigTimeoutTime_BSM" SG_ 1432 AverageFuelConsumptionAPlus 0;
BA_ "GenSigTimeoutTime_BCM" SG_ 1432 AverageFuelConsumptionAPlus 0;
BA_ "GenSigTimeoutTime_AGSM" SG_ 1432 AverageFuelConsumptionAPlus 0;
BA_ "GenSigTimeoutTime_ADCAM" SG_ 1432 AverageFuelConsumptionAPlus 0;
BA_ "GenSigSendType" SG_ 1432 AverageFuelConsumptionAPlus 3;
BA_ "GenSigTimeoutTime_SGW" SG_ 1432 CRC_IPC6 0;
BA_ "GenSigTimeoutTime_RFHM" SG_ 1432 CRC_IPC6 0;
BA_ "GenSigTimeoutTime_IPC" SG_ 1432 CRC_IPC6 0;
BA_ "GenSigTimeoutTime_GNMM" SG_ 1432 CRC_IPC6 0;
BA_ "GenSigTimeoutTime_EVCU2" SG_ 1432 CRC_IPC6 0;
BA_ "GenSigTimeoutTime_ESL" SG_ 1432 CRC_IPC6 0;
BA_ "GenSigTimeoutTime_ECM" SG_ 1432 CRC_IPC6 0;
BA_ "GenSigTimeoutTime_DTCM" SG_ 1432 CRC_IPC6 0;
BA_ "GenSigTimeoutTime_DMSM" SG_ 1432 CRC_IPC6 0;
BA_ "GenSigTimeoutTime_BSM" SG_ 1432 CRC_IPC6 0;
BA_ "GenSigTimeoutTime_AGSM" SG_ 1432 CRC_IPC6 0;
BA_ "GenSigTimeoutTime_ADCAM" SG_ 1432 CRC_IPC6 0;
BA_ "GenSigTimeoutTime_RFHM" SG_ 1154 Est_Range_Disp 0;
BA_ "GenSigTimeoutTime_MPAD" SG_ 1154 Est_Range_Disp 0;
BA_ "GenSigTimeoutTime_IPC" SG_ 1154 Est_Range_Disp 0;
BA_ "GenSigTimeoutTime_GNMM" SG_ 1154 Est_Range_Disp 0;
BA_ "GenSigTimeoutTime_EVCU2" SG_ 1154 Est_Range_Disp 0;
BA_ "GenSigTimeoutTime_ESL" SG_ 1154 Est_Range_Disp 0;
BA_ "GenSigTimeoutTime_ECM" SG_ 1154 Est_Range_Disp 0;
BA_ "GenSigTimeoutTime_DTCM" SG_ 1154 Est_Range_Disp 0;
BA_ "GenSigTimeoutTime_DMSM" SG_ 1154 Est_Range_Disp 0;
BA_ "GenSigTimeoutTime_BSM" SG_ 1154 Est_Range_Disp 0;
BA_ "GenSigTimeoutTime_BCM" SG_ 1154 Est_Range_Disp 0;
BA_ "GenSigTimeoutTime_AGSM" SG_ 1154 Est_Range_Disp 0;
BA_ "GenSigTimeoutTime_ADCAM" SG_ 1154 Est_Range_Disp 0;
BA_ "GenSigTimeoutTime_RFHM" SG_ 600 DisplayedSpeedLimSts 0;
BA_ "GenSigTimeoutTime_MPAD" SG_ 600 DisplayedSpeedLimSts 0;
BA_ "GenSigTimeoutTime_IPC" SG_ 600 DisplayedSpeedLimSts 0;
BA_ "GenSigTimeoutTime_GNMM" SG_ 600 DisplayedSpeedLimSts 0;
BA_ "GenSigTimeoutTime_ESL" SG_ 600 DisplayedSpeedLimSts 0;
BA_ "GenSigTimeoutTime_ECM" SG_ 600 DisplayedSpeedLimSts 0;
BA_ "GenSigTimeoutTime_DTCM" SG_ 600 DisplayedSpeedLimSts 0;
BA_ "GenSigTimeoutTime_DMSM" SG_ 600 DisplayedSpeedLimSts 0;
BA_ "GenSigTimeoutTime_BSM" SG_ 600 DisplayedSpeedLimSts 0;
BA_ "GenSigTimeoutTime_AGSM" SG_ 600 DisplayedSpeedLimSts 0;
BA_ "GenSigTimeoutTime_ADCAM" SG_ 600 DisplayedSpeedLimSts 0;
BA_ "GenSigSendType" SG_ 600 DisplayedSpeedLimSts 3;
BA_ "GenSigTimeoutTime_SGW" SG_ 1432 HAS_SoH_IPC 0;
BA_ "GenSigTimeoutTime_RFHM" SG_ 1432 HAS_SoH_IPC 0;
BA_ "GenSigTimeoutTime_IPC" SG_ 1432 HAS_SoH_IPC 0;
BA_ "GenSigTimeoutTime_GNMM" SG_ 1432 HAS_SoH_IPC 0;
BA_ "GenSigTimeoutTime_EVCU2" SG_ 1432 HAS_SoH_IPC 0;
BA_ "GenSigTimeoutTime_ESL" SG_ 1432 HAS_SoH_IPC 0;
BA_ "GenSigTimeoutTime_ECM" SG_ 1432 HAS_SoH_IPC 0;
BA_ "GenSigTimeoutTime_DTCM" SG_ 1432 HAS_SoH_IPC 0;
BA_ "GenSigTimeoutTime_DMSM" SG_ 1432 HAS_SoH_IPC 0;
BA_ "GenSigTimeoutTime_BSM" SG_ 1432 HAS_SoH_IPC 0;
BA_ "GenSigTimeoutTime_AGSM" SG_ 1432 HAS_SoH_IPC 0;
BA_ "GenSigTimeoutTime_ADCAM" SG_ 1432 HAS_SoH_IPC 0;
BA_ "GenSigSendType" SG_ 1432 HAS_SoH_IPC 3;
BA_ "GenSigTimeoutTime_SGW" SG_ 1441 DTE_Ave_Fuel_Econ 0;
BA_ "GenSigTimeoutTime_RFHM" SG_ 1441 DTE_Ave_Fuel_Econ 0;
BA_ "GenSigTimeoutTime_MPAD" SG_ 1441 DTE_Ave_Fuel_Econ 0;
BA_ "GenSigTimeoutTime_IPC" SG_ 1441 DTE_Ave_Fuel_Econ 0;
BA_ "GenSigTimeoutTime_GNMM" SG_ 1441 DTE_Ave_Fuel_Econ 0;
BA_ "GenSigTimeoutTime_EVCU2" SG_ 1441 DTE_Ave_Fuel_Econ 0;
BA_ "GenSigTimeoutTime_ESL" SG_ 1441 DTE_Ave_Fuel_Econ 0;
BA_ "GenSigTimeoutTime_ECM" SG_ 1441 DTE_Ave_Fuel_Econ 0;
BA_ "GenSigTimeoutTime_DTCM" SG_ 1441 DTE_Ave_Fuel_Econ 0;
BA_ "GenSigTimeoutTime_DMSM" SG_ 1441 DTE_Ave_Fuel_Econ 0;
BA_ "GenSigTimeoutTime_BSM" SG_ 1441 DTE_Ave_Fuel_Econ 0;
BA_ "GenSigTimeoutTime_BCM" SG_ 1441 DTE_Ave_Fuel_Econ 0;
BA_ "GenSigTimeoutTime_AGSM" SG_ 1441 DTE_Ave_Fuel_Econ 0;
BA_ "GenSigTimeoutTime_ADCAM" SG_ 1441 DTE_Ave_Fuel_Econ 0;
BA_ "GenSigSendType" SG_ 1441 DTE_Ave_Fuel_Econ 3;
BA_ "GenSigStartValue" SG_ 1441 DTE_Ave_Fuel_Econ 1023;
BA_ "GenSigTimeoutTime_SGW" SG_ 1955 IBS3_SOH_COR 0;
BA_ "GenSigTimeoutTime_RFHM" SG_ 1955 IBS3_SOH_COR 0;
BA_ "GenSigTimeoutTime_MPAD" SG_ 1955 IBS3_SOH_COR 0;
BA_ "GenSigTimeoutTime_IPC" SG_ 1955 IBS3_SOH_COR 0;
BA_ "GenSigTimeoutTime_GNMM" SG_ 1955 IBS3_SOH_COR 0;
BA_ "GenSigTimeoutTime_ESL" SG_ 1955 IBS3_SOH_COR 0;
BA_ "GenSigTimeoutTime_ECM" SG_ 1955 IBS3_SOH_COR 0;
BA_ "GenSigTimeoutTime_DTCM" SG_ 1955 IBS3_SOH_COR 0;
BA_ "GenSigTimeoutTime_DMSM" SG_ 1955 IBS3_SOH_COR 0;
BA_ "GenSigTimeoutTime_BSM" SG_ 1955 IBS3_SOH_COR 0;
BA_ "GenSigTimeoutTime_BCM" SG_ 1955 IBS3_SOH_COR 0;
BA_ "GenSigTimeoutTime_AGSM" SG_ 1955 IBS3_SOH_COR 0;
BA_ "GenSigTimeoutTime_ADCAM" SG_ 1955 IBS3_SOH_COR 0;
BA_ "GenSigStartValue" SG_ 1955 IBS3_SOH_COR 127;
BA_ "GenSigTimeoutTime_SGW" SG_ 1955 IBS3_SOH_SUL 0;
BA_ "GenSigTimeoutTime_RFHM" SG_ 1955 IBS3_SOH_SUL 0;
BA_ "GenSigTimeoutTime_MPAD" SG_ 1955 IBS3_SOH_SUL 0;
BA_ "GenSigTimeoutTime_IPC" SG_ 1955 IBS3_SOH_SUL 0;
BA_ "GenSigTimeoutTime_GNMM" SG_ 1955 IBS3_SOH_SUL 0;
BA_ "GenSigTimeoutTime_ESL" SG_ 1955 IBS3_SOH_SUL 0;
BA_ "GenSigTimeoutTime_ECM" SG_ 1955 IBS3_SOH_SUL 0;
BA_ "GenSigTimeoutTime_DTCM" SG_ 1955 IBS3_SOH_SUL 0;
BA_ "GenSigTimeoutTime_DMSM" SG_ 1955 IBS3_SOH_SUL 0;
BA_ "GenSigTimeoutTime_BSM" SG_ 1955 IBS3_SOH_SUL 0;
BA_ "GenSigTimeoutTime_BCM" SG_ 1955 IBS3_SOH_SUL 0;
BA_ "GenSigTimeoutTime_AGSM" SG_ 1955 IBS3_SOH_SUL 0;
BA_ "GenSigTimeoutTime_ADCAM" SG_ 1955 IBS3_SOH_SUL 0;
BA_ "GenSigStartValue" SG_ 1955 IBS3_SOH_SUL 127;
BA_ "GenSigTimeoutTime_RFHM" SG_ 1955 IBS3_TempFailStatus 0;
BA_ "GenSigTimeoutTime_MPAD" SG_ 1955 IBS3_TempFailStatus 0;
BA_ "GenSigTimeoutTime_IPC" SG_ 1955 IBS3_TempFailStatus 0;
BA_ "GenSigTimeoutTime_GNMM" SG_ 1955 IBS3_TempFailStatus 0;
BA_ "GenSigTimeoutTime_ESL" SG_ 1955 IBS3_TempFailStatus 0;
BA_ "GenSigTimeoutTime_DTCM" SG_ 1955 IBS3_TempFailStatus 0;
BA_ "GenSigTimeoutTime_DMSM" SG_ 1955 IBS3_TempFailStatus 0;
BA_ "GenSigTimeoutTime_BSM" SG_ 1955 IBS3_TempFailStatus 0;
BA_ "GenSigTimeoutTime_BCM" SG_ 1955 IBS3_TempFailStatus 0;
BA_ "GenSigTimeoutTime_AGSM" SG_ 1955 IBS3_TempFailStatus 0;
BA_ "GenSigTimeoutTime_ADCAM" SG_ 1955 IBS3_TempFailStatus 0;
BA_ "GenSigTimeoutTime_SGW" SG_ 1955 IBS3_SOH_SUL_Accuracy 0;
BA_ "GenSigTimeoutTime_RFHM" SG_ 1955 IBS3_SOH_SUL_Accuracy 0;
BA_ "GenSigTimeoutTime_MPAD" SG_ 1955 IBS3_SOH_SUL_Accuracy 0;
BA_ "GenSigTimeoutTime_IPC" SG_ 1955 IBS3_SOH_SUL_Accuracy 0;
BA_ "GenSigTimeoutTime_GNMM" SG_ 1955 IBS3_SOH_SUL_Accuracy 0;
BA_ "GenSigTimeoutTime_ESL" SG_ 1955 IBS3_SOH_SUL_Accuracy 0;
BA_ "GenSigTimeoutTime_ECM" SG_ 1955 IBS3_SOH_SUL_Accuracy 0;
BA_ "GenSigTimeoutTime_DTCM" SG_ 1955 IBS3_SOH_SUL_Accuracy 0;
BA_ "GenSigTimeoutTime_DMSM" SG_ 1955 IBS3_SOH_SUL_Accuracy 0;
BA_ "GenSigTimeoutTime_BSM" SG_ 1955 IBS3_SOH_SUL_Accuracy 0;
BA_ "GenSigTimeoutTime_BCM" SG_ 1955 IBS3_SOH_SUL_Accuracy 0;
BA_ "GenSigTimeoutTime_AGSM" SG_ 1955 IBS3_SOH_SUL_Accuracy 0;
BA_ "GenSigTimeoutTime_ADCAM" SG_ 1955 IBS3_SOH_SUL_Accuracy 0;
BA_ "GenSigTimeoutTime_GNMM" SG_ 1955 IBS3_SOC_Accuracy 0;
BA_ "GenSigTimeoutTime_ESL" SG_ 1955 IBS3_SOC_Accuracy 0;
BA_ "GenSigTimeoutTime_ECM" SG_ 1955 IBS3_SOC_Accuracy 0;
BA_ "GenSigTimeoutTime_DTCM" SG_ 1955 IBS3_SOC_Accuracy 0;
BA_ "GenSigTimeoutTime_DMSM" SG_ 1955 IBS3_SOC_Accuracy 0;
BA_ "GenSigTimeoutTime_BSM" SG_ 1955 IBS3_SOC_Accuracy 0;
BA_ "GenSigTimeoutTime_BCM" SG_ 1955 IBS3_SOC_Accuracy 0;
BA_ "GenSigTimeoutTime_AGSM" SG_ 1955 IBS3_SOC_Accuracy 0;
BA_ "GenSigTimeoutTime_ADCAM" SG_ 1955 IBS3_SOC_Accuracy 0;
BA_ "GenSigTimeoutTime_RFHM" SG_ 1955 IBS3_SOC_Accuracy 0;
BA_ "GenSigTimeoutTime_MPAD" SG_ 1955 IBS3_SOC_Accuracy 0;
BA_ "GenSigTimeoutTime_IPC" SG_ 1955 IBS3_SOC_Accuracy 0;
BA_ "GenSigTimeoutTime_SGW" SG_ 1955 IBS3_SOF_Q_Accuracy 0;
BA_ "GenSigTimeoutTime_RFHM" SG_ 1955 IBS3_SOF_Q_Accuracy 0;
BA_ "GenSigTimeoutTime_MPAD" SG_ 1955 IBS3_SOF_Q_Accuracy 0;
BA_ "GenSigTimeoutTime_IPC" SG_ 1955 IBS3_SOF_Q_Accuracy 0;
BA_ "GenSigTimeoutTime_GNMM" SG_ 1955 IBS3_SOF_Q_Accuracy 0;
BA_ "GenSigTimeoutTime_ESL" SG_ 1955 IBS3_SOF_Q_Accuracy 0;
BA_ "GenSigTimeoutTime_ECM" SG_ 1955 IBS3_SOF_Q_Accuracy 0;
BA_ "GenSigTimeoutTime_DTCM" SG_ 1955 IBS3_SOF_Q_Accuracy 0;
BA_ "GenSigTimeoutTime_DMSM" SG_ 1955 IBS3_SOF_Q_Accuracy 0;
BA_ "GenSigTimeoutTime_BSM" SG_ 1955 IBS3_SOF_Q_Accuracy 0;
BA_ "GenSigTimeoutTime_BCM" SG_ 1955 IBS3_SOF_Q_Accuracy 0;
BA_ "GenSigTimeoutTime_AGSM" SG_ 1955 IBS3_SOF_Q_Accuracy 0;
BA_ "GenSigTimeoutTime_ADCAM" SG_ 1955 IBS3_SOF_Q_Accuracy 0;
BA_ "GenSigTimeoutTime_SGW" SG_ 1955 IBS3_SOH_COR_Accuracy 0;
BA_ "GenSigTimeoutTime_RFHM" SG_ 1955 IBS3_SOH_COR_Accuracy 0;
BA_ "GenSigTimeoutTime_MPAD" SG_ 1955 IBS3_SOH_COR_Accuracy 0;
BA_ "GenSigTimeoutTime_IPC" SG_ 1955 IBS3_SOH_COR_Accuracy 0;
BA_ "GenSigTimeoutTime_GNMM" SG_ 1955 IBS3_SOH_COR_Accuracy 0;
BA_ "GenSigTimeoutTime_ESL" SG_ 1955 IBS3_SOH_COR_Accuracy 0;
BA_ "GenSigTimeoutTime_ECM" SG_ 1955 IBS3_SOH_COR_Accuracy 0;
BA_ "GenSigTimeoutTime_DTCM" SG_ 1955 IBS3_SOH_COR_Accuracy 0;
BA_ "GenSigTimeoutTime_DMSM" SG_ 1955 IBS3_SOH_COR_Accuracy 0;
BA_ "GenSigTimeoutTime_BSM" SG_ 1955 IBS3_SOH_COR_Accuracy 0;
BA_ "GenSigTimeoutTime_BCM" SG_ 1955 IBS3_SOH_COR_Accuracy 0;
BA_ "GenSigTimeoutTime_AGSM" SG_ 1955 IBS3_SOH_COR_Accuracy 0;
BA_ "GenSigTimeoutTime_ADCAM" SG_ 1955 IBS3_SOH_COR_Accuracy 0;
BA_ "GenSigTimeoutTime_SGW" SG_ 1955 IBS3_SOH_Q_Accuracy 0;
BA_ "GenSigTimeoutTime_RFHM" SG_ 1955 IBS3_SOH_Q_Accuracy 0;
BA_ "GenSigTimeoutTime_MPAD" SG_ 1955 IBS3_SOH_Q_Accuracy 0;
BA_ "GenSigTimeoutTime_IPC" SG_ 1955 IBS3_SOH_Q_Accuracy 0;
BA_ "GenSigTimeoutTime_GNMM" SG_ 1955 IBS3_SOH_Q_Accuracy 0;
BA_ "GenSigTimeoutTime_ESL" SG_ 1955 IBS3_SOH_Q_Accuracy 0;
BA_ "GenSigTimeoutTime_DTCM" SG_ 1955 IBS3_SOH_Q_Accuracy 0;
BA_ "GenSigTimeoutTime_DMSM" SG_ 1955 IBS3_SOH_Q_Accuracy 0;
BA_ "GenSigTimeoutTime_BSM" SG_ 1955 IBS3_SOH_Q_Accuracy 0;
BA_ "GenSigTimeoutTime_BCM" SG_ 1955 IBS3_SOH_Q_Accuracy 0;
BA_ "GenSigTimeoutTime_AGSM" SG_ 1955 IBS3_SOH_Q_Accuracy 0;
BA_ "GenSigTimeoutTime_ADCAM" SG_ 1955 IBS3_SOH_Q_Accuracy 0;
BA_ "GenSigTimeoutTime_SGW" SG_ 1955 MessageCounter_IBS3DATA2 0;
BA_ "GenSigTimeoutTime_RFHM" SG_ 1955 MessageCounter_IBS3DATA2 0;
BA_ "GenSigTimeoutTime_IPC" SG_ 1955 MessageCounter_IBS3DATA2 0;
BA_ "GenSigTimeoutTime_GNMM" SG_ 1955 MessageCounter_IBS3DATA2 0;
BA_ "GenSigTimeoutTime_ESL" SG_ 1955 MessageCounter_IBS3DATA2 0;
BA_ "GenSigTimeoutTime_ECM" SG_ 1955 MessageCounter_IBS3DATA2 0;
BA_ "GenSigTimeoutTime_DTCM" SG_ 1955 MessageCounter_IBS3DATA2 0;
BA_ "GenSigTimeoutTime_DMSM" SG_ 1955 MessageCounter_IBS3DATA2 0;
BA_ "GenSigTimeoutTime_BSM" SG_ 1955 MessageCounter_IBS3DATA2 0;
BA_ "GenSigTimeoutTime_BCM" SG_ 1955 MessageCounter_IBS3DATA2 0;
BA_ "GenSigTimeoutTime_AGSM" SG_ 1955 MessageCounter_IBS3DATA2 0;
BA_ "GenSigTimeoutTime_ADCAM" SG_ 1955 MessageCounter_IBS3DATA2 0;
BA_ "GenSigTimeoutTime_SGW" SG_ 1955 CRC_IBS3DATA2 0;
BA_ "GenSigTimeoutTime_RFHM" SG_ 1955 CRC_IBS3DATA2 0;
BA_ "GenSigTimeoutTime_IPC" SG_ 1955 CRC_IBS3DATA2 0;
BA_ "GenSigTimeoutTime_GNMM" SG_ 1955 CRC_IBS3DATA2 0;
BA_ "GenSigTimeoutTime_ESL" SG_ 1955 CRC_IBS3DATA2 0;
BA_ "GenSigTimeoutTime_ECM" SG_ 1955 CRC_IBS3DATA2 0;
BA_ "GenSigTimeoutTime_DTCM" SG_ 1955 CRC_IBS3DATA2 0;
BA_ "GenSigTimeoutTime_DMSM" SG_ 1955 CRC_IBS3DATA2 0;
BA_ "GenSigTimeoutTime_BSM" SG_ 1955 CRC_IBS3DATA2 0;
BA_ "GenSigTimeoutTime_BCM" SG_ 1955 CRC_IBS3DATA2 0;
BA_ "GenSigTimeoutTime_AGSM" SG_ 1955 CRC_IBS3DATA2 0;
BA_ "GenSigTimeoutTime_ADCAM" SG_ 1955 CRC_IBS3DATA2 0;
BA_ "GenSigTimeoutTime_SGW" SG_ 1955 IBS3_FLAG_DISCONNECT 0;
BA_ "GenSigTimeoutTime_RFHM" SG_ 1955 IBS3_FLAG_DISCONNECT 0;
BA_ "GenSigTimeoutTime_MPAD" SG_ 1955 IBS3_FLAG_DISCONNECT 0;
BA_ "GenSigTimeoutTime_IPC" SG_ 1955 IBS3_FLAG_DISCONNECT 0;
BA_ "GenSigTimeoutTime_GNMM" SG_ 1955 IBS3_FLAG_DISCONNECT 0;
BA_ "GenSigTimeoutTime_ESL" SG_ 1955 IBS3_FLAG_DISCONNECT 0;
BA_ "GenSigTimeoutTime_DTCM" SG_ 1955 IBS3_FLAG_DISCONNECT 0;
BA_ "GenSigTimeoutTime_DMSM" SG_ 1955 IBS3_FLAG_DISCONNECT 0;
BA_ "GenSigTimeoutTime_BSM" SG_ 1955 IBS3_FLAG_DISCONNECT 0;
BA_ "GenSigTimeoutTime_BCM" SG_ 1955 IBS3_FLAG_DISCONNECT 0;
BA_ "GenSigTimeoutTime_AGSM" SG_ 1955 IBS3_FLAG_DISCONNECT 0;
BA_ "GenSigTimeoutTime_ADCAM" SG_ 1955 IBS3_FLAG_DISCONNECT 0;
BA_ "GenSigTimeoutTime_SGW" SG_ 1955 IBS3_CRC_IBS_1 0;
BA_ "GenSigTimeoutTime_RFHM" SG_ 1955 IBS3_CRC_IBS_1 0;
BA_ "GenSigTimeoutTime_IPC" SG_ 1955 IBS3_CRC_IBS_1 0;
BA_ "GenSigTimeoutTime_GNMM" SG_ 1955 IBS3_CRC_IBS_1 0;
BA_ "GenSigTimeoutTime_EVCU2" SG_ 1955 IBS3_CRC_IBS_1 0;
BA_ "GenSigTimeoutTime_ESL" SG_ 1955 IBS3_CRC_IBS_1 0;
BA_ "GenSigTimeoutTime_ECM" SG_ 1955 IBS3_CRC_IBS_1 0;
BA_ "GenSigTimeoutTime_DTCM" SG_ 1955 IBS3_CRC_IBS_1 0;
BA_ "GenSigTimeoutTime_DMSM" SG_ 1955 IBS3_CRC_IBS_1 0;
BA_ "GenSigTimeoutTime_BSM" SG_ 1955 IBS3_CRC_IBS_1 0;
BA_ "GenSigTimeoutTime_BCM" SG_ 1955 IBS3_CRC_IBS_1 0;
BA_ "GenSigTimeoutTime_AGSM" SG_ 1955 IBS3_CRC_IBS_1 0;
BA_ "GenSigTimeoutTime_ADCAM" SG_ 1955 IBS3_CRC_IBS_1 0;
BA_ "GenSigTimeoutTime_SGW" SG_ 1955 IBS3_CRC_IBS_2 0;
BA_ "GenSigTimeoutTime_RFHM" SG_ 1955 IBS3_CRC_IBS_2 0;
BA_ "GenSigTimeoutTime_IPC" SG_ 1955 IBS3_CRC_IBS_2 0;
BA_ "GenSigTimeoutTime_GNMM" SG_ 1955 IBS3_CRC_IBS_2 0;
BA_ "GenSigTimeoutTime_EVCU2" SG_ 1955 IBS3_CRC_IBS_2 0;
BA_ "GenSigTimeoutTime_ESL" SG_ 1955 IBS3_CRC_IBS_2 0;
BA_ "GenSigTimeoutTime_ECM" SG_ 1955 IBS3_CRC_IBS_2 0;
BA_ "GenSigTimeoutTime_DTCM" SG_ 1955 IBS3_CRC_IBS_2 0;
BA_ "GenSigTimeoutTime_DMSM" SG_ 1955 IBS3_CRC_IBS_2 0;
BA_ "GenSigTimeoutTime_BSM" SG_ 1955 IBS3_CRC_IBS_2 0;
BA_ "GenSigTimeoutTime_BCM" SG_ 1955 IBS3_CRC_IBS_2 0;
BA_ "GenSigTimeoutTime_AGSM" SG_ 1955 IBS3_CRC_IBS_2 0;
BA_ "GenSigTimeoutTime_ADCAM" SG_ 1955 IBS3_CRC_IBS_2 0;
BA_ "GenSigTimeoutTime_SGW" SG_ 1955 IBS3_MC_IBS_1 0;
BA_ "GenSigTimeoutTime_RFHM" SG_ 1955 IBS3_MC_IBS_1 0;
BA_ "GenSigTimeoutTime_IPC" SG_ 1955 IBS3_MC_IBS_1 0;
BA_ "GenSigTimeoutTime_GNMM" SG_ 1955 IBS3_MC_IBS_1 0;
BA_ "GenSigTimeoutTime_EVCU2" SG_ 1955 IBS3_MC_IBS_1 0;
BA_ "GenSigTimeoutTime_ESL" SG_ 1955 IBS3_MC_IBS_1 0;
BA_ "GenSigTimeoutTime_ECM" SG_ 1955 IBS3_MC_IBS_1 0;
BA_ "GenSigTimeoutTime_DTCM" SG_ 1955 IBS3_MC_IBS_1 0;
BA_ "GenSigTimeoutTime_DMSM" SG_ 1955 IBS3_MC_IBS_1 0;
BA_ "GenSigTimeoutTime_BSM" SG_ 1955 IBS3_MC_IBS_1 0;
BA_ "GenSigTimeoutTime_BCM" SG_ 1955 IBS3_MC_IBS_1 0;
BA_ "GenSigTimeoutTime_AGSM" SG_ 1955 IBS3_MC_IBS_1 0;
BA_ "GenSigTimeoutTime_ADCAM" SG_ 1955 IBS3_MC_IBS_1 0;
BA_ "GenSigTimeoutTime_SGW" SG_ 1955 IBS3_MC_IBS_2 0;
BA_ "GenSigTimeoutTime_RFHM" SG_ 1955 IBS3_MC_IBS_2 0;
BA_ "GenSigTimeoutTime_IPC" SG_ 1955 IBS3_MC_IBS_2 0;
BA_ "GenSigTimeoutTime_GNMM" SG_ 1955 IBS3_MC_IBS_2 0;
BA_ "GenSigTimeoutTime_EVCU2" SG_ 1955 IBS3_MC_IBS_2 0;
BA_ "GenSigTimeoutTime_ESL" SG_ 1955 IBS3_MC_IBS_2 0;
BA_ "GenSigTimeoutTime_ECM" SG_ 1955 IBS3_MC_IBS_2 0;
BA_ "GenSigTimeoutTime_DTCM" SG_ 1955 IBS3_MC_IBS_2 0;
BA_ "GenSigTimeoutTime_DMSM" SG_ 1955 IBS3_MC_IBS_2 0;
BA_ "GenSigTimeoutTime_BSM" SG_ 1955 IBS3_MC_IBS_2 0;
BA_ "GenSigTimeoutTime_BCM" SG_ 1955 IBS3_MC_IBS_2 0;
BA_ "GenSigTimeoutTime_AGSM" SG_ 1955 IBS3_MC_IBS_2 0;
BA_ "GenSigTimeoutTime_ADCAM" SG_ 1955 IBS3_MC_IBS_2 0;
BA_ "GenSigTimeoutTime_SGW" SG_ 1955 IBS3_FLAG_DISCONNECT_ADAS 0;
BA_ "GenSigTimeoutTime_RFHM" SG_ 1955 IBS3_FLAG_DISCONNECT_ADAS 0;
BA_ "GenSigTimeoutTime_IPC" SG_ 1955 IBS3_FLAG_DISCONNECT_ADAS 0;
BA_ "GenSigTimeoutTime_GNMM" SG_ 1955 IBS3_FLAG_DISCONNECT_ADAS 0;
BA_ "GenSigTimeoutTime_EVCU2" SG_ 1955 IBS3_FLAG_DISCONNECT_ADAS 0;
BA_ "GenSigTimeoutTime_ESL" SG_ 1955 IBS3_FLAG_DISCONNECT_ADAS 0;
BA_ "GenSigTimeoutTime_ECM" SG_ 1955 IBS3_FLAG_DISCONNECT_ADAS 0;
BA_ "GenSigTimeoutTime_DTCM" SG_ 1955 IBS3_FLAG_DISCONNECT_ADAS 0;
BA_ "GenSigTimeoutTime_DMSM" SG_ 1955 IBS3_FLAG_DISCONNECT_ADAS 0;
BA_ "GenSigTimeoutTime_BSM" SG_ 1955 IBS3_FLAG_DISCONNECT_ADAS 0;
BA_ "GenSigTimeoutTime_BCM" SG_ 1955 IBS3_FLAG_DISCONNECT_ADAS 0;
BA_ "GenSigTimeoutTime_AGSM" SG_ 1955 IBS3_FLAG_DISCONNECT_ADAS 0;
BA_ "GenSigTimeoutTime_ADCAM" SG_ 1955 IBS3_FLAG_DISCONNECT_ADAS 0;
BA_ "GenSigTimeoutTime_SGW" SG_ 1955 IBS3_FLAG_DISCONNECT_ADAS_2 0;
BA_ "GenSigTimeoutTime_RFHM" SG_ 1955 IBS3_FLAG_DISCONNECT_ADAS_2 0;
BA_ "GenSigTimeoutTime_IPC" SG_ 1955 IBS3_FLAG_DISCONNECT_ADAS_2 0;
BA_ "GenSigTimeoutTime_GNMM" SG_ 1955 IBS3_FLAG_DISCONNECT_ADAS_2 0;
BA_ "GenSigTimeoutTime_EVCU2" SG_ 1955 IBS3_FLAG_DISCONNECT_ADAS_2 0;
BA_ "GenSigTimeoutTime_ESL" SG_ 1955 IBS3_FLAG_DISCONNECT_ADAS_2 0;
BA_ "GenSigTimeoutTime_ECM" SG_ 1955 IBS3_FLAG_DISCONNECT_ADAS_2 0;
BA_ "GenSigTimeoutTime_DTCM" SG_ 1955 IBS3_FLAG_DISCONNECT_ADAS_2 0;
BA_ "GenSigTimeoutTime_DMSM" SG_ 1955 IBS3_FLAG_DISCONNECT_ADAS_2 0;
BA_ "GenSigTimeoutTime_BSM" SG_ 1955 IBS3_FLAG_DISCONNECT_ADAS_2 0;
BA_ "GenSigTimeoutTime_BCM" SG_ 1955 IBS3_FLAG_DISCONNECT_ADAS_2 0;
BA_ "GenSigTimeoutTime_AGSM" SG_ 1955 IBS3_FLAG_DISCONNECT_ADAS_2 0;
BA_ "GenSigTimeoutTime_ADCAM" SG_ 1955 IBS3_FLAG_DISCONNECT_ADAS_2 0;
BA_ "GenSigTimeoutTime_SGW" SG_ 1955 IBS3_IBS_ADAS_OK 0;
BA_ "GenSigTimeoutTime_RFHM" SG_ 1955 IBS3_IBS_ADAS_OK 0;
BA_ "GenSigTimeoutTime_IPC" SG_ 1955 IBS3_IBS_ADAS_OK 0;
BA_ "GenSigTimeoutTime_GNMM" SG_ 1955 IBS3_IBS_ADAS_OK 0;
BA_ "GenSigTimeoutTime_EVCU2" SG_ 1955 IBS3_IBS_ADAS_OK 0;
BA_ "GenSigTimeoutTime_ESL" SG_ 1955 IBS3_IBS_ADAS_OK 0;
BA_ "GenSigTimeoutTime_ECM" SG_ 1955 IBS3_IBS_ADAS_OK 0;
BA_ "GenSigTimeoutTime_DTCM" SG_ 1955 IBS3_IBS_ADAS_OK 0;
BA_ "GenSigTimeoutTime_DMSM" SG_ 1955 IBS3_IBS_ADAS_OK 0;
BA_ "GenSigTimeoutTime_BSM" SG_ 1955 IBS3_IBS_ADAS_OK 0;
BA_ "GenSigTimeoutTime_BCM" SG_ 1955 IBS3_IBS_ADAS_OK 0;
BA_ "GenSigTimeoutTime_AGSM" SG_ 1955 IBS3_IBS_ADAS_OK 0;
BA_ "GenSigTimeoutTime_ADCAM" SG_ 1955 IBS3_IBS_ADAS_OK 0;
BA_ "GenSigTimeoutTime_SGW" SG_ 1955 IBS3_IBS_ADAS_OK_2 0;
BA_ "GenSigTimeoutTime_RFHM" SG_ 1955 IBS3_IBS_ADAS_OK_2 0;
BA_ "GenSigTimeoutTime_IPC" SG_ 1955 IBS3_IBS_ADAS_OK_2 0;
BA_ "GenSigTimeoutTime_GNMM" SG_ 1955 IBS3_IBS_ADAS_OK_2 0;
BA_ "GenSigTimeoutTime_EVCU2" SG_ 1955 IBS3_IBS_ADAS_OK_2 0;
BA_ "GenSigTimeoutTime_ESL" SG_ 1955 IBS3_IBS_ADAS_OK_2 0;
BA_ "GenSigTimeoutTime_ECM" SG_ 1955 IBS3_IBS_ADAS_OK_2 0;
BA_ "GenSigTimeoutTime_DTCM" SG_ 1955 IBS3_IBS_ADAS_OK_2 0;
BA_ "GenSigTimeoutTime_DMSM" SG_ 1955 IBS3_IBS_ADAS_OK_2 0;
BA_ "GenSigTimeoutTime_BSM" SG_ 1955 IBS3_IBS_ADAS_OK_2 0;
BA_ "GenSigTimeoutTime_BCM" SG_ 1955 IBS3_IBS_ADAS_OK_2 0;
BA_ "GenSigTimeoutTime_AGSM" SG_ 1955 IBS3_IBS_ADAS_OK_2 0;
BA_ "GenSigTimeoutTime_ADCAM" SG_ 1955 IBS3_IBS_ADAS_OK_2 0;
BA_ "GenSigTimeoutTime_SGW" SG_ 611 CRC_ORC1 0;
BA_ "GenSigTimeoutTime_RFHM" SG_ 611 CRC_ORC1 0;
BA_ "GenSigTimeoutTime_GNMM" SG_ 611 CRC_ORC1 0;
BA_ "GenSigTimeoutTime_EVCU2" SG_ 611 CRC_ORC1 0;
BA_ "GenSigTimeoutTime_ESL" SG_ 611 CRC_ORC1 0;
BA_ "GenSigTimeoutTime_ECM" SG_ 611 CRC_ORC1 0;
BA_ "GenSigTimeoutTime_DTCM" SG_ 611 CRC_ORC1 0;
BA_ "GenSigTimeoutTime_DMSM" SG_ 611 CRC_ORC1 0;
BA_ "GenSigTimeoutTime_BSM" SG_ 611 CRC_ORC1 0;
BA_ "GenSigTimeoutTime_BCM" SG_ 611 CRC_ORC1 0;
BA_ "GenSigTimeoutTime_AGSM" SG_ 611 CRC_ORC1 0;
BA_ "GenSigTimeoutTime_ADCAM" SG_ 611 CRC_ORC1 0;
BA_ "GenSigTimeoutTime_SGW" SG_ 1058 OAT_PT_EstV 0;
BA_ "GenSigTimeoutTime_RFHM" SG_ 1058 OAT_PT_EstV 0;
BA_ "GenSigTimeoutTime_MPAD" SG_ 1058 OAT_PT_EstV 0;
BA_ "GenSigTimeoutTime_IPC" SG_ 1058 OAT_PT_EstV 0;
BA_ "GenSigTimeoutTime_GNMM" SG_ 1058 OAT_PT_EstV 0;
BA_ "GenSigTimeoutTime_ESL" SG_ 1058 OAT_PT_EstV 0;
BA_ "GenSigTimeoutTime_ECM" SG_ 1058 OAT_PT_EstV 0;
BA_ "GenSigTimeoutTime_DTCM" SG_ 1058 OAT_PT_EstV 0;
BA_ "GenSigTimeoutTime_DMSM" SG_ 1058 OAT_PT_EstV 0;
BA_ "GenSigTimeoutTime_BSM" SG_ 1058 OAT_PT_EstV 0;
BA_ "GenSigTimeoutTime_BCM" SG_ 1058 OAT_PT_EstV 0;
BA_ "GenSigTimeoutTime_AGSM" SG_ 1058 OAT_PT_EstV 0;
BA_ "GenSigTimeoutTime_ADCAM" SG_ 1058 OAT_PT_EstV 0;
BA_ "GenSigTimeoutTime_SGW" SG_ 1058 OAT_PT_Est 0;
BA_ "GenSigTimeoutTime_RFHM" SG_ 1058 OAT_PT_Est 0;
BA_ "GenSigTimeoutTime_MPAD" SG_ 1058 OAT_PT_Est 0;
BA_ "GenSigTimeoutTime_IPC" SG_ 1058 OAT_PT_Est 0;
BA_ "GenSigTimeoutTime_GNMM" SG_ 1058 OAT_PT_Est 0;
BA_ "GenSigTimeoutTime_ESL" SG_ 1058 OAT_PT_Est 0;
BA_ "GenSigTimeoutTime_ECM" SG_ 1058 OAT_PT_Est 0;
BA_ "GenSigTimeoutTime_DTCM" SG_ 1058 OAT_PT_Est 0;
BA_ "GenSigTimeoutTime_DMSM" SG_ 1058 OAT_PT_Est 0;
BA_ "GenSigTimeoutTime_BSM" SG_ 1058 OAT_PT_Est 0;
BA_ "GenSigTimeoutTime_BCM" SG_ 1058 OAT_PT_Est 0;
BA_ "GenSigTimeoutTime_AGSM" SG_ 1058 OAT_PT_Est 0;
BA_ "GenSigTimeoutTime_ADCAM" SG_ 1058 OAT_PT_Est 0;
BA_ "GenSigTimeoutTime_SGW" SG_ 1058 EstCatCnvTmp 0;
BA_ "GenSigTimeoutTime_RFHM" SG_ 1058 EstCatCnvTmp 0;
BA_ "GenSigTimeoutTime_MPAD" SG_ 1058 EstCatCnvTmp 0;
BA_ "GenSigTimeoutTime_IPC" SG_ 1058 EstCatCnvTmp 0;
BA_ "GenSigTimeoutTime_GNMM" SG_ 1058 EstCatCnvTmp 0;
BA_ "GenSigTimeoutTime_ESL" SG_ 1058 EstCatCnvTmp 0;
BA_ "GenSigTimeoutTime_ECM" SG_ 1058 EstCatCnvTmp 0;
BA_ "GenSigTimeoutTime_DTCM" SG_ 1058 EstCatCnvTmp 0;
BA_ "GenSigTimeoutTime_DMSM" SG_ 1058 EstCatCnvTmp 0;
BA_ "GenSigTimeoutTime_BSM" SG_ 1058 EstCatCnvTmp 0;
BA_ "GenSigTimeoutTime_BCM" SG_ 1058 EstCatCnvTmp 0;
BA_ "GenSigTimeoutTime_AGSM" SG_ 1058 EstCatCnvTmp 0;
BA_ "GenSigTimeoutTime_ADCAM" SG_ 1058 EstCatCnvTmp 0;
BA_ "GenSigTimeoutTime_SGW" SG_ 1058 EngIntAirTmpV 0;
BA_ "GenSigTimeoutTime_RFHM" SG_ 1058 EngIntAirTmpV 0;
BA_ "GenSigTimeoutTime_MPAD" SG_ 1058 EngIntAirTmpV 0;
BA_ "GenSigTimeoutTime_IPC" SG_ 1058 EngIntAirTmpV 0;
BA_ "GenSigTimeoutTime_GNMM" SG_ 1058 EngIntAirTmpV 0;
BA_ "GenSigTimeoutTime_ESL" SG_ 1058 EngIntAirTmpV 0;
BA_ "GenSigTimeoutTime_ECM" SG_ 1058 EngIntAirTmpV 0;
BA_ "GenSigTimeoutTime_DTCM" SG_ 1058 EngIntAirTmpV 0;
BA_ "GenSigTimeoutTime_DMSM" SG_ 1058 EngIntAirTmpV 0;
BA_ "GenSigTimeoutTime_BSM" SG_ 1058 EngIntAirTmpV 0;
BA_ "GenSigTimeoutTime_BCM" SG_ 1058 EngIntAirTmpV 0;
BA_ "GenSigTimeoutTime_AGSM" SG_ 1058 EngIntAirTmpV 0;
BA_ "GenSigTimeoutTime_ADCAM" SG_ 1058 EngIntAirTmpV 0;
BA_ "GenSigTimeoutTime_SGW" SG_ 1058 EngIntAirTmp 0;
BA_ "GenSigTimeoutTime_RFHM" SG_ 1058 EngIntAirTmp 0;
BA_ "GenSigTimeoutTime_MPAD" SG_ 1058 EngIntAirTmp 0;
BA_ "GenSigTimeoutTime_IPC" SG_ 1058 EngIntAirTmp 0;
BA_ "GenSigTimeoutTime_GNMM" SG_ 1058 EngIntAirTmp 0;
BA_ "GenSigTimeoutTime_ESL" SG_ 1058 EngIntAirTmp 0;
BA_ "GenSigTimeoutTime_ECM" SG_ 1058 EngIntAirTmp 0;
BA_ "GenSigTimeoutTime_DTCM" SG_ 1058 EngIntAirTmp 0;
BA_ "GenSigTimeoutTime_DMSM" SG_ 1058 EngIntAirTmp 0;
BA_ "GenSigTimeoutTime_BSM" SG_ 1058 EngIntAirTmp 0;
BA_ "GenSigTimeoutTime_BCM" SG_ 1058 EngIntAirTmp 0;
BA_ "GenSigTimeoutTime_AGSM" SG_ 1058 EngIntAirTmp 0;
BA_ "GenSigTimeoutTime_ADCAM" SG_ 1058 EngIntAirTmp 0;
BA_ "GenSigTimeoutTime_SGW" SG_ 1058 MessageCounter_OBDCONTENTFRAME 0;
BA_ "GenSigTimeoutTime_RFHM" SG_ 1058 MessageCounter_OBDCONTENTFRAME 0;
BA_ "GenSigTimeoutTime_MPAD" SG_ 1058 MessageCounter_OBDCONTENTFRAME 0;
BA_ "GenSigTimeoutTime_IPC" SG_ 1058 MessageCounter_OBDCONTENTFRAME 0;
BA_ "GenSigTimeoutTime_GNMM" SG_ 1058 MessageCounter_OBDCONTENTFRAME 0;
BA_ "GenSigTimeoutTime_ESL" SG_ 1058 MessageCounter_OBDCONTENTFRAME 0;
BA_ "GenSigTimeoutTime_ECM" SG_ 1058 MessageCounter_OBDCONTENTFRAME 0;
BA_ "GenSigTimeoutTime_DTCM" SG_ 1058 MessageCounter_OBDCONTENTFRAME 0;
BA_ "GenSigTimeoutTime_DMSM" SG_ 1058 MessageCounter_OBDCONTENTFRAME 0;
BA_ "GenSigTimeoutTime_BSM" SG_ 1058 MessageCounter_OBDCONTENTFRAME 0;
BA_ "GenSigTimeoutTime_BCM" SG_ 1058 MessageCounter_OBDCONTENTFRAME 0;
BA_ "GenSigTimeoutTime_AGSM" SG_ 1058 MessageCounter_OBDCONTENTFRAME 0;
BA_ "GenSigTimeoutTime_ADCAM" SG_ 1058 MessageCounter_OBDCONTENTFRAME 0;
BA_ "GenSigTimeoutTime_SGW" SG_ 1058 CRC_OBDCONTENTFRAME 0;
BA_ "GenSigTimeoutTime_RFHM" SG_ 1058 CRC_OBDCONTENTFRAME 0;
BA_ "GenSigTimeoutTime_MPAD" SG_ 1058 CRC_OBDCONTENTFRAME 0;
BA_ "GenSigTimeoutTime_IPC" SG_ 1058 CRC_OBDCONTENTFRAME 0;
BA_ "GenSigTimeoutTime_GNMM" SG_ 1058 CRC_OBDCONTENTFRAME 0;
BA_ "GenSigTimeoutTime_ESL" SG_ 1058 CRC_OBDCONTENTFRAME 0;
BA_ "GenSigTimeoutTime_ECM" SG_ 1058 CRC_OBDCONTENTFRAME 0;
BA_ "GenSigTimeoutTime_DTCM" SG_ 1058 CRC_OBDCONTENTFRAME 0;
BA_ "GenSigTimeoutTime_DMSM" SG_ 1058 CRC_OBDCONTENTFRAME 0;
BA_ "GenSigTimeoutTime_BSM" SG_ 1058 CRC_OBDCONTENTFRAME 0;
BA_ "GenSigTimeoutTime_BCM" SG_ 1058 CRC_OBDCONTENTFRAME 0;
BA_ "GenSigTimeoutTime_AGSM" SG_ 1058 CRC_OBDCONTENTFRAME 0;
BA_ "GenSigTimeoutTime_ADCAM" SG_ 1058 CRC_OBDCONTENTFRAME 0;
BA_ "GenSigTimeoutTime_SGW" SG_ 611 AirBagFailSts 0;
BA_ "GenSigTimeoutTime_RFHM" SG_ 611 AirBagFailSts 0;
BA_ "GenSigTimeoutTime_MPAD" SG_ 611 AirBagFailSts 0;
BA_ "GenSigTimeoutTime_GNMM" SG_ 611 AirBagFailSts 0;
BA_ "GenSigTimeoutTime_EVCU2" SG_ 611 AirBagFailSts 0;
BA_ "GenSigTimeoutTime_ESL" SG_ 611 AirBagFailSts 0;
BA_ "GenSigTimeoutTime_ECM" SG_ 611 AirBagFailSts 0;
BA_ "GenSigTimeoutTime_DTCM" SG_ 611 AirBagFailSts 0;
BA_ "GenSigTimeoutTime_DMSM" SG_ 611 AirBagFailSts 0;
BA_ "GenSigTimeoutTime_BSM" SG_ 611 AirBagFailSts 0;
BA_ "GenSigTimeoutTime_BCM" SG_ 611 AirBagFailSts 0;
BA_ "GenSigTimeoutTime_AGSM" SG_ 611 AirBagFailSts 0;
BA_ "GenSigTimeoutTime_ADCAM" SG_ 611 AirBagFailSts 0;
BA_ "GenSigStartValue" SG_ 611 AirBagFailSts 2;
BA_ "GenSigTimeoutTime_SGW" SG_ 1058 LoadOBD 0;
BA_ "GenSigTimeoutTime_RFHM" SG_ 1058 LoadOBD 0;
BA_ "GenSigTimeoutTime_MPAD" SG_ 1058 LoadOBD 0;
BA_ "GenSigTimeoutTime_IPC" SG_ 1058 LoadOBD 0;
BA_ "GenSigTimeoutTime_GNMM" SG_ 1058 LoadOBD 0;
BA_ "GenSigTimeoutTime_EVCU2" SG_ 1058 LoadOBD 0;
BA_ "GenSigTimeoutTime_ESL" SG_ 1058 LoadOBD 0;
BA_ "GenSigTimeoutTime_ECM" SG_ 1058 LoadOBD 0;
BA_ "GenSigTimeoutTime_DTCM" SG_ 1058 LoadOBD 0;
BA_ "GenSigTimeoutTime_DMSM" SG_ 1058 LoadOBD 0;
BA_ "GenSigTimeoutTime_BSM" SG_ 1058 LoadOBD 0;
BA_ "GenSigTimeoutTime_BCM" SG_ 1058 LoadOBD 0;
BA_ "GenSigTimeoutTime_AGSM" SG_ 1058 LoadOBD 0;
BA_ "GenSigTimeoutTime_ADCAM" SG_ 1058 LoadOBD 0;
BA_ "GenSigTimeoutTime_SGW" SG_ 1058 InputsGDFail 0;
BA_ "GenSigTimeoutTime_RFHM" SG_ 1058 InputsGDFail 0;
BA_ "GenSigTimeoutTime_MPAD" SG_ 1058 InputsGDFail 0;
BA_ "GenSigTimeoutTime_IPC" SG_ 1058 InputsGDFail 0;
BA_ "GenSigTimeoutTime_GNMM" SG_ 1058 InputsGDFail 0;
BA_ "GenSigTimeoutTime_EVCU2" SG_ 1058 InputsGDFail 0;
BA_ "GenSigTimeoutTime_ESL" SG_ 1058 InputsGDFail 0;
BA_ "GenSigTimeoutTime_ECM" SG_ 1058 InputsGDFail 0;
BA_ "GenSigTimeoutTime_DTCM" SG_ 1058 InputsGDFail 0;
BA_ "GenSigTimeoutTime_DMSM" SG_ 1058 InputsGDFail 0;
BA_ "GenSigTimeoutTime_BSM" SG_ 1058 InputsGDFail 0;
BA_ "GenSigTimeoutTime_BCM" SG_ 1058 InputsGDFail 0;
BA_ "GenSigTimeoutTime_AGSM" SG_ 1058 InputsGDFail 0;
BA_ "GenSigTimeoutTime_ADCAM" SG_ 1058 InputsGDFail 0;
BA_ "GenSigTimeoutTime_SGW" SG_ 1058 Inp_ICC_Fail 0;
BA_ "GenSigTimeoutTime_RFHM" SG_ 1058 Inp_ICC_Fail 0;
BA_ "GenSigTimeoutTime_MPAD" SG_ 1058 Inp_ICC_Fail 0;
BA_ "GenSigTimeoutTime_IPC" SG_ 1058 Inp_ICC_Fail 0;
BA_ "GenSigTimeoutTime_GNMM" SG_ 1058 Inp_ICC_Fail 0;
BA_ "GenSigTimeoutTime_EVCU2" SG_ 1058 Inp_ICC_Fail 0;
BA_ "GenSigTimeoutTime_ESL" SG_ 1058 Inp_ICC_Fail 0;
BA_ "GenSigTimeoutTime_ECM" SG_ 1058 Inp_ICC_Fail 0;
BA_ "GenSigTimeoutTime_DTCM" SG_ 1058 Inp_ICC_Fail 0;
BA_ "GenSigTimeoutTime_DMSM" SG_ 1058 Inp_ICC_Fail 0;
BA_ "GenSigTimeoutTime_BSM" SG_ 1058 Inp_ICC_Fail 0;
BA_ "GenSigTimeoutTime_BCM" SG_ 1058 Inp_ICC_Fail 0;
BA_ "GenSigTimeoutTime_AGSM" SG_ 1058 Inp_ICC_Fail 0;
BA_ "GenSigTimeoutTime_ADCAM" SG_ 1058 Inp_ICC_Fail 0;
BA_ "GenSigTimeoutTime_SGW" SG_ 1058 IgnCntrTrue 0;
BA_ "GenSigTimeoutTime_RFHM" SG_ 1058 IgnCntrTrue 0;
BA_ "GenSigTimeoutTime_MPAD" SG_ 1058 IgnCntrTrue 0;
BA_ "GenSigTimeoutTime_IPC" SG_ 1058 IgnCntrTrue 0;
BA_ "GenSigTimeoutTime_GNMM" SG_ 1058 IgnCntrTrue 0;
BA_ "GenSigTimeoutTime_EVCU2" SG_ 1058 IgnCntrTrue 0;
BA_ "GenSigTimeoutTime_ESL" SG_ 1058 IgnCntrTrue 0;
BA_ "GenSigTimeoutTime_ECM" SG_ 1058 IgnCntrTrue 0;
BA_ "GenSigTimeoutTime_DTCM" SG_ 1058 IgnCntrTrue 0;
BA_ "GenSigTimeoutTime_DMSM" SG_ 1058 IgnCntrTrue 0;
BA_ "GenSigTimeoutTime_BSM" SG_ 1058 IgnCntrTrue 0;
BA_ "GenSigTimeoutTime_BCM" SG_ 1058 IgnCntrTrue 0;
BA_ "GenSigTimeoutTime_AGSM" SG_ 1058 IgnCntrTrue 0;
BA_ "GenSigTimeoutTime_ADCAM" SG_ 1058 IgnCntrTrue 0;
BA_ "GenSigTimeoutTime_SGW" SG_ 1058 GenDenominator 0;
BA_ "GenSigTimeoutTime_RFHM" SG_ 1058 GenDenominator 0;
BA_ "GenSigTimeoutTime_MPAD" SG_ 1058 GenDenominator 0;
BA_ "GenSigTimeoutTime_IPC" SG_ 1058 GenDenominator 0;
BA_ "GenSigTimeoutTime_GNMM" SG_ 1058 GenDenominator 0;
BA_ "GenSigTimeoutTime_EVCU2" SG_ 1058 GenDenominator 0;
BA_ "GenSigTimeoutTime_ESL" SG_ 1058 GenDenominator 0;
BA_ "GenSigTimeoutTime_ECM" SG_ 1058 GenDenominator 0;
BA_ "GenSigTimeoutTime_DTCM" SG_ 1058 GenDenominator 0;
BA_ "GenSigTimeoutTime_DMSM" SG_ 1058 GenDenominator 0;
BA_ "GenSigTimeoutTime_BSM" SG_ 1058 GenDenominator 0;
BA_ "GenSigTimeoutTime_BCM" SG_ 1058 GenDenominator 0;
BA_ "GenSigTimeoutTime_AGSM" SG_ 1058 GenDenominator 0;
BA_ "GenSigTimeoutTime_ADCAM" SG_ 1058 GenDenominator 0;
BA_ "GenSigTimeoutTime_SGW" SG_ 1058 EngineOFFTime 0;
BA_ "GenSigTimeoutTime_RFHM" SG_ 1058 EngineOFFTime 0;
BA_ "GenSigTimeoutTime_MPAD" SG_ 1058 EngineOFFTime 0;
BA_ "GenSigTimeoutTime_IPC" SG_ 1058 EngineOFFTime 0;
BA_ "GenSigTimeoutTime_GNMM" SG_ 1058 EngineOFFTime 0;
BA_ "GenSigTimeoutTime_EVCU2" SG_ 1058 EngineOFFTime 0;
BA_ "GenSigTimeoutTime_ESL" SG_ 1058 EngineOFFTime 0;
BA_ "GenSigTimeoutTime_ECM" SG_ 1058 EngineOFFTime 0;
BA_ "GenSigTimeoutTime_DTCM" SG_ 1058 EngineOFFTime 0;
BA_ "GenSigTimeoutTime_DMSM" SG_ 1058 EngineOFFTime 0;
BA_ "GenSigTimeoutTime_BSM" SG_ 1058 EngineOFFTime 0;
BA_ "GenSigTimeoutTime_BCM" SG_ 1058 EngineOFFTime 0;
BA_ "GenSigTimeoutTime_AGSM" SG_ 1058 EngineOFFTime 0;
BA_ "GenSigTimeoutTime_ADCAM" SG_ 1058 EngineOFFTime 0;
BA_ "GenSigStartValue" SG_ 1058 EngineOFFTime 1023;
BA_ "GenSigTimeoutTime_DMSM" SG_ 1058 CldStrtDenominator 0;
BA_ "GenSigTimeoutTime_BSM" SG_ 1058 CldStrtDenominator 0;
BA_ "GenSigTimeoutTime_BCM" SG_ 1058 CldStrtDenominator 0;
BA_ "GenSigTimeoutTime_AGSM" SG_ 1058 CldStrtDenominator 0;
BA_ "GenSigTimeoutTime_ADCAM" SG_ 1058 CldStrtDenominator 0;
BA_ "GenSigTimeoutTime_SGW" SG_ 1058 CldStrtDenominator 0;
BA_ "GenSigTimeoutTime_RFHM" SG_ 1058 CldStrtDenominator 0;
BA_ "GenSigTimeoutTime_MPAD" SG_ 1058 CldStrtDenominator 0;
BA_ "GenSigTimeoutTime_IPC" SG_ 1058 CldStrtDenominator 0;
BA_ "GenSigTimeoutTime_GNMM" SG_ 1058 CldStrtDenominator 0;
BA_ "GenSigTimeoutTime_EVCU2" SG_ 1058 CldStrtDenominator 0;
BA_ "GenSigTimeoutTime_ESL" SG_ 1058 CldStrtDenominator 0;
BA_ "GenSigTimeoutTime_ECM" SG_ 1058 CldStrtDenominator 0;
BA_ "GenSigTimeoutTime_DTCM" SG_ 1058 CldStrtDenominator 0;
BA_ "GenSigTimeoutTime_SGW" SG_ 1058 CarbWarmUp 0;
BA_ "GenSigTimeoutTime_RFHM" SG_ 1058 CarbWarmUp 0;
BA_ "GenSigTimeoutTime_MPAD" SG_ 1058 CarbWarmUp 0;
BA_ "GenSigTimeoutTime_IPC" SG_ 1058 CarbWarmUp 0;
BA_ "GenSigTimeoutTime_GNMM" SG_ 1058 CarbWarmUp 0;
BA_ "GenSigTimeoutTime_EVCU2" SG_ 1058 CarbWarmUp 0;
BA_ "GenSigTimeoutTime_ESL" SG_ 1058 CarbWarmUp 0;
BA_ "GenSigTimeoutTime_ECM" SG_ 1058 CarbWarmUp 0;
BA_ "GenSigTimeoutTime_DTCM" SG_ 1058 CarbWarmUp 0;
BA_ "GenSigTimeoutTime_DMSM" SG_ 1058 CarbWarmUp 0;
BA_ "GenSigTimeoutTime_BSM" SG_ 1058 CarbWarmUp 0;
BA_ "GenSigTimeoutTime_BCM" SG_ 1058 CarbWarmUp 0;
BA_ "GenSigTimeoutTime_AGSM" SG_ 1058 CarbWarmUp 0;
BA_ "GenSigTimeoutTime_ADCAM" SG_ 1058 CarbWarmUp 0;
BA_ "GenSigTimeoutTime_SGW" SG_ 1058 CARB_PERM 0;
BA_ "GenSigTimeoutTime_RFHM" SG_ 1058 CARB_PERM 0;
BA_ "GenSigTimeoutTime_MPAD" SG_ 1058 CARB_PERM 0;
BA_ "GenSigTimeoutTime_IPC" SG_ 1058 CARB_PERM 0;
BA_ "GenSigTimeoutTime_GNMM" SG_ 1058 CARB_PERM 0;
BA_ "GenSigTimeoutTime_EVCU2" SG_ 1058 CARB_PERM 0;
BA_ "GenSigTimeoutTime_ESL" SG_ 1058 CARB_PERM 0;
BA_ "GenSigTimeoutTime_ECM" SG_ 1058 CARB_PERM 0;
BA_ "GenSigTimeoutTime_DTCM" SG_ 1058 CARB_PERM 0;
BA_ "GenSigTimeoutTime_DMSM" SG_ 1058 CARB_PERM 0;
BA_ "GenSigTimeoutTime_BSM" SG_ 1058 CARB_PERM 0;
BA_ "GenSigTimeoutTime_BCM" SG_ 1058 CARB_PERM 0;
BA_ "GenSigTimeoutTime_AGSM" SG_ 1058 CARB_PERM 0;
BA_ "GenSigTimeoutTime_ADCAM" SG_ 1058 CARB_PERM 0;
BA_ "GenSigTimeoutTime_SGW" SG_ 1626 IMPACTThreshold 0;
BA_ "GenSigTimeoutTime_RFHM" SG_ 1626 IMPACTThreshold 0;
BA_ "GenSigTimeoutTime_MPAD" SG_ 1626 IMPACTThreshold 0;
BA_ "GenSigTimeoutTime_IPC" SG_ 1626 IMPACTThreshold 0;
BA_ "GenSigTimeoutTime_GNMM" SG_ 1626 IMPACTThreshold 0;
BA_ "GenSigTimeoutTime_EVCU2" SG_ 1626 IMPACTThreshold 0;
BA_ "GenSigTimeoutTime_ESL" SG_ 1626 IMPACTThreshold 0;
BA_ "GenSigTimeoutTime_DTCM" SG_ 1626 IMPACTThreshold 0;
BA_ "GenSigTimeoutTime_DMSM" SG_ 1626 IMPACTThreshold 0;
BA_ "GenSigTimeoutTime_BSM" SG_ 1626 IMPACTThreshold 0;
BA_ "GenSigTimeoutTime_BCM" SG_ 1626 IMPACTThreshold 0;
BA_ "GenSigTimeoutTime_AGSM" SG_ 1626 IMPACTThreshold 0;
BA_ "GenSigTimeoutTime_ADCAM" SG_ 1626 IMPACTThreshold 0;
BA_ "GenSigTimeoutTime_SGW" SG_ 1829 CRC_IPC1 0;
BA_ "GenSigTimeoutTime_RFHM" SG_ 1829 CRC_IPC1 0;
BA_ "GenSigTimeoutTime_IPC" SG_ 1829 CRC_IPC1 0;
BA_ "GenSigTimeoutTime_GNMM" SG_ 1829 CRC_IPC1 0;
BA_ "GenSigTimeoutTime_EVCU2" SG_ 1829 CRC_IPC1 0;
BA_ "GenSigTimeoutTime_ESL" SG_ 1829 CRC_IPC1 0;
BA_ "GenSigTimeoutTime_DTCM" SG_ 1829 CRC_IPC1 0;
BA_ "GenSigTimeoutTime_AGSM" SG_ 1829 CRC_IPC1 0;
BA_ "GenSigTimeoutTime_SGW" SG_ 1626 CRC_IMPACTINFO 0;
BA_ "GenSigTimeoutTime_RFHM" SG_ 1626 CRC_IMPACTINFO 0;
BA_ "GenSigTimeoutTime_MPAD" SG_ 1626 CRC_IMPACTINFO 0;
BA_ "GenSigTimeoutTime_IPC" SG_ 1626 CRC_IMPACTINFO 0;
BA_ "GenSigTimeoutTime_GNMM" SG_ 1626 CRC_IMPACTINFO 0;
BA_ "GenSigTimeoutTime_EVCU2" SG_ 1626 CRC_IMPACTINFO 0;
BA_ "GenSigTimeoutTime_ESL" SG_ 1626 CRC_IMPACTINFO 0;
BA_ "GenSigTimeoutTime_ECM" SG_ 1626 CRC_IMPACTINFO 0;
BA_ "GenSigTimeoutTime_DTCM" SG_ 1626 CRC_IMPACTINFO 0;
BA_ "GenSigTimeoutTime_BSM" SG_ 1626 CRC_IMPACTINFO 0;
BA_ "GenSigTimeoutTime_BCM" SG_ 1626 CRC_IMPACTINFO 0;
BA_ "GenSigTimeoutTime_AGSM" SG_ 1626 CRC_IMPACTINFO 0;
BA_ "GenSigTimeoutTime_ADCAM" SG_ 1626 CRC_IMPACTINFO 0;
BA_ "GenSigTimeoutTime_SGW" SG_ 1626 MessageCounter_IMPACTINFO 0;
BA_ "GenSigTimeoutTime_RFHM" SG_ 1626 MessageCounter_IMPACTINFO 0;
BA_ "GenSigTimeoutTime_MPAD" SG_ 1626 MessageCounter_IMPACTINFO 0;
BA_ "GenSigTimeoutTime_IPC" SG_ 1626 MessageCounter_IMPACTINFO 0;
BA_ "GenSigTimeoutTime_GNMM" SG_ 1626 MessageCounter_IMPACTINFO 0;
BA_ "GenSigTimeoutTime_EVCU2" SG_ 1626 MessageCounter_IMPACTINFO 0;
BA_ "GenSigTimeoutTime_ESL" SG_ 1626 MessageCounter_IMPACTINFO 0;
BA_ "GenSigTimeoutTime_ECM" SG_ 1626 MessageCounter_IMPACTINFO 0;
BA_ "GenSigTimeoutTime_DTCM" SG_ 1626 MessageCounter_IMPACTINFO 0;
BA_ "GenSigTimeoutTime_BSM" SG_ 1626 MessageCounter_IMPACTINFO 0;
BA_ "GenSigTimeoutTime_BCM" SG_ 1626 MessageCounter_IMPACTINFO 0;
BA_ "GenSigTimeoutTime_AGSM" SG_ 1626 MessageCounter_IMPACTINFO 0;
BA_ "GenSigTimeoutTime_ADCAM" SG_ 1626 MessageCounter_IMPACTINFO 0;
BA_ "GenSigTimeoutTime_RFHM" SG_ 1829 InstantaneousFuelConsumption1 0;
BA_ "GenSigTimeoutTime_MPAD" SG_ 1829 InstantaneousFuelConsumption1 0;
BA_ "GenSigTimeoutTime_IPC" SG_ 1829 InstantaneousFuelConsumption1 0;
BA_ "GenSigTimeoutTime_GNMM" SG_ 1829 InstantaneousFuelConsumption1 0;
BA_ "GenSigTimeoutTime_EVCU2" SG_ 1829 InstantaneousFuelConsumption1 0;
BA_ "GenSigTimeoutTime_ESL" SG_ 1829 InstantaneousFuelConsumption1 0;
BA_ "GenSigTimeoutTime_ECM" SG_ 1829 InstantaneousFuelConsumption1 0;
BA_ "GenSigTimeoutTime_DTCM" SG_ 1829 InstantaneousFuelConsumption1 0;
BA_ "GenSigTimeoutTime_DMSM" SG_ 1829 InstantaneousFuelConsumption1 0;
BA_ "GenSigTimeoutTime_BSM" SG_ 1829 InstantaneousFuelConsumption1 0;
BA_ "GenSigTimeoutTime_BCM" SG_ 1829 InstantaneousFuelConsumption1 0;
BA_ "GenSigTimeoutTime_AGSM" SG_ 1829 InstantaneousFuelConsumption1 0;
BA_ "GenSigTimeoutTime_ADCAM" SG_ 1829 InstantaneousFuelConsumption1 0;
BA_ "GenSigTimeoutTime_AGSM" SG_ 1829 InstantaneousFuelConsumption2 0;
BA_ "GenSigTimeoutTime_ADCAM" SG_ 1829 InstantaneousFuelConsumption2 0;
BA_ "GenSigTimeoutTime_SGW" SG_ 100 rnd_1 0;
BA_ "GenSigTimeoutTime_RFHM" SG_ 100 rnd_1 0;
BA_ "GenSigTimeoutTime_MPAD" SG_ 100 rnd_1 0;
BA_ "GenSigTimeoutTime_IPC" SG_ 100 rnd_1 0;
BA_ "GenSigTimeoutTime_GNMM" SG_ 100 rnd_1 0;
BA_ "GenSigTimeoutTime_EVCU2" SG_ 100 rnd_1 0;
BA_ "GenSigTimeoutTime_ESL" SG_ 100 rnd_1 0;
BA_ "GenSigTimeoutTime_ECM" SG_ 100 rnd_1 0;
BA_ "GenSigTimeoutTime_DTCM" SG_ 100 rnd_1 0;
BA_ "GenSigTimeoutTime_DMSM" SG_ 100 rnd_1 0;
BA_ "GenSigTimeoutTime_BSM" SG_ 100 rnd_1 0;
BA_ "GenSigTimeoutTime_AGSM" SG_ 100 rnd_1 0;
BA_ "GenSigTimeoutTime_SGW" SG_ 100 rnd_2 0;
BA_ "GenSigTimeoutTime_RFHM" SG_ 100 rnd_2 0;
BA_ "GenSigTimeoutTime_MPAD" SG_ 100 rnd_2 0;
BA_ "GenSigTimeoutTime_IPC" SG_ 100 rnd_2 0;
BA_ "GenSigTimeoutTime_GNMM" SG_ 100 rnd_2 0;
BA_ "GenSigTimeoutTime_EVCU2" SG_ 100 rnd_2 0;
BA_ "GenSigTimeoutTime_ESL" SG_ 100 rnd_2 0;
BA_ "GenSigTimeoutTime_ECM" SG_ 100 rnd_2 0;
BA_ "GenSigTimeoutTime_DTCM" SG_ 100 rnd_2 0;
BA_ "GenSigTimeoutTime_DMSM" SG_ 100 rnd_2 0;
BA_ "GenSigTimeoutTime_BSM" SG_ 100 rnd_2 0;
BA_ "GenSigTimeoutTime_AGSM" SG_ 100 rnd_2 0;
BA_ "GenSigTimeoutTime_ADCAM" SG_ 100 rnd_2 0;
BA_ "GenSigTimeoutTime_GNMM" SG_ 100 rnd_3 0;
BA_ "GenSigTimeoutTime_EVCU2" SG_ 100 rnd_3 0;
BA_ "GenSigTimeoutTime_ESL" SG_ 100 rnd_3 0;
BA_ "GenSigTimeoutTime_ECM" SG_ 100 rnd_3 0;
BA_ "GenSigTimeoutTime_DTCM" SG_ 100 rnd_3 0;
BA_ "GenSigTimeoutTime_DMSM" SG_ 100 rnd_3 0;
BA_ "GenSigTimeoutTime_BSM" SG_ 100 rnd_3 0;
BA_ "GenSigTimeoutTime_AGSM" SG_ 100 rnd_3 0;
BA_ "GenSigTimeoutTime_ADCAM" SG_ 100 rnd_3 0;
BA_ "GenSigTimeoutTime_SGW" SG_ 100 rnd_3 0;
BA_ "GenSigTimeoutTime_RFHM" SG_ 100 rnd_3 0;
BA_ "GenSigTimeoutTime_MPAD" SG_ 100 rnd_3 0;
BA_ "GenSigTimeoutTime_IPC" SG_ 100 rnd_3 0;
BA_ "GenSigTimeoutTime_SGW" SG_ 100 rnd_4 0;
BA_ "GenSigTimeoutTime_RFHM" SG_ 100 rnd_4 0;
BA_ "GenSigTimeoutTime_MPAD" SG_ 100 rnd_4 0;
BA_ "GenSigTimeoutTime_IPC" SG_ 100 rnd_4 0;
BA_ "GenSigTimeoutTime_GNMM" SG_ 100 rnd_4 0;
BA_ "GenSigTimeoutTime_EVCU2" SG_ 100 rnd_4 0;
BA_ "GenSigTimeoutTime_ESL" SG_ 100 rnd_4 0;
BA_ "GenSigTimeoutTime_ECM" SG_ 100 rnd_4 0;
BA_ "GenSigTimeoutTime_DTCM" SG_ 100 rnd_4 0;
BA_ "GenSigTimeoutTime_DMSM" SG_ 100 rnd_4 0;
BA_ "GenSigTimeoutTime_BSM" SG_ 100 rnd_4 0;
BA_ "GenSigTimeoutTime_AGSM" SG_ 100 rnd_4 0;
BA_ "GenSigTimeoutTime_ADCAM" SG_ 100 rnd_4 0;
BA_ "GenSigTimeoutTime_SGW" SG_ 104 ControlEncodingRsp 0;
BA_ "GenSigTimeoutTime_RFHM" SG_ 104 ControlEncodingRsp 0;
BA_ "GenSigTimeoutTime_MPAD" SG_ 104 ControlEncodingRsp 0;
BA_ "GenSigTimeoutTime_IPC" SG_ 104 ControlEncodingRsp 0;
BA_ "GenSigTimeoutTime_GNMM" SG_ 104 ControlEncodingRsp 0;
BA_ "GenSigTimeoutTime_ESL" SG_ 104 ControlEncodingRsp 0;
BA_ "GenSigTimeoutTime_ECM" SG_ 104 ControlEncodingRsp 0;
BA_ "GenSigTimeoutTime_DTCM" SG_ 104 ControlEncodingRsp 0;
BA_ "GenSigTimeoutTime_DMSM" SG_ 104 ControlEncodingRsp 0;
BA_ "GenSigTimeoutTime_BSM" SG_ 104 ControlEncodingRsp 0;
BA_ "GenSigTimeoutTime_BCM" SG_ 104 ControlEncodingRsp 0;
BA_ "GenSigTimeoutTime_AGSM" SG_ 104 ControlEncodingRsp 0;
BA_ "GenSigTimeoutTime_ADCAM" SG_ 104 ControlEncodingRsp 0;
BA_ "GenSigSendType" SG_ 104 ControlEncodingRsp 1;
BA_ "GenSigTimeoutTime_SGW" SG_ 104 MKKey_3 0;
BA_ "GenSigTimeoutTime_RFHM" SG_ 104 MKKey_3 0;
BA_ "GenSigTimeoutTime_MPAD" SG_ 104 MKKey_3 0;
BA_ "GenSigTimeoutTime_IPC" SG_ 104 MKKey_3 0;
BA_ "GenSigTimeoutTime_GNMM" SG_ 104 MKKey_3 0;
BA_ "GenSigTimeoutTime_ESL" SG_ 104 MKKey_3 0;
BA_ "GenSigTimeoutTime_ECM" SG_ 104 MKKey_3 0;
BA_ "GenSigTimeoutTime_DTCM" SG_ 104 MKKey_3 0;
BA_ "GenSigTimeoutTime_DMSM" SG_ 104 MKKey_3 0;
BA_ "GenSigTimeoutTime_BSM" SG_ 104 MKKey_3 0;
BA_ "GenSigTimeoutTime_BCM" SG_ 104 MKKey_3 0;
BA_ "GenSigTimeoutTime_AGSM" SG_ 104 MKKey_3 0;
BA_ "GenSigTimeoutTime_ADCAM" SG_ 104 MKKey_3 0;
BA_ "GenSigTimeoutTime_SGW" SG_ 104 MKKey_4 0;
BA_ "GenSigTimeoutTime_RFHM" SG_ 104 MKKey_4 0;
BA_ "GenSigTimeoutTime_MPAD" SG_ 104 MKKey_4 0;
BA_ "GenSigTimeoutTime_IPC" SG_ 104 MKKey_4 0;
BA_ "GenSigTimeoutTime_GNMM" SG_ 104 MKKey_4 0;
BA_ "GenSigTimeoutTime_ESL" SG_ 104 MKKey_4 0;
BA_ "GenSigTimeoutTime_ECM" SG_ 104 MKKey_4 0;
BA_ "GenSigTimeoutTime_DTCM" SG_ 104 MKKey_4 0;
BA_ "GenSigTimeoutTime_DMSM" SG_ 104 MKKey_4 0;
BA_ "GenSigTimeoutTime_BSM" SG_ 104 MKKey_4 0;
BA_ "GenSigTimeoutTime_BCM" SG_ 104 MKKey_4 0;
BA_ "GenSigTimeoutTime_AGSM" SG_ 104 MKKey_4 0;
BA_ "GenSigTimeoutTime_ADCAM" SG_ 104 MKKey_4 0;
BA_ "GenSigTimeoutTime_SGW" SG_ 104 MKKey_5 0;
BA_ "GenSigTimeoutTime_RFHM" SG_ 104 MKKey_5 0;
BA_ "GenSigTimeoutTime_MPAD" SG_ 104 MKKey_5 0;
BA_ "GenSigTimeoutTime_IPC" SG_ 104 MKKey_5 0;
BA_ "GenSigTimeoutTime_GNMM" SG_ 104 MKKey_5 0;
BA_ "GenSigTimeoutTime_ESL" SG_ 104 MKKey_5 0;
BA_ "GenSigTimeoutTime_ECM" SG_ 104 MKKey_5 0;
BA_ "GenSigTimeoutTime_DTCM" SG_ 104 MKKey_5 0;
BA_ "GenSigTimeoutTime_DMSM" SG_ 104 MKKey_5 0;
BA_ "GenSigTimeoutTime_BSM" SG_ 104 MKKey_5 0;
BA_ "GenSigTimeoutTime_BCM" SG_ 104 MKKey_5 0;
BA_ "GenSigTimeoutTime_AGSM" SG_ 104 MKKey_5 0;
BA_ "GenSigTimeoutTime_ADCAM" SG_ 104 MKKey_5 0;
BA_ "GenSigTimeoutTime_SGW" SG_ 104 MKKey_6 0;
BA_ "GenSigTimeoutTime_RFHM" SG_ 104 MKKey_6 0;
BA_ "GenSigTimeoutTime_MPAD" SG_ 104 MKKey_6 0;
BA_ "GenSigTimeoutTime_IPC" SG_ 104 MKKey_6 0;
BA_ "GenSigTimeoutTime_GNMM" SG_ 104 MKKey_6 0;
BA_ "GenSigTimeoutTime_ESL" SG_ 104 MKKey_6 0;
BA_ "GenSigTimeoutTime_ECM" SG_ 104 MKKey_6 0;
BA_ "GenSigTimeoutTime_DTCM" SG_ 104 MKKey_6 0;
BA_ "GenSigTimeoutTime_DMSM" SG_ 104 MKKey_6 0;
BA_ "GenSigTimeoutTime_BSM" SG_ 104 MKKey_6 0;
BA_ "GenSigTimeoutTime_BCM" SG_ 104 MKKey_6 0;
BA_ "GenSigTimeoutTime_AGSM" SG_ 104 MKKey_6 0;
BA_ "GenSigTimeoutTime_ADCAM" SG_ 104 MKKey_6 0;
BA_ "GenSigTimeoutTime_SGW" SG_ 104 MKKey1org21 0;
BA_ "GenSigTimeoutTime_RFHM" SG_ 104 MKKey1org21 0;
BA_ "GenSigTimeoutTime_MPAD" SG_ 104 MKKey1org21 0;
BA_ "GenSigTimeoutTime_IPC" SG_ 104 MKKey1org21 0;
BA_ "GenSigTimeoutTime_GNMM" SG_ 104 MKKey1org21 0;
BA_ "GenSigTimeoutTime_ESL" SG_ 104 MKKey1org21 0;
BA_ "GenSigTimeoutTime_ECM" SG_ 104 MKKey1org21 0;
BA_ "GenSigTimeoutTime_DTCM" SG_ 104 MKKey1org21 0;
BA_ "GenSigTimeoutTime_DMSM" SG_ 104 MKKey1org21 0;
BA_ "GenSigTimeoutTime_BSM" SG_ 104 MKKey1org21 0;
BA_ "GenSigTimeoutTime_BCM" SG_ 104 MKKey1org21 0;
BA_ "GenSigTimeoutTime_AGSM" SG_ 104 MKKey1org21 0;
BA_ "GenSigTimeoutTime_ADCAM" SG_ 104 MKKey1org21 0;
BA_ "GenSigTimeoutTime_SGW" SG_ 104 MKKey2org22 0;
BA_ "GenSigTimeoutTime_RFHM" SG_ 104 MKKey2org22 0;
BA_ "GenSigTimeoutTime_MPAD" SG_ 104 MKKey2org22 0;
BA_ "GenSigTimeoutTime_IPC" SG_ 104 MKKey2org22 0;
BA_ "GenSigTimeoutTime_GNMM" SG_ 104 MKKey2org22 0;
BA_ "GenSigTimeoutTime_ESL" SG_ 104 MKKey2org22 0;
BA_ "GenSigTimeoutTime_ECM" SG_ 104 MKKey2org22 0;
BA_ "GenSigTimeoutTime_DTCM" SG_ 104 MKKey2org22 0;
BA_ "GenSigTimeoutTime_DMSM" SG_ 104 MKKey2org22 0;
BA_ "GenSigTimeoutTime_BSM" SG_ 104 MKKey2org22 0;
BA_ "GenSigTimeoutTime_BCM" SG_ 104 MKKey2org22 0;
BA_ "GenSigTimeoutTime_AGSM" SG_ 104 MKKey2org22 0;
BA_ "GenSigTimeoutTime_ADCAM" SG_ 104 MKKey2org22 0;
BA_ "GenSigTimeoutTime_SGW" SG_ 1626 IMPACTCommand 0;
BA_ "GenSigTimeoutTime_RFHM" SG_ 1626 IMPACTCommand 0;
BA_ "GenSigTimeoutTime_MPAD" SG_ 1626 IMPACTCommand 0;
BA_ "GenSigTimeoutTime_IPC" SG_ 1626 IMPACTCommand 0;
BA_ "GenSigTimeoutTime_GNMM" SG_ 1626 IMPACTCommand 0;
BA_ "GenSigTimeoutTime_ESL" SG_ 1626 IMPACTCommand 0;
BA_ "GenSigTimeoutTime_DTCM" SG_ 1626 IMPACTCommand 0;
BA_ "GenSigTimeoutTime_BSM" SG_ 1626 IMPACTCommand 0;
BA_ "GenSigTimeoutTime_BCM" SG_ 1626 IMPACTCommand 0;
BA_ "GenSigTimeoutTime_AGSM" SG_ 1626 IMPACTCommand 0;
BA_ "GenSigTimeoutTime_ADCAM" SG_ 1626 IMPACTCommand 0;
BA_ "GenSigSendType" SG_ 1626 IMPACTCommand 5;
BA_ "GenSigTimeoutTime_SGW" SG_ 1626 IMPACTConfirm 0;
BA_ "GenSigTimeoutTime_RFHM" SG_ 1626 IMPACTConfirm 0;
BA_ "GenSigTimeoutTime_MPAD" SG_ 1626 IMPACTConfirm 0;
BA_ "GenSigTimeoutTime_IPC" SG_ 1626 IMPACTConfirm 0;
BA_ "GenSigTimeoutTime_GNMM" SG_ 1626 IMPACTConfirm 0;
BA_ "GenSigTimeoutTime_ESL" SG_ 1626 IMPACTConfirm 0;
BA_ "GenSigTimeoutTime_DTCM" SG_ 1626 IMPACTConfirm 0;
BA_ "GenSigTimeoutTime_BSM" SG_ 1626 IMPACTConfirm 0;
BA_ "GenSigTimeoutTime_BCM" SG_ 1626 IMPACTConfirm 0;
BA_ "GenSigTimeoutTime_AGSM" SG_ 1626 IMPACTConfirm 0;
BA_ "GenSigTimeoutTime_ADCAM" SG_ 1626 IMPACTConfirm 0;
BA_ "GenSigSendType" SG_ 1626 IMPACTConfirm 5;
BA_ "GenSigInactiveValue" SG_ 1626 IMPACTConfirm 1;
BA_ "GenSigStartValue" SG_ 1626 IMPACTConfirm 1;
BA_ "GenSigTimeoutTime_SGW" SG_ 274 YawRate 0;
BA_ "GenSigTimeoutTime_RFHM" SG_ 274 YawRate 0;
BA_ "GenSigTimeoutTime_IPC" SG_ 274 YawRate 0;
BA_ "GenSigTimeoutTime_GNMM" SG_ 274 YawRate 0;
BA_ "GenSigTimeoutTime_ESL" SG_ 274 YawRate 0;
BA_ "GenSigTimeoutTime_ECM" SG_ 274 YawRate 0;
BA_ "GenSigTimeoutTime_DMSM" SG_ 274 YawRate 0;
BA_ "GenSigTimeoutTime_BSM" SG_ 274 YawRate 0;
BA_ "GenSigTimeoutTime_BCM" SG_ 274 YawRate 0;
BA_ "GenSigTimeoutTime_AGSM" SG_ 274 YawRate 0;
BA_ "GenSigTimeoutTime_ADCAM" SG_ 274 YawRate 0;
BA_ "GenSigStartValue" SG_ 274 YawRate 4095;
BA_ "GenSigTimeoutTime_SGW" SG_ 274 LongAcceleration 0;
BA_ "GenSigTimeoutTime_RFHM" SG_ 274 LongAcceleration 0;
BA_ "GenSigTimeoutTime_IPC" SG_ 274 LongAcceleration 0;
BA_ "GenSigTimeoutTime_GNMM" SG_ 274 LongAcceleration 0;
BA_ "GenSigTimeoutTime_ESL" SG_ 274 LongAcceleration 0;
BA_ "GenSigTimeoutTime_DMSM" SG_ 274 LongAcceleration 0;
BA_ "GenSigTimeoutTime_BSM" SG_ 274 LongAcceleration 0;
BA_ "GenSigTimeoutTime_BCM" SG_ 274 LongAcceleration 0;
BA_ "GenSigTimeoutTime_AGSM" SG_ 274 LongAcceleration 0;
BA_ "GenSigTimeoutTime_ADCAM" SG_ 274 LongAcceleration 0;
BA_ "GenSigStartValue" SG_ 274 LongAcceleration 4095;
BA_ "GenSigTimeoutTime_ESL" SG_ 274 MessageCounter_ORC3 0;
BA_ "GenSigTimeoutTime_ECM" SG_ 274 MessageCounter_ORC3 0;
BA_ "GenSigTimeoutTime_DTCM" SG_ 274 MessageCounter_ORC3 0;
BA_ "GenSigTimeoutTime_DMSM" SG_ 274 MessageCounter_ORC3 0;
BA_ "GenSigTimeoutTime_BSM" SG_ 274 MessageCounter_ORC3 0;
BA_ "GenSigTimeoutTime_BCM" SG_ 274 MessageCounter_ORC3 0;
BA_ "GenSigTimeoutTime_AGSM" SG_ 274 MessageCounter_ORC3 0;
BA_ "GenSigTimeoutTime_ADCAM" SG_ 274 MessageCounter_ORC3 0;
BA_ "GenSigTimeoutTime_SGW" SG_ 274 MessageCounter_ORC3 0;
BA_ "GenSigTimeoutTime_RFHM" SG_ 274 MessageCounter_ORC3 0;
BA_ "GenSigTimeoutTime_IPC" SG_ 274 MessageCounter_ORC3 0;
BA_ "GenSigTimeoutTime_GNMM" SG_ 274 MessageCounter_ORC3 0;
BA_ "GenSigTimeoutTime_SGW" SG_ 274 YawRateFailSts 0;
BA_ "GenSigTimeoutTime_RFHM" SG_ 274 YawRateFailSts 0;
BA_ "GenSigTimeoutTime_IPC" SG_ 274 YawRateFailSts 0;
BA_ "GenSigTimeoutTime_GNMM" SG_ 274 YawRateFailSts 0;
BA_ "GenSigTimeoutTime_ESL" SG_ 274 YawRateFailSts 0;
BA_ "GenSigTimeoutTime_ECM" SG_ 274 YawRateFailSts 0;
BA_ "GenSigTimeoutTime_DMSM" SG_ 274 YawRateFailSts 0;
BA_ "GenSigTimeoutTime_BSM" SG_ 274 YawRateFailSts 0;
BA_ "GenSigTimeoutTime_BCM" SG_ 274 YawRateFailSts 0;
BA_ "GenSigTimeoutTime_AGSM" SG_ 274 YawRateFailSts 0;
BA_ "GenSigTimeoutTime_ADCAM" SG_ 274 YawRateFailSts 0;
BA_ "GenSigTimeoutTime_SGW" SG_ 274 LongAccelerationFailSts 0;
BA_ "GenSigTimeoutTime_RFHM" SG_ 274 LongAccelerationFailSts 0;
BA_ "GenSigTimeoutTime_IPC" SG_ 274 LongAccelerationFailSts 0;
BA_ "GenSigTimeoutTime_GNMM" SG_ 274 LongAccelerationFailSts 0;
BA_ "GenSigTimeoutTime_ESL" SG_ 274 LongAccelerationFailSts 0;
BA_ "GenSigTimeoutTime_DMSM" SG_ 274 LongAccelerationFailSts 0;
BA_ "GenSigTimeoutTime_BSM" SG_ 274 LongAccelerationFailSts 0;
BA_ "GenSigTimeoutTime_BCM" SG_ 274 LongAccelerationFailSts 0;
BA_ "GenSigTimeoutTime_AGSM" SG_ 274 LongAccelerationFailSts 0;
BA_ "GenSigTimeoutTime_ADCAM" SG_ 274 LongAccelerationFailSts 0;
BA_ "GenSigTimeoutTime_SGW" SG_ 274 LatAccelerationFailSts 0;
BA_ "GenSigTimeoutTime_RFHM" SG_ 274 LatAccelerationFailSts 0;
BA_ "GenSigTimeoutTime_IPC" SG_ 274 LatAccelerationFailSts 0;
BA_ "GenSigTimeoutTime_GNMM" SG_ 274 LatAccelerationFailSts 0;
BA_ "GenSigTimeoutTime_ESL" SG_ 274 LatAccelerationFailSts 0;
BA_ "GenSigTimeoutTime_DMSM" SG_ 274 LatAccelerationFailSts 0;
BA_ "GenSigTimeoutTime_BSM" SG_ 274 LatAccelerationFailSts 0;
BA_ "GenSigTimeoutTime_BCM" SG_ 274 LatAccelerationFailSts 0;
BA_ "GenSigTimeoutTime_AGSM" SG_ 274 LatAccelerationFailSts 0;
BA_ "GenSigTimeoutTime_ADCAM" SG_ 274 LatAccelerationFailSts 0;
BA_ "GenSigTimeoutTime_SGW" SG_ 611 MessageCounter_ORC1 0;
BA_ "GenSigTimeoutTime_RFHM" SG_ 611 MessageCounter_ORC1 0;
BA_ "GenSigTimeoutTime_GNMM" SG_ 611 MessageCounter_ORC1 0;
BA_ "GenSigTimeoutTime_EVCU2" SG_ 611 MessageCounter_ORC1 0;
BA_ "GenSigTimeoutTime_ESL" SG_ 611 MessageCounter_ORC1 0;
BA_ "GenSigTimeoutTime_ECM" SG_ 611 MessageCounter_ORC1 0;
BA_ "GenSigTimeoutTime_DTCM" SG_ 611 MessageCounter_ORC1 0;
BA_ "GenSigTimeoutTime_DMSM" SG_ 611 MessageCounter_ORC1 0;
BA_ "GenSigTimeoutTime_BSM" SG_ 611 MessageCounter_ORC1 0;
BA_ "GenSigTimeoutTime_BCM" SG_ 611 MessageCounter_ORC1 0;
BA_ "GenSigTimeoutTime_AGSM" SG_ 611 MessageCounter_ORC1 0;
BA_ "GenSigTimeoutTime_ADCAM" SG_ 611 MessageCounter_ORC1 0;
BA_ "GenSigTimeoutTime_SGW" SG_ 611 SBR2ndRowRSeatSts 0;
BA_ "GenSigTimeoutTime_RFHM" SG_ 611 SBR2ndRowRSeatSts 0;
BA_ "GenSigTimeoutTime_GNMM" SG_ 611 SBR2ndRowRSeatSts 0;
BA_ "GenSigTimeoutTime_EVCU2" SG_ 611 SBR2ndRowRSeatSts 0;
BA_ "GenSigTimeoutTime_ESL" SG_ 611 SBR2ndRowRSeatSts 0;
BA_ "GenSigTimeoutTime_ECM" SG_ 611 SBR2ndRowRSeatSts 0;
BA_ "GenSigTimeoutTime_DTCM" SG_ 611 SBR2ndRowRSeatSts 0;
BA_ "GenSigTimeoutTime_DMSM" SG_ 611 SBR2ndRowRSeatSts 0;
BA_ "GenSigTimeoutTime_BSM" SG_ 611 SBR2ndRowRSeatSts 0;
BA_ "GenSigTimeoutTime_BCM" SG_ 611 SBR2ndRowRSeatSts 0;
BA_ "GenSigTimeoutTime_AGSM" SG_ 611 SBR2ndRowRSeatSts 0;
BA_ "GenSigTimeoutTime_ADCAM" SG_ 611 SBR2ndRowRSeatSts 0;
BA_ "GenSigSendType" SG_ 611 SBR2ndRowRSeatSts 3;
BA_ "GenSigStartValue" SG_ 611 SBR2ndRowRSeatSts 6;
BA_ "GenSigTimeoutTime_SGW" SG_ 611 SBR2ndRowLSeatSts 0;
BA_ "GenSigTimeoutTime_RFHM" SG_ 611 SBR2ndRowLSeatSts 0;
BA_ "GenSigTimeoutTime_GNMM" SG_ 611 SBR2ndRowLSeatSts 0;
BA_ "GenSigTimeoutTime_EVCU2" SG_ 611 SBR2ndRowLSeatSts 0;
BA_ "GenSigTimeoutTime_ESL" SG_ 611 SBR2ndRowLSeatSts 0;
BA_ "GenSigTimeoutTime_ECM" SG_ 611 SBR2ndRowLSeatSts 0;
BA_ "GenSigTimeoutTime_DTCM" SG_ 611 SBR2ndRowLSeatSts 0;
BA_ "GenSigTimeoutTime_DMSM" SG_ 611 SBR2ndRowLSeatSts 0;
BA_ "GenSigTimeoutTime_BSM" SG_ 611 SBR2ndRowLSeatSts 0;
BA_ "GenSigTimeoutTime_BCM" SG_ 611 SBR2ndRowLSeatSts 0;
BA_ "GenSigTimeoutTime_AGSM" SG_ 611 SBR2ndRowLSeatSts 0;
BA_ "GenSigTimeoutTime_ADCAM" SG_ 611 SBR2ndRowLSeatSts 0;
BA_ "GenSigSendType" SG_ 611 SBR2ndRowLSeatSts 3;
BA_ "GenSigStartValue" SG_ 611 SBR2ndRowLSeatSts 6;
BA_ "GenSigTimeoutTime_SGW" SG_ 611 SBR2ndRowCSeatSts 0;
BA_ "GenSigTimeoutTime_RFHM" SG_ 611 SBR2ndRowCSeatSts 0;
BA_ "GenSigTimeoutTime_GNMM" SG_ 611 SBR2ndRowCSeatSts 0;
BA_ "GenSigTimeoutTime_EVCU2" SG_ 611 SBR2ndRowCSeatSts 0;
BA_ "GenSigTimeoutTime_ESL" SG_ 611 SBR2ndRowCSeatSts 0;
BA_ "GenSigTimeoutTime_ECM" SG_ 611 SBR2ndRowCSeatSts 0;
BA_ "GenSigTimeoutTime_DTCM" SG_ 611 SBR2ndRowCSeatSts 0;
BA_ "GenSigTimeoutTime_DMSM" SG_ 611 SBR2ndRowCSeatSts 0;
BA_ "GenSigTimeoutTime_BSM" SG_ 611 SBR2ndRowCSeatSts 0;
BA_ "GenSigTimeoutTime_BCM" SG_ 611 SBR2ndRowCSeatSts 0;
BA_ "GenSigTimeoutTime_AGSM" SG_ 611 SBR2ndRowCSeatSts 0;
BA_ "GenSigTimeoutTime_ADCAM" SG_ 611 SBR2ndRowCSeatSts 0;
BA_ "GenSigSendType" SG_ 611 SBR2ndRowCSeatSts 3;
BA_ "GenSigStartValue" SG_ 611 SBR2ndRowCSeatSts 6;
BA_ "GenSigTimeoutTime_SGW" SG_ 611 SBR1RowCentralSeatSts 0;
BA_ "GenSigTimeoutTime_RFHM" SG_ 611 SBR1RowCentralSeatSts 0;
BA_ "GenSigTimeoutTime_MPAD" SG_ 611 SBR1RowCentralSeatSts 0;
BA_ "GenSigTimeoutTime_IPC" SG_ 611 SBR1RowCentralSeatSts 0;
BA_ "GenSigTimeoutTime_GNMM" SG_ 611 SBR1RowCentralSeatSts 0;
BA_ "GenSigTimeoutTime_ESL" SG_ 611 SBR1RowCentralSeatSts 0;
BA_ "GenSigTimeoutTime_ECM" SG_ 611 SBR1RowCentralSeatSts 0;
BA_ "GenSigTimeoutTime_DTCM" SG_ 611 SBR1RowCentralSeatSts 0;
BA_ "GenSigTimeoutTime_DMSM" SG_ 611 SBR1RowCentralSeatSts 0;
BA_ "GenSigTimeoutTime_BSM" SG_ 611 SBR1RowCentralSeatSts 0;
BA_ "GenSigTimeoutTime_BCM" SG_ 611 SBR1RowCentralSeatSts 0;
BA_ "GenSigTimeoutTime_AGSM" SG_ 611 SBR1RowCentralSeatSts 0;
BA_ "GenSigTimeoutTime_ADCAM" SG_ 611 SBR1RowCentralSeatSts 0;
BA_ "GenSigSendType" SG_ 611 SBR1RowCentralSeatSts 3;
BA_ "GenSigStartValue" SG_ 611 SBR1RowCentralSeatSts 7;
BA_ "GenSigTimeoutTime_SGW" SG_ 274 CRC_ORC3 0;
BA_ "GenSigTimeoutTime_RFHM" SG_ 274 CRC_ORC3 0;
BA_ "GenSigTimeoutTime_IPC" SG_ 274 CRC_ORC3 0;
BA_ "GenSigTimeoutTime_GNMM" SG_ 274 CRC_ORC3 0;
BA_ "GenSigTimeoutTime_ESL" SG_ 274 CRC_ORC3 0;
BA_ "GenSigTimeoutTime_ECM" SG_ 274 CRC_ORC3 0;
BA_ "GenSigTimeoutTime_DTCM" SG_ 274 CRC_ORC3 0;
BA_ "GenSigTimeoutTime_DMSM" SG_ 274 CRC_ORC3 0;
BA_ "GenSigTimeoutTime_BSM" SG_ 274 CRC_ORC3 0;
BA_ "GenSigTimeoutTime_BCM" SG_ 274 CRC_ORC3 0;
BA_ "GenSigTimeoutTime_AGSM" SG_ 274 CRC_ORC3 0;
BA_ "GenSigTimeoutTime_ADCAM" SG_ 274 CRC_ORC3 0;
BA_ "GenSigTimeoutTime_SGW" SG_ 611 SBR2RowRightSeatConfigSts 0;
BA_ "GenSigTimeoutTime_RFHM" SG_ 611 SBR2RowRightSeatConfigSts 0;
BA_ "GenSigTimeoutTime_MPAD" SG_ 611 SBR2RowRightSeatConfigSts 0;
BA_ "GenSigTimeoutTime_GNMM" SG_ 611 SBR2RowRightSeatConfigSts 0;
BA_ "GenSigTimeoutTime_EVCU2" SG_ 611 SBR2RowRightSeatConfigSts 0;
BA_ "GenSigTimeoutTime_ESL" SG_ 611 SBR2RowRightSeatConfigSts 0;
BA_ "GenSigTimeoutTime_ECM" SG_ 611 SBR2RowRightSeatConfigSts 0;
BA_ "GenSigTimeoutTime_DTCM" SG_ 611 SBR2RowRightSeatConfigSts 0;
BA_ "GenSigTimeoutTime_DMSM" SG_ 611 SBR2RowRightSeatConfigSts 0;
BA_ "GenSigTimeoutTime_BSM" SG_ 611 SBR2RowRightSeatConfigSts 0;
BA_ "GenSigTimeoutTime_BCM" SG_ 611 SBR2RowRightSeatConfigSts 0;
BA_ "GenSigTimeoutTime_AGSM" SG_ 611 SBR2RowRightSeatConfigSts 0;
BA_ "GenSigTimeoutTime_ADCAM" SG_ 611 SBR2RowRightSeatConfigSts 0;
BA_ "GenSigTimeoutTime_SGW" SG_ 611 SBR2RowLeftSeatConfigSts 0;
BA_ "GenSigTimeoutTime_RFHM" SG_ 611 SBR2RowLeftSeatConfigSts 0;
BA_ "GenSigTimeoutTime_MPAD" SG_ 611 SBR2RowLeftSeatConfigSts 0;
BA_ "GenSigTimeoutTime_GNMM" SG_ 611 SBR2RowLeftSeatConfigSts 0;
BA_ "GenSigTimeoutTime_EVCU2" SG_ 611 SBR2RowLeftSeatConfigSts 0;
BA_ "GenSigTimeoutTime_ESL" SG_ 611 SBR2RowLeftSeatConfigSts 0;
BA_ "GenSigTimeoutTime_ECM" SG_ 611 SBR2RowLeftSeatConfigSts 0;
BA_ "GenSigTimeoutTime_DTCM" SG_ 611 SBR2RowLeftSeatConfigSts 0;
BA_ "GenSigTimeoutTime_DMSM" SG_ 611 SBR2RowLeftSeatConfigSts 0;
BA_ "GenSigTimeoutTime_BSM" SG_ 611 SBR2RowLeftSeatConfigSts 0;
BA_ "GenSigTimeoutTime_BCM" SG_ 611 SBR2RowLeftSeatConfigSts 0;
BA_ "GenSigTimeoutTime_AGSM" SG_ 611 SBR2RowLeftSeatConfigSts 0;
BA_ "GenSigTimeoutTime_ADCAM" SG_ 611 SBR2RowLeftSeatConfigSts 0;
BA_ "GenSigTimeoutTime_SGW" SG_ 611 SBR2RowCentralSeatConfigSts 0;
BA_ "GenSigTimeoutTime_RFHM" SG_ 611 SBR2RowCentralSeatConfigSts 0;
BA_ "GenSigTimeoutTime_MPAD" SG_ 611 SBR2RowCentralSeatConfigSts 0;
BA_ "GenSigTimeoutTime_GNMM" SG_ 611 SBR2RowCentralSeatConfigSts 0;
BA_ "GenSigTimeoutTime_EVCU2" SG_ 611 SBR2RowCentralSeatConfigSts 0;
BA_ "GenSigTimeoutTime_ESL" SG_ 611 SBR2RowCentralSeatConfigSts 0;
BA_ "GenSigTimeoutTime_ECM" SG_ 611 SBR2RowCentralSeatConfigSts 0;
BA_ "GenSigTimeoutTime_DTCM" SG_ 611 SBR2RowCentralSeatConfigSts 0;
BA_ "GenSigTimeoutTime_DMSM" SG_ 611 SBR2RowCentralSeatConfigSts 0;
BA_ "GenSigTimeoutTime_BSM" SG_ 611 SBR2RowCentralSeatConfigSts 0;
BA_ "GenSigTimeoutTime_BCM" SG_ 611 SBR2RowCentralSeatConfigSts 0;
BA_ "GenSigTimeoutTime_AGSM" SG_ 611 SBR2RowCentralSeatConfigSts 0;
BA_ "GenSigTimeoutTime_ADCAM" SG_ 611 SBR2RowCentralSeatConfigSts 0;
BA_ "GenSigTimeoutTime_SGW" SG_ 1954 CRC_ORC2 0;
BA_ "GenSigTimeoutTime_RFHM" SG_ 1954 CRC_ORC2 0;
BA_ "GenSigTimeoutTime_IPC" SG_ 1954 CRC_ORC2 0;
BA_ "GenSigTimeoutTime_GNMM" SG_ 1954 CRC_ORC2 0;
BA_ "GenSigTimeoutTime_EVCU2" SG_ 1954 CRC_ORC2 0;
BA_ "GenSigTimeoutTime_ESL" SG_ 1954 CRC_ORC2 0;
BA_ "GenSigTimeoutTime_ECM" SG_ 1954 CRC_ORC2 0;
BA_ "GenSigTimeoutTime_DTCM" SG_ 1954 CRC_ORC2 0;
BA_ "GenSigTimeoutTime_DMSM" SG_ 1954 CRC_ORC2 0;
BA_ "GenSigTimeoutTime_BCM" SG_ 1954 CRC_ORC2 0;
BA_ "GenSigTimeoutTime_AGSM" SG_ 1954 CRC_ORC2 0;
BA_ "GenSigTimeoutTime_ADCAM" SG_ 1954 CRC_ORC2 0;
BA_ "GenSigTimeoutTime_SGW" SG_ 1954 MessageCounter_ORC2 0;
BA_ "GenSigTimeoutTime_RFHM" SG_ 1954 MessageCounter_ORC2 0;
BA_ "GenSigTimeoutTime_IPC" SG_ 1954 MessageCounter_ORC2 0;
BA_ "GenSigTimeoutTime_GNMM" SG_ 1954 MessageCounter_ORC2 0;
BA_ "GenSigTimeoutTime_EVCU2" SG_ 1954 MessageCounter_ORC2 0;
BA_ "GenSigTimeoutTime_ESL" SG_ 1954 MessageCounter_ORC2 0;
BA_ "GenSigTimeoutTime_ECM" SG_ 1954 MessageCounter_ORC2 0;
BA_ "GenSigTimeoutTime_DTCM" SG_ 1954 MessageCounter_ORC2 0;
BA_ "GenSigTimeoutTime_DMSM" SG_ 1954 MessageCounter_ORC2 0;
BA_ "GenSigTimeoutTime_BCM" SG_ 1954 MessageCounter_ORC2 0;
BA_ "GenSigTimeoutTime_AGSM" SG_ 1954 MessageCounter_ORC2 0;
BA_ "GenSigTimeoutTime_ADCAM" SG_ 1954 MessageCounter_ORC2 0;
BA_ "GenSigTimeoutTime_SGW" SG_ 274 LatAcceleration 0;
BA_ "GenSigTimeoutTime_RFHM" SG_ 274 LatAcceleration 0;
BA_ "GenSigTimeoutTime_IPC" SG_ 274 LatAcceleration 0;
BA_ "GenSigTimeoutTime_GNMM" SG_ 274 LatAcceleration 0;
BA_ "GenSigTimeoutTime_ESL" SG_ 274 LatAcceleration 0;
BA_ "GenSigTimeoutTime_DMSM" SG_ 274 LatAcceleration 0;
BA_ "GenSigTimeoutTime_BSM" SG_ 274 LatAcceleration 0;
BA_ "GenSigTimeoutTime_BCM" SG_ 274 LatAcceleration 0;
BA_ "GenSigTimeoutTime_AGSM" SG_ 274 LatAcceleration 0;
BA_ "GenSigTimeoutTime_ADCAM" SG_ 274 LatAcceleration 0;
BA_ "GenSigStartValue" SG_ 274 LatAcceleration 4095;
BA_ "GenSigTimeoutTime_SGW" SG_ 611 SBR1RowPsngrSeatConfigSts 0;
BA_ "GenSigTimeoutTime_RFHM" SG_ 611 SBR1RowPsngrSeatConfigSts 0;
BA_ "GenSigTimeoutTime_MPAD" SG_ 611 SBR1RowPsngrSeatConfigSts 0;
BA_ "GenSigTimeoutTime_GNMM" SG_ 611 SBR1RowPsngrSeatConfigSts 0;
BA_ "GenSigTimeoutTime_EVCU2" SG_ 611 SBR1RowPsngrSeatConfigSts 0;
BA_ "GenSigTimeoutTime_ESL" SG_ 611 SBR1RowPsngrSeatConfigSts 0;
BA_ "GenSigTimeoutTime_ECM" SG_ 611 SBR1RowPsngrSeatConfigSts 0;
BA_ "GenSigTimeoutTime_DTCM" SG_ 611 SBR1RowPsngrSeatConfigSts 0;
BA_ "GenSigTimeoutTime_DMSM" SG_ 611 SBR1RowPsngrSeatConfigSts 0;
BA_ "GenSigTimeoutTime_BSM" SG_ 611 SBR1RowPsngrSeatConfigSts 0;
BA_ "GenSigTimeoutTime_BCM" SG_ 611 SBR1RowPsngrSeatConfigSts 0;
BA_ "GenSigTimeoutTime_AGSM" SG_ 611 SBR1RowPsngrSeatConfigSts 0;
BA_ "GenSigTimeoutTime_ADCAM" SG_ 611 SBR1RowPsngrSeatConfigSts 0;
BA_ "GenSigTimeoutTime_RFHM" SG_ 611 SBR1RowPsngrSeatSts 0;
BA_ "GenSigTimeoutTime_GNMM" SG_ 611 SBR1RowPsngrSeatSts 0;
BA_ "GenSigTimeoutTime_EVCU2" SG_ 611 SBR1RowPsngrSeatSts 0;
BA_ "GenSigTimeoutTime_ESL" SG_ 611 SBR1RowPsngrSeatSts 0;
BA_ "GenSigTimeoutTime_ECM" SG_ 611 SBR1RowPsngrSeatSts 0;
BA_ "GenSigTimeoutTime_DTCM" SG_ 611 SBR1RowPsngrSeatSts 0;
BA_ "GenSigTimeoutTime_DMSM" SG_ 611 SBR1RowPsngrSeatSts 0;
BA_ "GenSigTimeoutTime_BSM" SG_ 611 SBR1RowPsngrSeatSts 0;
BA_ "GenSigTimeoutTime_BCM" SG_ 611 SBR1RowPsngrSeatSts 0;
BA_ "GenSigTimeoutTime_AGSM" SG_ 611 SBR1RowPsngrSeatSts 0;
BA_ "GenSigTimeoutTime_ADCAM" SG_ 611 SBR1RowPsngrSeatSts 0;
BA_ "GenSigSendType" SG_ 611 SBR1RowPsngrSeatSts 3;
BA_ "GenSigStartValue" SG_ 611 SBR1RowPsngrSeatSts 7;
BA_ "GenSigTimeoutTime_RFHM" SG_ 611 SBR1RowDriverSeatSts 0;
BA_ "GenSigTimeoutTime_MPAD" SG_ 611 SBR1RowDriverSeatSts 0;
BA_ "GenSigTimeoutTime_GNMM" SG_ 611 SBR1RowDriverSeatSts 0;
BA_ "GenSigTimeoutTime_ESL" SG_ 611 SBR1RowDriverSeatSts 0;
BA_ "GenSigTimeoutTime_ECM" SG_ 611 SBR1RowDriverSeatSts 0;
BA_ "GenSigTimeoutTime_SGW" SG_ 1954 DrvSbltUnFltr_1 0;
BA_ "GenSigTimeoutTime_RFHM" SG_ 1954 DrvSbltUnFltr_1 0;
BA_ "GenSigTimeoutTime_MPAD" SG_ 1954 DrvSbltUnFltr_1 0;
BA_ "GenSigTimeoutTime_IPC" SG_ 1954 DrvSbltUnFltr_1 0;
BA_ "GenSigTimeoutTime_GNMM" SG_ 1954 DrvSbltUnFltr_1 0;
BA_ "GenSigTimeoutTime_EVCU2" SG_ 1954 DrvSbltUnFltr_1 0;
BA_ "GenSigTimeoutTime_ESL" SG_ 1954 DrvSbltUnFltr_1 0;
BA_ "GenSigTimeoutTime_DTCM" SG_ 1954 DrvSbltUnFltr_1 0;
BA_ "GenSigTimeoutTime_DMSM" SG_ 1954 DrvSbltUnFltr_1 0;
BA_ "GenSigTimeoutTime_BCM" SG_ 1954 DrvSbltUnFltr_1 0;
BA_ "GenSigTimeoutTime_AGSM" SG_ 1954 DrvSbltUnFltr_1 0;
BA_ "GenSigTimeoutTime_ADCAM" SG_ 1954 DrvSbltUnFltr_1 0;
BA_ "GenSigTimeoutTime_SGW" SG_ 274 IMUTemperature 0;
BA_ "GenSigTimeoutTime_RFHM" SG_ 274 IMUTemperature 0;
BA_ "GenSigTimeoutTime_IPC" SG_ 274 IMUTemperature 0;
BA_ "GenSigTimeoutTime_GNMM" SG_ 274 IMUTemperature 0;
BA_ "GenSigTimeoutTime_EVCU2" SG_ 274 IMUTemperature 0;
BA_ "GenSigTimeoutTime_ESL" SG_ 274 IMUTemperature 0;
BA_ "GenSigTimeoutTime_ECM" SG_ 274 IMUTemperature 0;
BA_ "GenSigTimeoutTime_DTCM" SG_ 274 IMUTemperature 0;
BA_ "GenSigTimeoutTime_DMSM" SG_ 274 IMUTemperature 0;
BA_ "GenSigTimeoutTime_BSM" SG_ 274 IMUTemperature 0;
BA_ "GenSigTimeoutTime_BCM" SG_ 274 IMUTemperature 0;
BA_ "GenSigTimeoutTime_AGSM" SG_ 274 IMUTemperature 0;
BA_ "GenSigTimeoutTime_ADCAM" SG_ 274 IMUTemperature 0;
BA_ "GenSigStartValue" SG_ 274 IMUTemperature 40;
BA_ "GenSigTimeoutTime_SGW" SG_ 1954 SBR1RowPsngrSeatPPDSts 0;
BA_ "GenSigTimeoutTime_RFHM" SG_ 1954 SBR1RowPsngrSeatPPDSts 0;
BA_ "GenSigTimeoutTime_GNMM" SG_ 1954 SBR1RowPsngrSeatPPDSts 0;
BA_ "GenSigTimeoutTime_EVCU2" SG_ 1954 SBR1RowPsngrSeatPPDSts 0;
BA_ "GenSigTimeoutTime_ESL" SG_ 1954 SBR1RowPsngrSeatPPDSts 0;
BA_ "GenSigTimeoutTime_ECM" SG_ 1954 SBR1RowPsngrSeatPPDSts 0;
BA_ "GenSigTimeoutTime_DTCM" SG_ 1954 SBR1RowPsngrSeatPPDSts 0;
BA_ "GenSigTimeoutTime_DMSM" SG_ 1954 SBR1RowPsngrSeatPPDSts 0;
BA_ "GenSigTimeoutTime_BSM" SG_ 1954 SBR1RowPsngrSeatPPDSts 0;
BA_ "GenSigTimeoutTime_BCM" SG_ 1954 SBR1RowPsngrSeatPPDSts 0;
BA_ "GenSigTimeoutTime_AGSM" SG_ 1954 SBR1RowPsngrSeatPPDSts 0;
BA_ "GenSigTimeoutTime_ADCAM" SG_ 1954 SBR1RowPsngrSeatPPDSts 0;
BA_ "GenSigSendType" SG_ 1954 SBR1RowPsngrSeatPPDSts 3;
BA_ "GenSigStartValue" SG_ 1954 SBR1RowPsngrSeatPPDSts 3;
BA_ "GenSigTimeoutTime_DTCM" SG_ 1432 PartialOdometerAPlus 0;
BA_ "GenSigTimeoutTime_DMSM" SG_ 1432 PartialOdometerAPlus 0;
BA_ "GenSigTimeoutTime_BSM" SG_ 1432 PartialOdometerAPlus 0;
BA_ "GenSigTimeoutTime_BCM" SG_ 1432 PartialOdometerAPlus 0;
BA_ "GenSigTimeoutTime_AGSM" SG_ 1432 PartialOdometerAPlus 0;
BA_ "GenSigTimeoutTime_ADCAM" SG_ 1432 PartialOdometerAPlus 0;
BA_ "GenSigSendType" SG_ 1432 PartialOdometerAPlus 3;
BA_ "GenSigTimeoutTime_EVCU2" SG_ 1432 PartialOdometerBPlus 0;
BA_ "GenSigTimeoutTime_ESL" SG_ 1432 PartialOdometerBPlus 0;
BA_ "GenSigTimeoutTime_ECM" SG_ 1432 PartialOdometerBPlus 0;
BA_ "GenSigTimeoutTime_DTCM" SG_ 1432 PartialOdometerBPlus 0;
BA_ "GenSigTimeoutTime_DMSM" SG_ 1432 PartialOdometerBPlus 0;
BA_ "GenSigTimeoutTime_BSM" SG_ 1432 PartialOdometerBPlus 0;
BA_ "GenSigTimeoutTime_BCM" SG_ 1432 PartialOdometerBPlus 0;
BA_ "GenSigTimeoutTime_AGSM" SG_ 1432 PartialOdometerBPlus 0;
BA_ "GenSigTimeoutTime_ADCAM" SG_ 1432 PartialOdometerBPlus 0;
BA_ "GenSigSendType" SG_ 1432 PartialOdometerBPlus 3;
BA_ "GenSigTimeoutTime_RFHM" SG_ 1432 PartialOdometerBPlus 0;
BA_ "GenSigTimeoutTime_MPAD" SG_ 1432 PartialOdometerBPlus 0;
BA_ "GenSigTimeoutTime_IPC" SG_ 1432 PartialOdometerBPlus 0;
BA_ "GenSigTimeoutTime_GNMM" SG_ 1432 PartialOdometerBPlus 0;
BA_ "GenSigTimeoutTime_SGW" SG_ 600 IPC_NV_DISP_STAT 0;
BA_ "GenSigTimeoutTime_RFHM" SG_ 600 IPC_NV_DISP_STAT 0;
BA_ "GenSigTimeoutTime_MPAD" SG_ 600 IPC_NV_DISP_STAT 0;
BA_ "GenSigTimeoutTime_IPC" SG_ 600 IPC_NV_DISP_STAT 0;
BA_ "GenSigTimeoutTime_GNMM" SG_ 600 IPC_NV_DISP_STAT 0;
BA_ "GenSigTimeoutTime_EVCU2" SG_ 600 IPC_NV_DISP_STAT 0;
BA_ "GenSigTimeoutTime_ESL" SG_ 600 IPC_NV_DISP_STAT 0;
BA_ "GenSigTimeoutTime_ECM" SG_ 600 IPC_NV_DISP_STAT 0;
BA_ "GenSigTimeoutTime_DTCM" SG_ 600 IPC_NV_DISP_STAT 0;
BA_ "GenSigTimeoutTime_DMSM" SG_ 600 IPC_NV_DISP_STAT 0;
BA_ "GenSigTimeoutTime_BSM" SG_ 600 IPC_NV_DISP_STAT 0;
BA_ "GenSigTimeoutTime_AGSM" SG_ 600 IPC_NV_DISP_STAT 0;
BA_ "GenSigTimeoutTime_ADCAM" SG_ 600 IPC_NV_DISP_STAT 0;
BA_ "GenSigSendType" SG_ 600 IPC_NV_DISP_STAT 3;
BA_ "GenSigTimeoutTime_RFHM" SG_ 1831 TRK_OPN_STAT 0;
BA_ "GenSigTimeoutTime_MPAD" SG_ 1831 TRK_OPN_STAT 0;
BA_ "GenSigTimeoutTime_IPC" SG_ 1831 TRK_OPN_STAT 0;
BA_ "GenSigTimeoutTime_GNMM" SG_ 1831 TRK_OPN_STAT 0;
BA_ "GenSigTimeoutTime_EVCU2" SG_ 1831 TRK_OPN_STAT 0;
BA_ "GenSigTimeoutTime_ESL" SG_ 1831 TRK_OPN_STAT 0;
BA_ "GenSigTimeoutTime_ECM" SG_ 1831 TRK_OPN_STAT 0;
BA_ "GenSigTimeoutTime_DTCM" SG_ 1831 TRK_OPN_STAT 0;
BA_ "GenSigTimeoutTime_DMSM" SG_ 1831 TRK_OPN_STAT 0;
BA_ "GenSigTimeoutTime_BSM" SG_ 1831 TRK_OPN_STAT 0;
BA_ "GenSigTimeoutTime_BCM" SG_ 1831 TRK_OPN_STAT 0;
BA_ "GenSigTimeoutTime_AGSM" SG_ 1831 TRK_OPN_STAT 0;
BA_ "GenSigTimeoutTime_ADCAM" SG_ 1831 TRK_OPN_STAT 0;
BA_ "GenSigTimeoutTime_RFHM" SG_ 1831 THEFT_ALARM_STAT 0;
BA_ "GenSigTimeoutTime_MPAD" SG_ 1831 THEFT_ALARM_STAT 0;
BA_ "GenSigTimeoutTime_IPC" SG_ 1831 THEFT_ALARM_STAT 0;
BA_ "GenSigTimeoutTime_GNMM" SG_ 1831 THEFT_ALARM_STAT 0;
BA_ "GenSigTimeoutTime_EVCU2" SG_ 1831 THEFT_ALARM_STAT 0;
BA_ "GenSigTimeoutTime_ESL" SG_ 1831 THEFT_ALARM_STAT 0;
BA_ "GenSigTimeoutTime_ECM" SG_ 1831 THEFT_ALARM_STAT 0;
BA_ "GenSigTimeoutTime_DTCM" SG_ 1831 THEFT_ALARM_STAT 0;
BA_ "GenSigTimeoutTime_DMSM" SG_ 1831 THEFT_ALARM_STAT 0;
BA_ "GenSigTimeoutTime_BSM" SG_ 1831 THEFT_ALARM_STAT 0;
BA_ "GenSigTimeoutTime_RFHM" SG_ 1831 TOW_HAUL_STAT 0;
BA_ "GenSigTimeoutTime_MPAD" SG_ 1831 TOW_HAUL_STAT 0;
BA_ "GenSigTimeoutTime_IPC" SG_ 1831 TOW_HAUL_STAT 0;
BA_ "GenSigTimeoutTime_GNMM" SG_ 1831 TOW_HAUL_STAT 0;
BA_ "GenSigTimeoutTime_EVCU2" SG_ 1831 TOW_HAUL_STAT 0;
BA_ "GenSigTimeoutTime_ESL" SG_ 1831 TOW_HAUL_STAT 0;
BA_ "GenSigTimeoutTime_ECM" SG_ 1831 TOW_HAUL_STAT 0;
BA_ "GenSigTimeoutTime_DTCM" SG_ 1831 TOW_HAUL_STAT 0;
BA_ "GenSigTimeoutTime_DMSM" SG_ 1831 TOW_HAUL_STAT 0;
BA_ "GenSigTimeoutTime_BSM" SG_ 1831 TOW_HAUL_STAT 0;
BA_ "GenSigTimeoutTime_BCM" SG_ 1831 TOW_HAUL_STAT 0;
BA_ "GenSigTimeoutTime_AGSM" SG_ 1831 TOW_HAUL_STAT 0;
BA_ "GenSigTimeoutTime_ADCAM" SG_ 1831 TOW_HAUL_STAT 0;
BA_ "GenSigTimeoutTime_SGW" SG_ 1154 VehSpd_MPH 0;
BA_ "GenSigTimeoutTime_RFHM" SG_ 1154 VehSpd_MPH 0;
BA_ "GenSigTimeoutTime_IPC" SG_ 1154 VehSpd_MPH 0;
BA_ "GenSigTimeoutTime_GNMM" SG_ 1154 VehSpd_MPH 0;
BA_ "GenSigTimeoutTime_EVCU2" SG_ 1154 VehSpd_MPH 0;
BA_ "GenSigTimeoutTime_ESL" SG_ 1154 VehSpd_MPH 0;
BA_ "GenSigTimeoutTime_ECM" SG_ 1154 VehSpd_MPH 0;
BA_ "GenSigTimeoutTime_DTCM" SG_ 1154 VehSpd_MPH 0;
BA_ "GenSigTimeoutTime_DMSM" SG_ 1154 VehSpd_MPH 0;
BA_ "GenSigTimeoutTime_BSM" SG_ 1154 VehSpd_MPH 0;
BA_ "GenSigTimeoutTime_BCM" SG_ 1154 VehSpd_MPH 0;
BA_ "GenSigTimeoutTime_AGSM" SG_ 1154 VehSpd_MPH 0;
BA_ "GenSigTimeoutTime_ADCAM" SG_ 1154 VehSpd_MPH 0;
BA_ "GenSigTimeoutTime_SGW" SG_ 1154 VehSpdDisp 0;
BA_ "GenSigTimeoutTime_RFHM" SG_ 1154 VehSpdDisp 0;
BA_ "GenSigTimeoutTime_IPC" SG_ 1154 VehSpdDisp 0;
BA_ "GenSigTimeoutTime_GNMM" SG_ 1154 VehSpdDisp 0;
BA_ "GenSigTimeoutTime_EVCU2" SG_ 1154 VehSpdDisp 0;
BA_ "GenSigTimeoutTime_ESL" SG_ 1154 VehSpdDisp 0;
BA_ "GenSigTimeoutTime_ECM" SG_ 1154 VehSpdDisp 0;
BA_ "GenSigTimeoutTime_DTCM" SG_ 1154 VehSpdDisp 0;
BA_ "GenSigTimeoutTime_DMSM" SG_ 1154 VehSpdDisp 0;
BA_ "GenSigTimeoutTime_BSM" SG_ 1154 VehSpdDisp 0;
BA_ "GenSigTimeoutTime_BCM" SG_ 1154 VehSpdDisp 0;
BA_ "GenSigTimeoutTime_AGSM" SG_ 1154 VehSpdDisp 0;
BA_ "GenSigTimeoutTime_ADCAM" SG_ 1154 VehSpdDisp 0;
BA_ "GenSigStartValue" SG_ 1154 VehSpdDisp 65535;
BA_ "GenSigTimeoutTime_SGW" SG_ 600 OilChgRst 0;
BA_ "GenSigTimeoutTime_RFHM" SG_ 600 OilChgRst 0;
BA_ "GenSigTimeoutTime_MPAD" SG_ 600 OilChgRst 0;
BA_ "GenSigTimeoutTime_IPC" SG_ 600 OilChgRst 0;
BA_ "GenSigTimeoutTime_GNMM" SG_ 600 OilChgRst 0;
BA_ "GenSigTimeoutTime_EVCU2" SG_ 600 OilChgRst 0;
BA_ "GenSigTimeoutTime_ESL" SG_ 600 OilChgRst 0;
BA_ "GenSigTimeoutTime_DTCM" SG_ 600 OilChgRst 0;
BA_ "GenSigTimeoutTime_DMSM" SG_ 600 OilChgRst 0;
BA_ "GenSigTimeoutTime_BSM" SG_ 600 OilChgRst 0;
BA_ "GenSigTimeoutTime_BCM" SG_ 600 OilChgRst 0;
BA_ "GenSigTimeoutTime_AGSM" SG_ 600 OilChgRst 0;
BA_ "GenSigTimeoutTime_ADCAM" SG_ 600 OilChgRst 0;
BA_ "GenSigTimeoutTime_RFHM" SG_ 1831 TIRE_PRESSURE_STAT 0;
BA_ "GenSigTimeoutTime_MPAD" SG_ 1831 TIRE_PRESSURE_STAT 0;
BA_ "GenSigTimeoutTime_IPC" SG_ 1831 TIRE_PRESSURE_STAT 0;
BA_ "GenSigTimeoutTime_GNMM" SG_ 1831 TIRE_PRESSURE_STAT 0;
BA_ "GenSigTimeoutTime_EVCU2" SG_ 1831 TIRE_PRESSURE_STAT 0;
BA_ "GenSigTimeoutTime_ESL" SG_ 1831 TIRE_PRESSURE_STAT 0;
BA_ "GenSigTimeoutTime_ECM" SG_ 1831 TIRE_PRESSURE_STAT 0;
BA_ "GenSigTimeoutTime_DTCM" SG_ 1831 TIRE_PRESSURE_STAT 0;
BA_ "GenSigTimeoutTime_DMSM" SG_ 1831 TIRE_PRESSURE_STAT 0;
BA_ "GenSigTimeoutTime_BSM" SG_ 1831 TIRE_PRESSURE_STAT 0;
BA_ "GenSigTimeoutTime_BCM" SG_ 1831 TIRE_PRESSURE_STAT 0;
BA_ "GenSigTimeoutTime_AGSM" SG_ 1831 TIRE_PRESSURE_STAT 0;
BA_ "GenSigTimeoutTime_ADCAM" SG_ 1831 TIRE_PRESSURE_STAT 0;
BA_ "GenSigTimeoutTime_IPC" SG_ 1831 TORQUE_STAT 0;
BA_ "GenSigTimeoutTime_GNMM" SG_ 1831 TORQUE_STAT 0;
BA_ "GenSigTimeoutTime_EVCU2" SG_ 1831 TORQUE_STAT 0;
BA_ "GenSigTimeoutTime_ESL" SG_ 1831 TORQUE_STAT 0;
BA_ "GenSigTimeoutTime_ECM" SG_ 1831 TORQUE_STAT 0;
BA_ "GenSigTimeoutTime_DTCM" SG_ 1831 TORQUE_STAT 0;
BA_ "GenSigTimeoutTime_DMSM" SG_ 1831 TORQUE_STAT 0;
BA_ "GenSigTimeoutTime_BSM" SG_ 1831 TORQUE_STAT 0;
BA_ "GenSigTimeoutTime_BCM" SG_ 1831 TORQUE_STAT 0;
BA_ "GenSigTimeoutTime_AGSM" SG_ 1831 TORQUE_STAT 0;
BA_ "GenSigTimeoutTime_ADCAM" SG_ 1831 TORQUE_STAT 0;
BA_ "GenSigTimeoutTime_RFHM" SG_ 1831 TORQUE_STAT 0;
BA_ "GenSigTimeoutTime_MPAD" SG_ 1831 TORQUE_STAT 0;
BA_ "GenSigTimeoutTime_RFHM" SG_ 1831 WATER_IN_FUEL_STAT 0;
BA_ "GenSigTimeoutTime_MPAD" SG_ 1831 WATER_IN_FUEL_STAT 0;
BA_ "GenSigTimeoutTime_IPC" SG_ 1831 WATER_IN_FUEL_STAT 0;
BA_ "GenSigTimeoutTime_GNMM" SG_ 1831 WATER_IN_FUEL_STAT 0;
BA_ "GenSigTimeoutTime_EVCU2" SG_ 1831 WATER_IN_FUEL_STAT 0;
BA_ "GenSigTimeoutTime_ESL" SG_ 1831 WATER_IN_FUEL_STAT 0;
BA_ "GenSigTimeoutTime_ECM" SG_ 1831 WATER_IN_FUEL_STAT 0;
BA_ "GenSigTimeoutTime_DTCM" SG_ 1831 WATER_IN_FUEL_STAT 0;
BA_ "GenSigTimeoutTime_DMSM" SG_ 1831 WATER_IN_FUEL_STAT 0;
BA_ "GenSigTimeoutTime_BSM" SG_ 1831 WATER_IN_FUEL_STAT 0;
BA_ "GenSigTimeoutTime_BCM" SG_ 1831 WATER_IN_FUEL_STAT 0;
BA_ "GenSigTimeoutTime_AGSM" SG_ 1831 WATER_IN_FUEL_STAT 0;
BA_ "GenSigTimeoutTime_ADCAM" SG_ 1831 WATER_IN_FUEL_STAT 0;
BA_ "GenSigTimeoutTime_RFHM" SG_ 600 AirBagLamp_FailSts 0;
BA_ "GenSigTimeoutTime_MPAD" SG_ 600 AirBagLamp_FailSts 0;
BA_ "GenSigTimeoutTime_IPC" SG_ 600 AirBagLamp_FailSts 0;
BA_ "GenSigTimeoutTime_GNMM" SG_ 600 AirBagLamp_FailSts 0;
BA_ "GenSigTimeoutTime_EVCU2" SG_ 600 AirBagLamp_FailSts 0;
BA_ "GenSigTimeoutTime_ESL" SG_ 600 AirBagLamp_FailSts 0;
BA_ "GenSigTimeoutTime_ECM" SG_ 600 AirBagLamp_FailSts 0;
BA_ "GenSigTimeoutTime_DTCM" SG_ 600 AirBagLamp_FailSts 0;
BA_ "GenSigTimeoutTime_DMSM" SG_ 600 AirBagLamp_FailSts 0;
BA_ "GenSigTimeoutTime_BSM" SG_ 600 AirBagLamp_FailSts 0;
BA_ "GenSigTimeoutTime_AGSM" SG_ 600 AirBagLamp_FailSts 0;
BA_ "GenSigTimeoutTime_ADCAM" SG_ 600 AirBagLamp_FailSts 0;
BA_ "GenSigTimeoutTime_RFHM" SG_ 1831 WINDSHIELD_FLUID_STAT 0;
BA_ "GenSigTimeoutTime_MPAD" SG_ 1831 WINDSHIELD_FLUID_STAT 0;
BA_ "GenSigTimeoutTime_IPC" SG_ 1831 WINDSHIELD_FLUID_STAT 0;
BA_ "GenSigTimeoutTime_GNMM" SG_ 1831 WINDSHIELD_FLUID_STAT 0;
BA_ "GenSigTimeoutTime_EVCU2" SG_ 1831 WINDSHIELD_FLUID_STAT 0;
BA_ "GenSigTimeoutTime_ESL" SG_ 1831 WINDSHIELD_FLUID_STAT 0;
BA_ "GenSigTimeoutTime_ECM" SG_ 1831 WINDSHIELD_FLUID_STAT 0;
BA_ "GenSigTimeoutTime_DTCM" SG_ 1831 WINDSHIELD_FLUID_STAT 0;
BA_ "GenSigTimeoutTime_DMSM" SG_ 1831 WINDSHIELD_FLUID_STAT 0;
BA_ "GenSigTimeoutTime_BSM" SG_ 1831 WINDSHIELD_FLUID_STAT 0;
BA_ "GenSigTimeoutTime_BCM" SG_ 1831 WINDSHIELD_FLUID_STAT 0;
BA_ "GenSigTimeoutTime_AGSM" SG_ 1831 WINDSHIELD_FLUID_STAT 0;
BA_ "GenSigTimeoutTime_ADCAM" SG_ 1831 WINDSHIELD_FLUID_STAT 0;
BA_ "GenSigTimeoutTime_RFHM" SG_ 1831 STOP_START_STAT 0;
BA_ "GenSigTimeoutTime_MPAD" SG_ 1831 STOP_START_STAT 0;
BA_ "GenSigTimeoutTime_IPC" SG_ 1831 STOP_START_STAT 0;
BA_ "GenSigTimeoutTime_GNMM" SG_ 1831 STOP_START_STAT 0;
BA_ "GenSigTimeoutTime_EVCU2" SG_ 1831 STOP_START_STAT 0;
BA_ "GenSigTimeoutTime_ESL" SG_ 1831 STOP_START_STAT 0;
BA_ "GenSigTimeoutTime_ECM" SG_ 1831 STOP_START_STAT 0;
BA_ "GenSigTimeoutTime_DTCM" SG_ 1831 STOP_START_STAT 0;
BA_ "GenSigTimeoutTime_DMSM" SG_ 1831 STOP_START_STAT 0;
BA_ "GenSigTimeoutTime_BSM" SG_ 1831 STOP_START_STAT 0;
BA_ "GenSigTimeoutTime_BCM" SG_ 1831 STOP_START_STAT 0;
BA_ "GenSigTimeoutTime_AGSM" SG_ 1831 STOP_START_STAT 0;
BA_ "GenSigTimeoutTime_ADCAM" SG_ 1831 STOP_START_STAT 0;
BA_ "GenSigTimeoutTime_RFHM" SG_ 1831 SERVICE_STAT 0;
BA_ "GenSigTimeoutTime_MPAD" SG_ 1831 SERVICE_STAT 0;
BA_ "GenSigTimeoutTime_IPC" SG_ 1831 SERVICE_STAT 0;
BA_ "GenSigTimeoutTime_GNMM" SG_ 1831 SERVICE_STAT 0;
BA_ "GenSigTimeoutTime_EVCU2" SG_ 1831 SERVICE_STAT 0;
BA_ "GenSigTimeoutTime_ESL" SG_ 1831 SERVICE_STAT 0;
BA_ "GenSigTimeoutTime_ECM" SG_ 1831 SERVICE_STAT 0;
BA_ "GenSigTimeoutTime_DTCM" SG_ 1831 SERVICE_STAT 0;
BA_ "GenSigTimeoutTime_DMSM" SG_ 1831 SERVICE_STAT 0;
BA_ "GenSigTimeoutTime_BSM" SG_ 1831 SERVICE_STAT 0;
BA_ "GenSigTimeoutTime_BCM" SG_ 1831 SERVICE_STAT 0;
BA_ "GenSigTimeoutTime_AGSM" SG_ 1831 SERVICE_STAT 0;
BA_ "GenSigTimeoutTime_ADCAM" SG_ 1831 SERVICE_STAT 0;
BA_ "GenSigTimeoutTime_RFHM" SG_ 1831 SPEED_CTRL_STAT 0;
BA_ "GenSigTimeoutTime_MPAD" SG_ 1831 SPEED_CTRL_STAT 0;
BA_ "GenSigTimeoutTime_IPC" SG_ 1831 SPEED_CTRL_STAT 0;
BA_ "GenSigTimeoutTime_GNMM" SG_ 1831 SPEED_CTRL_STAT 0;
BA_ "GenSigTimeoutTime_EVCU2" SG_ 1831 SPEED_CTRL_STAT 0;
BA_ "GenSigTimeoutTime_ESL" SG_ 1831 SPEED_CTRL_STAT 0;
BA_ "GenSigTimeoutTime_ECM" SG_ 1831 SPEED_CTRL_STAT 0;
BA_ "GenSigTimeoutTime_DTCM" SG_ 1831 SPEED_CTRL_STAT 0;
BA_ "GenSigTimeoutTime_DMSM" SG_ 1831 SPEED_CTRL_STAT 0;
BA_ "GenSigTimeoutTime_BSM" SG_ 1831 SPEED_CTRL_STAT 0;
BA_ "GenSigTimeoutTime_BCM" SG_ 1831 SPEED_CTRL_STAT 0;
BA_ "GenSigTimeoutTime_AGSM" SG_ 1831 SPEED_CTRL_STAT 0;
BA_ "GenSigTimeoutTime_ADCAM" SG_ 1831 SPEED_CTRL_STAT 0;
BA_ "GenSigTimeoutTime_RFHM" SG_ 1831 LANE_DEPART_FAIL_STAT 0;
BA_ "GenSigTimeoutTime_MPAD" SG_ 1831 LANE_DEPART_FAIL_STAT 0;
BA_ "GenSigTimeoutTime_RFHM" SG_ 1831 LANE_DEPART_STAT 0;
BA_ "GenSigTimeoutTime_MPAD" SG_ 1831 LANE_DEPART_STAT 0;
BA_ "GenSigTimeoutTime_IPC" SG_ 1831 LANE_DEPART_STAT 0;
BA_ "GenSigTimeoutTime_GNMM" SG_ 1831 LANE_DEPART_STAT 0;
BA_ "GenSigTimeoutTime_EVCU2" SG_ 1831 LANE_DEPART_STAT 0;
BA_ "GenSigTimeoutTime_ESL" SG_ 1831 LANE_DEPART_STAT 0;
BA_ "GenSigTimeoutTime_ECM" SG_ 1831 LANE_DEPART_STAT 0;
BA_ "GenSigTimeoutTime_DTCM" SG_ 1831 LANE_DEPART_STAT 0;
BA_ "GenSigTimeoutTime_DMSM" SG_ 1831 LANE_DEPART_STAT 0;
BA_ "GenSigTimeoutTime_BSM" SG_ 1831 LANE_DEPART_STAT 0;
BA_ "GenSigTimeoutTime_BCM" SG_ 1831 LANE_DEPART_STAT 0;
BA_ "GenSigTimeoutTime_AGSM" SG_ 1831 LANE_DEPART_STAT 0;
BA_ "GenSigTimeoutTime_ADCAM" SG_ 1831 LANE_DEPART_STAT 0;
BA_ "GenSigTimeoutTime_RFHM" SG_ 1831 LANE_SENSE_STAT 0;
BA_ "GenSigTimeoutTime_MPAD" SG_ 1831 LANE_SENSE_STAT 0;
BA_ "GenSigTimeoutTime_IPC" SG_ 1831 LANE_SENSE_STAT 0;
BA_ "GenSigTimeoutTime_GNMM" SG_ 1831 LANE_SENSE_STAT 0;
BA_ "GenSigTimeoutTime_EVCU2" SG_ 1831 LANE_SENSE_STAT 0;
BA_ "GenSigTimeoutTime_ESL" SG_ 1831 LANE_SENSE_STAT 0;
BA_ "GenSigTimeoutTime_ECM" SG_ 1831 LANE_SENSE_STAT 0;
BA_ "GenSigTimeoutTime_DTCM" SG_ 1831 LANE_SENSE_STAT 0;
BA_ "GenSigTimeoutTime_DMSM" SG_ 1831 LANE_SENSE_STAT 0;
BA_ "GenSigTimeoutTime_BSM" SG_ 1831 LANE_SENSE_STAT 0;
BA_ "GenSigTimeoutTime_BCM" SG_ 1831 LANE_SENSE_STAT 0;
BA_ "GenSigTimeoutTime_AGSM" SG_ 1831 LANE_SENSE_STAT 0;
BA_ "GenSigTimeoutTime_ADCAM" SG_ 1831 LANE_SENSE_STAT 0;
BA_ "GenSigTimeoutTime_BCM" SG_ 1831 LIFT_GATE_STAT 0;
BA_ "GenSigTimeoutTime_AGSM" SG_ 1831 LIFT_GATE_STAT 0;
BA_ "GenSigTimeoutTime_ADCAM" SG_ 1831 LIFT_GATE_STAT 0;
BA_ "GenSigTimeoutTime_RFHM" SG_ 1831 LIFT_GATE_STAT 0;
BA_ "GenSigTimeoutTime_MPAD" SG_ 1831 LIFT_GATE_STAT 0;
BA_ "GenSigTimeoutTime_IPC" SG_ 1831 LIFT_GATE_STAT 0;
BA_ "GenSigTimeoutTime_GNMM" SG_ 1831 LIFT_GATE_STAT 0;
BA_ "GenSigTimeoutTime_EVCU2" SG_ 1831 LIFT_GATE_STAT 0;
BA_ "GenSigTimeoutTime_ESL" SG_ 1831 LIFT_GATE_STAT 0;
BA_ "GenSigTimeoutTime_ECM" SG_ 1831 LIFT_GATE_STAT 0;
BA_ "GenSigTimeoutTime_DTCM" SG_ 1831 LIFT_GATE_STAT 0;
BA_ "GenSigTimeoutTime_DMSM" SG_ 1831 LIFT_GATE_STAT 0;
BA_ "GenSigTimeoutTime_BSM" SG_ 1831 LIFT_GATE_STAT 0;
BA_ "GenSigTimeoutTime_RFHM" SG_ 1831 LT_EXH_STAT 0;
BA_ "GenSigTimeoutTime_MPAD" SG_ 1831 LT_EXH_STAT 0;
BA_ "GenSigTimeoutTime_IPC" SG_ 1831 LT_EXH_STAT 0;
BA_ "GenSigTimeoutTime_GNMM" SG_ 1831 LT_EXH_STAT 0;
BA_ "GenSigTimeoutTime_EVCU2" SG_ 1831 LT_EXH_STAT 0;
BA_ "GenSigTimeoutTime_ESL" SG_ 1831 LT_EXH_STAT 0;
BA_ "GenSigTimeoutTime_ECM" SG_ 1831 LT_EXH_STAT 0;
BA_ "GenSigTimeoutTime_DTCM" SG_ 1831 LT_EXH_STAT 0;
BA_ "GenSigTimeoutTime_DMSM" SG_ 1831 LT_EXH_STAT 0;
BA_ "GenSigTimeoutTime_BSM" SG_ 1831 LT_EXH_STAT 0;
BA_ "GenSigTimeoutTime_BCM" SG_ 1831 LT_EXH_STAT 0;
BA_ "GenSigTimeoutTime_AGSM" SG_ 1831 LT_EXH_STAT 0;
BA_ "GenSigTimeoutTime_ADCAM" SG_ 1831 LT_EXH_STAT 0;
BA_ "GenSigTimeoutTime_RFHM" SG_ 1831 NAT_GAS_STAT 0;
BA_ "GenSigTimeoutTime_MPAD" SG_ 1831 NAT_GAS_STAT 0;
BA_ "GenSigTimeoutTime_IPC" SG_ 1831 NAT_GAS_STAT 0;
BA_ "GenSigTimeoutTime_GNMM" SG_ 1831 NAT_GAS_STAT 0;
BA_ "GenSigTimeoutTime_EVCU2" SG_ 1831 NAT_GAS_STAT 0;
BA_ "GenSigTimeoutTime_ESL" SG_ 1831 NAT_GAS_STAT 0;
BA_ "GenSigTimeoutTime_ECM" SG_ 1831 NAT_GAS_STAT 0;
BA_ "GenSigTimeoutTime_DTCM" SG_ 1831 NAT_GAS_STAT 0;
BA_ "GenSigTimeoutTime_DMSM" SG_ 1831 NAT_GAS_STAT 0;
BA_ "GenSigTimeoutTime_BSM" SG_ 1831 NAT_GAS_STAT 0;
BA_ "GenSigTimeoutTime_BCM" SG_ 1831 NAT_GAS_STAT 0;
BA_ "GenSigTimeoutTime_AGSM" SG_ 1831 NAT_GAS_STAT 0;
BA_ "GenSigTimeoutTime_ADCAM" SG_ 1831 NAT_GAS_STAT 0;
BA_ "GenSigTimeoutTime_RFHM" SG_ 1831 OIL_LEVEL_STAT 0;
BA_ "GenSigTimeoutTime_MPAD" SG_ 1831 OIL_LEVEL_STAT 0;
BA_ "GenSigTimeoutTime_IPC" SG_ 1831 OIL_LEVEL_STAT 0;
BA_ "GenSigTimeoutTime_GNMM" SG_ 1831 OIL_LEVEL_STAT 0;
BA_ "GenSigTimeoutTime_EVCU2" SG_ 1831 OIL_LEVEL_STAT 0;
BA_ "GenSigTimeoutTime_ESL" SG_ 1831 OIL_LEVEL_STAT 0;
BA_ "GenSigTimeoutTime_ECM" SG_ 1831 OIL_LEVEL_STAT 0;
BA_ "GenSigTimeoutTime_DTCM" SG_ 1831 OIL_LEVEL_STAT 0;
BA_ "GenSigTimeoutTime_DMSM" SG_ 1831 OIL_LEVEL_STAT 0;
BA_ "GenSigTimeoutTime_BSM" SG_ 1831 OIL_LEVEL_STAT 0;
BA_ "GenSigTimeoutTime_BCM" SG_ 1831 OIL_LEVEL_STAT 0;
BA_ "GenSigTimeoutTime_AGSM" SG_ 1831 OIL_LEVEL_STAT 0;
BA_ "GenSigTimeoutTime_ADCAM" SG_ 1831 OIL_LEVEL_STAT 0;
BA_ "GenSigTimeoutTime_RFHM" SG_ 1831 OIL_PRESSURE_STAT 0;
BA_ "GenSigTimeoutTime_MPAD" SG_ 1831 OIL_PRESSURE_STAT 0;
BA_ "GenSigTimeoutTime_IPC" SG_ 1831 OIL_PRESSURE_STAT 0;
BA_ "GenSigTimeoutTime_GNMM" SG_ 1831 OIL_PRESSURE_STAT 0;
BA_ "GenSigTimeoutTime_EVCU2" SG_ 1831 OIL_PRESSURE_STAT 0;
BA_ "GenSigTimeoutTime_ESL" SG_ 1831 OIL_PRESSURE_STAT 0;
BA_ "GenSigTimeoutTime_ECM" SG_ 1831 OIL_PRESSURE_STAT 0;
BA_ "GenSigTimeoutTime_DTCM" SG_ 1831 OIL_PRESSURE_STAT 0;
BA_ "GenSigTimeoutTime_DMSM" SG_ 1831 OIL_PRESSURE_STAT 0;
BA_ "GenSigTimeoutTime_BSM" SG_ 1831 OIL_PRESSURE_STAT 0;
BA_ "GenSigTimeoutTime_BCM" SG_ 1831 OIL_PRESSURE_STAT 0;
BA_ "GenSigTimeoutTime_AGSM" SG_ 1831 OIL_PRESSURE_STAT 0;
BA_ "GenSigTimeoutTime_ADCAM" SG_ 1831 OIL_PRESSURE_STAT 0;
BA_ "GenSigTimeoutTime_RFHM" SG_ 1831 OIL_TEMP_STAT 0;
BA_ "GenSigTimeoutTime_MPAD" SG_ 1831 OIL_TEMP_STAT 0;
BA_ "GenSigTimeoutTime_IPC" SG_ 1831 OIL_TEMP_STAT 0;
BA_ "GenSigTimeoutTime_GNMM" SG_ 1831 OIL_TEMP_STAT 0;
BA_ "GenSigTimeoutTime_EVCU2" SG_ 1831 OIL_TEMP_STAT 0;
BA_ "GenSigTimeoutTime_ESL" SG_ 1831 OIL_TEMP_STAT 0;
BA_ "GenSigTimeoutTime_ECM" SG_ 1831 OIL_TEMP_STAT 0;
BA_ "GenSigTimeoutTime_DTCM" SG_ 1831 OIL_TEMP_STAT 0;
BA_ "GenSigTimeoutTime_DMSM" SG_ 1831 OIL_TEMP_STAT 0;
BA_ "GenSigTimeoutTime_BSM" SG_ 1831 OIL_TEMP_STAT 0;
BA_ "GenSigTimeoutTime_BCM" SG_ 1831 OIL_TEMP_STAT 0;
BA_ "GenSigTimeoutTime_AGSM" SG_ 1831 OIL_TEMP_STAT 0;
BA_ "GenSigTimeoutTime_ADCAM" SG_ 1831 OIL_TEMP_STAT 0;
BA_ "GenSigTimeoutTime_RFHM" SG_ 1831 OVER_TEMP_STAT 0;
BA_ "GenSigTimeoutTime_MPAD" SG_ 1831 OVER_TEMP_STAT 0;
BA_ "GenSigTimeoutTime_IPC" SG_ 1831 OVER_TEMP_STAT 0;
BA_ "GenSigTimeoutTime_GNMM" SG_ 1831 OVER_TEMP_STAT 0;
BA_ "GenSigTimeoutTime_EVCU2" SG_ 1831 OVER_TEMP_STAT 0;
BA_ "GenSigTimeoutTime_ESL" SG_ 1831 OVER_TEMP_STAT 0;
BA_ "GenSigTimeoutTime_ECM" SG_ 1831 OVER_TEMP_STAT 0;
BA_ "GenSigTimeoutTime_DTCM" SG_ 1831 OVER_TEMP_STAT 0;
BA_ "GenSigTimeoutTime_DMSM" SG_ 1831 OVER_TEMP_STAT 0;
BA_ "GenSigTimeoutTime_BSM" SG_ 1831 OVER_TEMP_STAT 0;
BA_ "GenSigTimeoutTime_BCM" SG_ 1831 OVER_TEMP_STAT 0;
BA_ "GenSigTimeoutTime_AGSM" SG_ 1831 OVER_TEMP_STAT 0;
BA_ "GenSigTimeoutTime_ADCAM" SG_ 1831 OVER_TEMP_STAT 0;
BA_ "GenSigTimeoutTime_RFHM" SG_ 1831 PARK_BRAKE_STAT 0;
BA_ "GenSigTimeoutTime_MPAD" SG_ 1831 PARK_BRAKE_STAT 0;
BA_ "GenSigTimeoutTime_IPC" SG_ 1831 PARK_BRAKE_STAT 0;
BA_ "GenSigTimeoutTime_GNMM" SG_ 1831 PARK_BRAKE_STAT 0;
BA_ "GenSigTimeoutTime_EVCU2" SG_ 1831 PARK_BRAKE_STAT 0;
BA_ "GenSigTimeoutTime_ESL" SG_ 1831 PARK_BRAKE_STAT 0;
BA_ "GenSigTimeoutTime_ECM" SG_ 1831 PARK_BRAKE_STAT 0;
BA_ "GenSigTimeoutTime_DTCM" SG_ 1831 PARK_BRAKE_STAT 0;
BA_ "GenSigTimeoutTime_DMSM" SG_ 1831 PARK_BRAKE_STAT 0;
BA_ "GenSigTimeoutTime_BSM" SG_ 1831 PARK_BRAKE_STAT 0;
BA_ "GenSigTimeoutTime_BCM" SG_ 1831 PARK_BRAKE_STAT 0;
BA_ "GenSigTimeoutTime_AGSM" SG_ 1831 PARK_BRAKE_STAT 0;
BA_ "GenSigTimeoutTime_ADCAM" SG_ 1831 PARK_BRAKE_STAT 0;
BA_ "GenSigTimeoutTime_RFHM" SG_ 1831 POS_LIGHT_STAT 0;
BA_ "GenSigTimeoutTime_MPAD" SG_ 1831 POS_LIGHT_STAT 0;
BA_ "GenSigTimeoutTime_IPC" SG_ 1831 POS_LIGHT_STAT 0;
BA_ "GenSigTimeoutTime_GNMM" SG_ 1831 POS_LIGHT_STAT 0;
BA_ "GenSigTimeoutTime_EVCU2" SG_ 1831 POS_LIGHT_STAT 0;
BA_ "GenSigTimeoutTime_ESL" SG_ 1831 POS_LIGHT_STAT 0;
BA_ "GenSigTimeoutTime_ECM" SG_ 1831 POS_LIGHT_STAT 0;
BA_ "GenSigTimeoutTime_DTCM" SG_ 1831 POS_LIGHT_STAT 0;
BA_ "GenSigTimeoutTime_DMSM" SG_ 1831 POS_LIGHT_STAT 0;
BA_ "GenSigTimeoutTime_BSM" SG_ 1831 POS_LIGHT_STAT 0;
BA_ "GenSigTimeoutTime_BCM" SG_ 1831 POS_LIGHT_STAT 0;
BA_ "GenSigTimeoutTime_AGSM" SG_ 1831 POS_LIGHT_STAT 0;
BA_ "GenSigTimeoutTime_ADCAM" SG_ 1831 POS_LIGHT_STAT 0;
BA_ "GenSigTimeoutTime_RFHM" SG_ 1831 SEAT_BELT_STAT 0;
BA_ "GenSigTimeoutTime_MPAD" SG_ 1831 SEAT_BELT_STAT 0;
BA_ "GenSigTimeoutTime_IPC" SG_ 1831 SEAT_BELT_STAT 0;
BA_ "GenSigTimeoutTime_GNMM" SG_ 1831 SEAT_BELT_STAT 0;
BA_ "GenSigTimeoutTime_EVCU2" SG_ 1831 SEAT_BELT_STAT 0;
BA_ "GenSigTimeoutTime_ESL" SG_ 1831 SEAT_BELT_STAT 0;
BA_ "GenSigTimeoutTime_ECM" SG_ 1831 SEAT_BELT_STAT 0;
BA_ "GenSigTimeoutTime_DTCM" SG_ 1831 SEAT_BELT_STAT 0;
BA_ "GenSigTimeoutTime_DMSM" SG_ 1831 SEAT_BELT_STAT 0;
BA_ "GenSigTimeoutTime_BSM" SG_ 1831 SEAT_BELT_STAT 0;
BA_ "GenSigTimeoutTime_BCM" SG_ 1831 SEAT_BELT_STAT 0;
BA_ "GenSigTimeoutTime_AGSM" SG_ 1831 SEAT_BELT_STAT 0;
BA_ "GenSigTimeoutTime_ADCAM" SG_ 1831 SEAT_BELT_STAT 0;
BA_ "GenSigTimeoutTime_RFHM" SG_ 1831 SERVICE_ACC_STAT 0;
BA_ "GenSigTimeoutTime_MPAD" SG_ 1831 SERVICE_ACC_STAT 0;
BA_ "GenSigTimeoutTime_IPC" SG_ 1831 SERVICE_ACC_STAT 0;
BA_ "GenSigTimeoutTime_GNMM" SG_ 1831 SERVICE_ACC_STAT 0;
BA_ "GenSigTimeoutTime_EVCU2" SG_ 1831 SERVICE_ACC_STAT 0;
BA_ "GenSigTimeoutTime_ESL" SG_ 1831 SERVICE_ACC_STAT 0;
BA_ "GenSigTimeoutTime_ECM" SG_ 1831 SERVICE_ACC_STAT 0;
BA_ "GenSigTimeoutTime_DTCM" SG_ 1831 SERVICE_ACC_STAT 0;
BA_ "GenSigTimeoutTime_DMSM" SG_ 1831 SERVICE_ACC_STAT 0;
BA_ "GenSigTimeoutTime_BSM" SG_ 1831 SERVICE_ACC_STAT 0;
BA_ "GenSigTimeoutTime_BCM" SG_ 1831 SERVICE_ACC_STAT 0;
BA_ "GenSigTimeoutTime_AGSM" SG_ 1831 SERVICE_ACC_STAT 0;
BA_ "GenSigTimeoutTime_ADCAM" SG_ 1831 SERVICE_ACC_STAT 0;
BA_ "GenSigTimeoutTime_BCM" SG_ 1831 THEFT_ALARM_STAT 0;
BA_ "GenSigTimeoutTime_AGSM" SG_ 1831 THEFT_ALARM_STAT 0;
BA_ "GenSigTimeoutTime_ADCAM" SG_ 1831 THEFT_ALARM_STAT 0;
BA_ "GenSigTimeoutTime_RFHM" SG_ 1831 SPEED_LMT_STAT 0;
BA_ "GenSigTimeoutTime_MPAD" SG_ 1831 SPEED_LMT_STAT 0;
BA_ "GenSigTimeoutTime_IPC" SG_ 1831 SPEED_LMT_STAT 0;
BA_ "GenSigTimeoutTime_GNMM" SG_ 1831 SPEED_LMT_STAT 0;
BA_ "GenSigTimeoutTime_EVCU2" SG_ 1831 SPEED_LMT_STAT 0;
BA_ "GenSigTimeoutTime_ESL" SG_ 1831 SPEED_LMT_STAT 0;
BA_ "GenSigTimeoutTime_ECM" SG_ 1831 SPEED_LMT_STAT 0;
BA_ "GenSigTimeoutTime_DTCM" SG_ 1831 SPEED_LMT_STAT 0;
BA_ "GenSigTimeoutTime_DMSM" SG_ 1831 SPEED_LMT_STAT 0;
BA_ "GenSigTimeoutTime_BSM" SG_ 1831 SPEED_LMT_STAT 0;
BA_ "GenSigTimeoutTime_BCM" SG_ 1831 SPEED_LMT_STAT 0;
BA_ "GenSigTimeoutTime_AGSM" SG_ 1831 SPEED_LMT_STAT 0;
BA_ "GenSigTimeoutTime_ADCAM" SG_ 1831 SPEED_LMT_STAT 0;
BA_ "GenSigTimeoutTime_RFHM" SG_ 1831 STR_DIR_LT_STAT 0;
BA_ "GenSigTimeoutTime_MPAD" SG_ 1831 STR_DIR_LT_STAT 0;
BA_ "GenSigTimeoutTime_IPC" SG_ 1831 STR_DIR_LT_STAT 0;
BA_ "GenSigTimeoutTime_GNMM" SG_ 1831 STR_DIR_LT_STAT 0;
BA_ "GenSigTimeoutTime_EVCU2" SG_ 1831 STR_DIR_LT_STAT 0;
BA_ "GenSigTimeoutTime_ESL" SG_ 1831 STR_DIR_LT_STAT 0;
BA_ "GenSigTimeoutTime_ECM" SG_ 1831 STR_DIR_LT_STAT 0;
BA_ "GenSigTimeoutTime_DTCM" SG_ 1831 STR_DIR_LT_STAT 0;
BA_ "GenSigTimeoutTime_DMSM" SG_ 1831 STR_DIR_LT_STAT 0;
BA_ "GenSigTimeoutTime_BSM" SG_ 1831 STR_DIR_LT_STAT 0;
BA_ "GenSigTimeoutTime_BCM" SG_ 1831 STR_DIR_LT_STAT 0;
BA_ "GenSigTimeoutTime_AGSM" SG_ 1831 STR_DIR_LT_STAT 0;
BA_ "GenSigTimeoutTime_ADCAM" SG_ 1831 STR_DIR_LT_STAT 0;
BA_ "GenSigTimeoutTime_IPC" SG_ 1831 LANE_DEPART_FAIL_STAT 0;
BA_ "GenSigTimeoutTime_GNMM" SG_ 1831 LANE_DEPART_FAIL_STAT 0;
BA_ "GenSigTimeoutTime_EVCU2" SG_ 1831 LANE_DEPART_FAIL_STAT 0;
BA_ "GenSigTimeoutTime_ESL" SG_ 1831 LANE_DEPART_FAIL_STAT 0;
BA_ "GenSigTimeoutTime_ECM" SG_ 1831 LANE_DEPART_FAIL_STAT 0;
BA_ "GenSigTimeoutTime_DTCM" SG_ 1831 LANE_DEPART_FAIL_STAT 0;
BA_ "GenSigTimeoutTime_DMSM" SG_ 1831 LANE_DEPART_FAIL_STAT 0;
BA_ "GenSigTimeoutTime_BSM" SG_ 1831 LANE_DEPART_FAIL_STAT 0;
BA_ "GenSigTimeoutTime_BCM" SG_ 1831 LANE_DEPART_FAIL_STAT 0;
BA_ "GenSigTimeoutTime_AGSM" SG_ 1831 LANE_DEPART_FAIL_STAT 0;
BA_ "GenSigTimeoutTime_ADCAM" SG_ 1831 LANE_DEPART_FAIL_STAT 0;
BA_ "GenSigTimeoutTime_RFHM" SG_ 1831 HILL_DESCENT_STAT 0;
BA_ "GenSigTimeoutTime_MPAD" SG_ 1831 HILL_DESCENT_STAT 0;
BA_ "GenSigTimeoutTime_IPC" SG_ 1831 HILL_DESCENT_STAT 0;
BA_ "GenSigTimeoutTime_GNMM" SG_ 1831 HILL_DESCENT_STAT 0;
BA_ "GenSigTimeoutTime_EVCU2" SG_ 1831 HILL_DESCENT_STAT 0;
BA_ "GenSigTimeoutTime_ESL" SG_ 1831 HILL_DESCENT_STAT 0;
BA_ "GenSigTimeoutTime_ECM" SG_ 1831 HILL_DESCENT_STAT 0;
BA_ "GenSigTimeoutTime_DTCM" SG_ 1831 HILL_DESCENT_STAT 0;
BA_ "GenSigTimeoutTime_DMSM" SG_ 1831 HILL_DESCENT_STAT 0;
BA_ "GenSigTimeoutTime_BSM" SG_ 1831 HILL_DESCENT_STAT 0;
BA_ "GenSigTimeoutTime_BCM" SG_ 1831 HILL_DESCENT_STAT 0;
BA_ "GenSigTimeoutTime_AGSM" SG_ 1831 HILL_DESCENT_STAT 0;
BA_ "GenSigTimeoutTime_ADCAM" SG_ 1831 HILL_DESCENT_STAT 0;
BA_ "GenSigTimeoutTime_RFHM" SG_ 1831 HVY_EXH_STAT 0;
BA_ "GenSigTimeoutTime_MPAD" SG_ 1831 HVY_EXH_STAT 0;
BA_ "GenSigTimeoutTime_IPC" SG_ 1831 HVY_EXH_STAT 0;
BA_ "GenSigTimeoutTime_GNMM" SG_ 1831 HVY_EXH_STAT 0;
BA_ "GenSigTimeoutTime_EVCU2" SG_ 1831 HVY_EXH_STAT 0;
BA_ "GenSigTimeoutTime_ESL" SG_ 1831 HVY_EXH_STAT 0;
BA_ "GenSigTimeoutTime_ECM" SG_ 1831 HVY_EXH_STAT 0;
BA_ "GenSigTimeoutTime_DTCM" SG_ 1831 HVY_EXH_STAT 0;
BA_ "GenSigTimeoutTime_DMSM" SG_ 1831 HVY_EXH_STAT 0;
BA_ "GenSigTimeoutTime_BSM" SG_ 1831 HVY_EXH_STAT 0;
BA_ "GenSigTimeoutTime_BCM" SG_ 1831 HVY_EXH_STAT 0;
BA_ "GenSigTimeoutTime_AGSM" SG_ 1831 HVY_EXH_STAT 0;
BA_ "GenSigTimeoutTime_ADCAM" SG_ 1831 HVY_EXH_STAT 0;
BA_ "GenSigTimeoutTime_RFHM" SG_ 1831 ELEC_STAB_STAT 0;
BA_ "GenSigTimeoutTime_MPAD" SG_ 1831 ELEC_STAB_STAT 0;
BA_ "GenSigTimeoutTime_IPC" SG_ 1831 ELEC_STAB_STAT 0;
BA_ "GenSigTimeoutTime_GNMM" SG_ 1831 ELEC_STAB_STAT 0;
BA_ "GenSigTimeoutTime_EVCU2" SG_ 1831 ELEC_STAB_STAT 0;
BA_ "GenSigTimeoutTime_ESL" SG_ 1831 ELEC_STAB_STAT 0;
BA_ "GenSigTimeoutTime_ECM" SG_ 1831 ELEC_STAB_STAT 0;
BA_ "GenSigTimeoutTime_DTCM" SG_ 1831 ELEC_STAB_STAT 0;
BA_ "GenSigTimeoutTime_DMSM" SG_ 1831 ELEC_STAB_STAT 0;
BA_ "GenSigTimeoutTime_BSM" SG_ 1831 ELEC_STAB_STAT 0;
BA_ "GenSigTimeoutTime_RFHM" SG_ 1831 ELECTRIC_WRENCH_STAT 0;
BA_ "GenSigTimeoutTime_MPAD" SG_ 1831 ELECTRIC_WRENCH_STAT 0;
BA_ "GenSigTimeoutTime_IPC" SG_ 1831 ELECTRIC_WRENCH_STAT 0;
BA_ "GenSigTimeoutTime_GNMM" SG_ 1831 ELECTRIC_WRENCH_STAT 0;
BA_ "GenSigTimeoutTime_EVCU2" SG_ 1831 ELECTRIC_WRENCH_STAT 0;
BA_ "GenSigTimeoutTime_ESL" SG_ 1831 ELECTRIC_WRENCH_STAT 0;
BA_ "GenSigTimeoutTime_ECM" SG_ 1831 ELECTRIC_WRENCH_STAT 0;
BA_ "GenSigTimeoutTime_DTCM" SG_ 1831 ELECTRIC_WRENCH_STAT 0;
BA_ "GenSigTimeoutTime_DMSM" SG_ 1831 ELECTRIC_WRENCH_STAT 0;
BA_ "GenSigTimeoutTime_BSM" SG_ 1831 ELECTRIC_WRENCH_STAT 0;
BA_ "GenSigTimeoutTime_BCM" SG_ 1831 ELECTRIC_WRENCH_STAT 0;
BA_ "GenSigTimeoutTime_AGSM" SG_ 1831 ELECTRIC_WRENCH_STAT 0;
BA_ "GenSigTimeoutTime_ADCAM" SG_ 1831 ELECTRIC_WRENCH_STAT 0;
BA_ "GenSigTimeoutTime_IPC" SG_ 1831 ENGINE_MIL_STAT 0;
BA_ "GenSigTimeoutTime_GNMM" SG_ 1831 ENGINE_MIL_STAT 0;
BA_ "GenSigTimeoutTime_EVCU2" SG_ 1831 ENGINE_MIL_STAT 0;
BA_ "GenSigTimeoutTime_ESL" SG_ 1831 ENGINE_MIL_STAT 0;
BA_ "GenSigTimeoutTime_ECM" SG_ 1831 ENGINE_MIL_STAT 0;
BA_ "GenSigTimeoutTime_DTCM" SG_ 1831 ENGINE_MIL_STAT 0;
BA_ "GenSigTimeoutTime_DMSM" SG_ 1831 ENGINE_MIL_STAT 0;
BA_ "GenSigTimeoutTime_BSM" SG_ 1831 ENGINE_MIL_STAT 0;
BA_ "GenSigTimeoutTime_BCM" SG_ 1831 ENGINE_MIL_STAT 0;
BA_ "GenSigTimeoutTime_AGSM" SG_ 1831 ENGINE_MIL_STAT 0;
BA_ "GenSigTimeoutTime_ADCAM" SG_ 1831 ENGINE_MIL_STAT 0;
BA_ "GenSigTimeoutTime_RFHM" SG_ 1831 ENGINE_MIL_STAT 0;
BA_ "GenSigTimeoutTime_MPAD" SG_ 1831 ENGINE_MIL_STAT 0;
BA_ "GenSigTimeoutTime_RFHM" SG_ 1831 ENGINE_TEMP_STAT 0;
BA_ "GenSigTimeoutTime_MPAD" SG_ 1831 ENGINE_TEMP_STAT 0;
BA_ "GenSigTimeoutTime_IPC" SG_ 1831 ENGINE_TEMP_STAT 0;
BA_ "GenSigTimeoutTime_GNMM" SG_ 1831 ENGINE_TEMP_STAT 0;
BA_ "GenSigTimeoutTime_EVCU2" SG_ 1831 ENGINE_TEMP_STAT 0;
BA_ "GenSigTimeoutTime_ESL" SG_ 1831 ENGINE_TEMP_STAT 0;
BA_ "GenSigTimeoutTime_ECM" SG_ 1831 ENGINE_TEMP_STAT 0;
BA_ "GenSigTimeoutTime_DTCM" SG_ 1831 ENGINE_TEMP_STAT 0;
BA_ "GenSigTimeoutTime_DMSM" SG_ 1831 ENGINE_TEMP_STAT 0;
BA_ "GenSigTimeoutTime_BSM" SG_ 1831 ENGINE_TEMP_STAT 0;
BA_ "GenSigTimeoutTime_BCM" SG_ 1831 ENGINE_TEMP_STAT 0;
BA_ "GenSigTimeoutTime_AGSM" SG_ 1831 ENGINE_TEMP_STAT 0;
BA_ "GenSigTimeoutTime_ADCAM" SG_ 1831 ENGINE_TEMP_STAT 0;
BA_ "GenSigTimeoutTime_RFHM" SG_ 1831 EPB_WARN_STAT 0;
BA_ "GenSigTimeoutTime_MPAD" SG_ 1831 EPB_WARN_STAT 0;
BA_ "GenSigTimeoutTime_IPC" SG_ 1831 EPB_WARN_STAT 0;
BA_ "GenSigTimeoutTime_GNMM" SG_ 1831 EPB_WARN_STAT 0;
BA_ "GenSigTimeoutTime_EVCU2" SG_ 1831 EPB_WARN_STAT 0;
BA_ "GenSigTimeoutTime_ESL" SG_ 1831 EPB_WARN_STAT 0;
BA_ "GenSigTimeoutTime_ECM" SG_ 1831 EPB_WARN_STAT 0;
BA_ "GenSigTimeoutTime_DTCM" SG_ 1831 EPB_WARN_STAT 0;
BA_ "GenSigTimeoutTime_DMSM" SG_ 1831 EPB_WARN_STAT 0;
BA_ "GenSigTimeoutTime_BSM" SG_ 1831 EPB_WARN_STAT 0;
BA_ "GenSigTimeoutTime_BCM" SG_ 1831 EPB_WARN_STAT 0;
BA_ "GenSigTimeoutTime_AGSM" SG_ 1831 EPB_WARN_STAT 0;
BA_ "GenSigTimeoutTime_ADCAM" SG_ 1831 EPB_WARN_STAT 0;
BA_ "GenSigTimeoutTime_RFHM" SG_ 1831 EPS_STAT 0;
BA_ "GenSigTimeoutTime_MPAD" SG_ 1831 EPS_STAT 0;
BA_ "GenSigTimeoutTime_IPC" SG_ 1831 EPS_STAT 0;
BA_ "GenSigTimeoutTime_GNMM" SG_ 1831 EPS_STAT 0;
BA_ "GenSigTimeoutTime_EVCU2" SG_ 1831 EPS_STAT 0;
BA_ "GenSigTimeoutTime_ESL" SG_ 1831 EPS_STAT 0;
BA_ "GenSigTimeoutTime_ECM" SG_ 1831 EPS_STAT 0;
BA_ "GenSigTimeoutTime_DTCM" SG_ 1831 EPS_STAT 0;
BA_ "GenSigTimeoutTime_DMSM" SG_ 1831 EPS_STAT 0;
BA_ "GenSigTimeoutTime_BSM" SG_ 1831 EPS_STAT 0;
BA_ "GenSigTimeoutTime_BCM" SG_ 1831 EPS_STAT 0;
BA_ "GenSigTimeoutTime_AGSM" SG_ 1831 EPS_STAT 0;
BA_ "GenSigTimeoutTime_ADCAM" SG_ 1831 EPS_STAT 0;
BA_ "GenSigTimeoutTime_RFHM" SG_ 1831 ESC_OFF_STAT 0;
BA_ "GenSigTimeoutTime_MPAD" SG_ 1831 ESC_OFF_STAT 0;
BA_ "GenSigTimeoutTime_IPC" SG_ 1831 ESC_OFF_STAT 0;
BA_ "GenSigTimeoutTime_GNMM" SG_ 1831 ESC_OFF_STAT 0;
BA_ "GenSigTimeoutTime_EVCU2" SG_ 1831 ESC_OFF_STAT 0;
BA_ "GenSigTimeoutTime_ESL" SG_ 1831 ESC_OFF_STAT 0;
BA_ "GenSigTimeoutTime_ECM" SG_ 1831 ESC_OFF_STAT 0;
BA_ "GenSigTimeoutTime_DTCM" SG_ 1831 ESC_OFF_STAT 0;
BA_ "GenSigTimeoutTime_DMSM" SG_ 1831 ESC_OFF_STAT 0;
BA_ "GenSigTimeoutTime_BSM" SG_ 1831 ESC_OFF_STAT 0;
BA_ "GenSigTimeoutTime_BCM" SG_ 1831 ESC_OFF_STAT 0;
BA_ "GenSigTimeoutTime_AGSM" SG_ 1831 ESC_OFF_STAT 0;
BA_ "GenSigTimeoutTime_ADCAM" SG_ 1831 ESC_OFF_STAT 0;
BA_ "GenSigTimeoutTime_RFHM" SG_ 1831 ETC_CONTROL_STAT 0;
BA_ "GenSigTimeoutTime_MPAD" SG_ 1831 ETC_CONTROL_STAT 0;
BA_ "GenSigTimeoutTime_IPC" SG_ 1831 ETC_CONTROL_STAT 0;
BA_ "GenSigTimeoutTime_GNMM" SG_ 1831 ETC_CONTROL_STAT 0;
BA_ "GenSigTimeoutTime_EVCU2" SG_ 1831 ETC_CONTROL_STAT 0;
BA_ "GenSigTimeoutTime_ESL" SG_ 1831 ETC_CONTROL_STAT 0;
BA_ "GenSigTimeoutTime_ECM" SG_ 1831 ETC_CONTROL_STAT 0;
BA_ "GenSigTimeoutTime_DTCM" SG_ 1831 ETC_CONTROL_STAT 0;
BA_ "GenSigTimeoutTime_DMSM" SG_ 1831 ETC_CONTROL_STAT 0;
BA_ "GenSigTimeoutTime_BSM" SG_ 1831 ETC_CONTROL_STAT 0;
BA_ "GenSigTimeoutTime_BCM" SG_ 1831 ETC_CONTROL_STAT 0;
BA_ "GenSigTimeoutTime_AGSM" SG_ 1831 ETC_CONTROL_STAT 0;
BA_ "GenSigTimeoutTime_ADCAM" SG_ 1831 ETC_CONTROL_STAT 0;
BA_ "GenSigTimeoutTime_RFHM" SG_ 1831 EXH_BRK_STAT 0;
BA_ "GenSigTimeoutTime_MPAD" SG_ 1831 EXH_BRK_STAT 0;
BA_ "GenSigTimeoutTime_IPC" SG_ 1831 EXH_BRK_STAT 0;
BA_ "GenSigTimeoutTime_GNMM" SG_ 1831 EXH_BRK_STAT 0;
BA_ "GenSigTimeoutTime_EVCU2" SG_ 1831 EXH_BRK_STAT 0;
BA_ "GenSigTimeoutTime_ESL" SG_ 1831 EXH_BRK_STAT 0;
BA_ "GenSigTimeoutTime_ECM" SG_ 1831 EXH_BRK_STAT 0;
BA_ "GenSigTimeoutTime_DTCM" SG_ 1831 EXH_BRK_STAT 0;
BA_ "GenSigTimeoutTime_DMSM" SG_ 1831 EXH_BRK_STAT 0;
BA_ "GenSigTimeoutTime_BSM" SG_ 1831 EXH_BRK_STAT 0;
BA_ "GenSigTimeoutTime_BCM" SG_ 1831 EXH_BRK_STAT 0;
BA_ "GenSigTimeoutTime_AGSM" SG_ 1831 EXH_BRK_STAT 0;
BA_ "GenSigTimeoutTime_ADCAM" SG_ 1831 EXH_BRK_STAT 0;
BA_ "GenSigTimeoutTime_RFHM" SG_ 1831 FCW_SYSTEM_STAT 0;
BA_ "GenSigTimeoutTime_MPAD" SG_ 1831 FCW_SYSTEM_STAT 0;
BA_ "GenSigTimeoutTime_IPC" SG_ 1831 FCW_SYSTEM_STAT 0;
BA_ "GenSigTimeoutTime_GNMM" SG_ 1831 FCW_SYSTEM_STAT 0;
BA_ "GenSigTimeoutTime_EVCU2" SG_ 1831 FCW_SYSTEM_STAT 0;
BA_ "GenSigTimeoutTime_ESL" SG_ 1831 FCW_SYSTEM_STAT 0;
BA_ "GenSigTimeoutTime_ECM" SG_ 1831 FCW_SYSTEM_STAT 0;
BA_ "GenSigTimeoutTime_DTCM" SG_ 1831 FCW_SYSTEM_STAT 0;
BA_ "GenSigTimeoutTime_DMSM" SG_ 1831 FCW_SYSTEM_STAT 0;
BA_ "GenSigTimeoutTime_BSM" SG_ 1831 FCW_SYSTEM_STAT 0;
BA_ "GenSigTimeoutTime_BCM" SG_ 1831 FCW_SYSTEM_STAT 0;
BA_ "GenSigTimeoutTime_AGSM" SG_ 1831 FCW_SYSTEM_STAT 0;
BA_ "GenSigTimeoutTime_ADCAM" SG_ 1831 FCW_SYSTEM_STAT 0;
BA_ "GenSigTimeoutTime_RFHM" SG_ 1831 FOUR_WD_SERVICE_STAT 0;
BA_ "GenSigTimeoutTime_MPAD" SG_ 1831 FOUR_WD_SERVICE_STAT 0;
BA_ "GenSigTimeoutTime_IPC" SG_ 1831 FOUR_WD_SERVICE_STAT 0;
BA_ "GenSigTimeoutTime_GNMM" SG_ 1831 FOUR_WD_SERVICE_STAT 0;
BA_ "GenSigTimeoutTime_EVCU2" SG_ 1831 FOUR_WD_SERVICE_STAT 0;
BA_ "GenSigTimeoutTime_ESL" SG_ 1831 FOUR_WD_SERVICE_STAT 0;
BA_ "GenSigTimeoutTime_ECM" SG_ 1831 FOUR_WD_SERVICE_STAT 0;
BA_ "GenSigTimeoutTime_DTCM" SG_ 1831 FOUR_WD_SERVICE_STAT 0;
BA_ "GenSigTimeoutTime_DMSM" SG_ 1831 FOUR_WD_SERVICE_STAT 0;
BA_ "GenSigTimeoutTime_BSM" SG_ 1831 FOUR_WD_SERVICE_STAT 0;
BA_ "GenSigTimeoutTime_BCM" SG_ 1831 FOUR_WD_SERVICE_STAT 0;
BA_ "GenSigTimeoutTime_AGSM" SG_ 1831 FOUR_WD_SERVICE_STAT 0;
BA_ "GenSigTimeoutTime_ADCAM" SG_ 1831 FOUR_WD_SERVICE_STAT 0;
BA_ "GenSigTimeoutTime_RFHM" SG_ 1831 FT_FOG_STAT 0;
BA_ "GenSigTimeoutTime_MPAD" SG_ 1831 FT_FOG_STAT 0;
BA_ "GenSigTimeoutTime_IPC" SG_ 1831 FT_FOG_STAT 0;
BA_ "GenSigTimeoutTime_GNMM" SG_ 1831 FT_FOG_STAT 0;
BA_ "GenSigTimeoutTime_EVCU2" SG_ 1831 FT_FOG_STAT 0;
BA_ "GenSigTimeoutTime_ESL" SG_ 1831 FT_FOG_STAT 0;
BA_ "GenSigTimeoutTime_ECM" SG_ 1831 FT_FOG_STAT 0;
BA_ "GenSigTimeoutTime_DTCM" SG_ 1831 FT_FOG_STAT 0;
BA_ "GenSigTimeoutTime_DMSM" SG_ 1831 FT_FOG_STAT 0;
BA_ "GenSigTimeoutTime_BSM" SG_ 1831 FT_FOG_STAT 0;
BA_ "GenSigTimeoutTime_BCM" SG_ 1831 FT_FOG_STAT 0;
BA_ "GenSigTimeoutTime_AGSM" SG_ 1831 FT_FOG_STAT 0;
BA_ "GenSigTimeoutTime_ADCAM" SG_ 1831 FT_FOG_STAT 0;
BA_ "GenSigTimeoutTime_RFHM" SG_ 1831 FUEL_CAP_STAT 0;
BA_ "GenSigTimeoutTime_MPAD" SG_ 1831 FUEL_CAP_STAT 0;
BA_ "GenSigTimeoutTime_IPC" SG_ 1831 FUEL_CAP_STAT 0;
BA_ "GenSigTimeoutTime_GNMM" SG_ 1831 FUEL_CAP_STAT 0;
BA_ "GenSigTimeoutTime_EVCU2" SG_ 1831 FUEL_CAP_STAT 0;
BA_ "GenSigTimeoutTime_ESL" SG_ 1831 FUEL_CAP_STAT 0;
BA_ "GenSigTimeoutTime_ECM" SG_ 1831 FUEL_CAP_STAT 0;
BA_ "GenSigTimeoutTime_DTCM" SG_ 1831 FUEL_CAP_STAT 0;
BA_ "GenSigTimeoutTime_DMSM" SG_ 1831 FUEL_CAP_STAT 0;
BA_ "GenSigTimeoutTime_BSM" SG_ 1831 FUEL_CAP_STAT 0;
BA_ "GenSigTimeoutTime_BCM" SG_ 1831 FUEL_CAP_STAT 0;
BA_ "GenSigTimeoutTime_AGSM" SG_ 1831 FUEL_CAP_STAT 0;
VAL_ 274 YawRate 4095 "SNA";
VAL_ 274 LongAcceleration 4095 "SNA";
VAL_ 274 LatAcceleration 4095 "SNA";
VAL_ 611 SBR1RowPsngrSeatSts 0 "Seat_Belt_Fasten" 1 "Seat_Belt_Not_Fasten" 2 "Seat_Safe" 3 "Seat_Not_Safe" 7 "SNA";
VAL_ 611 SBR1RowPsngrSeatConfigSts 0 "Seat_Not_Checked" 1 "Seat_Checked";
VAL_ 611 SBR1RowDriverSeatSts 0 "Seat_Belt_Fasten" 1 "Seat_Belt_Not_Fasten" 3 "SNA";
VAL_ 611 SBR1RowDriverSeatConfigSts 0 "Seat_Not_Checked" 1 "Seat_Checked";
VAL_ 611 AirBagFailSts 0 "Fail_Not_Present_Lamp_Off" 1 "Fail_Not_Present_Lamp_Flashing" 2 "Fail_Present_Lamp_On" 3 "Not_Used";
VAL_ 1058 InputsGDFail 0 "False" 1 "True";
VAL_ 1058 Inp_ICC_Fail 0 "Fail_Not_Present" 1 "Fail_Present";
VAL_ 1058 IgnCntrTrue 0 "False" 1 "True";
VAL_ 1058 GenDenominator 0 "False" 1 "True";
VAL_ 1058 EngineOFFTime 1023 "SNA";
VAL_ 1058 CldStrtDenominator 0 "Not_Active" 1 "Active";
VAL_ 1058 CarbWarmUp 0 "False" 1 "True";
VAL_ 1058 CARB_PERM 0 "False" 1 "True";
VAL_ 1432 PartialOdometerAPlus 1048575 "SNA";
VAL_ 1154 VehSpdDisp 65535 "SNA";
VAL_ 600 OilChgRst 0 "Not_Active" 1 "Active";
VAL_ 600 AirBagLamp_FailSts 0 "OFF_Fail_not_present" 1 "OFF_Fail_present" 2 "ON_Fail_not_present" 3 "BLINKING_Fail_not_present";
VAL_ 1831 WINDSHIELD_FLUID_STAT 0 "Off" 1 "On" 2 "Blinking" 3 "SNA";
VAL_ 1831 WATER_IN_FUEL_STAT 0 "Off" 1 "On" 2 "Blinking" 3 "SNA";
VAL_ 1831 TORQUE_STAT 0 "Off" 1 "On" 2 "Blinking" 3 "SNA";
VAL_ 1831 TIRE_PRESSURE_STAT 0 "Off" 1 "On" 2 "Blinking" 3 "SNA";
VAL_ 1831 STOP_START_STAT 0 "Off" 1 "On" 2 "Blinking" 3 "SNA";
VAL_ 1831 SPEED_CTRL_STAT 0 "Off" 1 "On" 2 "Blinking" 3 "SNA";
VAL_ 1831 SERVICE_STAT 0 "Off" 1 "On" 2 "Blinking" 3 "SNA";
VAL_ 1831 SERVICE_ACC_STAT 0 "Off" 1 "On" 2 "Blinking" 3 "SNA";
VAL_ 1831 SEAT_BELT_STAT 0 "Off" 1 "On" 2 "Blinking" 3 "SNA";
VAL_ 1831 POS_LIGHT_STAT 0 "Off" 1 "On" 2 "Blinking" 3 "SNA";
VAL_ 1831 PARK_BRAKE_STAT 0 "Off" 1 "On" 2 "Blinking" 3 "SNA";
VAL_ 1831 OVER_TEMP_STAT 0 "Off" 1 "On" 2 "Blinking" 3 "SNA";
VAL_ 1831 OIL_TEMP_STAT 0 "Off" 1 "On" 2 "Blinking" 3 "SNA";
VAL_ 1831 OIL_PRESSURE_STAT 0 "Off" 1 "On" 2 "Blinking" 3 "SNA";
VAL_ 1831 OIL_LEVEL_STAT 0 "Off" 1 "On" 2 "Blinking" 3 "SNA";
VAL_ 1831 NAT_GAS_STAT 0 "Off" 1 "On" 2 "Blinking" 3 "SNA";
VAL_ 1831 LT_EXH_STAT 0 "Off" 1 "On" 2 "Blinking" 3 "SNA";
VAL_ 1831 LIFT_GATE_STAT 0 "Off" 1 "On" 2 "Blinking" 3 "SNA";
VAL_ 1831 LANE_SENSE_STAT 0 "Off" 1 "On" 2 "Blinking" 3 "SNA";
VAL_ 1831 LANE_DEPART_STAT 0 "Off" 1 "On" 2 "Blinking" 3 "SNA";
VAL_ 1831 LANE_DEPART_FAIL_STAT 0 "Off" 1 "On" 2 "Blinking" 3 "SNA";
VAL_ 1831 HVY_EXH_STAT 0 "Off" 1 "On" 2 "Blinking" 3 "SNA";
VAL_ 1831 HILL_DESCENT_STAT 0 "Off" 1 "On" 2 "Blinking" 3 "SNA";
VAL_ 1831 HI_BEAM_STAT 0 "Off" 1 "On" 2 "Blinking" 3 "SNA";
VAL_ 1831 HDLT_LVL_STAT 0 "Off" 1 "On" 2 "Blinking" 3 "SNA";
VAL_ 1831 FUEL_CUT_OFF_STAT 0 "Off" 1 "On" 2 "Blinking" 3 "SNA";
VAL_ 1831 FUEL_CAP_STAT 0 "Off" 1 "On" 2 "Blinking" 3 "SNA";
VAL_ 1831 FT_FOG_STAT 0 "Off" 1 "On" 2 "Blinking" 3 "SNA";
VAL_ 1831 FOUR_WD_SERVICE_STAT 0 "Off" 1 "On" 2 "Blinking" 3 "SNA";
VAL_ 1831 FCW_SYSTEM_STAT 0 "Off" 1 "On" 2 "Blinking" 3 "SNA";
VAL_ 1831 EXH_BRK_STAT 0 "Off" 1 "On" 2 "Blinking" 3 "SNA";
VAL_ 1831 ETC_CONTROL_STAT 0 "Off" 1 "On" 2 "Blinking" 3 "SNA";
VAL_ 1831 ESC_OFF_STAT 0 "Off" 1 "On" 2 "Blinking" 3 "SNA";
VAL_ 1831 EPS_STAT 0 "Off" 1 "On" 2 "Blinking" 3 "SNA";
VAL_ 1831 EPB_WARN_STAT 0 "Off" 1 "On" 2 "Blinking" 3 "SNA";
VAL_ 1831 ENGINE_TEMP_STAT 0 "Off" 1 "On" 2 "Blinking" 3 "SNA";
VAL_ 1831 ENGINE_MIL_STAT 0 "Off" 1 "On" 2 "Blinking" 3 "SNA";
VAL_ 1831 ELECTRIC_WRENCH_STAT 0 "Off" 1 "On" 2 "Blinking" 3 "SNA";
VAL_ 1831 ELEC_STAB_STAT 0 "Off" 1 "On" 2 "Blinking" 3 "SNA";
VAL_ 1831 DOORS_STAT 0 "Off" 1 "On" 2 "Blinking" 3 "SNA";
VAL_ 1831 DEF_STAT 0 "Off" 1 "On" 2 "Blinking" 3 "SNA";
VAL_ 1831 DAMPING_SYSTEM_STAT 0 "Off" 1 "On" 2 "Blinking" 3 "SNA";
VAL_ 1831 CRUISE_SET_STAT 0 "Off" 1 "On" 2 "Blinking" 3 "SNA";
VAL_ 1831 COOLENT_LEVEL_STAT 0 "Off" 1 "On" 2 "Blinking" 3 "SNA";
VAL_ 1831 CATALYST_TEMP_STAT 0 "Off" 1 "On" 2 "Blinking" 3 "SNA";
VAL_ 1831 CARGO_LT_STAT 0 "Off" 1 "On" 2 "Blinking" 3 "SNA";
VAL_ 1831 BRK_IND_STAT 0 "Off" 1 "On" 2 "Blinking" 3 "SNA";
VAL_ 1831 BRAKE_PAD_STAT 0 "Off" 1 "On" 2 "Blinking" 3 "SNA";
VAL_ 1831 BATTERY_CHARGE_STAT 0 "Off" 1 "On" 2 "Blinking" 3 "SNA";
VAL_ 1831 AWD_SERVICE_STAT 0 "Off" 1 "On" 2 "Blinking" 3 "SNA";
VAL_ 1831 AWD_IND_STAT 0 "Off" 1 "On" 2 "Blinking" 3 "SNA";
VAL_ 1831 ABS_IND_STAT 0 "Off" 1 "On" 2 "Blinking" 3 "SNA";
VAL_ 1829 InstantaneousFuelConsumption3 15 "SNA";
VAL_ 1829 InstantaneousFuelConsumption2 15 "SNA";
VAL_ 1829 InstantaneousFuelConsumption1 15 "SNA";
VAL_ 1626 IMPACTConfirm 0 "Actuate" 1 "Do_Not_Actuate";
VAL_ 1626 IMPACTCommand 0 "Do_Not_Actuate" 1 "Actuate";
VAL_ 104 MKKey2org22 85 "FIX__MKKey_2";
VAL_ 104 MKKey1org21 84 "FIX__MKKey_1";
VAL_ 104 MKKey_6 77 "FIX__MKKey_6";
VAL_ 104 MKKey_5 1 "FIX__MKKey_5";
VAL_ 104 MKKey_4 214 "FIX__MKKey_4";
VAL_ 104 MKKey_3 36 "FIX__MKKey_3";
VAL_ 100 rnd_4 0 "Val1_rnd_4" 170 "Val5_rnd_4" 203 "Val2_rnd_4" 221 "Val3_rnd_4" 238 "Val4_rnd_4";
VAL_ 100 rnd_3 0 "Val1_rnd_3" 19 "Val3_rnd_3" 21 "Val5_rnd_3" 32 "Val4_rnd_3" 129 "Val2_rnd_3";
VAL_ 100 rnd_2 0 "Val1_rnd_2" 26 "Val3_rnd_2" 43 "Val5_rnd_2" 79 "Val2_rnd_2" 168 "Val4_rnd_2";
VAL_ 100 rnd_1 0 "Val1_rnd_1" 58 "Val2_rnd_1" 59 "Val3_rnd_1" 60 "Val4_rnd_1" 61 "Val5_rnd_1" 62 "Val6_rnd_1" 63 "Val7_rnd_1" 64 "Val8_rnd_1" 65 "Val9_rnd_1" 66 "ValA_rnd_1" 67 "ValB_rnd_1" 68 "ValC_rnd_1" 69 "ValD_rnd_1" 70 "ValE_rnd_1" 71 "ValF_rnd_1";
VAL_ 100 f1_2 0 "Val1_f1_2" 5 "Val2_f1_2" 13 "Val4_f1_2" 14 "Val3_f1_2" 15 "Val5_f1_2";
VAL_ 100 f1_1 0 "Val1_f1_1" 81 "Val5_f1_1" 119 "Val2_f1_1" 145 "Val3_f1_1" 159 "Val4_f1_1";
VAL_ 100 ControlEncodingReq 5 "ControlEncoding_ENQ" 6 "ControlEncoding_ACK" 21 "ControlEncoding_NACK" 132 "ControlEncoding_EOTp" 133 "ControlEncoding_ENQp" 134 "ControlEncoding_ACK1p" 135 "ControlEncoding_ACK2p";
VAL_ 1955 IBS3_Tm_Lst_Reset_Sec 65535 "SNA";
VAL_ 1955 IBS3_Tm_Lst_Reset_Days 4095 "SNA";
VAL_ 1955 IBS3_T_BATT 255 "SNA";
VAL_ 1955 IBS3_SOH_Q 127 "SNA";
VAL_ 1955 IBS3_SOF_Q 255 "SNA";
VAL_ 1955 IBS3_SOC 127 "SNA";
VAL_ 1955 IBS3_Q_received 65535 "SNA";
VAL_ 248 ProgrammedSts_ESL 0 "Not_Programmed" 1 "programmed";
VAL_ 248 ESLUnlockFailSts 0 "Not_Failure" 1 "Failure";
VAL_ 248 ESLLockFailSts 0 "Not_Failure" 1 "Failure";
VAL_ 248 ESLFeedbackCmd 0 "Undefined_Position" 1 "Not_Used" 2 "Not_Used" 3 "Lock" 4 "Not_Used" 5 "Unlock" 6 "SNA" 7 "Not_Used";
VAL_ 248 CodeCheckSts_ESL 0 "No_Code" 1 "CodeCheck_OK" 2 "CodeCheck_Fault" 3 "Not_Used";
VAL_ 274 YawRateFailSts 0 "Fail_Not_Present" 1 "Fail_Present";
VAL_ 274 LongAccelerationFailSts 0 "Fail_Not_Present" 1 "Fail_Present";
VAL_ 274 LatAccelerationFailSts 0 "Fail_Not_Present" 1 "Fail_Present";
VAL_ 611 SBR2RowRightSeatConfigSts 0 "Seat_Not_Checked" 1 "Seat_Checked";
VAL_ 611 SBR2RowLeftSeatConfigSts 0 "Seat_Not_Checked" 1 "Seat_Checked";
VAL_ 611 SBR2RowCentralSeatConfigSts 0 "Seat_Not_Checked" 1 "Seat_Checked";
VAL_ 611 SBR2ndRowRSeatSts 0 "PSG_SEAT_OK" 2 "PSG_SEAT_NOK" 3 "SEAT_EMPTY" 4 "FAULT_OC" 5 "FAULT_SC" 6 "SNA" 7 "REMOVE_SEAT";
VAL_ 611 SBR2ndRowLSeatSts 0 "PSG_SEAT_OK" 2 "PSG_SEAT_NOK" 3 "SEAT_EMPTY" 4 "FAULT_OC" 5 "FAULT_SC" 6 "SNA" 7 "REMOVE_SEAT";
VAL_ 611 SBR2ndRowCSeatSts 0 "PSG_SEAT_OK" 2 "PSG_SEAT_NOK" 3 "SEAT_EMPTY" 4 "FAULT_OC" 5 "FAULT_SC" 6 "SNA" 7 "REMOVE_SEAT";
VAL_ 611 SBR1RowCentralSeatSts 0 "Seat_Belt_Fasten" 1 "Seat_Belt_Not_Fasten" 2 "Seat_Safe" 3 "Seat_Not_Safe" 7 "SNA";
VAL_ 1058 OAT_PT_EstV 0 "Valid" 1 "Not_Valid";
VAL_ 1058 EstCatCnvTmp 255 "SNA";
VAL_ 1058 EngIntAirTmpV 0 "Valid" 1 "Not_Valid";
VAL_ 1058 EngIntAirTmp 255 "SNA";
VAL_ 1058 BarPrsAbsV 0 "Valid" 1 "Not_Valid";
VAL_ 1432 PartialOdometerBPlus 1048575 "SNA";
VAL_ 600 IPC_NV_DISP_STAT 0 "DISP_NON_NV_SCREEN" 1 "DISP_NV_SCREEN";
VAL_ 1831 TRK_OPN_STAT 0 "Off" 1 "On" 2 "Blinking" 3 "SNA";
VAL_ 1831 TOW_HAUL_STAT 0 "Off" 1 "On" 2 "Blinking" 3 "SNA";
VAL_ 1831 THEFT_ALARM_STAT 0 "Off" 1 "On" 2 "Blinking" 3 "SNA";
VAL_ 1831 STR_DIR_LT_STAT 0 "Off" 1 "On" 2 "Blinking" 3 "SNA";
VAL_ 1831 SPEED_LMT_STAT 0 "Off" 1 "On" 2 "Blinking" 3 "SNA";
VAL_ 1831 ECO_MODE_STAT 0 "Off" 1 "On" 2 "Blinking" 3 "SNA";
VAL_ 1831 AIR_BAG_STAT 0 "Off" 1 "On" 2 "Blinking" 3 "SNA";
VAL_ 1831 ACC_WARN_STAT 0 "Off" 1 "On" 2 "Blinking" 3 "SNA";
VAL_ 1626 IMPACTThreshold 0 "Threshold_Not_Met" 1 "Threshold_Met";
VAL_ 1955 IBS3_Q_released 65535 "SNA";
VAL_ 1154 VehSpd_MPH 0 "kph" 1 "mph";
VAL_ 1955 IBS3_R_Batt_25 255 "SNA";
VAL_ 1955 IBS3_R_Batt 255 "SNA";
VAL_ 1432 HAS_SoH_IPC 0 "No Fault" 1 "Fault";
VAL_ 1441 DTE_Ave_Fuel_Econ 1023 "SNA";
VAL_ 1955 IBS3_SOH_SUL 127 "SNA";
VAL_ 1955 IBS3_SOH_COR 127 "SNA";
VAL_ 1154 Est_Range_Disp 255 "SNA";
VAL_ 600 DisplayedSpeedLimSts 0 "Sign_Not_Detected" 1 "Speed_Limit_0" 2 "Speed_Limit_1" 3 "Speed_Limit_2" 4 "Speed_Limit_3" 5 "Speed_Limit_4" 6 "Speed_Limit_5" 7 "Speed_Limit_6" 8 "Speed_Limit_7" 9 "Speed_Limit_8" 10 "Speed_Limit_9" 11 "Speed_Limit_10" 12 "Speed_Limit_11" 13 "Speed_Limit_12" 14 "Speed_Limit_13" 15 "Speed_Limit_14" 16 "Speed_Limit_15" 17 "Speed_Limit_16" 18 "Speed_Limit_17" 19 "Speed_Limit_18" 20 "Speed_Limit_19" 21 "Speed_Limit_20" 22 "Speed_Limit_21" 23 "Speed_Limit_22" 24 "Speed_Limit_23" 25 "Speed_Limit_24" 26 "Speed_Limit_25" 27 "Speed_Limit_26" 28 "Speed_Limit_27" 29 "Speed_Limit_28" 30 "Speed_Limit_29" 31 "Speed_Limit_30" 32 "Speed_Limit_31" 33 "Speed_Limit_32" 34 "Speed_Limit_33" 35 "Speed_Limit_34" 36 "Speed_Limit_35" 37 "Speed_Limit_36" 38 "Speed_Limit_37" 39 "Speed_Limit_38" 40 "Speed_Limit_39" 41 "Speed_Limit_40" 42 "Speed_Limit_41" 43 "Speed_Limit_42" 44 "Speed_Limit_43" 45 "Speed_Limit_44" 46 "Speed_Limit_45" 47 "Speed_Limit_46" 48 "Speed_Limit_47" 49 "Speed_Limit_48" 50 "Speed_Limit_49" 51 "Speed_Limit_50" 52 "Speed_Limit_51" 53 "Speed_Limit_52" 54 "Speed_Limit_53" 55 "Speed_Limit_54" 56 "Speed_Limit_55" 57 "Speed_Limit_56" 58 "Speed_Limit_57" 59 "Speed_Limit_58" 60 "Speed_Limit_59" 61 "Speed_Limit_60" 62 "Speed_Limit_61" 63 "Speed_Limit_62" 64 "Speed_Limit_63" 65 "Speed_Limit_64" 66 "Speed_Limit_65" 67 "Speed_Limit_66" 68 "Speed_Limit_67" 69 "Speed_Limit_68" 70 "Speed_Limit_69" 71 "Speed_Limit_70" 72 "Speed_Limit_71" 73 "Speed_Limit_72" 74 "Speed_Limit_73" 75 "Speed_Limit_74" 76 "Speed_Limit_75" 77 "Speed_Limit_76" 78 "Speed_Limit_77" 79 "Speed_Limit_78" 80 "Speed_Limit_79" 81 "Speed_Limit_80" 82 "Speed_Limit_81" 83 "Speed_Limit_82" 84 "Speed_Limit_83" 85 "Speed_Limit_84" 86 "Speed_Limit_85" 87 "Speed_Limit_86" 88 "Speed_Limit_87" 89 "Speed_Limit_88" 90 "Speed_Limit_89" 91 "Speed_Limit_90" 92 "Speed_Limit_91" 93 "Speed_Limit_92" 94 "Speed_Limit_93" 95 "Speed_Limit_94" 96 "Speed_Limit_95" 97 "Speed_Limit_96" 98 "Speed_Limit_97" 99 "Speed_Limit_98" 100 "Speed_Limit_99" 101 "Speed_Limit_100" 102 "Speed_Limit_101" 103 "Speed_Limit_102" 104 "Speed_Limit_103" 105 "Speed_Limit_104" 106 "Speed_Limit_105" 107 "Speed_Limit_106" 108 "Speed_Limit_107" 109 "Speed_Limit_108" 110 "Speed_Limit_109" 111 "Speed_Limit_110" 112 "Speed_Limit_111" 113 "Speed_Limit_112" 114 "Speed_Limit_113" 115 "Speed_Limit_114" 116 "Speed_Limit_115" 117 "Speed_Limit_116" 118 "Speed_Limit_117" 119 "Speed_Limit_118" 120 "Speed_Limit_119" 121 "Speed_Limit_120" 122 "Speed_Limit_121" 123 "Speed_Limit_122" 124 "Speed_Limit_123" 125 "Speed_Limit_124" 126 "Speed_Limit_125" 127 "Speed_Limit_126" 128 "Speed_Limit_127" 129 "Speed_Limit_128" 130 "Speed_Limit_129" 131 "Speed_Limit_130" 132 "Speed_Limit_131" 133 "Speed_Limit_132" 134 "Speed_Limit_133" 135 "Speed_Limit_134" 136 "Speed_Limit_135" 137 "Speed_Limit_136" 138 "Speed_Limit_137" 139 "Speed_Limit_138" 140 "Speed_Limit_139" 141 "Speed_Limit_140" 142 "Speed_Limit_141" 143 "Speed_Limit_142" 144 "Speed_Limit_143" 145 "Speed_Limit_144" 146 "Speed_Limit_145" 147 "Speed_Limit_146" 148 "Speed_Limit_147" 149 "Speed_Limit_148" 150 "Speed_Limit_149" 151 "Speed_Limit_150" 152 "Speed_Limit_151" 153 "Speed_Limit_152" 154 "Speed_Limit_153" 155 "Speed_Limit_154" 156 "Speed_Limit_155" 157 "Speed_Limit_156" 158 "Speed_Limit_157" 159 "Speed_Limit_158" 160 "Speed_Limit_159" 161 "Speed_Limit_160" 162 "Speed_Limit_161" 163 "Speed_Limit_162" 164 "Speed_Limit_163" 165 "Speed_Limit_164" 166 "Speed_Limit_165" 167 "Speed_Limit_166" 168 "Speed_Limit_167" 169 "Speed_Limit_168" 170 "Speed_Limit_169" 171 "Speed_Limit_170" 172 "Speed_Limit_171" 173 "Speed_Limit_172" 174 "Speed_Limit_173" 175 "Speed_Limit_174" 176 "Speed_Limit_175" 177 "Speed_Limit_176" 178 "Speed_Limit_177" 179 "Speed_Limit_178" 180 "Speed_Limit_179" 181 "Speed_Limit_180" 182 "Speed_Limit_181" 183 "Speed_Limit_182" 184 "Speed_Limit_183" 185 "Speed_Limit_184" 186 "Speed_Limit_185" 187 "Speed_Limit_186" 188 "Speed_Limit_187" 189 "Speed_Limit_188" 190 "Speed_Limit_189" 191 "Speed_Limit_190" 192 "Speed_Limit_191" 193 "Speed_Limit_192" 194 "Speed_Limit_193" 195 "Speed_Limit_194" 196 "Speed_Limit_195" 197 "Speed_Limit_196" 198 "Speed_Limit_197" 199 "Speed_Limit_198" 200 "Speed_Limit_199" 201 "Speed_Limit_200" 202 "Speed_Limit_201" 203 "Speed_Limit_202" 204 "Speed_Limit_203" 205 "Speed_Limit_204" 206 "Speed_Limit_205" 207 "Speed_Limit_206" 208 "Speed_Limit_207" 209 "Speed_Limit_208" 210 "Speed_Limit_209" 211 "Speed_Limit_210" 212 "Speed_Limit_211" 213 "Speed_Limit_212" 214 "Speed_Limit_213" 215 "Speed_Limit_214" 216 "Speed_Limit_215" 217 "Speed_Limit_216" 218 "Speed_Limit_217" 219 "Speed_Limit_218" 220 "Speed_Limit_219" 221 "Speed_Limit_220" 222 "Speed_Limit_221" 223 "Speed_Limit_222" 224 "Speed_Limit_223" 225 "Speed_Limit_224" 226 "Speed_Limit_225" 227 "Speed_Limit_226" 228 "Speed_Limit_227" 229 "Speed_Limit_228" 230 "Speed_Limit_229" 231 "Speed_Limit_230" 232 "Speed_Limit_231" 233 "Speed_Limit_232" 234 "Speed_Limit_233" 254 "Speed_Limit_Unlimited" 255 "End_Speed_Limit";
VAL_ 1955 IBS3_IBS_ADAS_OK_2 0 "unknown" 1 "OK" 2 "NOT_OK" 3 "SNA";
VAL_ 1955 IBS3_IBS_ADAS_OK 0 "unknown" 1 "OK" 2 "NOT_OK" 3 "SNA";
VAL_ 1955 IBS3_FLAG_DISCONNECT_ADAS_2 0 "NOT_DISCONNECTED" 1 "DISCONNECTED_DETECTED" 2 "not_used" 3 "SNA";
VAL_ 1955 IBS3_FLAG_DISCONNECT_ADAS 0 "NOT_DISCONNECTED" 1 "DISCONNECTED_DETECTED" 2 "not_used" 3 "SNA";
VAL_ 1432 AverageFuelConsumptionBPlus 1023 "SNA";
VAL_ 1432 AverageFuelConsumptionAPlus 1023 "SNA";
VAL_ 1955 IBS3_TempFailStatus 0 "Fail_not_present" 1 "Fail_present";
VAL_ 1955 IBS3_SOH_SUL_Accuracy 0 "Inaccurate" 1 "Accurate";
VAL_ 1955 IBS3_SOH_Q_Accuracy 0 "Inaccurate" 1 "Accurate";
VAL_ 1955 IBS3_SOH_COR_Accuracy 0 "Inaccurate" 1 "Accurate";
VAL_ 1955 IBS3_SOF_Q_Accuracy 0 "Inaccurate" 1 "Accurate";
VAL_ 1955 IBS3_SOC_Accuracy 0 "Inaccurate" 1 "Accurate";
VAL_ 1955 IBS3_FLAG_DISCONNECT 0 "No_Disconnect" 1 "Disconnect";
VAL_ 1954 SBR1RowPsngrSeatPPDSts 0 "ODS_STAT_NOCC" 1 "ODS_STAT_OCC" 2 "ODS_FAULT" 3 "SNA";
VAL_ 104 ImmoParkReq 0 "None" 1 "Request Park";
VAL_ 1154 Est_Range_Disp_Long 2047 "SNA";
VAL_ 1432 PowerMode_RQ 0 "CUSTOMER" 1 "STORAGE" 2 "SHIP" 3 "ABBR" 7 "SNA";
VAL_ 274 StbmSyncState_ORC 0 "IN_SYNC" 1 "NOT_IN_SYNC" 255 "INVALID";
VAL_ 274 IMUTemperature 255 "SNA";
SIG_GROUP_ 274 ORC_FD_3_Pkt 1 : YawRate LongAcceleration LatAcceleration YawRateFailSts MessageCounter_ORC3 LongAccelerationFailSts LatAccelerationFailSts CRC_ORC3 StbmTimestampSec_ORC StbmTimestampNSec_ORC StbmSyncState_ORC IMUTemperature;
SIG_GROUP_ 611 ORC_FD_1_Pkt 1 : SBR1RowPsngrSeatSts SBR1RowPsngrSeatConfigSts SBR1RowDriverSeatSts SBR1RowDriverSeatConfigSts AirBagFailSts SBR2RowRightSeatConfigSts SBR2RowLeftSeatConfigSts SBR2RowCentralSeatConfigSts SBR2ndRowRSeatSts SBR2ndRowLSeatSts SBR2ndRowCSeatSts SBR1RowCentralSeatSts MessageCounter_ORC1 CRC_ORC1;
SIG_GROUP_ 1058 OBD_CONTENT_FRAME_Pkt 1 : LoadOBD InputsGDFail Inp_ICC_Fail IgnCntrTrue GenDenominator EngineOFFTime CldStrtDenominator CarbWarmUp CARB_PERM OAT_PT_EstV OAT_PT_Est EstCatCnvTmp EngIntAirTmpV EngIntAirTmp BarPrsAbsV BarPrsAbs MessageCounter_OBDCONTENTFRAME CRC_OBDCONTENTFRAME;
SIG_GROUP_ 600 IPC_FD_4_Pkt 1 : CRC_IPC4 MessageCounter_IPC4 OilChgRst AirBagLamp_FailSts IPC_NV_DISP_STAT DisplayedSpeedLimSts;
SIG_GROUP_ 1626 IMPACT_INFO_Pkt 1 : IMPACTConfirm IMPACTCommand IMPACTThreshold MessageCounter_IMPACTINFO CRC_IMPACTINFO;
SIG_GROUP_ 104 IMMO_CODE_RESPONSE_Pkt 1 : MKKey2org22 MKKey1org21 MKKey_6 MKKey_5 MKKey_4 MKKey_3 ControlEncodingRsp ImmoParkReq;
SIG_GROUP_ 100 IMMO_CODE_REQUEST_Pkt 1 : rnd_4 rnd_3 rnd_2 rnd_1 f1_2 f1_1 ControlEncodingReq;
SIG_GROUP_ 1955 IBS3_DATA_2_Pkt 1 : IBS3_Tm_Lst_Reset_Sec IBS3_Tm_Lst_Reset_Days IBS3_T_BATT IBS3_SOH_Q IBS3_SOF_Q IBS3_SOC IBS3_Q_received IBS3_Q_released IBS3_R_Batt_25 IBS3_R_Batt IBS3_SOH_SUL IBS3_SOH_COR IBS3_MC_IBS_2 IBS3_MC_IBS_1 IBS3_IBS_ADAS_OK_2 IBS3_IBS_ADAS_OK IBS3_FLAG_DISCONNECT_ADAS_2 IBS3_FLAG_DISCONNECT_ADAS IBS3_CRC_IBS_2 IBS3_CRC_IBS_1 IBS3_TempFailStatus IBS3_SOH_SUL_Accuracy IBS3_SOH_Q_Accuracy IBS3_SOH_COR_Accuracy IBS3_SOF_Q_Accuracy IBS3_SOC_Accuracy IBS3_FLAG_DISCONNECT MessageCounter_IBS3DATA2 CRC_IBS3DATA2;

VERSION ""

NS_ :

BS_:

BU_: SGW RFHM MPAD IPC GNMM EVCU2 ESL ECM DTCM DMSM BSM BCM AGSM ADCAM

BO_ 513 BRAKE_FD_1: 32 BSM
 SG_ VehicleStandStillSts : 111|2@0+ (1,0) [0|2] "-"  MPAD,EVCU2,BCM,IPC
 SG_ ShftChrDsp_Rq_ESC : 127|4@0+ (1,0) [0|14] "-"  MPAD,BCM
 SG_ Ft_RrTrqCoupling_ModeRq : 107|2@0+ (1,0) [0|3] "-"  MPAD,BCM,DTCM
 SG_ ExternalBrkRequestsDisabled : 109|2@0+ (1,0) [0|2] "-"  ADCAM,MPAD,EVCU2,BCM
 SG_ BrkTrq_Driver : 150|15@0+ (3,0) [0|98301] "Nm"  BCM,ECM,DTCM,MPAD,EVCU2
 SG_ BrkTrq : 94|15@0+ (3,0) [0|98301] "Nm"  MPAD,EVCU2,SGW,BCM,ECM,DTCM
 SG_ Brk_Thermdl : 151|1@0+ (1,0) [0|1] "-"  MPAD,EVCU2,SGW,BCM
 SG_ SelSpdLmp : 59|2@0+ (1,0) [0|0] "-"  MPAD,SGW,BCM,IPC
 SG_ SelectSpdSts : 165|2@0+ (1,0) [0|2] "-"  MPAD,EVCU2,SGW,BCM,IPC,DTCM
 SG_ REF_VEH_SPEED : 57|10@0+ (0.5,0) [0|511] "kph"  MPAD,EVCU2,BCM,IPC,DTCM
 SG_ MessageCounter_BRAKE1 : 179|4@0+ (1,0) [0|15] "-"  ADCAM,MPAD,EVCU2,BCM,IPC
 SG_ Ft_RrAxleCoupling_TrqRq : 15|8@0+ (12,0) [0|3060] "Nm"  MPAD,BCM,DTCM
 SG_ CRC_BRAKE1 : 191|8@0+ (1,0) [0|255] "-"  ADCAM,MPAD,EVCU2,BCM,IPC
 SG_ DASEngReqPos : 61|1@0+ (1,0) [0|1] "-"  ADCAM,MPAD,BCM
 SG_ Brk_Jrk_Resp : 60|1@0+ (1,0) [0|1] "-"  ADCAM,MPAD,BCM
 SG_ ACCFSafe : 7|8@0+ (1,0) [0|255] "-"  ADCAM,MPAD,BCM
 SG_ HILL_DES_STAT : 79|3@0+ (1,0) [0|7] "-"  SGW
 SG_ MAC_BRAKE1 : 215|48@0+ (1,0) [0|0] "-"  MPAD,BCM
 SG_ eBurn_Stages : 76|3@0+ (1,0) [0|7] "" EVCU2,IPC
 SG_ Cntr_BRAKE1 : 199|16@0+ (1,0) [0|0] "-"  MPAD,BCM

BO_ 245 BCM_MINICRYPT_ACK: 32 BCM
 SG_ MinicryptReceptionSts : 72|1@0+ (1,0) [0|1] "-"  RFHM

BO_ 1066 BCM_FD_9: 32 BCM
 SG_ TheftAlarmStatus : 87|3@0+ (1,0) [0|6] "" SGW,RFHM
 SG_ StopLightSts : 88|1@0+ (1,0) [0|1] "-"  SGW,DTCM
 SG_ StopLightFault : 108|1@0+ (1,0) [0|1] "-"  MPAD,SGW
 SG_ RHTurnSignalSts : 114|1@0+ (1,0) [0|1] "-"  MPAD,SGW
 SG_ PowerModeSts : 161|2@0+ (1,0) [0|3] "" ADCAM,MPAD,EVCU2,GNMM,SGW,BCM,BSM,IPC,RFHM
 SG_ ParkBrakeSts : 180|1@0+ (1,0) [0|1] "-"  MPAD,SGW,IPC
 SG_ LHTurnSignalSts : 107|1@0+ (1,0) [0|1] "-"  MPAD,SGW
 SG_ LHParkingLightSts : 110|1@0+ (1,0) [0|1] "-"  SGW,IPC
 SG_ HighBeamSts : 97|1@0+ (1,0) [0|1] "-"  ADCAM,MPAD,SGW,IPC
 SG_ FuelLevel : 135|8@0+ (1,0) [0|255] "%"  SGW,ECM
 SG_ BonnetSts : 182|1@0+ (1,0) [0|1] "-"  EVCU2,SGW,BSM,IPC
 SG_ AHBFeature : 103|1@0+ (1,0) [0|1] "-"  SGW,IPC
 SG_ WashLightWarningSts : 61|1@0+ (1,0) [0|1] "" SGW,IPC
 SG_ RHRDoorSts : 42|1@0+ (1,0) [0|1] "-"  MPAD,SGW,IPC,RFHM
 SG_ RHParkingLightSts : 73|1@0+ (1,0) [0|1] "-"  SGW,IPC
 SG_ RHatchSts : 43|1@0+ (1,0) [0|1] "-"  EVCU2,SGW,IPC,RFHM
 SG_ RearTrunkEnableLastElSts : 33|1@0+ (1,0) [0|1] "-"  SGW
 SG_ RearFogLightSts : 38|1@0+ (1,0) [0|1] "-"  MPAD,EVCU2,SGW,IPC
 SG_ RainSensorFailSts : 45|1@0+ (1,0) [0|1] "-"  IPC
 SG_ PsngrDoorSts : 46|1@0+ (1,0) [0|1] "-"  MPAD,SGW,IPC,RFHM
 SG_ MoveWheelSts : 55|1@0+ (1,0) [0|1] "-"  IPC
 SG_ MessageCounter_BCM9 : 179|4@0+ (1,0) [0|15] "-"  ADCAM,MPAD,EVCU2,GNMM,BSM,IPC
 SG_ LowFuelWarningSts : 47|1@0+ (1,0) [0|1] "-"  SGW,IPC,ECM
 SG_ LowBeamSts : 72|1@0+ (1,0) [0|1] "" ADCAM,MPAD,SGW
 SG_ LHRDoorSts : 32|1@0+ (1,0) [0|1] "-"  MPAD,SGW,IPC,RFHM
 SG_ HDCFnRqstSts : 4|2@0+ (1,0) [0|2] "" ADCAM,EVCU2,BCM
 SG_ FrontWiperMoveSts : 60|1@0+ (1,0) [0|1] "" ADCAM,MPAD,EVCU2,ECM,DTCM
 SG_ FrontFogLightSts : 99|1@0+ (1,0) [0|1] "-"  SGW,IPC
 SG_ ExternalTemperature : 0|9@0+ (0.5,-85) [-85|170] "°C"  ADCAM,MPAD,EVCU2,SGW,BSM,RFHM,DTCM
 SG_ ESLUnlockFailSts_Indication : 52|1@0+ (1,0) [0|1] "-"  IPC
 SG_ ESLLockFailSts_Indication : 54|1@0+ (1,0) [0|1] "-"  IPC
 SG_ DriverDoorSts : 35|1@0+ (1,0) [0|1] "-"  ADCAM,MPAD,EVCU2,SGW,AGSM,BSM,IPC,RFHM,ECM
 SG_ DoorLockLastElSts : 51|2@0+ (1,0) [0|3] "" EVCU2,SGW,RFHM
 SG_ CRC_BCM9 : 191|8@0+ (1,0) [0|255] "-"  ADCAM,MPAD,EVCU2,GNMM,BSM,IPC
 SG_ BrakeFluidLevelSts : 181|1@0+ (1,0) [0|1] "-"  SGW,BSM,IPC
 SG_ TrunkHandleReleaseSts : 92|1@0+ (1,0) [0|1] "" MPAD,SGW
 SG_ FuelLevel2 : 143|8@0+ (0.5,0) [0|127.5] "%"  IPC,ECM

BO_ 1827 BCM_FD_7: 32 BCM
 SG_ IgnitionOnCounter : 95|16@0+ (1,0) [0|65535] "-"  ADCAM,MPAD,EVCU2,DMSM,GNMM,SGW,AGSM,ESL,BSM,IPC,RFHM,ECM,DTCM
 SG_ MessageCounter_BCM7 : 179|4@0+ (1,0) [0|15] "-"  ADCAM,MPAD,DMSM,BSM
 SG_ CRC_BCM7 : 191|8@0+ (1,0) [0|255] "-"  ADCAM,MPAD,DMSM,BSM
 SG_ AbsoluteTimerSeconds : 111|17@0+ (1,0) [0|131070] "s"  ECM
 SG_ AbsoluteTimerDays : 135|16@0+ (1,0) [0|65534] "days"  ECM

BO_ 1375 BCM_FD_6: 32 BCM
 SG_ ChkFuelLevelSts : 99|3@0+ (1,0) [0|7] "-"  IPC,ECM
 SG_ FrontWiperReq : 75|4@0+ (1,0) [0|5] "" ADCAM,MPAD,EVCU2,SGW,BSM,DTCM
 SG_ MessageCounter_BCM6 : 179|4@0+ (1,0) [0|15] "-"  ADCAM,MPAD,BSM
 SG_ CRC_BCM6 : 191|8@0+ (1,0) [0|255] "-"  ADCAM,MPAD,BSM
 SG_ ChkFuelLevelSts2 : 102|3@0+ (1,0) [0|7] "-"  IPC,ECM
 SG_ SysEOLSts : 7|1@0+ (1,0) [0|1] "-"  MPAD,IPC

BO_ 1051 BCM_FD_4: 32 BCM
 SG_ RollAngle : 175|8@0+ (1,-90) [-90|165] "°"  SGW,IPC
 SG_ PitchAngle : 167|8@0+ (1,-90) [-90|165] "°"  SGW,IPC
 SG_ FUEL_VOLT : 143|8@0+ (0.019607843,0) [0|4.98] "Volt"  ECM
 SG_ ExternalTemperatureAD_Voltage : 159|8@0+ (0.019607843,0) [0|4.98] "Volt"  EVCU2,ECM
 SG_ FUEL_VOLT2 : 151|8@0+ (0.019607843,0) [0|4.98] "Volt"  ECM
 SG_ EVAP_TEMP_P1C : 18|11@0+ (0.1,-40) [-40|85] "°C"  EVCU2
 SG_ AM_ECM_Trace : 71|2@0+ (1,0) [0|2] "-"  ECM
 SG_ MessageCounter_BCM4 : 179|4@0+ (1,0) [0|15] "-"  EVCU2
 SG_ CRC_BCM4 : 191|8@0+ (1,0) [0|255] "-"  EVCU2
 SG_ RR_HS_STATFailSts : 72|1@0+ (1,0) [0|1] "" EVCU2
 SG_ RR_HS_STAT : 75|2@0+ (1,0) [0|3] "" EVCU2
 SG_ RL_HS_STATFailSts : 73|1@0+ (1,0) [0|1] "" EVCU2
 SG_ RL_HS_STAT : 77|2@0+ (1,0) [0|3] "" EVCU2
 SG_ HSW_StatFailSts : 182|1@0+ (1,0) [0|1] "" EVCU2
 SG_ FR_VS_STATSts : 67|2@0+ (1,0) [0|3] "" EVCU2
 SG_ FR_VS_STATFailSts : 181|1@0+ (1,0) [0|1] "" EVCU2
 SG_ FL_VS_STATSts : 69|2@0+ (1,0) [0|3] "" EVCU2
 SG_ FL_VS_STATFailSts : 180|1@0+ (1,0) [0|1] "" EVCU2
 SG_ RR_VS_STATFailSts : 86|1@0+ (1,0) [0|1] "" EVCU2
 SG_ RR_VS_STAT : 79|2@0+ (1,0) [0|3] "" EVCU2
 SG_ RL_VS_STATFailSts : 87|1@0+ (1,0) [0|1] "" EVCU2
 SG_ RL_VS_STAT : 65|2@0+ (1,0) [0|3] "" EVCU2

BO_ 256 BCM_FD_2: 32 BCM
 SG_ OperationalModeSts : 75|4@0+ (1,0) [0|15] "" ADCAM,MPAD,EVCU2,DMSM,GNMM,SGW,AGSM,ESL,BSM,IPC,RFHM,ECM,DTCM
 SG_ KeyInIgnSts : 106|2@0+ (1,0) [0|2] "" EVCU2,SGW,ESL
 SG_ EngineOffRequest : 119|1@0+ (1,0) [0|1] "-"  Vector__XXX
 SG_ TurnIndicatorSts : 95|2@0+ (1,0) [0|3] "-"  MPAD,SGW
 SG_ RemStActvSts_R : 7|1@0+ (1,0) [0|1] "" MPAD,EVCU2,DTCM
 SG_ RemStActvSts : 107|1@0+ (1,0) [0|1] "" ADCAM,EVCU2,SGW,IPC,RFHM
 SG_ RefuelRequest : 19|2@0+ (1,0) [0|3] "" ECM
 SG_ MessageCounter_BCM2 : 179|4@0+ (1,0) [0|15] "-"  ADCAM,MPAD,EVCU2,DMSM,BSM
 SG_ CRC_BCM2 : 191|8@0+ (1,0) [0|255] "-"  ADCAM,MPAD,EVCU2,DMSM,BSM
 SG_ BrkPdlStat_BCM : 6|2@0+ (1,0) [0|2] "" RFHM
 SG_ SCCActvSts : 104|1@0+ (1,0) [0|1] "" EVCU2,SGW,AGSM,IPC,RFHM

BO_ 512 BCM_FD_18: 32 BCM
 SG_ LeakCheckTimerExpired : 73|2@0+ (1,0) [0|0] "" ECM
 SG_ DRV_DR_UNLOCKING : 183|1@0+ (1,0) [0|1] "-"  EVCU2
 SG_ BonnetAjarRawValSts_8 : 15|8@0+ (0.019607843,0) [0|4.999999965] "Volt"  EVCU2,BSM,ECM
 SG_ MessageCounter_BCM18 : 179|4@0+ (1,0) [0|15] "-"  EVCU2,BSM
 SG_ CRC_BCM18 : 191|8@0+ (1,0) [0|255] "-"  EVCU2,BSM
 SG_ Fuel_Door_Sts : 78|3@0+ (1,0) [0|7] "" ECM
 SG_ Braking_Mode_Req : 34|3@0+ (1,0) [0|7] "" EVCU2

BO_ 736 BCM_FD_14: 32 BCM
 SG_ Command_15Sts : 111|2@0+ (1,0) [0|2] "" ADCAM,MPAD,SGW,IPC
 SG_ Command_14Sts : 97|2@0+ (1,0) [0|2] "" ADCAM,MPAD,SGW,IPC
 SG_ Command_13Sts : 99|2@0+ (1,0) [0|2] "" ADCAM,MPAD,SGW,IPC
 SG_ Command_12Sts : 101|2@0+ (1,0) [0|2] "" ADCAM,MPAD,SGW,IPC
 SG_ Command_11Sts : 103|2@0+ (1,0) [0|2] "" ADCAM,MPAD,SGW,IPC
 SG_ Command_10Sts : 89|2@0+ (1,0) [0|2] "" ADCAM,MPAD,SGW,IPC
 SG_ Command_09Sts : 91|2@0+ (1,0) [0|2] "" ADCAM,MPAD,SGW
 SG_ Command_08Sts : 93|2@0+ (1,0) [0|2] "" ADCAM,MPAD,SGW
 SG_ Command_07Sts : 95|2@0+ (1,0) [0|2] "" ADCAM,MPAD,SGW
 SG_ Command_06Sts : 81|2@0+ (1,0) [0|2] "" ADCAM,MPAD,SGW
 SG_ Command_05Sts : 83|2@0+ (1,0) [0|2] "" ADCAM,MPAD,SGW
 SG_ Command_04Sts : 85|2@0+ (1,0) [0|2] "" ADCAM,MPAD,SGW
 SG_ Command_03Sts : 87|2@0+ (1,0) [0|2] "" ADCAM,MPAD,SGW
 SG_ Command_02Sts : 73|2@0+ (1,0) [0|2] "" ADCAM,MPAD,SGW
 SG_ Command_01Sts : 75|2@0+ (1,0) [0|2] "" ADCAM,MPAD,SGW
 SG_ MessageCounter_BCM14 : 179|4@0+ (1,0) [0|15] "-"  ADCAM,MPAD
 SG_ CRC_BCM14 : 191|8@0+ (1,0) [0|255] "-"  ADCAM,MPAD

BO_ 159 BCM_FD_13: 32 BCM
 SG_ SpeedLimiterOnOffSts : 81|1@0+ (1,0) [0|1] "" ADCAM,MPAD,EVCU2
 SG_ MC_CSWC_1 : 95|4@0+ (1,0) [0|15] "" EVCU2
 SG_ CrusCnclSwitch : 84|1@0+ (1,0) [0|1] "" ADCAM,MPAD,EVCU2,SGW,BSM
 SG_ CRC_CSWC_1 : 103|8@0+ (1,0) [0|255] "" EVCU2
 SG_ ACC_On : 85|1@0+ (1,0) [0|1] "" ADCAM,MPAD,EVCU2,SGW,BSM
 SG_ ACC_DistSwInc : 86|1@0+ (1,0) [0|1] "" ADCAM,MPAD,SGW
 SG_ ACC_DistSwDec : 87|1@0+ (1,0) [0|1] "" ADCAM,MPAD,SGW
 SG_ MessageCounter_BCM13 : 179|4@0+ (1,0) [0|15] "-"  ADCAM,MPAD,BSM
 SG_ CRC_BCM13 : 191|8@0+ (1,0) [0|255] "-"  ADCAM,MPAD,BSM
 SG_ ResumeSwitch : 108|1@0+ (1,0) [0|1] "" ADCAM,MPAD,EVCU2,SGW,BSM
 SG_ DeceleratorSts : 109|1@0+ (1,0) [0|1] "" ADCAM,MPAD,EVCU2,SGW,BSM
 SG_ CruiseControlOnOffSts : 111|1@0+ (1,0) [0|1] "" ADCAM,MPAD,EVCU2,SGW,BSM
 SG_ CruiseControlFailSts : 107|1@0+ (1,0) [0|1] "" ADCAM,MPAD,EVCU2
 SG_ AcceleratorSts : 110|1@0+ (1,0) [0|1] "" ADCAM,MPAD,EVCU2,SGW,BSM

BO_ 1431 BCM_FD_12: 32 BCM
 SG_ Switch2_Rq : 100|2@0+ (1,0) [0|2] "" DTCM
 SG_ Switch1_Rq : 98|2@0+ (1,0) [0|2] "" DTCM
 SG_ TRAC_PSD : 14|1@0+ (1,0) [0|1] "" BSM
 SG_ TerrainSwStat : 7|3@0+ (1,0) [0|6] "" EVCU2
 SG_ PreCondCabinSts : 111|2@0+ (1,0) [0|2] "" EVCU2
 SG_ IGN_OFF_TIME_LNG : 147|12@0+ (1,0) [0|4080] "min"  BSM,DTCM
 SG_ EPS_MODE_CFG_STAT : 170|3@0+ (1,0) [0|0] "" Vector__XXX
 SG_ AirTemp_Outsd : 47|8@0+ (0.5,-40) [-40|85] "°C"  Vector__XXX
 SG_ PAMRequestSts : 125|1@0+ (1,0) [0|1] "" SGW
 SG_ MessageCounter_BCM12 : 179|4@0+ (1,0) [0|15] "-"  MPAD,BSM,DTCM,EVCU2
 SG_ CRC_BCM12 : 191|8@0+ (1,0) [0|255] "-"  MPAD,BSM,DTCM,EVCU2
 SG_ APARequestSts : 124|1@0+ (1,0) [0|1] "" SGW
 SG_ DALM_Status : 96|1@0+ (1,0) [0|1] "" MPAD
 SG_ SeatVib_Sts : 33|2@0+ (1,0) [0|3] "" MPAD
 SG_ AxleLckrSEL_SW : 39|2@0+ (1,0) [0|2] "" DTCM

BO_ 1430 BCM_FD_11: 32 BCM
 SG_ Gate_Req_PE : 45|2@0+ (1,0) [0|3] "" SGW,RFHM
 SG_ StopStartClimateInfo : 175|3@0+ (1,0) [0|5] "-"  SGW,ECM
 SG_ PN14_LS_Lvl7 : 129|1@0+ (1,0) [0|1] "" ADCAM,SGW
 SG_ PN14_LS_Actv : 112|1@0+ (1,0) [0|1] "" ADCAM,EVCU2,SGW,IPC
 SG_ EngineOffTimer : 83|12@0+ (1,0) [0|4080] "min"  Vector__XXX
 SG_ PanicModeActive : 145|1@0+ (1,0) [0|1] "-"  SGW
 SG_ CMP_DIR : 79|4@0+ (1,0) [0|15] "" SGW,IPC
 SG_ Batt_ST_Crit : 141|1@0+ (1,0) [0|1] "" ADCAM,SGW,IPC
 SG_ DCSD_TUNEKNOB_VAL : 101|6@0+ (1,0) [0|63] "" SGW
 SG_ DCSD_TUNEKNOB_DIR : 181|2@0+ (1,0) [0|3] "" SGW
 SG_ DCSD_Enter : 168|1@0+ (1,0) [0|1] "" SGW
 SG_ A2D_DRV_TEMP_DR_POS : 57|10@0+ (0.0048828125,0) [0|4.9951171875] "Volt"  ECM
 SG_ MessageCounter_BCM11 : 179|4@0+ (1,0) [0|15] "-"  ADCAM,EVCU2
 SG_ CRC_BCM11 : 191|8@0+ (1,0) [0|255] "-"  ADCAM,EVCU2

BO_ 1153 BCM_FD_10: 32 BCM
 SG_ StTypSts : 141|3@0+ (1,0) [0|7] "" SGW,RFHM
 SG_ FOBSearchRequest : 159|2@0+ (1,0) [0|3] "" RFHM
 SG_ ExternalTemperatureF : 96|9@0+ (1,-121) [-121|389] "°F"  MPAD,SGW,IPC
 SG_ ExternalTemperatureC : 80|9@0+ (0.5,-85) [-85|170] "°C"  ADCAM,MPAD,EVCU2,DMSM,GNMM,SGW,AGSM,ESL,BSM,IPC,RFHM,ECM,DTCM
 SG_ CompressorACReqSts : 175|1@0+ (1,0) [0|1] "-"  EVCU2
 SG_ CmdIgnSts : 138|3@0+ (1,0) [0|7] "" ADCAM,MPAD,EVCU2,DMSM,GNMM,SGW,AGSM,ESL,BSM,IPC,RFHM,ECM,DTCM
 SG_ TurnIndicationSts : 143|2@0+ (1,0) [0|3] "" ADCAM,MPAD,SGW
 SG_ SpSt_Pad1 : 149|3@0+ (1,0) [0|6] "" SGW
 SG_ RemSt_InhibitSts : 133|6@0+ (1,0) [0|62] "" SGW,IPC
 SG_ PANEL_INTS : 7|8@0+ (0.5,0) [0|100] "%"  SGW,AGSM,BSM,RFHM
 SG_ MessageCounter_BCM10 : 179|4@0+ (1,0) [0|15] "-"  ADCAM,MPAD,EVCU2,DMSM,GNMM,AGSM,BSM,IPC,RFHM
 SG_ ExteriorRearReleaseSwitchSts : 161|1@0+ (1,0) [0|1] "" RFHM
 SG_ CRC_BCM10 : 191|8@0+ (1,0) [0|255] "-"  ADCAM,MPAD,EVCU2,DMSM,GNMM,AGSM,BSM,IPC,RFHM
 SG_ WPR_SYS_AUTO : 43|1@0+ (1,0) [0|1] "-"  ADCAM,MPAD
 SG_ FOA_Msg_Req : 146|3@0+ (1,0) [0|7] "-"  SGW,IPC
 SG_ SCC_InhibitSts : 14|6@0+ (1,0) [0|62] "" IPC
 SG_ DAY_LGT_MD : 15|1@0+ (1,0) [0|1] "" EVCU2,SGW,AGSM,BSM,IPC,RFHM
 SG_ FOA_Mobile_App_Alert : 41|1@0+ (1,0) [0|1] "" SGW

BO_ 247 BCM_CODE_TRM_REQUEST: 32 BCM
 SG_ MiniCryptFCode_TRM_Rq : 95|16@0+ (1,0) [0|65535] "-"  RFHM
 SG_ MiniCrypt_Rnd_TRM_Rq : 111|32@0+ (1,0) [0|4294967295] "-"  RFHM
 SG_ ControlEncoding_TRM_Rq : 87|8@0+ (1,0) [0|255] "-"  RFHM

BO_ 246 BCM_CODE_ESL_REQUEST: 32 BCM
 SG_ MiniCryptFCode_ESL_Rq : 95|16@0+ (1,0) [0|65535] "-"  ESL
 SG_ MiniCrypt_Rnd_ESL_Rq : 111|32@0+ (1,0) [0|4294967295] "-"  ESL
 SG_ ESLLockUnlockReq_ESL_Rq : 73|2@0+ (1,0) [0|3] "-"  ESL
 SG_ ControlEncoding_ESL_Rq : 87|8@0+ (1,0) [0|255] "-"  ESL

BO_ 1445 ASCM_FD_2: 32 BCM
 SG_ ADS_SrvSys : 115|1@0+ (1,0) [0|1] "-"  IPC
 SG_ MessageCounter_ASCM2 : 179|4@0+ (1,0) [0|15] "-"  BSM
 SG_ CRC_ASCM2 : 191|8@0+ (1,0) [0|255] "-"  BSM

BO_ 2654555920 APPL_ECU_FD_ECM: 64 SGW
 SG_ APPL_ECU_FD_ECM : 455|64@0+ (1,0) [0|0] "" ECM

BO_ 2654555930 APPL_ECU_FD_DTCM: 64 SGW
 SG_ APPL_ECU_FD_DTCM : 455|64@0+ (1,0) [0|0] "" DTCM

BO_ 2654555935 APPL_ECU_FD_AGSM: 64 SGW
 SG_ APPL_ECU_FD_AGSM : 455|64@0+ (1,0) [0|0] "" AGSM

BO_ 951 U_CONN_REQ_TBM: 32 SGW
 SG_ UConnReqFOBNum_TBM : 31|4@0+ (1,0) [0|15] "-"  RFHM
 SG_ UConnReqAuthCode_TBM : 15|16@0+ (1,0) [0|65535] "-"  RFHM
 SG_ UConnReq_TBM : 7|5@0+ (1,0) [0|31] "-"  RFHM

CM_ SG_ 513 Brk_Jrk_Resp "0";
CM_ SG_ 513 ShftChrDsp_Rq_ESC "0";
CM_ SG_ 513 SelSpdLmp "Select speed lamp status";
CM_ SG_ 513 SelectSpdSts "0";
CM_ SG_ 513 MessageCounter_BRAKE1 "This signal is a counter used for safety checks strategies. This counter is incremented of 1 (one) unit at each frame transmission.";
CM_ SG_ 513 MAC_BRAKE1 "-";
CM_ SG_ 513 REF_VEH_SPEED "0";
CM_ SG_ 513 HILL_DES_STAT "Hill descent feature status";
CM_ SG_ 513 Ft_RrTrqCoupling_ModeRq "ESP Requested Center Differential State";
CM_ SG_ 513 Ft_RrAxleCoupling_TrqRq "Desired Torque for Center Diff";
CM_ SG_ 513 ExternalBrkRequestsDisabled "0";
CM_ SG_ 513 eBurn_Stages "This signal will use 3 stages to trigger brakes overheat indications";
CM_ SG_ 513 DASEngReqPos "0";
CM_ SG_ 513 CRC_BRAKE1 "CRC according to SAE J1850 standard at each frame transmission.";
CM_ SG_ 513 Cntr_BRAKE1 "-";
CM_ SG_ 513 BrkTrq_Driver "0";
CM_ SG_ 513 BrkTrq "0";
CM_ SG_ 513 Brk_Thermdl "This signal indicate when the estimated brake temperature is over a predefined threshold.";
CM_ SG_ 513 ACCFSafe "0";
CM_ SG_ 513 VehicleStandStillSts "This signal indicates if the car is in stand still condition";
CM_ SG_ 245 MinicryptReceptionSts "This signal is used to give an acknowledge on specific message reception.";
CM_ SG_ 1066 TrunkHandleReleaseSts "Trunk Handle Release Status";
CM_ SG_ 1066 TheftAlarmStatus "VTA Status";
CM_ SG_ 1066 StopLightSts "Request of Stop Lights activation";
CM_ SG_ 1066 RHRDoorSts "Used to indicate the status of right rear door";
CM_ SG_ 1066 RHatchSts "Used to indicate the status of the trunk liftgate";
CM_ SG_ 1066 RearTrunkEnableLastElSts "It specifies the electric status of the rear trunk switch";
CM_ SG_ 1066 RainSensorFailSts "This signal indicates a Rain sensor fail.";
CM_ SG_ 1066 PsngrDoorSts "Used to indicate the status of passenger door";
CM_ SG_ 1066 ParkBrakeSts "Status of Park Brake";
CM_ SG_ 1066 MoveWheelSts "This signal is used to give a message to the customer to move the steering wheel.";
CM_ SG_ 1066 MessageCounter_BCM9 "This signal is a counter used for safety checks strategies. This counter is incremented of 1 (one) unit at each frame transmission.";
CM_ SG_ 1066 LowFuelWarningSts "Used to give information about the status of the low fuel warning.";
CM_ SG_ 1066 LHRDoorSts "Used to indicate the status of left rear door";
CM_ SG_ 1066 HDCFnRqstSts "This signal is used by BCM to inicate the status of HDC switch";
CM_ SG_ 1066 FuelLevel2 "Average fuel level";
CM_ SG_ 1066 FuelLevel "Used to give information about the percentage of the fuel level present in the tank.";
CM_ SG_ 1066 FrontWiperMoveSts "This signal indicates the position of the front wiper (contact cam open or close).";
CM_ SG_ 1066 ESLUnlockFailSts_Indication "This signal is used to give information about a failure of the ESL during an unlock procedure.";
CM_ SG_ 1066 ESLLockFailSts_Indication "This signal is used to give information about a failure of the ESL during a lock procedure.";
CM_ SG_ 1066 DriverDoorSts "Used to indicate the status of driver door";
CM_ SG_ 1066 DoorLockLastElSts "Reports the last knonw eletrical request for the doors to lock or unlock.";
CM_ SG_ 1066 CRC_BCM9 "CRC according to SAE J1850 standard at each frame transmission.";
CM_ SG_ 1066 BonnetSts "Used to indicate the status of the bonnet";
CM_ SG_ 1066 AHBFeature "This signal indicates the Auto High Beam Feature status";
CM_ SG_ 1827 MessageCounter_BCM7 "This signal is a counter used for safety checks strategies. This counter is incremented of 1 (one) unit at each frame transmission.";
CM_ SG_ 1827 CRC_BCM7 "CRC according to SAE J1850 standard at each frame transmission.";
CM_ SG_ 1827 AbsoluteTimerSeconds "Total seconds since last reset";
CM_ SG_ 1827 AbsoluteTimerDays "Total days since last reset";
CM_ SG_ 1375 SysEOLSts "EOL Status";
CM_ SG_ 1375 MessageCounter_BCM6 "This signal is a counter used for safety checks strategies. This counter is incremented of 1 (one) unit at each frame transmission.";
CM_ SG_ 1375 CRC_BCM6 "CRC according to SAE J1850 standard at each frame transmission.";
CM_ SG_ 1375 ChkFuelLevelSts2 "Used to give information about the diagnostic of the secondary fuel sensor";
CM_ SG_ 1375 ChkFuelLevelSts "Used to give information about the diagnostic of CILC.";
CM_ SG_ 1051 RR_VS_STATFailSts "Indicates a fail in rear right vented set";
CM_ SG_ 1051 RR_VS_STAT "EI9367";
CM_ SG_ 1051 RR_HS_STATFailSts "Indicates a fail in Rear Right Heated Seat";
CM_ SG_ 1051 RR_HS_STAT "Rear Right Heated Seat On/Off Status";
CM_ SG_ 1051 RollAngle "This signal provides the calculation  of the roll angle by BCM";
CM_ SG_ 1051 RL_VS_STATFailSts "Indicates a fail in rear left vented set";
CM_ SG_ 1051 RL_VS_STAT "EI9367";
CM_ SG_ 1051 RL_HS_STATFailSts "Indicates a fail in Rear Left Heated Seat";
CM_ SG_ 1051 RL_HS_STAT "Rear Left Heated Seat On/Off Status";
CM_ SG_ 1051 PitchAngle "This signal provides the calculation of the pitch angle by BCM";
CM_ SG_ 1051 MessageCounter_BCM4 "This signal is a counter used for safety checks strategies. This counter is incremented of 1 (one) unit at each frame transmission.";
CM_ SG_ 1051 HSW_StatFailSts "It indicates a fail in Heated steering wheel";
CM_ SG_ 1051 FUEL_VOLT2 "Sub Side Fuel level sensor A/D Voltage (saddle/Dual tank)";
CM_ SG_ 1051 FUEL_VOLT "Used to give information about the not filtered fuell level value in volt.";
CM_ SG_ 1051 FR_VS_STATSts "EI9367";
CM_ SG_ 1051 FR_VS_STATFailSts "Indicates a fail in front right vented seat";
CM_ SG_ 1051 FL_VS_STATSts "EI9367";
CM_ SG_ 1051 FL_VS_STATFailSts "Indicates a fail in front left vented seat";
CM_ SG_ 1051 ExternalTemperatureAD_Voltage "Indicates the raw voltage of the ambient temp sensor";
CM_ SG_ 1051 EVAP_TEMP_P1C "Evaporator Temperature";
CM_ SG_ 1051 CRC_BCM4 "CRC according to SAE J1850 standard at each frame transmission.";
CM_ SG_ 1051 AM_ECM_Trace "Aftermarket ECM trace";
CM_ SG_ 256 RefuelRequest "Driver has initiated a refueling event";
CM_ SG_ 256 MessageCounter_BCM2 "This signal is a counter used for safety checks strategies. This counter is incremented of 1 (one) unit at each frame transmission.";
CM_ SG_ 256 KeyInIgnSts "Key in ignition status";
CM_ SG_ 256 TurnIndicatorSts "The signal is used to indicate the turn indicator position.";
CM_ SG_ 256 SCCActvSts "SCCActvSts";
CM_ SG_ 256 RemStActvSts "Redundant Remote Start Active Status";
CM_ SG_ 256 RemStActvSts_R "Redundant Remote Start Active Status";
CM_ SG_ 256 CRC_BCM2 "CRC according to SAE J1850 standard at each frame transmission.";
CM_ SG_ 256 BrkPdlStat_BCM "Brake pedal state reported by CBC";
CM_ SG_ 256 EngineOffRequest "The signal is used to require an  engine shut off";
CM_ SG_ 512 MessageCounter_BCM18 "This signal is a counter used for safety checks strategies. This counter is incremented of 1 (one) unit at each frame transmission.";
CM_ SG_ 512 LeakCheckTimerExpired "Status of leak test timer";
CM_ SG_ 512 Fuel_Door_Sts "This signal is sent to the ECM based on the status of the fuel door.";
CM_ SG_ 512 DRV_DR_UNLOCKING "This signal describe the actuation state of driver door unlock switch";
CM_ SG_ 512 CRC_BCM18 "CRC according to SAE J1850 standard at each frame transmission.";
CM_ SG_ 512 BonnetAjarRawValSts_8 "The signal gives info on Bonnet ajar input to engine controller to use for stop-start and do diagnosis in the engine controller.";
CM_ SG_ 512 Braking_Mode_Req "Signal Indicating L Button Pressed Status";
CM_ SG_ 736 CRC_BCM14 "CRC according to SAE J1850 standard at each frame transmission.";
CM_ SG_ 736 Command_15Sts "Infotainment Switch 15";
CM_ SG_ 736 Command_14Sts "Infotainment Switch 14";
CM_ SG_ 736 Command_13Sts "Infotainment Switch 13";
CM_ SG_ 736 Command_12Sts "Infotainment Switch 12";
CM_ SG_ 736 Command_11Sts "Infotainment Switch 11";
CM_ SG_ 736 Command_10Sts "Infotainment Switch 10";
CM_ SG_ 736 Command_09Sts "Infotainment Switch 9";
CM_ SG_ 736 Command_08Sts "Infotainment Switch 8";
CM_ SG_ 736 Command_07Sts "Infotainment Switch 7";
CM_ SG_ 736 Command_06Sts "Infotainment Switch 6";
CM_ SG_ 736 Command_05Sts "Infotainment Switch 5";
CM_ SG_ 736 MessageCounter_BCM14 "This signal is a counter used for safety checks strategies. This counter is incremented of 1 (one) unit at each frame transmission.";
CM_ SG_ 736 Command_04Sts "Infotainment Switch 4";
CM_ SG_ 736 Command_03Sts "Infotainment Switch 3";
CM_ SG_ 736 Command_02Sts "Infotainment Switch 2";
CM_ SG_ 736 Command_01Sts "Infotainment Switch 1";
CM_ SG_ 159 SpeedLimiterOnOffSts "The signal is sent from SCCM to the ECM for turning the Speed Limter Function ON and OFF.";
CM_ SG_ 159 ResumeSwitch "This signal is used to give information about cruise control RESUME button activation.";
CM_ SG_ 159 MessageCounter_BCM13 "This signal is a counter used for safety checks strategies. This counter is incremented of 1 (one) unit at each frame transmission.";
CM_ SG_ 159 MC_CSWC_1 "This signal is a counter used for safety checks strategies. This counter is incremented of 1 (one) unit at each frame transmission.";
CM_ SG_ 159 DeceleratorSts "This signal is used to give information about cruise control decelerator button activation.";
CM_ SG_ 159 CrusCnclSwitch "Cruise Switch:  Cancel Pressed.";
CM_ SG_ 159 CruiseControlOnOffSts "This signal is used to give information about cruise control on/off button activation .";
CM_ SG_ 159 CruiseControlFailSts "This signal is used to give information about a fault on cruise control commands";
CM_ SG_ 159 CRC_CSWC_1 "CRC according to SAE J1850 standard that has to be calculated from bit 63 to bit 48 at each frame transmission.";
CM_ SG_ 159 CRC_BCM13 "CRC according to SAE J1850 standard at each frame transmission.";
CM_ SG_ 159 AcceleratorSts "This signal is used to give information about cruise control accelerator button activation.";
CM_ SG_ 159 ACC_On "ACC on/off";
CM_ SG_ 159 ACC_DistSwDec "ACC distance switch decrement";
CM_ SG_ 159 ACC_DistSwInc "ACC distance switch increment";
CM_ SG_ 1431 Switch1_Rq "Used to require the activation of the related feature";
CM_ SG_ 1431 SeatVib_Sts "Seat vibration status";
CM_ SG_ 1431 MessageCounter_BCM12 "This signal is a counter used for safety checks strategies. This counter is incremented of 1 (one) unit at each frame transmission.";
CM_ SG_ 1431 IGN_OFF_TIME_LNG "Time since last ignition on (long)";
CM_ SG_ 1431 EPS_MODE_CFG_STAT "Config setting - EPS personalization mode";
CM_ SG_ 1431 PAMRequestSts "It indicates the pressure of Park Assist pushbutton";
CM_ SG_ 1431 DALM_Status "DALM status";
CM_ SG_ 1431 CRC_BCM12 "CRC according to SAE J1850 standard at each frame transmission.";
CM_ SG_ 1431 AxleLckrSEL_SW "AxleLckrSEL_SW";
CM_ SG_ 1431 APARequestSts "It indicates the pressure of Advanced Park Assist pushbutton";
CM_ SG_ 1431 AirTemp_Outsd "Outside air temperature";
CM_ SG_ 1431 TRAC_PSD "Traction on/off button pressed; [0] = Not Pressed, [1] = Pressed";
CM_ SG_ 1431 TerrainSwStat "Terrain select switch status";
CM_ SG_ 1431 Switch2_Rq "Used to require the activation of the related feature";
CM_ SG_ 1430 StopStartClimateInfo "HVAC conditions effecting stop start enable";
CM_ SG_ 1430 PN14_LS_Actv "14 V powernet Load Shed active";
CM_ SG_ 1430 PanicModeActive "Panic Status";
CM_ SG_ 1430 MessageCounter_BCM11 "This signal is a counter used for safety checks strategies. This counter is incremented of 1 (one) unit at each frame transmission.";
CM_ SG_ 1430 Gate_Req_PE "Gate passive entry requested";
CM_ SG_ 1430 EngineOffTimer "Engine off timer - engine off ignition NOT lock.";
CM_ SG_ 1430 DCSD_TUNEKNOB_VAL "DCSD TUNEKNOB VAL";
CM_ SG_ 1430 DCSD_TUNEKNOB_DIR "DCSD_TUNEKNOB_DIR";
CM_ SG_ 1430 DCSD_Enter "DCSD Enter";
CM_ SG_ 1430 CRC_BCM11 "CRC according to SAE J1850 standard at each frame transmission.";
CM_ SG_ 1430 PN14_LS_Lvl7 "Load Shedding level7";
CM_ SG_ 1430 CMP_DIR "Compass direction";
CM_ SG_ 1430 Batt_ST_Crit "Battery reached critical state";
CM_ SG_ 1430 A2D_DRV_TEMP_DR_POS "Transmit raw A/D driver temp door position to ECM, the information is used to make OBD model more robust";
CM_ SG_ 1153 SpSt_Pad1 "Stop Start Button Press 1";
CM_ SG_ 1153 SCC_InhibitSts "SCC_InhibitSts";
CM_ SG_ 1153 WPR_SYS_AUTO "Wiper system auto; [1] = Auto wipers equipped";
CM_ SG_ 1153 RemSt_InhibitSts "Remote start inhibit";
CM_ SG_ 1153 MessageCounter_BCM10 "This signal is a counter used for safety checks strategies. This counter is incremented of 1 (one) unit at each frame transmission.";
CM_ SG_ 1153 FOBSearchRequest "Signal used to request the FOB searching.";
CM_ SG_ 1153 FOA_Msg_Req "Represents Message request to display on HMI for Forgotten Object Alert";
CM_ SG_ 1153 PANEL_INTS "Panel-/display intensity";
CM_ SG_ 1153 FOA_Mobile_App_Alert "Forgotten Object Alert mobile alert";
CM_ SG_ 1153 ExternalTemperatureC "Used to indicate the external temperature value in °C";
CM_ SG_ 1153 ExternalTemperatureF "Used to indicate the external temperature value in °F";
CM_ SG_ 1153 ExteriorRearReleaseSwitchSts "Used to give rear access button press info to the body controller to allow releasing the rear access point";
CM_ SG_ 1153 CRC_BCM10 "CRC according to SAE J1850 standard at each frame transmission.";
CM_ SG_ 1153 CmdIgnSts "Used to give information about the key selector position";
CM_ SG_ 1153 DAY_LGT_MD "Day light brightness mode; Night=[0], Day=[1]";
CM_ SG_ 1153 CompressorACReqSts "This signal is sent from BCM to ECM to inform of Compressor AC activation request";
CM_ SG_ 246 ESLLockUnlockReq_ESL_Rq "This signal is used to command the steering column lock/unlock procedure.";
CM_ SG_ 1445 ADS_SrvSys "ADS service system; True = [1]";
CM_ SG_ 1445 CRC_ASCM2 "CRC according to SAE J1850 standard at each frame transmission.";
CM_ SG_ 1445 MessageCounter_ASCM2 "This signal is a counter used for safety checks strategies. This counter is incremented of 1 (one) unit at each frame transmission.";
CM_ SG_ 2654555920 APPL_ECU_FD_ECM "External application to ECU";
CM_ SG_ 2654555930 APPL_ECU_FD_DTCM "External application to ECU";
CM_ SG_ 2654555935 APPL_ECU_FD_AGSM "External application to ECU";
CM_ SG_ 951 UConnReq_TBM "Requests specific vehicle function";
CM_ SG_ 951 UConnReqAuthCode_TBM "Authenticates function requests";
CM_ SG_ 951 UConnReqFOBNum_TBM "Indicates Corresponding  FOB number 1-8";
BA_DEF_ BO_ "CANFD_BRS" ENUM "0","1";
BA_DEF_ BO_ "VFrameFormat" ENUM "StandardCAN","ExtendedCAN","reserved","reserved","reserved","reserved","reserved","reserved","reserved","reserved","reserved","reserved","reserved","reserved","StandardCAN_FD","ExtendedCAN_FD";
BA_DEF_ BO_ "DiagConnection" HEX 0 65535;
BA_DEF_ BO_ "DiagState" ENUM "No","Yes";
BA_DEF_ BO_ "NmAsrMessage" ENUM "No","Yes";
BA_DEF_ BO_ "GenMsgDelayTime" INT 0 65535;
BA_DEF_ BO_ "GenMsgCycleTime" INT 0 65535;
BA_DEF_ BO_ "GenMsgCycleTimeFast" INT 0 65535;
BA_DEF_ BO_ "GenMsgStartDelayTime" INT 0 65535;
BA_DEF_ BO_ "GenMsgILSupport" ENUM "No","Yes";
BA_DEF_ BO_ "GenMsgNrOfRepetition" INT 0 255;
BA_DEF_ BO_ "GenMsgSendType" ENUM "Cyclic","NotUsed","NotUsed","NotUsed","NotUsed","NotUsed","NotUsed","NotUsed","NoMsgSendType";
BA_DEF_ BO_ "NmMessage" ENUM "No","Yes";
BA_DEF_ BO_ "DiagResponse" ENUM "No","Yes";
BA_DEF_ BO_ "Type" ENUM "P","C","PE","COC","PE_Cntrl","E","E_Cntrl","OC","S","BAF","DC","EM","MM","ISO-TP","-";
BA_DEF_ BO_ "DiagRequest" ENUM "No","Yes";
BA_DEF_ SG_ "GenSigTimeoutTime_SGW" INT 0 65535;
BA_DEF_ SG_ "GenSigTimeoutTime_RFHM" INT 0 65535;
BA_DEF_ SG_ "GenSigTimeoutTime_MPAD" INT 0 65535;
BA_DEF_ SG_ "GenSigTimeoutTime_IPC" INT 0 65535;
BA_DEF_ SG_ "GenSigTimeoutTime_GNMM" INT 0 65535;
BA_DEF_ SG_ "GenSigTimeoutTime_EVCU2" INT 0 65535;
BA_DEF_ SG_ "GenSigTimeoutTime_ESL" INT 0 65535;
BA_DEF_ SG_ "GenSigTimeoutTime_ECM" INT 0 65535;
BA_DEF_ SG_ "GenSigTimeoutTime_DTCM" INT 0 65535;
BA_DEF_ SG_ "GenSigTimeoutTime_DMSM" INT 0 65535;
BA_DEF_ SG_ "GenSigTimeoutTime_BSM" INT 0 65535;
BA_DEF_ SG_ "GenSigTimeoutTime_BCM" INT 0 65535;
BA_DEF_ SG_ "GenSigTimeoutTime_AGSM" INT 0 65535;
BA_DEF_ SG_ "GenSigTimeoutTime_ADCAM" INT 0 65535;
BA_DEF_ SG_ "SystemSignalLongSymbol" STRING ;
BA_DEF_ SG_ "GenSigSendType" ENUM "NotUsed","OnWrite","OnWriteWithRepetition","OnChange","OnChangeWithRepetition","IfActive","IfActiveWithRepetition","NoSigSendType";
BA_DEF_ SG_ "GenSigInactiveValue" INT 0 2147483647;
BA_DEF_ SG_ "GenSigStartValue" INT 0 2147483647;
BA_DEF_DEF_ "CANFD_BRS" "0";
BA_DEF_DEF_ "VFrameFormat" "StandardCAN_FD";
BA_DEF_DEF_ "DiagConnection" 0;
BA_DEF_DEF_ "DiagState" "No";
BA_DEF_DEF_ "NmAsrMessage" "No";
BA_DEF_DEF_ "GenMsgDelayTime" 0;
BA_DEF_DEF_ "GenMsgCycleTime" 0;
BA_DEF_DEF_ "GenMsgCycleTimeFast" 0;
BA_DEF_DEF_ "GenMsgStartDelayTime" 0;
BA_DEF_DEF_ "GenMsgILSupport" "No";
BA_DEF_DEF_ "GenMsgNrOfRepetition" 0;
BA_DEF_DEF_ "GenMsgSendType" "NoMsgSendType";
BA_DEF_DEF_ "NmMessage" "No";
BA_DEF_DEF_ "DiagResponse" "No";
BA_DEF_DEF_ "Type" "-";
BA_DEF_DEF_ "DiagRequest" "No";
BA_DEF_DEF_ "GenSigTimeoutTime_SGW" 2500;
BA_DEF_DEF_ "GenSigTimeoutTime_RFHM" 2500;
BA_DEF_DEF_ "GenSigTimeoutTime_MPAD" 2500;
BA_DEF_DEF_ "GenSigTimeoutTime_IPC" 2500;
BA_DEF_DEF_ "GenSigTimeoutTime_GNMM" 2500;
BA_DEF_DEF_ "GenSigTimeoutTime_EVCU2" 2500;
BA_DEF_DEF_ "GenSigTimeoutTime_ESL" 2500;
BA_DEF_DEF_ "GenSigTimeoutTime_ECM" 2500;
BA_DEF_DEF_ "GenSigTimeoutTime_DTCM" 2500;
BA_DEF_DEF_ "GenSigTimeoutTime_DMSM" 2500;
BA_DEF_DEF_ "GenSigTimeoutTime_BSM" 2500;
BA_DEF_DEF_ "GenSigTimeoutTime_BCM" 2500;
BA_DEF_DEF_ "GenSigTimeoutTime_AGSM" 2500;
BA_DEF_DEF_ "GenSigTimeoutTime_ADCAM" 2500;
BA_DEF_DEF_ "SystemSignalLongSymbol" "";
BA_DEF_DEF_ "GenSigSendType" "NoSigSendType";
BA_DEF_DEF_ "GenSigInactiveValue" 0;
BA_DEF_DEF_ "GenSigStartValue" 0;
BA_ "CANFD_BRS" BO_ 513 1;
BA_ "GenMsgCycleTime" BO_ 513 20;
BA_ "GenMsgILSupport" BO_ 513 1;
BA_ "GenMsgSendType" BO_ 513 0;
BA_ "Type" BO_ 513 1;
BA_ "CANFD_BRS" BO_ 245 1;
BA_ "GenMsgILSupport" BO_ 245 1;
BA_ "Type" BO_ 245 8;
BA_ "CANFD_BRS" BO_ 1066 1;
BA_ "GenMsgDelayTime" BO_ 1066 20;
BA_ "GenMsgCycleTime" BO_ 1066 250;
BA_ "GenMsgCycleTimeFast" BO_ 1066 20;
BA_ "GenMsgStartDelayTime" BO_ 1066 50;
BA_ "GenMsgILSupport" BO_ 1066 1;
BA_ "GenMsgNrOfRepetition" BO_ 1066 2;
BA_ "GenMsgSendType" BO_ 1066 0;
BA_ "Type" BO_ 1066 3;
BA_ "CANFD_BRS" BO_ 1827 1;
BA_ "GenMsgCycleTime" BO_ 1827 1000;
BA_ "GenMsgStartDelayTime" BO_ 1827 410;
BA_ "GenMsgILSupport" BO_ 1827 1;
BA_ "GenMsgSendType" BO_ 1827 0;
BA_ "Type" BO_ 1827 1;
BA_ "CANFD_BRS" BO_ 1375 1;
BA_ "GenMsgCycleTime" BO_ 1375 250;
BA_ "GenMsgStartDelayTime" BO_ 1375 55;
BA_ "GenMsgILSupport" BO_ 1375 1;
BA_ "GenMsgSendType" BO_ 1375 0;
BA_ "Type" BO_ 1375 1;
BA_ "CANFD_BRS" BO_ 1051 1;
BA_ "GenMsgCycleTime" BO_ 1051 100;
BA_ "GenMsgStartDelayTime" BO_ 1051 65;
BA_ "GenMsgILSupport" BO_ 1051 1;
BA_ "GenMsgSendType" BO_ 1051 0;
BA_ "Type" BO_ 1051 1;
BA_ "GenMsgCycleTime" BO_ 256 10;
BA_ "GenMsgILSupport" BO_ 256 1;
BA_ "GenMsgSendType" BO_ 256 0;
BA_ "Type" BO_ 256 1;
BA_ "CANFD_BRS" BO_ 256 1;
BA_ "CANFD_BRS" BO_ 512 1;
BA_ "GenMsgCycleTime" BO_ 512 20;
BA_ "GenMsgStartDelayTime" BO_ 512 15;
BA_ "GenMsgILSupport" BO_ 512 1;
BA_ "GenMsgSendType" BO_ 512 0;
BA_ "Type" BO_ 512 1;
BA_ "Type" BO_ 736 7;
BA_ "CANFD_BRS" BO_ 736 1;
BA_ "GenMsgDelayTime" BO_ 736 20;
BA_ "GenMsgILSupport" BO_ 736 1;
BA_ "CANFD_BRS" BO_ 159 1;
BA_ "GenMsgDelayTime" BO_ 159 50;
BA_ "GenMsgILSupport" BO_ 159 1;
BA_ "Type" BO_ 159 11;
BA_ "CANFD_BRS" BO_ 1431 1;
BA_ "GenMsgDelayTime" BO_ 1431 20;
BA_ "GenMsgCycleTime" BO_ 1431 100;
BA_ "GenMsgCycleTimeFast" BO_ 1431 20;
BA_ "GenMsgILSupport" BO_ 1431 1;
BA_ "GenMsgNrOfRepetition" BO_ 1431 2;
BA_ "GenMsgSendType" BO_ 1431 0;
BA_ "Type" BO_ 1431 3;
BA_ "CANFD_BRS" BO_ 1430 1;
BA_ "GenMsgDelayTime" BO_ 1430 20;
BA_ "GenMsgCycleTime" BO_ 1430 1000;
BA_ "GenMsgCycleTimeFast" BO_ 1430 20;
BA_ "GenMsgStartDelayTime" BO_ 1430 380;
BA_ "GenMsgILSupport" BO_ 1430 1;
BA_ "GenMsgNrOfRepetition" BO_ 1430 2;
BA_ "GenMsgSendType" BO_ 1430 0;
BA_ "Type" BO_ 1430 3;
BA_ "CANFD_BRS" BO_ 1153 1;
BA_ "GenMsgDelayTime" BO_ 1153 20;
BA_ "GenMsgCycleTime" BO_ 1153 500;
BA_ "GenMsgCycleTimeFast" BO_ 1153 20;
BA_ "GenMsgStartDelayTime" BO_ 1153 65;
BA_ "GenMsgILSupport" BO_ 1153 1;
BA_ "GenMsgNrOfRepetition" BO_ 1153 2;
BA_ "GenMsgSendType" BO_ 1153 0;
BA_ "Type" BO_ 1153 3;
BA_ "CANFD_BRS" BO_ 247 1;
BA_ "GenMsgILSupport" BO_ 247 1;
BA_ "Type" BO_ 247 8;
BA_ "CANFD_BRS" BO_ 246 1;
BA_ "GenMsgILSupport" BO_ 246 1;
BA_ "Type" BO_ 246 8;
BA_ "CANFD_BRS" BO_ 1445 1;
BA_ "GenMsgDelayTime" BO_ 1445 20;
BA_ "GenMsgCycleTime" BO_ 1445 1000;
BA_ "GenMsgCycleTimeFast" BO_ 1445 20;
BA_ "GenMsgStartDelayTime" BO_ 1445 375;
BA_ "GenMsgILSupport" BO_ 1445 1;
BA_ "GenMsgNrOfRepetition" BO_ 1445 2;
BA_ "GenMsgSendType" BO_ 1445 0;
BA_ "Type" BO_ 1445 3;
BA_ "CANFD_BRS" BO_ 2654555920 1;
BA_ "VFrameFormat" BO_ 2654555920 15;
BA_ "GenMsgILSupport" BO_ 2654555920 1;
BA_ "Type" BO_ 2654555920 8;
BA_ "CANFD_BRS" BO_ 2654555930 1;
BA_ "VFrameFormat" BO_ 2654555930 15;
BA_ "GenMsgILSupport" BO_ 2654555930 1;
BA_ "Type" BO_ 2654555930 8;
BA_ "CANFD_BRS" BO_ 2654555935 1;
BA_ "VFrameFormat" BO_ 2654555935 15;
BA_ "GenMsgILSupport" BO_ 2654555935 1;
BA_ "Type" BO_ 2654555935 8;
BA_ "CANFD_BRS" BO_ 951 1;
BA_ "GenMsgDelayTime" BO_ 951 20;
BA_ "GenMsgCycleTimeFast" BO_ 951 100;
BA_ "GenMsgILSupport" BO_ 951 1;
BA_ "GenMsgNrOfRepetition" BO_ 951 2;
BA_ "Type" BO_ 951 9;
BA_ "GenSigTimeoutTime_MPAD" SG_ 1066 LowFuelWarningSts 0;
BA_ "GenSigTimeoutTime_GNMM" SG_ 1066 LowFuelWarningSts 0;
BA_ "GenSigTimeoutTime_EVCU2" SG_ 1066 LowFuelWarningSts 0;
BA_ "GenSigTimeoutTime_ESL" SG_ 1066 LowFuelWarningSts 0;
BA_ "GenSigTimeoutTime_DTCM" SG_ 1066 LowFuelWarningSts 0;
BA_ "GenSigTimeoutTime_DMSM" SG_ 1066 LowFuelWarningSts 0;
BA_ "GenSigTimeoutTime_BSM" SG_ 1066 LowFuelWarningSts 0;
BA_ "GenSigTimeoutTime_BCM" SG_ 1066 LowFuelWarningSts 0;
BA_ "GenSigTimeoutTime_AGSM" SG_ 1066 LowFuelWarningSts 0;
BA_ "GenSigTimeoutTime_ADCAM" SG_ 1066 LowFuelWarningSts 0;
BA_ "GenSigTimeoutTime_SGW" SG_ 1066 MessageCounter_BCM9 0;
BA_ "GenSigTimeoutTime_RFHM" SG_ 1066 MessageCounter_BCM9 0;
BA_ "GenSigTimeoutTime_ESL" SG_ 1066 MessageCounter_BCM9 0;
BA_ "GenSigTimeoutTime_ECM" SG_ 1066 MessageCounter_BCM9 0;
BA_ "GenSigTimeoutTime_DTCM" SG_ 1066 MessageCounter_BCM9 0;
BA_ "GenSigTimeoutTime_DMSM" SG_ 1066 MessageCounter_BCM9 0;
BA_ "GenSigTimeoutTime_BCM" SG_ 1066 MessageCounter_BCM9 0;
BA_ "GenSigTimeoutTime_AGSM" SG_ 1066 MessageCounter_BCM9 0;
BA_ "GenSigTimeoutTime_SGW" SG_ 1066 MoveWheelSts 0;
BA_ "GenSigTimeoutTime_RFHM" SG_ 1066 MoveWheelSts 0;
BA_ "GenSigTimeoutTime_MPAD" SG_ 1066 MoveWheelSts 0;
BA_ "GenSigTimeoutTime_GNMM" SG_ 1066 MoveWheelSts 0;
BA_ "GenSigTimeoutTime_EVCU2" SG_ 1066 MoveWheelSts 0;
BA_ "GenSigTimeoutTime_ESL" SG_ 1066 MoveWheelSts 0;
BA_ "GenSigTimeoutTime_ECM" SG_ 1066 MoveWheelSts 0;
BA_ "GenSigTimeoutTime_DTCM" SG_ 1066 MoveWheelSts 0;
BA_ "GenSigTimeoutTime_DMSM" SG_ 1066 MoveWheelSts 0;
BA_ "GenSigTimeoutTime_BSM" SG_ 1066 MoveWheelSts 0;
BA_ "GenSigTimeoutTime_BCM" SG_ 1066 MoveWheelSts 0;
BA_ "GenSigTimeoutTime_AGSM" SG_ 1066 MoveWheelSts 0;
BA_ "GenSigTimeoutTime_ADCAM" SG_ 1066 MoveWheelSts 0;
BA_ "GenSigSendType" SG_ 1066 MoveWheelSts 3;
BA_ "GenSigSendType" SG_ 1066 LowFuelWarningSts 3;
BA_ "GenSigTimeoutTime_SGW" SG_ 1066 FrontWiperMoveSts 0;
BA_ "GenSigTimeoutTime_RFHM" SG_ 1066 FrontWiperMoveSts 0;
BA_ "GenSigTimeoutTime_IPC" SG_ 1066 FrontWiperMoveSts 0;
BA_ "GenSigTimeoutTime_GNMM" SG_ 1066 FrontWiperMoveSts 0;
BA_ "GenSigTimeoutTime_ESL" SG_ 1066 FrontWiperMoveSts 0;
BA_ "GenSigTimeoutTime_DMSM" SG_ 1066 FrontWiperMoveSts 0;
BA_ "GenSigTimeoutTime_BSM" SG_ 1066 FrontWiperMoveSts 0;
BA_ "GenSigTimeoutTime_BCM" SG_ 1066 FrontWiperMoveSts 0;
BA_ "GenSigTimeoutTime_AGSM" SG_ 1066 FrontWiperMoveSts 0;
BA_ "GenSigTimeoutTime_SGW" SG_ 1066 HDCFnRqstSts 0;
BA_ "GenSigTimeoutTime_RFHM" SG_ 1066 HDCFnRqstSts 0;
BA_ "GenSigTimeoutTime_MPAD" SG_ 1066 HDCFnRqstSts 0;
BA_ "GenSigTimeoutTime_IPC" SG_ 1066 HDCFnRqstSts 0;
BA_ "GenSigTimeoutTime_GNMM" SG_ 1066 HDCFnRqstSts 0;
BA_ "GenSigTimeoutTime_ESL" SG_ 1066 HDCFnRqstSts 0;
BA_ "GenSigTimeoutTime_ECM" SG_ 1066 HDCFnRqstSts 0;
BA_ "GenSigTimeoutTime_DTCM" SG_ 1066 HDCFnRqstSts 0;
BA_ "GenSigTimeoutTime_DMSM" SG_ 1066 HDCFnRqstSts 0;
BA_ "GenSigTimeoutTime_BSM" SG_ 1066 HDCFnRqstSts 0;
BA_ "GenSigTimeoutTime_AGSM" SG_ 1066 HDCFnRqstSts 0;
BA_ "GenSigSendType" SG_ 1066 HDCFnRqstSts 3;
BA_ "GenSigTimeoutTime_GNMM" SG_ 1066 LHRDoorSts 0;
BA_ "GenSigTimeoutTime_EVCU2" SG_ 1066 LHRDoorSts 0;
BA_ "GenSigTimeoutTime_ESL" SG_ 1066 LHRDoorSts 0;
BA_ "GenSigTimeoutTime_ECM" SG_ 1066 LHRDoorSts 0;
BA_ "GenSigTimeoutTime_DTCM" SG_ 1066 LHRDoorSts 0;
BA_ "GenSigTimeoutTime_DMSM" SG_ 1066 LHRDoorSts 0;
BA_ "GenSigTimeoutTime_BSM" SG_ 1066 LHRDoorSts 0;
BA_ "GenSigTimeoutTime_BCM" SG_ 1066 LHRDoorSts 0;
BA_ "GenSigTimeoutTime_AGSM" SG_ 1066 LHRDoorSts 0;
BA_ "GenSigTimeoutTime_ADCAM" SG_ 1066 LHRDoorSts 0;
BA_ "GenSigSendType" SG_ 1066 LHRDoorSts 3;
BA_ "GenSigTimeoutTime_RFHM" SG_ 1066 LowBeamSts 0;
BA_ "GenSigTimeoutTime_IPC" SG_ 1066 LowBeamSts 0;
BA_ "GenSigTimeoutTime_GNMM" SG_ 1066 LowBeamSts 0;
BA_ "GenSigTimeoutTime_EVCU2" SG_ 1066 LowBeamSts 0;
BA_ "GenSigTimeoutTime_ESL" SG_ 1066 LowBeamSts 0;
BA_ "GenSigTimeoutTime_ECM" SG_ 1066 LowBeamSts 0;
BA_ "GenSigTimeoutTime_DTCM" SG_ 1066 LowBeamSts 0;
BA_ "GenSigTimeoutTime_DMSM" SG_ 1066 LowBeamSts 0;
BA_ "GenSigTimeoutTime_BSM" SG_ 1066 LowBeamSts 0;
BA_ "GenSigTimeoutTime_BCM" SG_ 1066 LowBeamSts 0;
BA_ "GenSigTimeoutTime_AGSM" SG_ 1066 LowBeamSts 0;
BA_ "GenSigTimeoutTime_GNMM" SG_ 1066 DriverDoorSts 0;
BA_ "GenSigTimeoutTime_ESL" SG_ 1066 DriverDoorSts 0;
BA_ "GenSigTimeoutTime_DTCM" SG_ 1066 DriverDoorSts 0;
BA_ "GenSigTimeoutTime_DMSM" SG_ 1066 DriverDoorSts 0;
BA_ "GenSigTimeoutTime_BCM" SG_ 1066 DriverDoorSts 0;
BA_ "GenSigSendType" SG_ 1066 DriverDoorSts 3;
BA_ "GenSigTimeoutTime_IPC" SG_ 1066 ExternalTemperature 0;
BA_ "GenSigTimeoutTime_GNMM" SG_ 1066 ExternalTemperature 0;
BA_ "GenSigTimeoutTime_ESL" SG_ 1066 ExternalTemperature 0;
BA_ "GenSigTimeoutTime_ECM" SG_ 1066 ExternalTemperature 0;
BA_ "GenSigTimeoutTime_DMSM" SG_ 1066 ExternalTemperature 0;
BA_ "GenSigTimeoutTime_BCM" SG_ 1066 ExternalTemperature 0;
BA_ "GenSigTimeoutTime_AGSM" SG_ 1066 ExternalTemperature 0;
BA_ "GenSigTimeoutTime_SGW" SG_ 1066 ESLLockFailSts_Indication 0;
BA_ "GenSigTimeoutTime_RFHM" SG_ 1066 ESLLockFailSts_Indication 0;
BA_ "GenSigTimeoutTime_MPAD" SG_ 1066 ESLLockFailSts_Indication 0;
BA_ "GenSigTimeoutTime_GNMM" SG_ 1066 ESLLockFailSts_Indication 0;
BA_ "GenSigTimeoutTime_EVCU2" SG_ 1066 ESLLockFailSts_Indication 0;
BA_ "GenSigTimeoutTime_ESL" SG_ 1066 ESLLockFailSts_Indication 0;
BA_ "GenSigTimeoutTime_ECM" SG_ 1066 ESLLockFailSts_Indication 0;
BA_ "GenSigTimeoutTime_DTCM" SG_ 1066 ESLLockFailSts_Indication 0;
BA_ "GenSigTimeoutTime_DMSM" SG_ 1066 ESLLockFailSts_Indication 0;
BA_ "GenSigTimeoutTime_BSM" SG_ 1066 ESLLockFailSts_Indication 0;
BA_ "GenSigTimeoutTime_BCM" SG_ 1066 ESLLockFailSts_Indication 0;
BA_ "GenSigTimeoutTime_AGSM" SG_ 1066 ESLLockFailSts_Indication 0;
BA_ "GenSigTimeoutTime_ADCAM" SG_ 1066 ESLLockFailSts_Indication 0;
BA_ "GenSigTimeoutTime_SGW" SG_ 1066 ESLUnlockFailSts_Indication 0;
BA_ "GenSigTimeoutTime_RFHM" SG_ 1066 ESLUnlockFailSts_Indication 0;
BA_ "GenSigTimeoutTime_MPAD" SG_ 1066 ESLUnlockFailSts_Indication 0;
BA_ "GenSigTimeoutTime_GNMM" SG_ 1066 ESLUnlockFailSts_Indication 0;
BA_ "GenSigTimeoutTime_EVCU2" SG_ 1066 ESLUnlockFailSts_Indication 0;
BA_ "GenSigTimeoutTime_ESL" SG_ 1066 ESLUnlockFailSts_Indication 0;
BA_ "GenSigTimeoutTime_ECM" SG_ 1066 ESLUnlockFailSts_Indication 0;
BA_ "GenSigTimeoutTime_DTCM" SG_ 1066 ESLUnlockFailSts_Indication 0;
BA_ "GenSigTimeoutTime_DMSM" SG_ 1066 ESLUnlockFailSts_Indication 0;
BA_ "GenSigTimeoutTime_BSM" SG_ 1066 ESLUnlockFailSts_Indication 0;
BA_ "GenSigTimeoutTime_BCM" SG_ 1066 ESLUnlockFailSts_Indication 0;
BA_ "GenSigTimeoutTime_AGSM" SG_ 1066 ESLUnlockFailSts_Indication 0;
BA_ "GenSigTimeoutTime_ADCAM" SG_ 1066 ESLUnlockFailSts_Indication 0;
BA_ "GenSigTimeoutTime_RFHM" SG_ 1066 FrontFogLightSts 0;
BA_ "GenSigTimeoutTime_MPAD" SG_ 1066 FrontFogLightSts 0;
BA_ "GenSigTimeoutTime_GNMM" SG_ 1066 FrontFogLightSts 0;
BA_ "GenSigTimeoutTime_EVCU2" SG_ 1066 FrontFogLightSts 0;
BA_ "GenSigTimeoutTime_ESL" SG_ 1066 FrontFogLightSts 0;
BA_ "GenSigTimeoutTime_ECM" SG_ 1066 FrontFogLightSts 0;
BA_ "GenSigTimeoutTime_DTCM" SG_ 1066 FrontFogLightSts 0;
BA_ "GenSigTimeoutTime_DMSM" SG_ 1066 FrontFogLightSts 0;
BA_ "GenSigTimeoutTime_BSM" SG_ 1066 FrontFogLightSts 0;
BA_ "GenSigTimeoutTime_BCM" SG_ 1066 FrontFogLightSts 0;
BA_ "GenSigTimeoutTime_AGSM" SG_ 1066 FrontFogLightSts 0;
BA_ "GenSigTimeoutTime_ADCAM" SG_ 1066 FrontFogLightSts 0;
BA_ "GenSigSendType" SG_ 1066 FrontFogLightSts 3;
BA_ "GenSigTimeoutTime_RFHM" SG_ 1066 BrakeFluidLevelSts 0;
BA_ "GenSigTimeoutTime_MPAD" SG_ 1066 BrakeFluidLevelSts 0;
BA_ "GenSigTimeoutTime_GNMM" SG_ 1066 BrakeFluidLevelSts 0;
BA_ "GenSigTimeoutTime_EVCU2" SG_ 1066 BrakeFluidLevelSts 0;
BA_ "GenSigTimeoutTime_ESL" SG_ 1066 BrakeFluidLevelSts 0;
BA_ "GenSigTimeoutTime_ECM" SG_ 1066 BrakeFluidLevelSts 0;
BA_ "GenSigTimeoutTime_DTCM" SG_ 1066 BrakeFluidLevelSts 0;
BA_ "GenSigTimeoutTime_DMSM" SG_ 1066 BrakeFluidLevelSts 0;
BA_ "GenSigTimeoutTime_BCM" SG_ 1066 BrakeFluidLevelSts 0;
BA_ "GenSigTimeoutTime_AGSM" SG_ 1066 BrakeFluidLevelSts 0;
BA_ "GenSigTimeoutTime_ADCAM" SG_ 1066 BrakeFluidLevelSts 0;
BA_ "GenSigTimeoutTime_SGW" SG_ 1066 CRC_BCM9 0;
BA_ "GenSigTimeoutTime_RFHM" SG_ 1066 CRC_BCM9 0;
BA_ "GenSigTimeoutTime_ESL" SG_ 1066 CRC_BCM9 0;
BA_ "GenSigTimeoutTime_ECM" SG_ 1066 CRC_BCM9 0;
BA_ "GenSigTimeoutTime_DTCM" SG_ 1066 CRC_BCM9 0;
BA_ "GenSigTimeoutTime_DMSM" SG_ 1066 CRC_BCM9 0;
BA_ "GenSigTimeoutTime_BCM" SG_ 1066 CRC_BCM9 0;
BA_ "GenSigTimeoutTime_AGSM" SG_ 1066 CRC_BCM9 0;
BA_ "GenSigTimeoutTime_MPAD" SG_ 1066 DoorLockLastElSts 0;
BA_ "GenSigTimeoutTime_IPC" SG_ 1066 DoorLockLastElSts 0;
BA_ "GenSigTimeoutTime_GNMM" SG_ 1066 DoorLockLastElSts 0;
BA_ "GenSigTimeoutTime_ESL" SG_ 1066 DoorLockLastElSts 0;
BA_ "GenSigTimeoutTime_ECM" SG_ 1066 DoorLockLastElSts 0;
BA_ "GenSigTimeoutTime_DTCM" SG_ 1066 DoorLockLastElSts 0;
BA_ "GenSigTimeoutTime_DMSM" SG_ 1066 DoorLockLastElSts 0;
BA_ "GenSigTimeoutTime_BSM" SG_ 1066 DoorLockLastElSts 0;
BA_ "GenSigTimeoutTime_BCM" SG_ 1066 DoorLockLastElSts 0;
BA_ "GenSigTimeoutTime_AGSM" SG_ 1066 DoorLockLastElSts 0;
BA_ "GenSigTimeoutTime_ADCAM" SG_ 1066 DoorLockLastElSts 0;
BA_ "GenSigTimeoutTime_RFHM" SG_ 1066 LHParkingLightSts 0;
BA_ "GenSigTimeoutTime_MPAD" SG_ 1066 LHParkingLightSts 0;
BA_ "GenSigTimeoutTime_GNMM" SG_ 1066 LHParkingLightSts 0;
BA_ "GenSigTimeoutTime_EVCU2" SG_ 1066 LHParkingLightSts 0;
BA_ "GenSigTimeoutTime_ESL" SG_ 1066 LHParkingLightSts 0;
BA_ "GenSigTimeoutTime_ECM" SG_ 1066 LHParkingLightSts 0;
BA_ "GenSigTimeoutTime_DTCM" SG_ 1066 LHParkingLightSts 0;
BA_ "GenSigTimeoutTime_DMSM" SG_ 1066 LHParkingLightSts 0;
BA_ "GenSigTimeoutTime_BSM" SG_ 1066 LHParkingLightSts 0;
BA_ "GenSigTimeoutTime_BCM" SG_ 1066 LHParkingLightSts 0;
BA_ "GenSigTimeoutTime_AGSM" SG_ 1066 LHParkingLightSts 0;
BA_ "GenSigTimeoutTime_ADCAM" SG_ 1066 LHParkingLightSts 0;
BA_ "GenSigSendType" SG_ 1066 LHParkingLightSts 3;
BA_ "GenSigTimeoutTime_RFHM" SG_ 1066 LHTurnSignalSts 0;
BA_ "GenSigTimeoutTime_IPC" SG_ 1066 LHTurnSignalSts 0;
BA_ "GenSigTimeoutTime_GNMM" SG_ 1066 LHTurnSignalSts 0;
BA_ "GenSigTimeoutTime_EVCU2" SG_ 1066 LHTurnSignalSts 0;
BA_ "GenSigTimeoutTime_ESL" SG_ 1066 LHTurnSignalSts 0;
BA_ "GenSigTimeoutTime_ECM" SG_ 1066 LHTurnSignalSts 0;
BA_ "GenSigTimeoutTime_DTCM" SG_ 1066 LHTurnSignalSts 0;
BA_ "GenSigTimeoutTime_DMSM" SG_ 1066 LHTurnSignalSts 0;
BA_ "GenSigTimeoutTime_BSM" SG_ 1066 LHTurnSignalSts 0;
BA_ "GenSigTimeoutTime_BCM" SG_ 1066 LHTurnSignalSts 0;
BA_ "GenSigTimeoutTime_AGSM" SG_ 1066 LHTurnSignalSts 0;
BA_ "GenSigTimeoutTime_ADCAM" SG_ 1066 LHTurnSignalSts 0;
BA_ "GenSigSendType" SG_ 1066 LHTurnSignalSts 3;
BA_ "GenSigTimeoutTime_AGSM" SG_ 1066 AHBFeature 0;
BA_ "GenSigTimeoutTime_ADCAM" SG_ 1066 AHBFeature 0;
BA_ "GenSigSendType" SG_ 1066 AHBFeature 3;
BA_ "GenSigTimeoutTime_RFHM" SG_ 1066 AHBFeature 0;
BA_ "GenSigTimeoutTime_MPAD" SG_ 1066 AHBFeature 0;
BA_ "GenSigTimeoutTime_GNMM" SG_ 1066 AHBFeature 0;
BA_ "GenSigTimeoutTime_EVCU2" SG_ 1066 AHBFeature 0;
BA_ "GenSigTimeoutTime_ESL" SG_ 1066 AHBFeature 0;
BA_ "GenSigTimeoutTime_ECM" SG_ 1066 AHBFeature 0;
BA_ "GenSigTimeoutTime_DTCM" SG_ 1066 AHBFeature 0;
BA_ "GenSigTimeoutTime_DMSM" SG_ 1066 AHBFeature 0;
BA_ "GenSigTimeoutTime_BSM" SG_ 1066 AHBFeature 0;
BA_ "GenSigTimeoutTime_BCM" SG_ 1066 AHBFeature 0;
BA_ "GenSigTimeoutTime_RFHM" SG_ 1066 BonnetSts 0;
BA_ "GenSigTimeoutTime_MPAD" SG_ 1066 BonnetSts 0;
BA_ "GenSigTimeoutTime_GNMM" SG_ 1066 BonnetSts 0;
BA_ "GenSigTimeoutTime_ESL" SG_ 1066 BonnetSts 0;
BA_ "GenSigTimeoutTime_ECM" SG_ 1066 BonnetSts 0;
BA_ "GenSigTimeoutTime_DTCM" SG_ 1066 BonnetSts 0;
BA_ "GenSigTimeoutTime_DMSM" SG_ 1066 BonnetSts 0;
BA_ "GenSigTimeoutTime_BCM" SG_ 1066 BonnetSts 0;
BA_ "GenSigTimeoutTime_AGSM" SG_ 1066 BonnetSts 0;
BA_ "GenSigTimeoutTime_ADCAM" SG_ 1066 BonnetSts 0;
BA_ "GenSigSendType" SG_ 1066 BonnetSts 3;
BA_ "GenSigTimeoutTime_RFHM" SG_ 1066 HighBeamSts 0;
BA_ "GenSigTimeoutTime_GNMM" SG_ 1066 HighBeamSts 0;
BA_ "GenSigTimeoutTime_EVCU2" SG_ 1066 HighBeamSts 0;
BA_ "GenSigTimeoutTime_ESL" SG_ 1066 HighBeamSts 0;
BA_ "GenSigTimeoutTime_ECM" SG_ 1066 HighBeamSts 0;
BA_ "GenSigTimeoutTime_DTCM" SG_ 1066 HighBeamSts 0;
BA_ "GenSigTimeoutTime_DMSM" SG_ 1066 HighBeamSts 0;
BA_ "GenSigTimeoutTime_BSM" SG_ 1066 HighBeamSts 0;
BA_ "GenSigTimeoutTime_BCM" SG_ 1066 HighBeamSts 0;
BA_ "GenSigTimeoutTime_AGSM" SG_ 1066 HighBeamSts 0;
BA_ "GenSigSendType" SG_ 1066 HighBeamSts 3;
BA_ "GenSigTimeoutTime_RFHM" SG_ 1066 FuelLevel 0;
BA_ "GenSigTimeoutTime_MPAD" SG_ 1066 FuelLevel 0;
BA_ "GenSigTimeoutTime_IPC" SG_ 1066 FuelLevel 0;
BA_ "GenSigTimeoutTime_GNMM" SG_ 1066 FuelLevel 0;
BA_ "GenSigTimeoutTime_EVCU2" SG_ 1066 FuelLevel 0;
BA_ "GenSigTimeoutTime_ESL" SG_ 1066 FuelLevel 0;
BA_ "GenSigTimeoutTime_DTCM" SG_ 1066 FuelLevel 0;
BA_ "GenSigTimeoutTime_DMSM" SG_ 1066 FuelLevel 0;
BA_ "GenSigTimeoutTime_BSM" SG_ 1066 FuelLevel 0;
BA_ "GenSigTimeoutTime_BCM" SG_ 1066 FuelLevel 0;
BA_ "GenSigTimeoutTime_AGSM" SG_ 1066 FuelLevel 0;
BA_ "GenSigTimeoutTime_ADCAM" SG_ 1066 FuelLevel 0;
BA_ "GenSigTimeoutTime_BCM" SG_ 1827 IgnitionOnCounter 0;
BA_ "GenSigTimeoutTime_SGW" SG_ 1827 CRC_BCM7 0;
BA_ "GenSigTimeoutTime_RFHM" SG_ 1827 CRC_BCM7 0;
BA_ "GenSigTimeoutTime_IPC" SG_ 1827 CRC_BCM7 0;
BA_ "GenSigTimeoutTime_GNMM" SG_ 1827 CRC_BCM7 0;
BA_ "GenSigTimeoutTime_EVCU2" SG_ 1827 CRC_BCM7 0;
BA_ "GenSigTimeoutTime_ESL" SG_ 1827 CRC_BCM7 0;
BA_ "GenSigTimeoutTime_ECM" SG_ 1827 CRC_BCM7 0;
BA_ "GenSigTimeoutTime_DTCM" SG_ 1827 CRC_BCM7 0;
BA_ "GenSigTimeoutTime_BCM" SG_ 1827 CRC_BCM7 0;
BA_ "GenSigTimeoutTime_AGSM" SG_ 1827 CRC_BCM7 0;
BA_ "GenSigTimeoutTime_SGW" SG_ 1827 MessageCounter_BCM7 0;
BA_ "GenSigTimeoutTime_RFHM" SG_ 1827 MessageCounter_BCM7 0;
BA_ "GenSigTimeoutTime_IPC" SG_ 1827 MessageCounter_BCM7 0;
BA_ "GenSigTimeoutTime_GNMM" SG_ 1827 MessageCounter_BCM7 0;
BA_ "GenSigTimeoutTime_EVCU2" SG_ 1827 MessageCounter_BCM7 0;
BA_ "GenSigTimeoutTime_ESL" SG_ 1827 MessageCounter_BCM7 0;
BA_ "GenSigTimeoutTime_ECM" SG_ 1827 MessageCounter_BCM7 0;
BA_ "GenSigTimeoutTime_DTCM" SG_ 1827 MessageCounter_BCM7 0;
BA_ "GenSigTimeoutTime_BCM" SG_ 1827 MessageCounter_BCM7 0;
BA_ "GenSigTimeoutTime_AGSM" SG_ 1827 MessageCounter_BCM7 0;
BA_ "GenSigTimeoutTime_GNMM" SG_ 1051 PitchAngle 0;
BA_ "GenSigTimeoutTime_EVCU2" SG_ 1051 PitchAngle 0;
BA_ "GenSigTimeoutTime_ESL" SG_ 1051 PitchAngle 0;
BA_ "GenSigTimeoutTime_ECM" SG_ 1051 PitchAngle 0;
BA_ "GenSigTimeoutTime_DTCM" SG_ 1051 PitchAngle 0;
BA_ "GenSigTimeoutTime_DMSM" SG_ 1051 PitchAngle 0;
BA_ "GenSigTimeoutTime_BSM" SG_ 1051 PitchAngle 0;
BA_ "GenSigTimeoutTime_BCM" SG_ 1051 PitchAngle 0;
BA_ "GenSigTimeoutTime_AGSM" SG_ 1051 PitchAngle 0;
BA_ "GenSigTimeoutTime_ADCAM" SG_ 1051 PitchAngle 0;
BA_ "GenSigTimeoutTime_RFHM" SG_ 1051 PitchAngle 0;
BA_ "GenSigTimeoutTime_MPAD" SG_ 1051 PitchAngle 0;
BA_ "GenSigTimeoutTime_RFHM" SG_ 1051 RollAngle 0;
BA_ "GenSigTimeoutTime_MPAD" SG_ 1051 RollAngle 0;
BA_ "GenSigTimeoutTime_GNMM" SG_ 1051 RollAngle 0;
BA_ "GenSigTimeoutTime_EVCU2" SG_ 1051 RollAngle 0;
BA_ "GenSigTimeoutTime_ESL" SG_ 1051 RollAngle 0;
BA_ "GenSigTimeoutTime_ECM" SG_ 1051 RollAngle 0;
BA_ "GenSigTimeoutTime_DTCM" SG_ 1051 RollAngle 0;
BA_ "GenSigTimeoutTime_DMSM" SG_ 1051 RollAngle 0;
BA_ "GenSigTimeoutTime_BSM" SG_ 1051 RollAngle 0;
BA_ "GenSigTimeoutTime_BCM" SG_ 1051 RollAngle 0;
BA_ "GenSigTimeoutTime_AGSM" SG_ 1051 RollAngle 0;
BA_ "GenSigTimeoutTime_ADCAM" SG_ 1051 RollAngle 0;
BA_ "GenSigTimeoutTime_SGW" SG_ 1375 ChkFuelLevelSts 0;
BA_ "GenSigTimeoutTime_RFHM" SG_ 1375 ChkFuelLevelSts 0;
BA_ "GenSigTimeoutTime_MPAD" SG_ 1375 ChkFuelLevelSts 0;
BA_ "GenSigTimeoutTime_GNMM" SG_ 1375 ChkFuelLevelSts 0;
BA_ "GenSigTimeoutTime_EVCU2" SG_ 1375 ChkFuelLevelSts 0;
BA_ "GenSigTimeoutTime_ESL" SG_ 1375 ChkFuelLevelSts 0;
BA_ "GenSigTimeoutTime_DTCM" SG_ 1375 ChkFuelLevelSts 0;
BA_ "GenSigTimeoutTime_DMSM" SG_ 1375 ChkFuelLevelSts 0;
BA_ "GenSigTimeoutTime_BSM" SG_ 1375 ChkFuelLevelSts 0;
BA_ "GenSigTimeoutTime_BCM" SG_ 1375 ChkFuelLevelSts 0;
BA_ "GenSigTimeoutTime_AGSM" SG_ 1375 ChkFuelLevelSts 0;
BA_ "GenSigTimeoutTime_ADCAM" SG_ 1375 ChkFuelLevelSts 0;
BA_ "GenSigTimeoutTime_RFHM" SG_ 1375 FrontWiperReq 0;
BA_ "GenSigTimeoutTime_IPC" SG_ 1375 FrontWiperReq 0;
BA_ "GenSigTimeoutTime_GNMM" SG_ 1375 FrontWiperReq 0;
BA_ "GenSigTimeoutTime_ESL" SG_ 1375 FrontWiperReq 0;
BA_ "GenSigTimeoutTime_ECM" SG_ 1375 FrontWiperReq 0;
BA_ "GenSigTimeoutTime_DMSM" SG_ 1375 FrontWiperReq 0;
BA_ "GenSigTimeoutTime_BCM" SG_ 1375 FrontWiperReq 0;
BA_ "GenSigTimeoutTime_AGSM" SG_ 1375 FrontWiperReq 0;
BA_ "GenSigTimeoutTime_SGW" SG_ 1051 ExternalTemperatureAD_Voltage 0;
BA_ "GenSigTimeoutTime_RFHM" SG_ 1051 ExternalTemperatureAD_Voltage 0;
BA_ "GenSigTimeoutTime_MPAD" SG_ 1051 ExternalTemperatureAD_Voltage 0;
BA_ "GenSigTimeoutTime_IPC" SG_ 1051 ExternalTemperatureAD_Voltage 0;
BA_ "GenSigTimeoutTime_GNMM" SG_ 1051 ExternalTemperatureAD_Voltage 0;
BA_ "GenSigTimeoutTime_ESL" SG_ 1051 ExternalTemperatureAD_Voltage 0;
BA_ "GenSigTimeoutTime_DTCM" SG_ 1051 ExternalTemperatureAD_Voltage 0;
BA_ "GenSigTimeoutTime_DMSM" SG_ 1051 ExternalTemperatureAD_Voltage 0;
BA_ "GenSigTimeoutTime_BSM" SG_ 1051 ExternalTemperatureAD_Voltage 0;
BA_ "GenSigTimeoutTime_BCM" SG_ 1051 ExternalTemperatureAD_Voltage 0;
BA_ "GenSigTimeoutTime_AGSM" SG_ 1051 ExternalTemperatureAD_Voltage 0;
BA_ "GenSigTimeoutTime_ADCAM" SG_ 1051 ExternalTemperatureAD_Voltage 0;
BA_ "GenSigStartValue" SG_ 1051 ExternalTemperatureAD_Voltage 255;
BA_ "GenSigTimeoutTime_SGW" SG_ 1051 FUEL_VOLT 0;
BA_ "GenSigTimeoutTime_RFHM" SG_ 1051 FUEL_VOLT 0;
BA_ "GenSigTimeoutTime_MPAD" SG_ 1051 FUEL_VOLT 0;
BA_ "GenSigTimeoutTime_IPC" SG_ 1051 FUEL_VOLT 0;
BA_ "GenSigTimeoutTime_GNMM" SG_ 1051 FUEL_VOLT 0;
BA_ "GenSigTimeoutTime_EVCU2" SG_ 1051 FUEL_VOLT 0;
BA_ "GenSigTimeoutTime_ESL" SG_ 1051 FUEL_VOLT 0;
BA_ "GenSigTimeoutTime_DTCM" SG_ 1051 FUEL_VOLT 0;
BA_ "GenSigTimeoutTime_DMSM" SG_ 1051 FUEL_VOLT 0;
BA_ "GenSigTimeoutTime_BSM" SG_ 1051 FUEL_VOLT 0;
BA_ "GenSigTimeoutTime_BCM" SG_ 1051 FUEL_VOLT 0;
BA_ "GenSigTimeoutTime_AGSM" SG_ 1051 FUEL_VOLT 0;
BA_ "GenSigTimeoutTime_ADCAM" SG_ 1051 FUEL_VOLT 0;
BA_ "GenSigStartValue" SG_ 1051 FUEL_VOLT 255;
BA_ "GenSigTimeoutTime_SGW" SG_ 1051 FUEL_VOLT2 0;
BA_ "GenSigTimeoutTime_RFHM" SG_ 1051 FUEL_VOLT2 0;
BA_ "GenSigTimeoutTime_MPAD" SG_ 1051 FUEL_VOLT2 0;
BA_ "GenSigTimeoutTime_IPC" SG_ 1051 FUEL_VOLT2 0;
BA_ "GenSigTimeoutTime_GNMM" SG_ 1051 FUEL_VOLT2 0;
BA_ "GenSigTimeoutTime_EVCU2" SG_ 1051 FUEL_VOLT2 0;
BA_ "GenSigTimeoutTime_ESL" SG_ 1051 FUEL_VOLT2 0;
BA_ "GenSigTimeoutTime_DTCM" SG_ 1051 FUEL_VOLT2 0;
BA_ "GenSigTimeoutTime_DMSM" SG_ 1051 FUEL_VOLT2 0;
BA_ "GenSigTimeoutTime_BSM" SG_ 1051 FUEL_VOLT2 0;
BA_ "GenSigTimeoutTime_BCM" SG_ 1051 FUEL_VOLT2 0;
BA_ "GenSigTimeoutTime_AGSM" SG_ 1051 FUEL_VOLT2 0;
BA_ "GenSigTimeoutTime_ADCAM" SG_ 1051 FUEL_VOLT2 0;
BA_ "GenSigStartValue" SG_ 1051 FUEL_VOLT2 255;
BA_ "GenSigTimeoutTime_SGW" SG_ 1051 AM_ECM_Trace 0;
BA_ "GenSigTimeoutTime_RFHM" SG_ 1051 AM_ECM_Trace 0;
BA_ "GenSigTimeoutTime_MPAD" SG_ 1051 AM_ECM_Trace 0;
BA_ "GenSigTimeoutTime_IPC" SG_ 1051 AM_ECM_Trace 0;
BA_ "GenSigTimeoutTime_GNMM" SG_ 1051 AM_ECM_Trace 0;
BA_ "GenSigTimeoutTime_EVCU2" SG_ 1051 AM_ECM_Trace 0;
BA_ "GenSigTimeoutTime_ESL" SG_ 1051 AM_ECM_Trace 0;
BA_ "GenSigTimeoutTime_DTCM" SG_ 1051 AM_ECM_Trace 0;
BA_ "GenSigTimeoutTime_DMSM" SG_ 1051 AM_ECM_Trace 0;
BA_ "GenSigTimeoutTime_BSM" SG_ 1051 AM_ECM_Trace 0;
BA_ "GenSigTimeoutTime_BCM" SG_ 1051 AM_ECM_Trace 0;
BA_ "GenSigTimeoutTime_AGSM" SG_ 1051 AM_ECM_Trace 0;
BA_ "GenSigTimeoutTime_ADCAM" SG_ 1051 AM_ECM_Trace 0;
BA_ "GenSigTimeoutTime_SGW" SG_ 1051 EVAP_TEMP_P1C 0;
BA_ "GenSigTimeoutTime_RFHM" SG_ 1051 EVAP_TEMP_P1C 0;
BA_ "GenSigTimeoutTime_MPAD" SG_ 1051 EVAP_TEMP_P1C 0;
BA_ "GenSigTimeoutTime_IPC" SG_ 1051 EVAP_TEMP_P1C 0;
BA_ "GenSigTimeoutTime_GNMM" SG_ 1051 EVAP_TEMP_P1C 0;
BA_ "GenSigTimeoutTime_ESL" SG_ 1051 EVAP_TEMP_P1C 0;
BA_ "GenSigTimeoutTime_ECM" SG_ 1051 EVAP_TEMP_P1C 0;
BA_ "GenSigTimeoutTime_DTCM" SG_ 1051 EVAP_TEMP_P1C 0;
BA_ "GenSigTimeoutTime_DMSM" SG_ 1051 EVAP_TEMP_P1C 0;
BA_ "GenSigTimeoutTime_BSM" SG_ 1051 EVAP_TEMP_P1C 0;
BA_ "GenSigTimeoutTime_BCM" SG_ 1051 EVAP_TEMP_P1C 0;
BA_ "GenSigTimeoutTime_AGSM" SG_ 1051 EVAP_TEMP_P1C 0;
BA_ "GenSigTimeoutTime_ADCAM" SG_ 1051 EVAP_TEMP_P1C 0;
BA_ "GenSigSendType" SG_ 1051 EVAP_TEMP_P1C 3;
BA_ "GenSigTimeoutTime_SGW" SG_ 1051 CRC_BCM4 0;
BA_ "GenSigTimeoutTime_RFHM" SG_ 1051 CRC_BCM4 0;
BA_ "GenSigTimeoutTime_MPAD" SG_ 1051 CRC_BCM4 0;
BA_ "GenSigTimeoutTime_IPC" SG_ 1051 CRC_BCM4 0;
BA_ "GenSigTimeoutTime_GNMM" SG_ 1051 CRC_BCM4 0;
BA_ "GenSigTimeoutTime_ESL" SG_ 1051 CRC_BCM4 0;
BA_ "GenSigTimeoutTime_ECM" SG_ 1051 CRC_BCM4 0;
BA_ "GenSigTimeoutTime_DTCM" SG_ 1051 CRC_BCM4 0;
BA_ "GenSigTimeoutTime_DMSM" SG_ 1051 CRC_BCM4 0;
BA_ "GenSigTimeoutTime_BSM" SG_ 1051 CRC_BCM4 0;
BA_ "GenSigTimeoutTime_BCM" SG_ 1051 CRC_BCM4 0;
BA_ "GenSigTimeoutTime_AGSM" SG_ 1051 CRC_BCM4 0;
BA_ "GenSigTimeoutTime_ADCAM" SG_ 1051 CRC_BCM4 0;
BA_ "GenSigTimeoutTime_SGW" SG_ 1051 FL_VS_STATFailSts 0;
BA_ "GenSigTimeoutTime_RFHM" SG_ 1051 FL_VS_STATFailSts 0;
BA_ "GenSigTimeoutTime_MPAD" SG_ 1051 FL_VS_STATFailSts 0;
BA_ "GenSigTimeoutTime_IPC" SG_ 1051 FL_VS_STATFailSts 0;
BA_ "GenSigTimeoutTime_GNMM" SG_ 1051 FL_VS_STATFailSts 0;
BA_ "GenSigTimeoutTime_ESL" SG_ 1051 FL_VS_STATFailSts 0;
BA_ "GenSigTimeoutTime_ECM" SG_ 1051 FL_VS_STATFailSts 0;
BA_ "GenSigTimeoutTime_DTCM" SG_ 1051 FL_VS_STATFailSts 0;
BA_ "GenSigTimeoutTime_DMSM" SG_ 1051 FL_VS_STATFailSts 0;
BA_ "GenSigTimeoutTime_BSM" SG_ 1051 FL_VS_STATFailSts 0;
BA_ "GenSigTimeoutTime_BCM" SG_ 1051 FL_VS_STATFailSts 0;
BA_ "GenSigTimeoutTime_AGSM" SG_ 1051 FL_VS_STATFailSts 0;
BA_ "GenSigTimeoutTime_ADCAM" SG_ 1051 FL_VS_STATFailSts 0;
BA_ "GenSigTimeoutTime_SGW" SG_ 1051 FL_VS_STATSts 0;
BA_ "GenSigTimeoutTime_RFHM" SG_ 1051 FL_VS_STATSts 0;
BA_ "GenSigTimeoutTime_MPAD" SG_ 1051 FL_VS_STATSts 0;
BA_ "GenSigTimeoutTime_IPC" SG_ 1051 FL_VS_STATSts 0;
BA_ "GenSigTimeoutTime_GNMM" SG_ 1051 FL_VS_STATSts 0;
BA_ "GenSigTimeoutTime_ESL" SG_ 1051 FL_VS_STATSts 0;
BA_ "GenSigTimeoutTime_ECM" SG_ 1051 FL_VS_STATSts 0;
BA_ "GenSigTimeoutTime_DTCM" SG_ 1051 FL_VS_STATSts 0;
BA_ "GenSigTimeoutTime_DMSM" SG_ 1051 FL_VS_STATSts 0;
BA_ "GenSigTimeoutTime_BSM" SG_ 1051 FL_VS_STATSts 0;
BA_ "GenSigTimeoutTime_BCM" SG_ 1051 FL_VS_STATSts 0;
BA_ "GenSigTimeoutTime_AGSM" SG_ 1051 FL_VS_STATSts 0;
BA_ "GenSigTimeoutTime_ADCAM" SG_ 1051 FL_VS_STATSts 0;
BA_ "GenSigTimeoutTime_AGSM" SG_ 1051 HSW_StatFailSts 0;
BA_ "GenSigTimeoutTime_ADCAM" SG_ 1051 HSW_StatFailSts 0;
BA_ "GenSigTimeoutTime_SGW" SG_ 1051 FR_VS_STATFailSts 0;
BA_ "GenSigTimeoutTime_RFHM" SG_ 1051 FR_VS_STATFailSts 0;
BA_ "GenSigTimeoutTime_MPAD" SG_ 1051 FR_VS_STATFailSts 0;
BA_ "GenSigTimeoutTime_IPC" SG_ 1051 FR_VS_STATFailSts 0;
BA_ "GenSigTimeoutTime_GNMM" SG_ 1051 FR_VS_STATFailSts 0;
BA_ "GenSigTimeoutTime_ESL" SG_ 1051 FR_VS_STATFailSts 0;
BA_ "GenSigTimeoutTime_ECM" SG_ 1051 FR_VS_STATFailSts 0;
BA_ "GenSigTimeoutTime_DTCM" SG_ 1051 FR_VS_STATFailSts 0;
BA_ "GenSigTimeoutTime_DMSM" SG_ 1051 FR_VS_STATFailSts 0;
BA_ "GenSigTimeoutTime_BSM" SG_ 1051 FR_VS_STATFailSts 0;
BA_ "GenSigTimeoutTime_BCM" SG_ 1051 FR_VS_STATFailSts 0;
BA_ "GenSigTimeoutTime_AGSM" SG_ 1051 FR_VS_STATFailSts 0;
BA_ "GenSigTimeoutTime_ADCAM" SG_ 1051 FR_VS_STATFailSts 0;
BA_ "GenSigTimeoutTime_SGW" SG_ 1051 FR_VS_STATSts 0;
BA_ "GenSigTimeoutTime_RFHM" SG_ 1051 FR_VS_STATSts 0;
BA_ "GenSigTimeoutTime_MPAD" SG_ 1051 FR_VS_STATSts 0;
BA_ "GenSigTimeoutTime_IPC" SG_ 1051 FR_VS_STATSts 0;
BA_ "GenSigTimeoutTime_GNMM" SG_ 1051 FR_VS_STATSts 0;
BA_ "GenSigTimeoutTime_ESL" SG_ 1051 FR_VS_STATSts 0;
BA_ "GenSigTimeoutTime_ECM" SG_ 1051 FR_VS_STATSts 0;
BA_ "GenSigTimeoutTime_DTCM" SG_ 1051 FR_VS_STATSts 0;
BA_ "GenSigTimeoutTime_DMSM" SG_ 1051 FR_VS_STATSts 0;
BA_ "GenSigTimeoutTime_BSM" SG_ 1051 FR_VS_STATSts 0;
BA_ "GenSigTimeoutTime_BCM" SG_ 1051 FR_VS_STATSts 0;
BA_ "GenSigTimeoutTime_AGSM" SG_ 1051 FR_VS_STATSts 0;
BA_ "GenSigTimeoutTime_ADCAM" SG_ 1051 FR_VS_STATSts 0;
BA_ "GenSigTimeoutTime_SGW" SG_ 951 UConnReqFOBNum_TBM 0;
BA_ "GenSigTimeoutTime_MPAD" SG_ 951 UConnReqFOBNum_TBM 0;
BA_ "GenSigTimeoutTime_IPC" SG_ 951 UConnReqFOBNum_TBM 0;
BA_ "GenSigTimeoutTime_GNMM" SG_ 951 UConnReqFOBNum_TBM 0;
BA_ "GenSigTimeoutTime_EVCU2" SG_ 951 UConnReqFOBNum_TBM 0;
BA_ "GenSigTimeoutTime_ESL" SG_ 951 UConnReqFOBNum_TBM 0;
BA_ "GenSigTimeoutTime_ECM" SG_ 951 UConnReqFOBNum_TBM 0;
BA_ "GenSigTimeoutTime_DTCM" SG_ 951 UConnReqFOBNum_TBM 0;
BA_ "GenSigTimeoutTime_DMSM" SG_ 951 UConnReqFOBNum_TBM 0;
BA_ "GenSigTimeoutTime_BSM" SG_ 951 UConnReqFOBNum_TBM 0;
BA_ "GenSigTimeoutTime_BCM" SG_ 951 UConnReqFOBNum_TBM 0;
BA_ "GenSigTimeoutTime_AGSM" SG_ 951 UConnReqFOBNum_TBM 0;
BA_ "GenSigTimeoutTime_ADCAM" SG_ 951 UConnReqFOBNum_TBM 0;
BA_ "GenSigTimeoutTime_SGW" SG_ 951 UConnReqAuthCode_TBM 0;
BA_ "GenSigTimeoutTime_MPAD" SG_ 951 UConnReqAuthCode_TBM 0;
BA_ "GenSigTimeoutTime_IPC" SG_ 951 UConnReqAuthCode_TBM 0;
BA_ "GenSigTimeoutTime_GNMM" SG_ 951 UConnReqAuthCode_TBM 0;
BA_ "GenSigTimeoutTime_EVCU2" SG_ 951 UConnReqAuthCode_TBM 0;
BA_ "GenSigTimeoutTime_ESL" SG_ 951 UConnReqAuthCode_TBM 0;
BA_ "GenSigTimeoutTime_ECM" SG_ 951 UConnReqAuthCode_TBM 0;
BA_ "GenSigTimeoutTime_DTCM" SG_ 951 UConnReqAuthCode_TBM 0;
BA_ "GenSigTimeoutTime_DMSM" SG_ 951 UConnReqAuthCode_TBM 0;
BA_ "GenSigTimeoutTime_BSM" SG_ 951 UConnReqAuthCode_TBM 0;
BA_ "GenSigTimeoutTime_BCM" SG_ 951 UConnReqAuthCode_TBM 0;
BA_ "GenSigTimeoutTime_AGSM" SG_ 951 UConnReqAuthCode_TBM 0;
BA_ "GenSigTimeoutTime_ADCAM" SG_ 951 UConnReqAuthCode_TBM 0;
BA_ "GenSigTimeoutTime_SGW" SG_ 951 UConnReq_TBM 0;
BA_ "GenSigTimeoutTime_MPAD" SG_ 951 UConnReq_TBM 0;
BA_ "GenSigTimeoutTime_IPC" SG_ 951 UConnReq_TBM 0;
BA_ "GenSigTimeoutTime_GNMM" SG_ 951 UConnReq_TBM 0;
BA_ "GenSigTimeoutTime_EVCU2" SG_ 951 UConnReq_TBM 0;
BA_ "GenSigTimeoutTime_ESL" SG_ 951 UConnReq_TBM 0;
BA_ "GenSigTimeoutTime_ECM" SG_ 951 UConnReq_TBM 0;
BA_ "GenSigTimeoutTime_DTCM" SG_ 951 UConnReq_TBM 0;
BA_ "GenSigTimeoutTime_DMSM" SG_ 951 UConnReq_TBM 0;
BA_ "GenSigTimeoutTime_BSM" SG_ 951 UConnReq_TBM 0;
BA_ "GenSigTimeoutTime_BCM" SG_ 951 UConnReq_TBM 0;
BA_ "GenSigTimeoutTime_AGSM" SG_ 951 UConnReq_TBM 0;
BA_ "GenSigTimeoutTime_ADCAM" SG_ 951 UConnReq_TBM 0;
BA_ "GenSigSendType" SG_ 951 UConnReq_TBM 6;
BA_ "GenSigTimeoutTime_RFHM" SG_ 513 SelectSpdSts 0;
BA_ "GenSigTimeoutTime_GNMM" SG_ 513 SelectSpdSts 0;
BA_ "GenSigTimeoutTime_ESL" SG_ 513 SelectSpdSts 0;
BA_ "GenSigTimeoutTime_ECM" SG_ 513 SelectSpdSts 0;
BA_ "GenSigTimeoutTime_DMSM" SG_ 513 SelectSpdSts 0;
BA_ "GenSigTimeoutTime_BSM" SG_ 513 SelectSpdSts 0;
BA_ "GenSigTimeoutTime_AGSM" SG_ 513 SelectSpdSts 0;
BA_ "GenSigTimeoutTime_ADCAM" SG_ 513 SelectSpdSts 0;
BA_ "GenSigTimeoutTime_RFHM" SG_ 513 SelSpdLmp 0;
BA_ "GenSigTimeoutTime_GNMM" SG_ 513 SelSpdLmp 0;
BA_ "GenSigTimeoutTime_EVCU2" SG_ 513 SelSpdLmp 0;
BA_ "GenSigTimeoutTime_ESL" SG_ 513 SelSpdLmp 0;
BA_ "GenSigTimeoutTime_ECM" SG_ 513 SelSpdLmp 0;
BA_ "GenSigTimeoutTime_DTCM" SG_ 513 SelSpdLmp 0;
BA_ "GenSigTimeoutTime_DMSM" SG_ 513 SelSpdLmp 0;
BA_ "GenSigTimeoutTime_BSM" SG_ 513 SelSpdLmp 0;
BA_ "GenSigTimeoutTime_AGSM" SG_ 513 SelSpdLmp 0;
BA_ "GenSigTimeoutTime_ADCAM" SG_ 513 SelSpdLmp 0;
BA_ "GenSigTimeoutTime_SGW" SG_ 513 CRC_BRAKE1 0;
BA_ "GenSigTimeoutTime_RFHM" SG_ 513 CRC_BRAKE1 0;
BA_ "GenSigTimeoutTime_GNMM" SG_ 513 CRC_BRAKE1 0;
BA_ "GenSigTimeoutTime_ESL" SG_ 513 CRC_BRAKE1 0;
BA_ "GenSigTimeoutTime_ECM" SG_ 513 CRC_BRAKE1 0;
BA_ "GenSigTimeoutTime_DTCM" SG_ 513 CRC_BRAKE1 0;
BA_ "GenSigTimeoutTime_DMSM" SG_ 513 CRC_BRAKE1 0;
BA_ "GenSigTimeoutTime_BSM" SG_ 513 CRC_BRAKE1 0;
BA_ "GenSigTimeoutTime_AGSM" SG_ 513 CRC_BRAKE1 0;
BA_ "GenSigTimeoutTime_SGW" SG_ 513 Ft_RrAxleCoupling_TrqRq 0;
BA_ "GenSigTimeoutTime_RFHM" SG_ 513 Ft_RrAxleCoupling_TrqRq 0;
BA_ "GenSigTimeoutTime_IPC" SG_ 513 Ft_RrAxleCoupling_TrqRq 0;
BA_ "GenSigTimeoutTime_GNMM" SG_ 513 Ft_RrAxleCoupling_TrqRq 0;
BA_ "GenSigTimeoutTime_EVCU2" SG_ 513 Ft_RrAxleCoupling_TrqRq 0;
BA_ "GenSigTimeoutTime_ESL" SG_ 513 Ft_RrAxleCoupling_TrqRq 0;
BA_ "GenSigTimeoutTime_ECM" SG_ 513 Ft_RrAxleCoupling_TrqRq 0;
BA_ "GenSigTimeoutTime_DMSM" SG_ 513 Ft_RrAxleCoupling_TrqRq 0;
BA_ "GenSigTimeoutTime_BSM" SG_ 513 Ft_RrAxleCoupling_TrqRq 0;
BA_ "GenSigTimeoutTime_AGSM" SG_ 513 Ft_RrAxleCoupling_TrqRq 0;
BA_ "GenSigTimeoutTime_ADCAM" SG_ 513 Ft_RrAxleCoupling_TrqRq 0;
BA_ "GenSigStartValue" SG_ 513 Ft_RrAxleCoupling_TrqRq 254;
BA_ "GenSigTimeoutTime_SGW" SG_ 513 MessageCounter_BRAKE1 0;
BA_ "GenSigTimeoutTime_RFHM" SG_ 513 MessageCounter_BRAKE1 0;
BA_ "GenSigTimeoutTime_GNMM" SG_ 513 MessageCounter_BRAKE1 0;
BA_ "GenSigTimeoutTime_ESL" SG_ 513 MessageCounter_BRAKE1 0;
BA_ "GenSigTimeoutTime_ECM" SG_ 513 MessageCounter_BRAKE1 0;
BA_ "GenSigTimeoutTime_DTCM" SG_ 513 MessageCounter_BRAKE1 0;
BA_ "GenSigTimeoutTime_DMSM" SG_ 513 MessageCounter_BRAKE1 0;
BA_ "GenSigTimeoutTime_BSM" SG_ 513 MessageCounter_BRAKE1 0;
BA_ "GenSigTimeoutTime_AGSM" SG_ 513 MessageCounter_BRAKE1 0;
BA_ "GenSigTimeoutTime_SGW" SG_ 513 REF_VEH_SPEED 0;
BA_ "GenSigTimeoutTime_RFHM" SG_ 513 REF_VEH_SPEED 0;
BA_ "GenSigTimeoutTime_GNMM" SG_ 513 REF_VEH_SPEED 0;
BA_ "GenSigTimeoutTime_ESL" SG_ 513 REF_VEH_SPEED 0;
BA_ "GenSigTimeoutTime_ECM" SG_ 513 REF_VEH_SPEED 0;
BA_ "GenSigTimeoutTime_DMSM" SG_ 513 REF_VEH_SPEED 0;
BA_ "GenSigTimeoutTime_BSM" SG_ 513 REF_VEH_SPEED 0;
BA_ "GenSigTimeoutTime_AGSM" SG_ 513 REF_VEH_SPEED 0;
BA_ "GenSigTimeoutTime_ADCAM" SG_ 513 REF_VEH_SPEED 0;
BA_ "GenSigStartValue" SG_ 513 REF_VEH_SPEED 1023;
BA_ "GenSigTimeoutTime_RFHM" SG_ 513 Brk_Thermdl 0;
BA_ "GenSigTimeoutTime_IPC" SG_ 513 Brk_Thermdl 0;
BA_ "GenSigTimeoutTime_GNMM" SG_ 513 Brk_Thermdl 0;
BA_ "GenSigTimeoutTime_ESL" SG_ 513 Brk_Thermdl 0;
BA_ "GenSigTimeoutTime_ECM" SG_ 513 Brk_Thermdl 0;
BA_ "GenSigTimeoutTime_DTCM" SG_ 513 Brk_Thermdl 0;
BA_ "GenSigTimeoutTime_DMSM" SG_ 513 Brk_Thermdl 0;
BA_ "GenSigTimeoutTime_BSM" SG_ 513 Brk_Thermdl 0;
BA_ "GenSigTimeoutTime_AGSM" SG_ 513 Brk_Thermdl 0;
BA_ "GenSigTimeoutTime_ADCAM" SG_ 513 Brk_Thermdl 0;
BA_ "GenSigTimeoutTime_RFHM" SG_ 513 BrkTrq 0;
BA_ "GenSigTimeoutTime_IPC" SG_ 513 BrkTrq 0;
BA_ "GenSigTimeoutTime_GNMM" SG_ 513 BrkTrq 0;
BA_ "GenSigTimeoutTime_ESL" SG_ 513 BrkTrq 0;
BA_ "GenSigTimeoutTime_DMSM" SG_ 513 BrkTrq 0;
BA_ "GenSigTimeoutTime_BSM" SG_ 513 BrkTrq 0;
BA_ "GenSigTimeoutTime_AGSM" SG_ 513 BrkTrq 0;
BA_ "GenSigTimeoutTime_ADCAM" SG_ 513 BrkTrq 0;
BA_ "GenSigStartValue" SG_ 513 BrkTrq 32767;
BA_ "GenSigTimeoutTime_SGW" SG_ 513 BrkTrq_Driver 0;
BA_ "GenSigTimeoutTime_RFHM" SG_ 513 BrkTrq_Driver 0;
BA_ "GenSigTimeoutTime_IPC" SG_ 513 BrkTrq_Driver 0;
BA_ "GenSigTimeoutTime_GNMM" SG_ 513 BrkTrq_Driver 0;
BA_ "GenSigTimeoutTime_ESL" SG_ 513 BrkTrq_Driver 0;
BA_ "GenSigTimeoutTime_DMSM" SG_ 513 BrkTrq_Driver 0;
BA_ "GenSigTimeoutTime_BSM" SG_ 513 BrkTrq_Driver 0;
BA_ "GenSigTimeoutTime_AGSM" SG_ 513 BrkTrq_Driver 0;
BA_ "GenSigTimeoutTime_ADCAM" SG_ 513 BrkTrq_Driver 0;
BA_ "GenSigStartValue" SG_ 513 BrkTrq_Driver 32767;
BA_ "GenSigTimeoutTime_SGW" SG_ 513 ExternalBrkRequestsDisabled 0;
BA_ "GenSigTimeoutTime_RFHM" SG_ 513 ExternalBrkRequestsDisabled 0;
BA_ "GenSigTimeoutTime_IPC" SG_ 513 ExternalBrkRequestsDisabled 0;
BA_ "GenSigTimeoutTime_GNMM" SG_ 513 ExternalBrkRequestsDisabled 0;
BA_ "GenSigTimeoutTime_ESL" SG_ 513 ExternalBrkRequestsDisabled 0;
BA_ "GenSigTimeoutTime_ECM" SG_ 513 ExternalBrkRequestsDisabled 0;
BA_ "GenSigTimeoutTime_DTCM" SG_ 513 ExternalBrkRequestsDisabled 0;
BA_ "GenSigTimeoutTime_DMSM" SG_ 513 ExternalBrkRequestsDisabled 0;
BA_ "GenSigTimeoutTime_BSM" SG_ 513 ExternalBrkRequestsDisabled 0;
BA_ "GenSigTimeoutTime_AGSM" SG_ 513 ExternalBrkRequestsDisabled 0;
BA_ "GenSigTimeoutTime_SGW" SG_ 513 ShftChrDsp_Rq_ESC 0;
BA_ "GenSigTimeoutTime_RFHM" SG_ 513 ShftChrDsp_Rq_ESC 0;
BA_ "GenSigTimeoutTime_IPC" SG_ 513 ShftChrDsp_Rq_ESC 0;
BA_ "GenSigTimeoutTime_GNMM" SG_ 513 ShftChrDsp_Rq_ESC 0;
BA_ "GenSigTimeoutTime_EVCU2" SG_ 513 ShftChrDsp_Rq_ESC 0;
BA_ "GenSigTimeoutTime_ESL" SG_ 513 ShftChrDsp_Rq_ESC 0;
BA_ "GenSigTimeoutTime_ECM" SG_ 513 ShftChrDsp_Rq_ESC 0;
BA_ "GenSigTimeoutTime_DTCM" SG_ 513 ShftChrDsp_Rq_ESC 0;
BA_ "GenSigTimeoutTime_DMSM" SG_ 513 ShftChrDsp_Rq_ESC 0;
BA_ "GenSigTimeoutTime_BSM" SG_ 513 ShftChrDsp_Rq_ESC 0;
BA_ "GenSigTimeoutTime_AGSM" SG_ 513 ShftChrDsp_Rq_ESC 0;
BA_ "GenSigTimeoutTime_ADCAM" SG_ 513 ShftChrDsp_Rq_ESC 0;
BA_ "GenSigTimeoutTime_SGW" SG_ 513 Ft_RrTrqCoupling_ModeRq 0;
BA_ "GenSigTimeoutTime_RFHM" SG_ 513 Ft_RrTrqCoupling_ModeRq 0;
BA_ "GenSigTimeoutTime_IPC" SG_ 513 Ft_RrTrqCoupling_ModeRq 0;
BA_ "GenSigTimeoutTime_GNMM" SG_ 513 Ft_RrTrqCoupling_ModeRq 0;
BA_ "GenSigTimeoutTime_EVCU2" SG_ 513 Ft_RrTrqCoupling_ModeRq 0;
BA_ "GenSigTimeoutTime_ESL" SG_ 513 Ft_RrTrqCoupling_ModeRq 0;
BA_ "GenSigTimeoutTime_ECM" SG_ 513 Ft_RrTrqCoupling_ModeRq 0;
BA_ "GenSigTimeoutTime_DMSM" SG_ 513 Ft_RrTrqCoupling_ModeRq 0;
BA_ "GenSigTimeoutTime_BSM" SG_ 513 Ft_RrTrqCoupling_ModeRq 0;
BA_ "GenSigTimeoutTime_AGSM" SG_ 513 Ft_RrTrqCoupling_ModeRq 0;
BA_ "GenSigTimeoutTime_ADCAM" SG_ 513 Ft_RrTrqCoupling_ModeRq 0;
BA_ "GenSigTimeoutTime_SGW" SG_ 513 VehicleStandStillSts 0;
BA_ "GenSigTimeoutTime_RFHM" SG_ 513 VehicleStandStillSts 0;
BA_ "GenSigTimeoutTime_GNMM" SG_ 513 VehicleStandStillSts 0;
BA_ "GenSigTimeoutTime_ESL" SG_ 513 VehicleStandStillSts 0;
BA_ "GenSigTimeoutTime_ECM" SG_ 513 VehicleStandStillSts 0;
BA_ "GenSigTimeoutTime_DTCM" SG_ 513 VehicleStandStillSts 0;
BA_ "GenSigTimeoutTime_DMSM" SG_ 513 VehicleStandStillSts 0;
BA_ "GenSigTimeoutTime_BSM" SG_ 513 VehicleStandStillSts 0;
BA_ "GenSigTimeoutTime_AGSM" SG_ 513 VehicleStandStillSts 0;
BA_ "GenSigTimeoutTime_ADCAM" SG_ 513 VehicleStandStillSts 0;
BA_ "GenSigStartValue" SG_ 513 VehicleStandStillSts 1;
BA_ "GenSigTimeoutTime_RFHM" SG_ 1066 StopLightFault 0;
BA_ "GenSigTimeoutTime_IPC" SG_ 1066 StopLightFault 0;
BA_ "GenSigTimeoutTime_GNMM" SG_ 1066 StopLightFault 0;
BA_ "GenSigTimeoutTime_EVCU2" SG_ 1066 StopLightFault 0;
BA_ "GenSigTimeoutTime_ESL" SG_ 1066 StopLightFault 0;
BA_ "GenSigTimeoutTime_ECM" SG_ 1066 StopLightFault 0;
BA_ "GenSigTimeoutTime_DTCM" SG_ 1066 StopLightFault 0;
BA_ "GenSigTimeoutTime_DMSM" SG_ 1066 StopLightFault 0;
BA_ "GenSigTimeoutTime_BSM" SG_ 1066 StopLightFault 0;
BA_ "GenSigTimeoutTime_BCM" SG_ 1066 StopLightFault 0;
BA_ "GenSigTimeoutTime_AGSM" SG_ 1066 StopLightFault 0;
BA_ "GenSigTimeoutTime_ADCAM" SG_ 1066 StopLightFault 0;
BA_ "GenSigTimeoutTime_RFHM" SG_ 1066 StopLightSts 0;
BA_ "GenSigTimeoutTime_MPAD" SG_ 1066 StopLightSts 0;
BA_ "GenSigTimeoutTime_IPC" SG_ 1066 StopLightSts 0;
BA_ "GenSigTimeoutTime_GNMM" SG_ 1066 StopLightSts 0;
BA_ "GenSigTimeoutTime_EVCU2" SG_ 1066 StopLightSts 0;
BA_ "GenSigTimeoutTime_ESL" SG_ 1066 StopLightSts 0;
BA_ "GenSigTimeoutTime_ECM" SG_ 1066 StopLightSts 0;
BA_ "GenSigTimeoutTime_DMSM" SG_ 1066 StopLightSts 0;
BA_ "GenSigTimeoutTime_BSM" SG_ 1066 StopLightSts 0;
BA_ "GenSigTimeoutTime_BCM" SG_ 1066 StopLightSts 0;
BA_ "GenSigTimeoutTime_AGSM" SG_ 1066 StopLightSts 0;
BA_ "GenSigTimeoutTime_ADCAM" SG_ 1066 StopLightSts 0;
BA_ "GenSigSendType" SG_ 1066 StopLightSts 3;
BA_ "GenSigTimeoutTime_MPAD" SG_ 1066 TheftAlarmStatus 0;
BA_ "GenSigTimeoutTime_IPC" SG_ 1066 TheftAlarmStatus 0;
BA_ "GenSigTimeoutTime_GNMM" SG_ 1066 TheftAlarmStatus 0;
BA_ "GenSigTimeoutTime_EVCU2" SG_ 1066 TheftAlarmStatus 0;
BA_ "GenSigTimeoutTime_ESL" SG_ 1066 TheftAlarmStatus 0;
BA_ "GenSigTimeoutTime_ECM" SG_ 1066 TheftAlarmStatus 0;
BA_ "GenSigTimeoutTime_DTCM" SG_ 1066 TheftAlarmStatus 0;
BA_ "GenSigTimeoutTime_DMSM" SG_ 1066 TheftAlarmStatus 0;
BA_ "GenSigTimeoutTime_BSM" SG_ 1066 TheftAlarmStatus 0;
BA_ "GenSigTimeoutTime_BCM" SG_ 1066 TheftAlarmStatus 0;
BA_ "GenSigTimeoutTime_AGSM" SG_ 1066 TheftAlarmStatus 0;
BA_ "GenSigTimeoutTime_ADCAM" SG_ 1066 TheftAlarmStatus 0;
BA_ "GenSigSendType" SG_ 1066 TheftAlarmStatus 3;
BA_ "GenSigTimeoutTime_SGW" SG_ 245 MinicryptReceptionSts 0;
BA_ "GenSigTimeoutTime_MPAD" SG_ 245 MinicryptReceptionSts 0;
BA_ "GenSigTimeoutTime_IPC" SG_ 245 MinicryptReceptionSts 0;
BA_ "GenSigTimeoutTime_GNMM" SG_ 245 MinicryptReceptionSts 0;
BA_ "GenSigTimeoutTime_EVCU2" SG_ 245 MinicryptReceptionSts 0;
BA_ "GenSigTimeoutTime_ESL" SG_ 245 MinicryptReceptionSts 0;
BA_ "GenSigTimeoutTime_ECM" SG_ 245 MinicryptReceptionSts 0;
BA_ "GenSigTimeoutTime_DTCM" SG_ 245 MinicryptReceptionSts 0;
BA_ "GenSigTimeoutTime_DMSM" SG_ 245 MinicryptReceptionSts 0;
BA_ "GenSigTimeoutTime_BSM" SG_ 245 MinicryptReceptionSts 0;
BA_ "GenSigTimeoutTime_BCM" SG_ 245 MinicryptReceptionSts 0;
BA_ "GenSigTimeoutTime_AGSM" SG_ 245 MinicryptReceptionSts 0;
BA_ "GenSigTimeoutTime_ADCAM" SG_ 245 MinicryptReceptionSts 0;
BA_ "GenSigSendType" SG_ 245 MinicryptReceptionSts 1;
BA_ "GenSigTimeoutTime_RFHM" SG_ 1066 ParkBrakeSts 0;
BA_ "GenSigTimeoutTime_GNMM" SG_ 1066 ParkBrakeSts 0;
BA_ "GenSigTimeoutTime_EVCU2" SG_ 1066 ParkBrakeSts 0;
BA_ "GenSigTimeoutTime_ESL" SG_ 1066 ParkBrakeSts 0;
BA_ "GenSigTimeoutTime_ECM" SG_ 1066 ParkBrakeSts 0;
BA_ "GenSigTimeoutTime_DTCM" SG_ 1066 ParkBrakeSts 0;
BA_ "GenSigTimeoutTime_DMSM" SG_ 1066 ParkBrakeSts 0;
BA_ "GenSigTimeoutTime_BSM" SG_ 1066 ParkBrakeSts 0;
BA_ "GenSigTimeoutTime_BCM" SG_ 1066 ParkBrakeSts 0;
BA_ "GenSigTimeoutTime_AGSM" SG_ 1066 ParkBrakeSts 0;
BA_ "GenSigTimeoutTime_ADCAM" SG_ 1066 ParkBrakeSts 0;
BA_ "GenSigSendType" SG_ 1066 ParkBrakeSts 3;
BA_ "GenSigTimeoutTime_ESL" SG_ 1066 PowerModeSts 0;
BA_ "GenSigTimeoutTime_ECM" SG_ 1066 PowerModeSts 0;
BA_ "GenSigTimeoutTime_DTCM" SG_ 1066 PowerModeSts 0;
BA_ "GenSigTimeoutTime_DMSM" SG_ 1066 PowerModeSts 0;
BA_ "GenSigTimeoutTime_AGSM" SG_ 1066 PowerModeSts 0;
BA_ "GenSigTimeoutTime_RFHM" SG_ 1066 RHTurnSignalSts 0;
BA_ "GenSigTimeoutTime_IPC" SG_ 1066 RHTurnSignalSts 0;
BA_ "GenSigTimeoutTime_GNMM" SG_ 1066 RHTurnSignalSts 0;
BA_ "GenSigTimeoutTime_EVCU2" SG_ 1066 RHTurnSignalSts 0;
BA_ "GenSigTimeoutTime_ESL" SG_ 1066 RHTurnSignalSts 0;
BA_ "GenSigTimeoutTime_ECM" SG_ 1066 RHTurnSignalSts 0;
BA_ "GenSigTimeoutTime_DTCM" SG_ 1066 RHTurnSignalSts 0;
BA_ "GenSigTimeoutTime_DMSM" SG_ 1066 RHTurnSignalSts 0;
BA_ "GenSigTimeoutTime_BSM" SG_ 1066 RHTurnSignalSts 0;
BA_ "GenSigTimeoutTime_BCM" SG_ 1066 RHTurnSignalSts 0;
BA_ "GenSigTimeoutTime_AGSM" SG_ 1066 RHTurnSignalSts 0;
BA_ "GenSigTimeoutTime_ADCAM" SG_ 1066 RHTurnSignalSts 0;
BA_ "GenSigSendType" SG_ 1066 RHTurnSignalSts 3;
BA_ "GenSigTimeoutTime_RFHM" SG_ 1066 RHParkingLightSts 0;
BA_ "GenSigTimeoutTime_MPAD" SG_ 1066 RHParkingLightSts 0;
BA_ "GenSigTimeoutTime_GNMM" SG_ 1066 RHParkingLightSts 0;
BA_ "GenSigTimeoutTime_EVCU2" SG_ 1066 RHParkingLightSts 0;
BA_ "GenSigTimeoutTime_ESL" SG_ 1066 RHParkingLightSts 0;
BA_ "GenSigTimeoutTime_ECM" SG_ 1066 RHParkingLightSts 0;
BA_ "GenSigTimeoutTime_DTCM" SG_ 1066 RHParkingLightSts 0;
BA_ "GenSigTimeoutTime_DMSM" SG_ 1066 RHParkingLightSts 0;
BA_ "GenSigTimeoutTime_BSM" SG_ 1066 RHParkingLightSts 0;
BA_ "GenSigTimeoutTime_BCM" SG_ 1066 RHParkingLightSts 0;
BA_ "GenSigTimeoutTime_AGSM" SG_ 1066 RHParkingLightSts 0;
BA_ "GenSigTimeoutTime_ADCAM" SG_ 1066 RHParkingLightSts 0;
BA_ "GenSigSendType" SG_ 1066 RHParkingLightSts 3;
BA_ "GenSigTimeoutTime_RFHM" SG_ 1066 WashLightWarningSts 0;
BA_ "GenSigTimeoutTime_MPAD" SG_ 1066 WashLightWarningSts 0;
BA_ "GenSigTimeoutTime_GNMM" SG_ 1066 WashLightWarningSts 0;
BA_ "GenSigTimeoutTime_EVCU2" SG_ 1066 WashLightWarningSts 0;
BA_ "GenSigTimeoutTime_ESL" SG_ 1066 WashLightWarningSts 0;
BA_ "GenSigTimeoutTime_ECM" SG_ 1066 WashLightWarningSts 0;
BA_ "GenSigTimeoutTime_DTCM" SG_ 1066 WashLightWarningSts 0;
BA_ "GenSigTimeoutTime_DMSM" SG_ 1066 WashLightWarningSts 0;
BA_ "GenSigTimeoutTime_BSM" SG_ 1066 WashLightWarningSts 0;
BA_ "GenSigTimeoutTime_BCM" SG_ 1066 WashLightWarningSts 0;
BA_ "GenSigTimeoutTime_AGSM" SG_ 1066 WashLightWarningSts 0;
BA_ "GenSigTimeoutTime_ADCAM" SG_ 1066 WashLightWarningSts 0;
BA_ "GenSigTimeoutTime_GNMM" SG_ 1066 PsngrDoorSts 0;
BA_ "GenSigTimeoutTime_EVCU2" SG_ 1066 PsngrDoorSts 0;
BA_ "GenSigTimeoutTime_ESL" SG_ 1066 PsngrDoorSts 0;
BA_ "GenSigTimeoutTime_ECM" SG_ 1066 PsngrDoorSts 0;
BA_ "GenSigTimeoutTime_DTCM" SG_ 1066 PsngrDoorSts 0;
BA_ "GenSigTimeoutTime_DMSM" SG_ 1066 PsngrDoorSts 0;
BA_ "GenSigTimeoutTime_BSM" SG_ 1066 PsngrDoorSts 0;
BA_ "GenSigTimeoutTime_BCM" SG_ 1066 PsngrDoorSts 0;
BA_ "GenSigTimeoutTime_AGSM" SG_ 1066 PsngrDoorSts 0;
BA_ "GenSigTimeoutTime_ADCAM" SG_ 1066 PsngrDoorSts 0;
BA_ "GenSigSendType" SG_ 1066 PsngrDoorSts 3;
BA_ "GenSigTimeoutTime_RFHM" SG_ 1066 RearFogLightSts 0;
BA_ "GenSigTimeoutTime_GNMM" SG_ 1066 RearFogLightSts 0;
BA_ "GenSigTimeoutTime_ESL" SG_ 1066 RearFogLightSts 0;
BA_ "GenSigTimeoutTime_ECM" SG_ 1066 RearFogLightSts 0;
BA_ "GenSigTimeoutTime_DTCM" SG_ 1066 RearFogLightSts 0;
BA_ "GenSigTimeoutTime_DMSM" SG_ 1066 RearFogLightSts 0;
BA_ "GenSigTimeoutTime_BSM" SG_ 1066 RearFogLightSts 0;
BA_ "GenSigTimeoutTime_BCM" SG_ 1066 RearFogLightSts 0;
BA_ "GenSigTimeoutTime_AGSM" SG_ 1066 RearFogLightSts 0;
BA_ "GenSigTimeoutTime_ADCAM" SG_ 1066 RearFogLightSts 0;
BA_ "GenSigSendType" SG_ 1066 RearFogLightSts 3;
BA_ "GenSigTimeoutTime_SGW" SG_ 1066 RainSensorFailSts 0;
BA_ "GenSigTimeoutTime_RFHM" SG_ 1066 RainSensorFailSts 0;
BA_ "GenSigTimeoutTime_MPAD" SG_ 1066 RainSensorFailSts 0;
BA_ "GenSigTimeoutTime_GNMM" SG_ 1066 RainSensorFailSts 0;
BA_ "GenSigTimeoutTime_EVCU2" SG_ 1066 RainSensorFailSts 0;
BA_ "GenSigTimeoutTime_ESL" SG_ 1066 RainSensorFailSts 0;
BA_ "GenSigTimeoutTime_ECM" SG_ 1066 RainSensorFailSts 0;
BA_ "GenSigTimeoutTime_DTCM" SG_ 1066 RainSensorFailSts 0;
BA_ "GenSigTimeoutTime_DMSM" SG_ 1066 RainSensorFailSts 0;
BA_ "GenSigTimeoutTime_BSM" SG_ 1066 RainSensorFailSts 0;
BA_ "GenSigTimeoutTime_BCM" SG_ 1066 RainSensorFailSts 0;
BA_ "GenSigTimeoutTime_AGSM" SG_ 1066 RainSensorFailSts 0;
BA_ "GenSigTimeoutTime_ADCAM" SG_ 1066 RainSensorFailSts 0;
BA_ "GenSigTimeoutTime_RFHM" SG_ 1066 RearTrunkEnableLastElSts 0;
BA_ "GenSigTimeoutTime_MPAD" SG_ 1066 RearTrunkEnableLastElSts 0;
BA_ "GenSigTimeoutTime_IPC" SG_ 1066 RearTrunkEnableLastElSts 0;
BA_ "GenSigTimeoutTime_GNMM" SG_ 1066 RearTrunkEnableLastElSts 0;
BA_ "GenSigTimeoutTime_EVCU2" SG_ 1066 RearTrunkEnableLastElSts 0;
BA_ "GenSigTimeoutTime_ESL" SG_ 1066 RearTrunkEnableLastElSts 0;
BA_ "GenSigTimeoutTime_ECM" SG_ 1066 RearTrunkEnableLastElSts 0;
BA_ "GenSigTimeoutTime_DTCM" SG_ 1066 RearTrunkEnableLastElSts 0;
BA_ "GenSigTimeoutTime_DMSM" SG_ 1066 RearTrunkEnableLastElSts 0;
BA_ "GenSigTimeoutTime_BSM" SG_ 1066 RearTrunkEnableLastElSts 0;
BA_ "GenSigTimeoutTime_BCM" SG_ 1066 RearTrunkEnableLastElSts 0;
BA_ "GenSigTimeoutTime_AGSM" SG_ 1066 RearTrunkEnableLastElSts 0;
BA_ "GenSigTimeoutTime_ADCAM" SG_ 1066 RearTrunkEnableLastElSts 0;
BA_ "GenSigTimeoutTime_MPAD" SG_ 1066 RHatchSts 0;
BA_ "GenSigTimeoutTime_GNMM" SG_ 1066 RHatchSts 0;
BA_ "GenSigTimeoutTime_ESL" SG_ 1066 RHatchSts 0;
BA_ "GenSigTimeoutTime_ECM" SG_ 1066 RHatchSts 0;
BA_ "GenSigTimeoutTime_DTCM" SG_ 1066 RHatchSts 0;
BA_ "GenSigTimeoutTime_DMSM" SG_ 1066 RHatchSts 0;
BA_ "GenSigTimeoutTime_BSM" SG_ 1066 RHatchSts 0;
BA_ "GenSigTimeoutTime_BCM" SG_ 1066 RHatchSts 0;
BA_ "GenSigTimeoutTime_AGSM" SG_ 1066 RHatchSts 0;
BA_ "GenSigTimeoutTime_ADCAM" SG_ 1066 RHatchSts 0;
BA_ "GenSigSendType" SG_ 1066 RHatchSts 3;
BA_ "GenSigTimeoutTime_GNMM" SG_ 1066 RHRDoorSts 0;
BA_ "GenSigTimeoutTime_EVCU2" SG_ 1066 RHRDoorSts 0;
BA_ "GenSigTimeoutTime_ESL" SG_ 1066 RHRDoorSts 0;
BA_ "GenSigTimeoutTime_ECM" SG_ 1066 RHRDoorSts 0;
BA_ "GenSigTimeoutTime_DTCM" SG_ 1066 RHRDoorSts 0;
BA_ "GenSigTimeoutTime_DMSM" SG_ 1066 RHRDoorSts 0;
BA_ "GenSigTimeoutTime_BSM" SG_ 1066 RHRDoorSts 0;
BA_ "GenSigTimeoutTime_BCM" SG_ 1066 RHRDoorSts 0;
BA_ "GenSigTimeoutTime_AGSM" SG_ 1066 RHRDoorSts 0;
BA_ "GenSigTimeoutTime_ADCAM" SG_ 1066 RHRDoorSts 0;
BA_ "GenSigSendType" SG_ 1066 RHRDoorSts 3;
BA_ "GenSigTimeoutTime_RFHM" SG_ 1066 LowFuelWarningSts 0;
BA_ "GenSigTimeoutTime_SGW" SG_ 513 MAC_BRAKE1 0;
BA_ "GenSigTimeoutTime_RFHM" SG_ 513 MAC_BRAKE1 0;
BA_ "GenSigTimeoutTime_IPC" SG_ 513 MAC_BRAKE1 0;
BA_ "GenSigTimeoutTime_GNMM" SG_ 513 MAC_BRAKE1 0;
BA_ "GenSigTimeoutTime_EVCU2" SG_ 513 MAC_BRAKE1 0;
BA_ "GenSigTimeoutTime_ESL" SG_ 513 MAC_BRAKE1 0;
BA_ "GenSigTimeoutTime_ECM" SG_ 513 MAC_BRAKE1 0;
BA_ "GenSigTimeoutTime_DTCM" SG_ 513 MAC_BRAKE1 0;
BA_ "GenSigTimeoutTime_DMSM" SG_ 513 MAC_BRAKE1 0;
BA_ "GenSigTimeoutTime_BSM" SG_ 513 MAC_BRAKE1 0;
BA_ "GenSigTimeoutTime_AGSM" SG_ 513 MAC_BRAKE1 0;
BA_ "GenSigTimeoutTime_ADCAM" SG_ 513 MAC_BRAKE1 0;
BA_ "GenSigTimeoutTime_DMSM" SG_ 513 Cntr_BRAKE1 0;
BA_ "GenSigTimeoutTime_BSM" SG_ 513 Cntr_BRAKE1 0;
BA_ "GenSigTimeoutTime_AGSM" SG_ 513 Cntr_BRAKE1 0;
BA_ "GenSigTimeoutTime_ADCAM" SG_ 513 Cntr_BRAKE1 0;
BA_ "GenSigTimeoutTime_SGW" SG_ 513 Cntr_BRAKE1 0;
BA_ "GenSigTimeoutTime_RFHM" SG_ 513 Cntr_BRAKE1 0;
BA_ "GenSigTimeoutTime_IPC" SG_ 513 Cntr_BRAKE1 0;
BA_ "GenSigTimeoutTime_GNMM" SG_ 513 Cntr_BRAKE1 0;
BA_ "GenSigTimeoutTime_EVCU2" SG_ 513 Cntr_BRAKE1 0;
BA_ "GenSigTimeoutTime_ESL" SG_ 513 Cntr_BRAKE1 0;
BA_ "GenSigTimeoutTime_ECM" SG_ 513 Cntr_BRAKE1 0;
BA_ "GenSigTimeoutTime_DTCM" SG_ 513 Cntr_BRAKE1 0;
BA_ "GenSigTimeoutTime_SGW" SG_ 513 eBurn_Stages 0;
BA_ "GenSigTimeoutTime_RFHM" SG_ 513 eBurn_Stages 0;
BA_ "GenSigTimeoutTime_MPAD" SG_ 513 eBurn_Stages 0;
BA_ "GenSigTimeoutTime_GNMM" SG_ 513 eBurn_Stages 0;
BA_ "GenSigTimeoutTime_ESL" SG_ 513 eBurn_Stages 0;
BA_ "GenSigTimeoutTime_ECM" SG_ 513 eBurn_Stages 0;
BA_ "GenSigTimeoutTime_DTCM" SG_ 513 eBurn_Stages 0;
BA_ "GenSigTimeoutTime_DMSM" SG_ 513 eBurn_Stages 0;
BA_ "GenSigTimeoutTime_BSM" SG_ 513 eBurn_Stages 0;
BA_ "GenSigTimeoutTime_BCM" SG_ 513 eBurn_Stages 0;
BA_ "GenSigTimeoutTime_AGSM" SG_ 513 eBurn_Stages 0;
BA_ "GenSigTimeoutTime_ADCAM" SG_ 513 eBurn_Stages 0;
BA_ "GenSigTimeoutTime_SGW" SG_ 513 DASEngReqPos 0;
BA_ "GenSigTimeoutTime_RFHM" SG_ 513 DASEngReqPos 0;
BA_ "GenSigTimeoutTime_IPC" SG_ 513 DASEngReqPos 0;
BA_ "GenSigTimeoutTime_GNMM" SG_ 513 DASEngReqPos 0;
BA_ "GenSigTimeoutTime_EVCU2" SG_ 513 DASEngReqPos 0;
BA_ "GenSigTimeoutTime_ESL" SG_ 513 DASEngReqPos 0;
BA_ "GenSigTimeoutTime_ECM" SG_ 513 DASEngReqPos 0;
BA_ "GenSigTimeoutTime_DTCM" SG_ 513 DASEngReqPos 0;
BA_ "GenSigTimeoutTime_DMSM" SG_ 513 DASEngReqPos 0;
BA_ "GenSigTimeoutTime_BSM" SG_ 513 DASEngReqPos 0;
BA_ "GenSigTimeoutTime_AGSM" SG_ 513 DASEngReqPos 0;
BA_ "GenSigTimeoutTime_RFHM" SG_ 513 HILL_DES_STAT 0;
BA_ "GenSigTimeoutTime_MPAD" SG_ 513 HILL_DES_STAT 0;
BA_ "GenSigTimeoutTime_IPC" SG_ 513 HILL_DES_STAT 0;
BA_ "GenSigTimeoutTime_GNMM" SG_ 513 HILL_DES_STAT 0;
BA_ "GenSigTimeoutTime_EVCU2" SG_ 513 HILL_DES_STAT 0;
BA_ "GenSigTimeoutTime_ESL" SG_ 513 HILL_DES_STAT 0;
BA_ "GenSigTimeoutTime_ECM" SG_ 513 HILL_DES_STAT 0;
BA_ "GenSigTimeoutTime_DTCM" SG_ 513 HILL_DES_STAT 0;
BA_ "GenSigTimeoutTime_DMSM" SG_ 513 HILL_DES_STAT 0;
BA_ "GenSigTimeoutTime_BSM" SG_ 513 HILL_DES_STAT 0;
BA_ "GenSigTimeoutTime_BCM" SG_ 513 HILL_DES_STAT 0;
BA_ "GenSigTimeoutTime_AGSM" SG_ 513 HILL_DES_STAT 0;
BA_ "GenSigTimeoutTime_ADCAM" SG_ 513 HILL_DES_STAT 0;
BA_ "GenSigTimeoutTime_SGW" SG_ 513 Brk_Jrk_Resp 0;
BA_ "GenSigTimeoutTime_RFHM" SG_ 513 Brk_Jrk_Resp 0;
BA_ "GenSigTimeoutTime_IPC" SG_ 513 Brk_Jrk_Resp 0;
BA_ "GenSigTimeoutTime_GNMM" SG_ 513 Brk_Jrk_Resp 0;
BA_ "GenSigTimeoutTime_EVCU2" SG_ 513 Brk_Jrk_Resp 0;
BA_ "GenSigTimeoutTime_ESL" SG_ 513 Brk_Jrk_Resp 0;
BA_ "GenSigTimeoutTime_ECM" SG_ 513 Brk_Jrk_Resp 0;
BA_ "GenSigTimeoutTime_DTCM" SG_ 513 Brk_Jrk_Resp 0;
BA_ "GenSigTimeoutTime_DMSM" SG_ 513 Brk_Jrk_Resp 0;
BA_ "GenSigTimeoutTime_BSM" SG_ 513 Brk_Jrk_Resp 0;
BA_ "GenSigTimeoutTime_AGSM" SG_ 513 Brk_Jrk_Resp 0;
BA_ "GenSigTimeoutTime_SGW" SG_ 513 ACCFSafe 0;
BA_ "GenSigTimeoutTime_RFHM" SG_ 513 ACCFSafe 0;
BA_ "GenSigTimeoutTime_IPC" SG_ 513 ACCFSafe 0;
BA_ "GenSigTimeoutTime_GNMM" SG_ 513 ACCFSafe 0;
BA_ "GenSigTimeoutTime_EVCU2" SG_ 513 ACCFSafe 0;
BA_ "GenSigTimeoutTime_ESL" SG_ 513 ACCFSafe 0;
BA_ "GenSigTimeoutTime_ECM" SG_ 513 ACCFSafe 0;
BA_ "GenSigTimeoutTime_DTCM" SG_ 513 ACCFSafe 0;
BA_ "GenSigTimeoutTime_DMSM" SG_ 513 ACCFSafe 0;
BA_ "GenSigTimeoutTime_BSM" SG_ 513 ACCFSafe 0;
BA_ "GenSigTimeoutTime_AGSM" SG_ 513 ACCFSafe 0;
BA_ "GenSigTimeoutTime_RFHM" SG_ 1066 TrunkHandleReleaseSts 0;
BA_ "GenSigTimeoutTime_IPC" SG_ 1066 TrunkHandleReleaseSts 0;
BA_ "GenSigTimeoutTime_GNMM" SG_ 1066 TrunkHandleReleaseSts 0;
BA_ "GenSigTimeoutTime_EVCU2" SG_ 1066 TrunkHandleReleaseSts 0;
BA_ "GenSigTimeoutTime_ESL" SG_ 1066 TrunkHandleReleaseSts 0;
BA_ "GenSigTimeoutTime_ECM" SG_ 1066 TrunkHandleReleaseSts 0;
BA_ "GenSigTimeoutTime_DTCM" SG_ 1066 TrunkHandleReleaseSts 0;
BA_ "GenSigTimeoutTime_DMSM" SG_ 1066 TrunkHandleReleaseSts 0;
BA_ "GenSigTimeoutTime_BSM" SG_ 1066 TrunkHandleReleaseSts 0;
BA_ "GenSigTimeoutTime_BCM" SG_ 1066 TrunkHandleReleaseSts 0;
BA_ "GenSigTimeoutTime_AGSM" SG_ 1066 TrunkHandleReleaseSts 0;
BA_ "GenSigTimeoutTime_ADCAM" SG_ 1066 TrunkHandleReleaseSts 0;
BA_ "GenSigSendType" SG_ 1066 TrunkHandleReleaseSts 3;
BA_ "GenSigTimeoutTime_SGW" SG_ 1827 AbsoluteTimerSeconds 0;
BA_ "GenSigTimeoutTime_RFHM" SG_ 1827 AbsoluteTimerSeconds 0;
BA_ "GenSigTimeoutTime_MPAD" SG_ 1827 AbsoluteTimerSeconds 0;
BA_ "GenSigTimeoutTime_IPC" SG_ 1827 AbsoluteTimerSeconds 0;
BA_ "GenSigTimeoutTime_GNMM" SG_ 1827 AbsoluteTimerSeconds 0;
BA_ "GenSigTimeoutTime_SGW" SG_ 1066 FuelLevel2 0;
BA_ "GenSigTimeoutTime_RFHM" SG_ 1066 FuelLevel2 0;
BA_ "GenSigTimeoutTime_MPAD" SG_ 1066 FuelLevel2 0;
BA_ "GenSigTimeoutTime_GNMM" SG_ 1066 FuelLevel2 0;
BA_ "GenSigTimeoutTime_EVCU2" SG_ 1066 FuelLevel2 0;
BA_ "GenSigTimeoutTime_ESL" SG_ 1066 FuelLevel2 0;
BA_ "GenSigTimeoutTime_DTCM" SG_ 1066 FuelLevel2 0;
BA_ "GenSigTimeoutTime_DMSM" SG_ 1066 FuelLevel2 0;
BA_ "GenSigTimeoutTime_BSM" SG_ 1066 FuelLevel2 0;
BA_ "GenSigTimeoutTime_BCM" SG_ 1066 FuelLevel2 0;
BA_ "GenSigTimeoutTime_AGSM" SG_ 1066 FuelLevel2 0;
BA_ "GenSigTimeoutTime_ADCAM" SG_ 1066 FuelLevel2 0;
BA_ "GenSigTimeoutTime_EVCU2" SG_ 1827 AbsoluteTimerSeconds 0;
BA_ "GenSigTimeoutTime_ESL" SG_ 1827 AbsoluteTimerSeconds 0;
BA_ "GenSigTimeoutTime_DTCM" SG_ 1827 AbsoluteTimerSeconds 0;
BA_ "GenSigTimeoutTime_DMSM" SG_ 1827 AbsoluteTimerSeconds 0;
BA_ "GenSigTimeoutTime_BSM" SG_ 1827 AbsoluteTimerSeconds 0;
BA_ "GenSigTimeoutTime_BCM" SG_ 1827 AbsoluteTimerSeconds 0;
BA_ "GenSigTimeoutTime_AGSM" SG_ 1827 AbsoluteTimerSeconds 0;
BA_ "GenSigTimeoutTime_ADCAM" SG_ 1827 AbsoluteTimerSeconds 0;
BA_ "GenSigTimeoutTime_SGW" SG_ 1827 AbsoluteTimerDays 0;
BA_ "GenSigTimeoutTime_RFHM" SG_ 1827 AbsoluteTimerDays 0;
BA_ "GenSigTimeoutTime_MPAD" SG_ 1827 AbsoluteTimerDays 0;
BA_ "GenSigTimeoutTime_IPC" SG_ 1827 AbsoluteTimerDays 0;
BA_ "GenSigTimeoutTime_GNMM" SG_ 1827 AbsoluteTimerDays 0;
BA_ "GenSigTimeoutTime_EVCU2" SG_ 1827 AbsoluteTimerDays 0;
BA_ "GenSigTimeoutTime_ESL" SG_ 1827 AbsoluteTimerDays 0;
BA_ "GenSigTimeoutTime_DTCM" SG_ 1827 AbsoluteTimerDays 0;
BA_ "GenSigTimeoutTime_DMSM" SG_ 1827 AbsoluteTimerDays 0;
BA_ "GenSigTimeoutTime_BSM" SG_ 1827 AbsoluteTimerDays 0;
BA_ "GenSigTimeoutTime_BCM" SG_ 1827 AbsoluteTimerDays 0;
BA_ "GenSigTimeoutTime_AGSM" SG_ 1827 AbsoluteTimerDays 0;
BA_ "GenSigTimeoutTime_ADCAM" SG_ 1827 AbsoluteTimerDays 0;
BA_ "GenSigTimeoutTime_SGW" SG_ 1375 SysEOLSts 0;
BA_ "GenSigTimeoutTime_RFHM" SG_ 1375 SysEOLSts 0;
BA_ "GenSigTimeoutTime_GNMM" SG_ 1375 SysEOLSts 0;
BA_ "GenSigTimeoutTime_EVCU2" SG_ 1375 SysEOLSts 0;
BA_ "GenSigTimeoutTime_ESL" SG_ 1375 SysEOLSts 0;
BA_ "GenSigTimeoutTime_ECM" SG_ 1375 SysEOLSts 0;
BA_ "GenSigTimeoutTime_DTCM" SG_ 1375 SysEOLSts 0;
BA_ "GenSigTimeoutTime_DMSM" SG_ 1375 SysEOLSts 0;
BA_ "GenSigTimeoutTime_BSM" SG_ 1375 SysEOLSts 0;
BA_ "GenSigTimeoutTime_BCM" SG_ 1375 SysEOLSts 0;
BA_ "GenSigTimeoutTime_AGSM" SG_ 1375 SysEOLSts 0;
BA_ "GenSigTimeoutTime_ADCAM" SG_ 1375 SysEOLSts 0;
BA_ "GenSigTimeoutTime_SGW" SG_ 1375 ChkFuelLevelSts2 0;
BA_ "GenSigTimeoutTime_RFHM" SG_ 1375 ChkFuelLevelSts2 0;
BA_ "GenSigTimeoutTime_MPAD" SG_ 1375 ChkFuelLevelSts2 0;
BA_ "GenSigTimeoutTime_GNMM" SG_ 1375 ChkFuelLevelSts2 0;
BA_ "GenSigTimeoutTime_EVCU2" SG_ 1375 ChkFuelLevelSts2 0;
BA_ "GenSigTimeoutTime_ESL" SG_ 1375 ChkFuelLevelSts2 0;
BA_ "GenSigTimeoutTime_DTCM" SG_ 1375 ChkFuelLevelSts2 0;
BA_ "GenSigTimeoutTime_DMSM" SG_ 1375 ChkFuelLevelSts2 0;
BA_ "GenSigTimeoutTime_BSM" SG_ 1375 ChkFuelLevelSts2 0;
BA_ "GenSigTimeoutTime_BCM" SG_ 1375 ChkFuelLevelSts2 0;
BA_ "GenSigTimeoutTime_AGSM" SG_ 1375 ChkFuelLevelSts2 0;
BA_ "GenSigTimeoutTime_ADCAM" SG_ 1375 ChkFuelLevelSts2 0;
BA_ "GenSigTimeoutTime_SGW" SG_ 1375 MessageCounter_BCM6 0;
BA_ "GenSigTimeoutTime_RFHM" SG_ 1375 MessageCounter_BCM6 0;
BA_ "GenSigTimeoutTime_IPC" SG_ 1375 MessageCounter_BCM6 0;
BA_ "GenSigTimeoutTime_GNMM" SG_ 1375 MessageCounter_BCM6 0;
BA_ "GenSigTimeoutTime_EVCU2" SG_ 1375 MessageCounter_BCM6 0;
BA_ "GenSigTimeoutTime_ESL" SG_ 1375 MessageCounter_BCM6 0;
BA_ "GenSigTimeoutTime_ECM" SG_ 1375 MessageCounter_BCM6 0;
BA_ "GenSigTimeoutTime_DTCM" SG_ 1375 MessageCounter_BCM6 0;
BA_ "GenSigTimeoutTime_DMSM" SG_ 1375 MessageCounter_BCM6 0;
BA_ "GenSigTimeoutTime_BCM" SG_ 1375 MessageCounter_BCM6 0;
BA_ "GenSigTimeoutTime_AGSM" SG_ 1375 MessageCounter_BCM6 0;
BA_ "GenSigTimeoutTime_SGW" SG_ 1375 CRC_BCM6 0;
BA_ "GenSigTimeoutTime_RFHM" SG_ 1375 CRC_BCM6 0;
BA_ "GenSigTimeoutTime_IPC" SG_ 1375 CRC_BCM6 0;
BA_ "GenSigTimeoutTime_GNMM" SG_ 1375 CRC_BCM6 0;
BA_ "GenSigTimeoutTime_EVCU2" SG_ 1375 CRC_BCM6 0;
BA_ "GenSigTimeoutTime_ESL" SG_ 1375 CRC_BCM6 0;
BA_ "GenSigTimeoutTime_ECM" SG_ 1375 CRC_BCM6 0;
BA_ "GenSigTimeoutTime_DTCM" SG_ 1375 CRC_BCM6 0;
BA_ "GenSigTimeoutTime_DMSM" SG_ 1375 CRC_BCM6 0;
BA_ "GenSigTimeoutTime_BCM" SG_ 1375 CRC_BCM6 0;
BA_ "GenSigTimeoutTime_AGSM" SG_ 1375 CRC_BCM6 0;
BA_ "GenSigTimeoutTime_SGW" SG_ 1051 RR_HS_STAT 0;
BA_ "GenSigTimeoutTime_RFHM" SG_ 1051 RR_HS_STAT 0;
BA_ "GenSigTimeoutTime_MPAD" SG_ 1051 RR_HS_STAT 0;
BA_ "GenSigTimeoutTime_IPC" SG_ 1051 RR_HS_STAT 0;
BA_ "GenSigTimeoutTime_GNMM" SG_ 1051 RR_HS_STAT 0;
BA_ "GenSigTimeoutTime_ESL" SG_ 1051 RR_HS_STAT 0;
BA_ "GenSigTimeoutTime_ECM" SG_ 1051 RR_HS_STAT 0;
BA_ "GenSigTimeoutTime_DTCM" SG_ 1051 RR_HS_STAT 0;
BA_ "GenSigTimeoutTime_DMSM" SG_ 1051 RR_HS_STAT 0;
BA_ "GenSigTimeoutTime_BSM" SG_ 1051 RR_HS_STAT 0;
BA_ "GenSigTimeoutTime_BCM" SG_ 1051 RR_HS_STAT 0;
BA_ "GenSigTimeoutTime_AGSM" SG_ 1051 RR_HS_STAT 0;
BA_ "GenSigTimeoutTime_ADCAM" SG_ 1051 RR_HS_STAT 0;
BA_ "GenSigTimeoutTime_SGW" SG_ 1051 RR_HS_STATFailSts 0;
BA_ "GenSigTimeoutTime_RFHM" SG_ 1051 RR_HS_STATFailSts 0;
BA_ "GenSigTimeoutTime_MPAD" SG_ 1051 RR_HS_STATFailSts 0;
BA_ "GenSigTimeoutTime_IPC" SG_ 1051 RR_HS_STATFailSts 0;
BA_ "GenSigTimeoutTime_GNMM" SG_ 1051 RR_HS_STATFailSts 0;
BA_ "GenSigTimeoutTime_ESL" SG_ 1051 RR_HS_STATFailSts 0;
BA_ "GenSigTimeoutTime_ECM" SG_ 1051 RR_HS_STATFailSts 0;
BA_ "GenSigTimeoutTime_DTCM" SG_ 1051 RR_HS_STATFailSts 0;
BA_ "GenSigTimeoutTime_DMSM" SG_ 1051 RR_HS_STATFailSts 0;
BA_ "GenSigTimeoutTime_BSM" SG_ 1051 RR_HS_STATFailSts 0;
BA_ "GenSigTimeoutTime_BCM" SG_ 1051 RR_HS_STATFailSts 0;
BA_ "GenSigTimeoutTime_AGSM" SG_ 1051 RR_HS_STATFailSts 0;
BA_ "GenSigTimeoutTime_ADCAM" SG_ 1051 RR_HS_STATFailSts 0;
BA_ "GenSigTimeoutTime_SGW" SG_ 1051 RR_VS_STAT 0;
BA_ "GenSigTimeoutTime_RFHM" SG_ 1051 RR_VS_STAT 0;
BA_ "GenSigTimeoutTime_MPAD" SG_ 1051 RR_VS_STAT 0;
BA_ "GenSigTimeoutTime_IPC" SG_ 1051 RR_VS_STAT 0;
BA_ "GenSigTimeoutTime_GNMM" SG_ 1051 RR_VS_STAT 0;
BA_ "GenSigTimeoutTime_ESL" SG_ 1051 RR_VS_STAT 0;
BA_ "GenSigTimeoutTime_ECM" SG_ 1051 RR_VS_STAT 0;
BA_ "GenSigTimeoutTime_DTCM" SG_ 1051 RR_VS_STAT 0;
BA_ "GenSigTimeoutTime_DMSM" SG_ 1051 RR_VS_STAT 0;
BA_ "GenSigTimeoutTime_BSM" SG_ 1051 RR_VS_STAT 0;
BA_ "GenSigTimeoutTime_BCM" SG_ 1051 RR_VS_STAT 0;
BA_ "GenSigTimeoutTime_AGSM" SG_ 1051 RR_VS_STAT 0;
BA_ "GenSigTimeoutTime_ADCAM" SG_ 1051 RR_VS_STAT 0;
BA_ "GenSigTimeoutTime_SGW" SG_ 1051 RR_VS_STATFailSts 0;
BA_ "GenSigTimeoutTime_RFHM" SG_ 1051 RR_VS_STATFailSts 0;
BA_ "GenSigTimeoutTime_MPAD" SG_ 1051 RR_VS_STATFailSts 0;
BA_ "GenSigTimeoutTime_IPC" SG_ 1051 RR_VS_STATFailSts 0;
BA_ "GenSigTimeoutTime_GNMM" SG_ 1051 RR_VS_STATFailSts 0;
BA_ "GenSigTimeoutTime_ESL" SG_ 1051 RR_VS_STATFailSts 0;
BA_ "GenSigTimeoutTime_ECM" SG_ 1051 RR_VS_STATFailSts 0;
BA_ "GenSigTimeoutTime_DTCM" SG_ 1051 RR_VS_STATFailSts 0;
BA_ "GenSigTimeoutTime_DMSM" SG_ 1051 RR_VS_STATFailSts 0;
BA_ "GenSigTimeoutTime_BSM" SG_ 1051 RR_VS_STATFailSts 0;
BA_ "GenSigTimeoutTime_BCM" SG_ 1051 RR_VS_STATFailSts 0;
BA_ "GenSigTimeoutTime_AGSM" SG_ 1051 RR_VS_STATFailSts 0;
BA_ "GenSigTimeoutTime_ADCAM" SG_ 1051 RR_VS_STATFailSts 0;
BA_ "GenSigTimeoutTime_SGW" SG_ 1051 HSW_StatFailSts 0;
BA_ "GenSigTimeoutTime_RFHM" SG_ 1051 HSW_StatFailSts 0;
BA_ "GenSigTimeoutTime_MPAD" SG_ 1051 HSW_StatFailSts 0;
BA_ "GenSigTimeoutTime_IPC" SG_ 1051 HSW_StatFailSts 0;
BA_ "GenSigTimeoutTime_GNMM" SG_ 1051 HSW_StatFailSts 0;
BA_ "GenSigTimeoutTime_ESL" SG_ 1051 HSW_StatFailSts 0;
BA_ "GenSigTimeoutTime_ECM" SG_ 1051 HSW_StatFailSts 0;
BA_ "GenSigTimeoutTime_DTCM" SG_ 1051 HSW_StatFailSts 0;
BA_ "GenSigTimeoutTime_DMSM" SG_ 1051 HSW_StatFailSts 0;
BA_ "GenSigTimeoutTime_BSM" SG_ 1051 HSW_StatFailSts 0;
BA_ "GenSigTimeoutTime_BCM" SG_ 1051 HSW_StatFailSts 0;
BA_ "GenSigTimeoutTime_SGW" SG_ 1051 MessageCounter_BCM4 0;
BA_ "GenSigTimeoutTime_RFHM" SG_ 1051 MessageCounter_BCM4 0;
BA_ "GenSigTimeoutTime_MPAD" SG_ 1051 MessageCounter_BCM4 0;
BA_ "GenSigTimeoutTime_IPC" SG_ 1051 MessageCounter_BCM4 0;
BA_ "GenSigTimeoutTime_GNMM" SG_ 1051 MessageCounter_BCM4 0;
BA_ "GenSigTimeoutTime_ESL" SG_ 1051 MessageCounter_BCM4 0;
BA_ "GenSigTimeoutTime_ECM" SG_ 1051 MessageCounter_BCM4 0;
BA_ "GenSigTimeoutTime_DTCM" SG_ 1051 MessageCounter_BCM4 0;
BA_ "GenSigTimeoutTime_DMSM" SG_ 1051 MessageCounter_BCM4 0;
BA_ "GenSigTimeoutTime_BSM" SG_ 1051 MessageCounter_BCM4 0;
BA_ "GenSigTimeoutTime_BCM" SG_ 1051 MessageCounter_BCM4 0;
BA_ "GenSigTimeoutTime_AGSM" SG_ 1051 MessageCounter_BCM4 0;
BA_ "GenSigTimeoutTime_ADCAM" SG_ 1051 MessageCounter_BCM4 0;
BA_ "GenSigTimeoutTime_SGW" SG_ 1051 RL_HS_STAT 0;
BA_ "GenSigTimeoutTime_RFHM" SG_ 1051 RL_HS_STAT 0;
BA_ "GenSigTimeoutTime_MPAD" SG_ 1051 RL_HS_STAT 0;
BA_ "GenSigTimeoutTime_IPC" SG_ 1051 RL_HS_STAT 0;
BA_ "GenSigTimeoutTime_GNMM" SG_ 1051 RL_HS_STAT 0;
BA_ "GenSigTimeoutTime_ESL" SG_ 1051 RL_HS_STAT 0;
BA_ "GenSigTimeoutTime_ECM" SG_ 1051 RL_HS_STAT 0;
BA_ "GenSigTimeoutTime_DTCM" SG_ 1051 RL_HS_STAT 0;
BA_ "GenSigTimeoutTime_DMSM" SG_ 1051 RL_HS_STAT 0;
BA_ "GenSigTimeoutTime_BSM" SG_ 1051 RL_HS_STAT 0;
BA_ "GenSigTimeoutTime_BCM" SG_ 1051 RL_HS_STAT 0;
BA_ "GenSigTimeoutTime_AGSM" SG_ 1051 RL_HS_STAT 0;
BA_ "GenSigTimeoutTime_ADCAM" SG_ 1051 RL_HS_STAT 0;
BA_ "GenSigTimeoutTime_SGW" SG_ 1051 RL_HS_STATFailSts 0;
BA_ "GenSigTimeoutTime_RFHM" SG_ 1051 RL_HS_STATFailSts 0;
BA_ "GenSigTimeoutTime_MPAD" SG_ 1051 RL_HS_STATFailSts 0;
BA_ "GenSigTimeoutTime_IPC" SG_ 1051 RL_HS_STATFailSts 0;
BA_ "GenSigTimeoutTime_GNMM" SG_ 1051 RL_HS_STATFailSts 0;
BA_ "GenSigTimeoutTime_ESL" SG_ 1051 RL_HS_STATFailSts 0;
BA_ "GenSigTimeoutTime_ECM" SG_ 1051 RL_HS_STATFailSts 0;
BA_ "GenSigTimeoutTime_DTCM" SG_ 1051 RL_HS_STATFailSts 0;
BA_ "GenSigTimeoutTime_DMSM" SG_ 1051 RL_HS_STATFailSts 0;
BA_ "GenSigTimeoutTime_BSM" SG_ 1051 RL_HS_STATFailSts 0;
BA_ "GenSigTimeoutTime_BCM" SG_ 1051 RL_HS_STATFailSts 0;
BA_ "GenSigTimeoutTime_AGSM" SG_ 1051 RL_HS_STATFailSts 0;
BA_ "GenSigTimeoutTime_ADCAM" SG_ 1051 RL_HS_STATFailSts 0;
BA_ "GenSigTimeoutTime_SGW" SG_ 1051 RL_VS_STAT 0;
BA_ "GenSigTimeoutTime_RFHM" SG_ 1051 RL_VS_STAT 0;
BA_ "GenSigTimeoutTime_MPAD" SG_ 1051 RL_VS_STAT 0;
BA_ "GenSigTimeoutTime_IPC" SG_ 1051 RL_VS_STAT 0;
BA_ "GenSigTimeoutTime_GNMM" SG_ 1051 RL_VS_STAT 0;
BA_ "GenSigTimeoutTime_ESL" SG_ 1051 RL_VS_STAT 0;
BA_ "GenSigTimeoutTime_ECM" SG_ 1051 RL_VS_STAT 0;
BA_ "GenSigTimeoutTime_DTCM" SG_ 1051 RL_VS_STAT 0;
BA_ "GenSigTimeoutTime_DMSM" SG_ 1051 RL_VS_STAT 0;
BA_ "GenSigTimeoutTime_BSM" SG_ 1051 RL_VS_STAT 0;
BA_ "GenSigTimeoutTime_BCM" SG_ 1051 RL_VS_STAT 0;
BA_ "GenSigTimeoutTime_AGSM" SG_ 1051 RL_VS_STAT 0;
BA_ "GenSigTimeoutTime_ADCAM" SG_ 1051 RL_VS_STAT 0;
BA_ "GenSigTimeoutTime_SGW" SG_ 1051 RL_VS_STATFailSts 0;
BA_ "GenSigTimeoutTime_RFHM" SG_ 1051 RL_VS_STATFailSts 0;
BA_ "GenSigTimeoutTime_MPAD" SG_ 1051 RL_VS_STATFailSts 0;
BA_ "GenSigTimeoutTime_IPC" SG_ 1051 RL_VS_STATFailSts 0;
BA_ "GenSigTimeoutTime_GNMM" SG_ 1051 RL_VS_STATFailSts 0;
BA_ "GenSigTimeoutTime_ESL" SG_ 1051 RL_VS_STATFailSts 0;
BA_ "GenSigTimeoutTime_ECM" SG_ 1051 RL_VS_STATFailSts 0;
BA_ "GenSigTimeoutTime_DTCM" SG_ 1051 RL_VS_STATFailSts 0;
BA_ "GenSigTimeoutTime_DMSM" SG_ 1051 RL_VS_STATFailSts 0;
BA_ "GenSigTimeoutTime_BSM" SG_ 1051 RL_VS_STATFailSts 0;
BA_ "GenSigTimeoutTime_BCM" SG_ 1051 RL_VS_STATFailSts 0;
BA_ "GenSigTimeoutTime_AGSM" SG_ 1051 RL_VS_STATFailSts 0;
BA_ "GenSigTimeoutTime_ADCAM" SG_ 1051 RL_VS_STATFailSts 0;
BA_ "GenSigTimeoutTime_SGW" SG_ 512 MessageCounter_BCM18 0;
BA_ "GenSigTimeoutTime_RFHM" SG_ 512 MessageCounter_BCM18 0;
BA_ "GenSigTimeoutTime_MPAD" SG_ 512 MessageCounter_BCM18 0;
BA_ "GenSigTimeoutTime_IPC" SG_ 512 MessageCounter_BCM18 0;
BA_ "GenSigTimeoutTime_GNMM" SG_ 512 MessageCounter_BCM18 0;
BA_ "GenSigTimeoutTime_ESL" SG_ 512 MessageCounter_BCM18 0;
BA_ "GenSigTimeoutTime_ECM" SG_ 512 MessageCounter_BCM18 0;
BA_ "GenSigTimeoutTime_DTCM" SG_ 512 MessageCounter_BCM18 0;
BA_ "GenSigTimeoutTime_DMSM" SG_ 512 MessageCounter_BCM18 0;
BA_ "GenSigTimeoutTime_MPAD" SG_ 256 SCCActvSts 0;
BA_ "GenSigTimeoutTime_GNMM" SG_ 256 SCCActvSts 0;
BA_ "GenSigTimeoutTime_ESL" SG_ 256 SCCActvSts 0;
BA_ "GenSigTimeoutTime_ECM" SG_ 256 SCCActvSts 0;
BA_ "GenSigTimeoutTime_DTCM" SG_ 256 SCCActvSts 0;
BA_ "GenSigTimeoutTime_DMSM" SG_ 256 SCCActvSts 0;
BA_ "GenSigTimeoutTime_BSM" SG_ 256 SCCActvSts 0;
BA_ "GenSigTimeoutTime_BCM" SG_ 256 SCCActvSts 0;
BA_ "GenSigTimeoutTime_ADCAM" SG_ 256 SCCActvSts 0;
BA_ "GenSigTimeoutTime_SGW" SG_ 1431 SeatVib_Sts 0;
BA_ "GenSigTimeoutTime_RFHM" SG_ 1431 SeatVib_Sts 0;
BA_ "GenSigTimeoutTime_IPC" SG_ 1431 SeatVib_Sts 0;
BA_ "GenSigTimeoutTime_GNMM" SG_ 1431 SeatVib_Sts 0;
BA_ "GenSigTimeoutTime_EVCU2" SG_ 1431 SeatVib_Sts 0;
BA_ "GenSigTimeoutTime_ESL" SG_ 1431 SeatVib_Sts 0;
BA_ "GenSigTimeoutTime_ECM" SG_ 1431 SeatVib_Sts 0;
BA_ "GenSigTimeoutTime_RFHM" SG_ 159 AcceleratorSts 0;
BA_ "GenSigTimeoutTime_IPC" SG_ 159 AcceleratorSts 0;
BA_ "GenSigTimeoutTime_GNMM" SG_ 159 AcceleratorSts 0;
BA_ "GenSigTimeoutTime_ESL" SG_ 159 AcceleratorSts 0;
BA_ "GenSigTimeoutTime_ECM" SG_ 159 AcceleratorSts 0;
BA_ "GenSigTimeoutTime_DTCM" SG_ 159 AcceleratorSts 0;
BA_ "GenSigTimeoutTime_DMSM" SG_ 159 AcceleratorSts 0;
BA_ "GenSigTimeoutTime_BCM" SG_ 159 AcceleratorSts 0;
BA_ "GenSigTimeoutTime_AGSM" SG_ 159 AcceleratorSts 0;
BA_ "GenSigTimeoutTime_SGW" SG_ 159 CruiseControlFailSts 0;
BA_ "GenSigTimeoutTime_RFHM" SG_ 159 CruiseControlFailSts 0;
BA_ "GenSigTimeoutTime_IPC" SG_ 159 CruiseControlFailSts 0;
BA_ "GenSigTimeoutTime_GNMM" SG_ 159 CruiseControlFailSts 0;
BA_ "GenSigTimeoutTime_ESL" SG_ 159 CruiseControlFailSts 0;
BA_ "GenSigTimeoutTime_ECM" SG_ 159 CruiseControlFailSts 0;
BA_ "GenSigTimeoutTime_DTCM" SG_ 159 CruiseControlFailSts 0;
BA_ "GenSigTimeoutTime_DMSM" SG_ 159 CruiseControlFailSts 0;
BA_ "GenSigTimeoutTime_BSM" SG_ 159 CruiseControlFailSts 0;
BA_ "GenSigTimeoutTime_BCM" SG_ 159 CruiseControlFailSts 0;
BA_ "GenSigTimeoutTime_AGSM" SG_ 159 CruiseControlFailSts 0;
BA_ "GenSigTimeoutTime_RFHM" SG_ 159 CruiseControlOnOffSts 0;
BA_ "GenSigTimeoutTime_IPC" SG_ 159 CruiseControlOnOffSts 0;
BA_ "GenSigTimeoutTime_GNMM" SG_ 159 CruiseControlOnOffSts 0;
BA_ "GenSigTimeoutTime_ESL" SG_ 159 CruiseControlOnOffSts 0;
BA_ "GenSigTimeoutTime_ECM" SG_ 159 CruiseControlOnOffSts 0;
BA_ "GenSigTimeoutTime_DTCM" SG_ 159 CruiseControlOnOffSts 0;
BA_ "GenSigTimeoutTime_DMSM" SG_ 159 CruiseControlOnOffSts 0;
BA_ "GenSigTimeoutTime_BCM" SG_ 159 CruiseControlOnOffSts 0;
BA_ "GenSigTimeoutTime_AGSM" SG_ 159 CruiseControlOnOffSts 0;
BA_ "GenSigTimeoutTime_RFHM" SG_ 159 DeceleratorSts 0;
BA_ "GenSigTimeoutTime_IPC" SG_ 159 DeceleratorSts 0;
BA_ "GenSigTimeoutTime_GNMM" SG_ 159 DeceleratorSts 0;
BA_ "GenSigTimeoutTime_ESL" SG_ 159 DeceleratorSts 0;
BA_ "GenSigTimeoutTime_ECM" SG_ 159 DeceleratorSts 0;
BA_ "GenSigTimeoutTime_DTCM" SG_ 159 DeceleratorSts 0;
BA_ "GenSigTimeoutTime_DMSM" SG_ 159 DeceleratorSts 0;
BA_ "GenSigTimeoutTime_BCM" SG_ 159 DeceleratorSts 0;
BA_ "GenSigTimeoutTime_AGSM" SG_ 159 DeceleratorSts 0;
BA_ "GenSigTimeoutTime_RFHM" SG_ 159 ResumeSwitch 0;
BA_ "GenSigTimeoutTime_IPC" SG_ 159 ResumeSwitch 0;
BA_ "GenSigTimeoutTime_GNMM" SG_ 159 ResumeSwitch 0;
BA_ "GenSigTimeoutTime_ESL" SG_ 159 ResumeSwitch 0;
BA_ "GenSigTimeoutTime_ECM" SG_ 159 ResumeSwitch 0;
BA_ "GenSigTimeoutTime_DTCM" SG_ 159 ResumeSwitch 0;
BA_ "GenSigTimeoutTime_DMSM" SG_ 159 ResumeSwitch 0;
BA_ "GenSigTimeoutTime_BCM" SG_ 159 ResumeSwitch 0;
BA_ "GenSigTimeoutTime_AGSM" SG_ 159 ResumeSwitch 0;
BA_ "GenSigTimeoutTime_SGW" SG_ 512 Braking_Mode_Req 0;
BA_ "GenSigTimeoutTime_RFHM" SG_ 512 Braking_Mode_Req 0;
BA_ "GenSigTimeoutTime_MPAD" SG_ 512 Braking_Mode_Req 0;
BA_ "GenSigTimeoutTime_IPC" SG_ 512 Braking_Mode_Req 0;
BA_ "GenSigTimeoutTime_GNMM" SG_ 512 Braking_Mode_Req 0;
BA_ "GenSigTimeoutTime_ESL" SG_ 512 Braking_Mode_Req 0;
BA_ "GenSigTimeoutTime_ECM" SG_ 512 Braking_Mode_Req 0;
BA_ "GenSigTimeoutTime_DTCM" SG_ 512 Braking_Mode_Req 0;
BA_ "GenSigTimeoutTime_DMSM" SG_ 512 Braking_Mode_Req 0;
BA_ "GenSigTimeoutTime_BSM" SG_ 512 Braking_Mode_Req 0;
BA_ "GenSigTimeoutTime_BCM" SG_ 512 Braking_Mode_Req 0;
BA_ "GenSigTimeoutTime_AGSM" SG_ 512 Braking_Mode_Req 0;
BA_ "GenSigTimeoutTime_ADCAM" SG_ 512 Braking_Mode_Req 0;
BA_ "GenSigTimeoutTime_SGW" SG_ 512 Fuel_Door_Sts 0;
BA_ "GenSigTimeoutTime_RFHM" SG_ 512 Fuel_Door_Sts 0;
BA_ "GenSigTimeoutTime_MPAD" SG_ 512 Fuel_Door_Sts 0;
BA_ "GenSigTimeoutTime_IPC" SG_ 512 Fuel_Door_Sts 0;
BA_ "GenSigTimeoutTime_GNMM" SG_ 512 Fuel_Door_Sts 0;
BA_ "GenSigTimeoutTime_EVCU2" SG_ 512 Fuel_Door_Sts 0;
BA_ "GenSigTimeoutTime_ESL" SG_ 512 Fuel_Door_Sts 0;
BA_ "GenSigTimeoutTime_DTCM" SG_ 512 Fuel_Door_Sts 0;
BA_ "GenSigTimeoutTime_DMSM" SG_ 512 Fuel_Door_Sts 0;
BA_ "GenSigTimeoutTime_BSM" SG_ 512 Fuel_Door_Sts 0;
BA_ "GenSigTimeoutTime_BCM" SG_ 512 Fuel_Door_Sts 0;
BA_ "GenSigTimeoutTime_AGSM" SG_ 512 Fuel_Door_Sts 0;
BA_ "GenSigTimeoutTime_ADCAM" SG_ 512 Fuel_Door_Sts 0;
BA_ "GenSigTimeoutTime_BCM" SG_ 512 MessageCounter_BCM18 0;
BA_ "GenSigTimeoutTime_AGSM" SG_ 512 MessageCounter_BCM18 0;
BA_ "GenSigTimeoutTime_ADCAM" SG_ 512 MessageCounter_BCM18 0;
BA_ "GenSigTimeoutTime_SGW" SG_ 512 CRC_BCM18 0;
BA_ "GenSigTimeoutTime_RFHM" SG_ 512 CRC_BCM18 0;
BA_ "GenSigTimeoutTime_MPAD" SG_ 512 CRC_BCM18 0;
BA_ "GenSigTimeoutTime_IPC" SG_ 512 CRC_BCM18 0;
BA_ "GenSigTimeoutTime_GNMM" SG_ 512 CRC_BCM18 0;
BA_ "GenSigTimeoutTime_ESL" SG_ 512 CRC_BCM18 0;
BA_ "GenSigTimeoutTime_ECM" SG_ 512 CRC_BCM18 0;
BA_ "GenSigTimeoutTime_DTCM" SG_ 512 CRC_BCM18 0;
BA_ "GenSigTimeoutTime_DMSM" SG_ 512 CRC_BCM18 0;
BA_ "GenSigTimeoutTime_BCM" SG_ 512 CRC_BCM18 0;
BA_ "GenSigTimeoutTime_AGSM" SG_ 512 CRC_BCM18 0;
BA_ "GenSigTimeoutTime_ADCAM" SG_ 512 CRC_BCM18 0;
BA_ "GenSigTimeoutTime_SGW" SG_ 1431 DALM_Status 0;
BA_ "GenSigTimeoutTime_RFHM" SG_ 1431 DALM_Status 0;
BA_ "GenSigTimeoutTime_IPC" SG_ 1431 DALM_Status 0;
BA_ "GenSigTimeoutTime_GNMM" SG_ 1431 DALM_Status 0;
BA_ "GenSigTimeoutTime_EVCU2" SG_ 1431 DALM_Status 0;
BA_ "GenSigTimeoutTime_ESL" SG_ 1431 DALM_Status 0;
BA_ "GenSigTimeoutTime_ECM" SG_ 1431 DALM_Status 0;
BA_ "GenSigTimeoutTime_DTCM" SG_ 1431 DALM_Status 0;
BA_ "GenSigTimeoutTime_DMSM" SG_ 1431 DALM_Status 0;
BA_ "GenSigTimeoutTime_BSM" SG_ 1431 DALM_Status 0;
BA_ "GenSigTimeoutTime_BCM" SG_ 1431 DALM_Status 0;
BA_ "GenSigTimeoutTime_AGSM" SG_ 1431 DALM_Status 0;
BA_ "GenSigTimeoutTime_ADCAM" SG_ 1431 DALM_Status 0;
BA_ "GenSigSendType" SG_ 1431 DALM_Status 3;
BA_ "GenSigTimeoutTime_RFHM" SG_ 1430 DCSD_TUNEKNOB_DIR 0;
BA_ "GenSigTimeoutTime_MPAD" SG_ 1430 DCSD_TUNEKNOB_DIR 0;
BA_ "GenSigTimeoutTime_IPC" SG_ 1430 DCSD_TUNEKNOB_DIR 0;
BA_ "GenSigTimeoutTime_GNMM" SG_ 1430 DCSD_TUNEKNOB_DIR 0;
BA_ "GenSigTimeoutTime_EVCU2" SG_ 1430 DCSD_TUNEKNOB_DIR 0;
BA_ "GenSigTimeoutTime_ESL" SG_ 1430 DCSD_TUNEKNOB_DIR 0;
BA_ "GenSigTimeoutTime_ECM" SG_ 1430 DCSD_TUNEKNOB_DIR 0;
BA_ "GenSigTimeoutTime_RFHM" SG_ 1430 DCSD_TUNEKNOB_VAL 0;
BA_ "GenSigTimeoutTime_MPAD" SG_ 1430 DCSD_TUNEKNOB_VAL 0;
BA_ "GenSigTimeoutTime_IPC" SG_ 1430 DCSD_TUNEKNOB_VAL 0;
BA_ "GenSigTimeoutTime_GNMM" SG_ 1430 DCSD_TUNEKNOB_VAL 0;
BA_ "GenSigTimeoutTime_EVCU2" SG_ 1430 DCSD_TUNEKNOB_VAL 0;
BA_ "GenSigTimeoutTime_ESL" SG_ 1430 DCSD_TUNEKNOB_VAL 0;
BA_ "GenSigTimeoutTime_ECM" SG_ 1430 DCSD_TUNEKNOB_VAL 0;
BA_ "GenSigTimeoutTime_DTCM" SG_ 1430 DCSD_TUNEKNOB_VAL 0;
BA_ "GenSigTimeoutTime_DMSM" SG_ 1430 DCSD_TUNEKNOB_VAL 0;
BA_ "GenSigTimeoutTime_BSM" SG_ 1430 DCSD_TUNEKNOB_VAL 0;
BA_ "GenSigTimeoutTime_BCM" SG_ 1430 DCSD_TUNEKNOB_VAL 0;
BA_ "GenSigTimeoutTime_AGSM" SG_ 1430 DCSD_TUNEKNOB_VAL 0;
BA_ "GenSigTimeoutTime_ADCAM" SG_ 1430 DCSD_TUNEKNOB_VAL 0;
BA_ "GenSigSendType" SG_ 1430 DCSD_TUNEKNOB_VAL 3;
BA_ "GenSigTimeoutTime_SGW" SG_ 1431 AxleLckrSEL_SW 0;
BA_ "GenSigTimeoutTime_RFHM" SG_ 1431 AxleLckrSEL_SW 0;
BA_ "GenSigTimeoutTime_MPAD" SG_ 1431 AxleLckrSEL_SW 0;
BA_ "GenSigTimeoutTime_IPC" SG_ 1431 AxleLckrSEL_SW 0;
BA_ "GenSigTimeoutTime_GNMM" SG_ 1431 AxleLckrSEL_SW 0;
BA_ "GenSigTimeoutTime_EVCU2" SG_ 1431 AxleLckrSEL_SW 0;
BA_ "GenSigTimeoutTime_ESL" SG_ 1431 AxleLckrSEL_SW 0;
BA_ "GenSigTimeoutTime_ECM" SG_ 1431 AxleLckrSEL_SW 0;
BA_ "GenSigTimeoutTime_DMSM" SG_ 1431 AxleLckrSEL_SW 0;
BA_ "GenSigTimeoutTime_BSM" SG_ 1431 AxleLckrSEL_SW 0;
BA_ "GenSigTimeoutTime_BCM" SG_ 1431 AxleLckrSEL_SW 0;
BA_ "GenSigTimeoutTime_AGSM" SG_ 1431 AxleLckrSEL_SW 0;
BA_ "GenSigTimeoutTime_ADCAM" SG_ 1431 AxleLckrSEL_SW 0;
BA_ "GenSigSendType" SG_ 1431 AxleLckrSEL_SW 3;
BA_ "GenSigTimeoutTime_SGW" SG_ 1430 MessageCounter_BCM11 0;
BA_ "GenSigTimeoutTime_RFHM" SG_ 1430 MessageCounter_BCM11 0;
BA_ "GenSigTimeoutTime_MPAD" SG_ 1430 MessageCounter_BCM11 0;
BA_ "GenSigTimeoutTime_IPC" SG_ 1430 MessageCounter_BCM11 0;
BA_ "GenSigTimeoutTime_GNMM" SG_ 1430 MessageCounter_BCM11 0;
BA_ "GenSigTimeoutTime_EVCU2" SG_ 1430 MessageCounter_BCM11 0;
BA_ "GenSigTimeoutTime_ESL" SG_ 1430 MessageCounter_BCM11 0;
BA_ "GenSigTimeoutTime_ECM" SG_ 1430 MessageCounter_BCM11 0;
BA_ "GenSigTimeoutTime_DTCM" SG_ 1430 MessageCounter_BCM11 0;
BA_ "GenSigTimeoutTime_DMSM" SG_ 1430 MessageCounter_BCM11 0;
BA_ "GenSigTimeoutTime_BSM" SG_ 1430 MessageCounter_BCM11 0;
BA_ "GenSigTimeoutTime_BCM" SG_ 1430 MessageCounter_BCM11 0;
BA_ "GenSigTimeoutTime_AGSM" SG_ 1430 MessageCounter_BCM11 0;
BA_ "GenSigTimeoutTime_DTCM" SG_ 1431 SeatVib_Sts 0;
BA_ "GenSigTimeoutTime_DMSM" SG_ 1431 SeatVib_Sts 0;
BA_ "GenSigTimeoutTime_BSM" SG_ 1431 SeatVib_Sts 0;
BA_ "GenSigTimeoutTime_BCM" SG_ 1431 SeatVib_Sts 0;
BA_ "GenSigTimeoutTime_AGSM" SG_ 1431 SeatVib_Sts 0;
BA_ "GenSigTimeoutTime_ADCAM" SG_ 1431 SeatVib_Sts 0;
BA_ "GenSigSendType" SG_ 1431 SeatVib_Sts 3;
BA_ "GenSigTimeoutTime_SGW" SG_ 1430 CRC_BCM11 0;
BA_ "GenSigTimeoutTime_RFHM" SG_ 1430 CRC_BCM11 0;
BA_ "GenSigTimeoutTime_MPAD" SG_ 1430 CRC_BCM11 0;
BA_ "GenSigTimeoutTime_IPC" SG_ 1430 CRC_BCM11 0;
BA_ "GenSigTimeoutTime_GNMM" SG_ 1430 CRC_BCM11 0;
BA_ "GenSigTimeoutTime_EVCU2" SG_ 1430 CRC_BCM11 0;
BA_ "GenSigTimeoutTime_ESL" SG_ 1430 CRC_BCM11 0;
BA_ "GenSigTimeoutTime_ECM" SG_ 1430 CRC_BCM11 0;
BA_ "GenSigTimeoutTime_DTCM" SG_ 1430 CRC_BCM11 0;
BA_ "GenSigTimeoutTime_DMSM" SG_ 1430 CRC_BCM11 0;
BA_ "GenSigTimeoutTime_BSM" SG_ 1430 CRC_BCM11 0;
BA_ "GenSigTimeoutTime_BCM" SG_ 1430 CRC_BCM11 0;
BA_ "GenSigTimeoutTime_AGSM" SG_ 1430 CRC_BCM11 0;
BA_ "GenSigTimeoutTime_SGW" SG_ 1153 SCC_InhibitSts 0;
BA_ "GenSigTimeoutTime_RFHM" SG_ 1153 SCC_InhibitSts 0;
BA_ "GenSigTimeoutTime_MPAD" SG_ 1153 SCC_InhibitSts 0;
BA_ "GenSigTimeoutTime_GNMM" SG_ 1153 SCC_InhibitSts 0;
BA_ "GenSigTimeoutTime_EVCU2" SG_ 1153 SCC_InhibitSts 0;
BA_ "GenSigTimeoutTime_ESL" SG_ 1153 SCC_InhibitSts 0;
BA_ "GenSigTimeoutTime_ECM" SG_ 1153 SCC_InhibitSts 0;
BA_ "GenSigTimeoutTime_DTCM" SG_ 1153 SCC_InhibitSts 0;
BA_ "GenSigTimeoutTime_DMSM" SG_ 1153 SCC_InhibitSts 0;
BA_ "GenSigTimeoutTime_BSM" SG_ 1153 SCC_InhibitSts 0;
BA_ "GenSigTimeoutTime_BCM" SG_ 1153 SCC_InhibitSts 0;
BA_ "GenSigTimeoutTime_AGSM" SG_ 1153 SCC_InhibitSts 0;
BA_ "GenSigTimeoutTime_ADCAM" SG_ 1153 SCC_InhibitSts 0;
BA_ "GenSigSendType" SG_ 1153 SCC_InhibitSts 3;
BA_ "GenSigTimeoutTime_RFHM" SG_ 1153 FOA_Msg_Req 0;
BA_ "GenSigTimeoutTime_MPAD" SG_ 1153 FOA_Msg_Req 0;
BA_ "GenSigTimeoutTime_GNMM" SG_ 1153 FOA_Msg_Req 0;
BA_ "GenSigTimeoutTime_EVCU2" SG_ 1153 FOA_Msg_Req 0;
BA_ "GenSigTimeoutTime_ESL" SG_ 1153 FOA_Msg_Req 0;
BA_ "GenSigTimeoutTime_ECM" SG_ 1153 FOA_Msg_Req 0;
BA_ "GenSigTimeoutTime_DTCM" SG_ 1153 FOA_Msg_Req 0;
BA_ "GenSigTimeoutTime_DMSM" SG_ 1153 FOA_Msg_Req 0;
BA_ "GenSigTimeoutTime_BSM" SG_ 1153 FOA_Msg_Req 0;
BA_ "GenSigTimeoutTime_BCM" SG_ 1153 FOA_Msg_Req 0;
BA_ "GenSigTimeoutTime_AGSM" SG_ 1153 FOA_Msg_Req 0;
BA_ "GenSigTimeoutTime_ADCAM" SG_ 1153 FOA_Msg_Req 0;
BA_ "GenSigSendType" SG_ 1153 FOA_Msg_Req 3;
BA_ "GenSigTimeoutTime_MPAD" SG_ 1153 DAY_LGT_MD 0;
BA_ "GenSigTimeoutTime_GNMM" SG_ 1153 DAY_LGT_MD 0;
BA_ "GenSigTimeoutTime_ESL" SG_ 1153 DAY_LGT_MD 0;
BA_ "GenSigTimeoutTime_ECM" SG_ 1153 DAY_LGT_MD 0;
BA_ "GenSigTimeoutTime_DTCM" SG_ 1153 DAY_LGT_MD 0;
BA_ "GenSigTimeoutTime_DMSM" SG_ 1153 DAY_LGT_MD 0;
BA_ "GenSigTimeoutTime_BCM" SG_ 1153 DAY_LGT_MD 0;
BA_ "GenSigTimeoutTime_ADCAM" SG_ 1153 DAY_LGT_MD 0;
BA_ "GenSigSendType" SG_ 1153 DAY_LGT_MD 3;
BA_ "GenSigTimeoutTime_RFHM" SG_ 1153 FOA_Mobile_App_Alert 0;
BA_ "GenSigTimeoutTime_MPAD" SG_ 1153 FOA_Mobile_App_Alert 0;
BA_ "GenSigTimeoutTime_IPC" SG_ 1153 FOA_Mobile_App_Alert 0;
BA_ "GenSigTimeoutTime_GNMM" SG_ 1153 FOA_Mobile_App_Alert 0;
BA_ "GenSigTimeoutTime_EVCU2" SG_ 1153 FOA_Mobile_App_Alert 0;
BA_ "GenSigTimeoutTime_ESL" SG_ 1153 FOA_Mobile_App_Alert 0;
BA_ "GenSigTimeoutTime_ECM" SG_ 1153 FOA_Mobile_App_Alert 0;
BA_ "GenSigTimeoutTime_DTCM" SG_ 1153 FOA_Mobile_App_Alert 0;
BA_ "GenSigTimeoutTime_DMSM" SG_ 1153 FOA_Mobile_App_Alert 0;
BA_ "GenSigTimeoutTime_BSM" SG_ 1153 FOA_Mobile_App_Alert 0;
BA_ "GenSigTimeoutTime_BCM" SG_ 1153 FOA_Mobile_App_Alert 0;
BA_ "GenSigTimeoutTime_AGSM" SG_ 1153 FOA_Mobile_App_Alert 0;
BA_ "GenSigTimeoutTime_ADCAM" SG_ 1153 FOA_Mobile_App_Alert 0;
BA_ "GenSigSendType" SG_ 1153 FOA_Mobile_App_Alert 3;
BA_ "GenSigTimeoutTime_DTCM" SG_ 1430 DCSD_TUNEKNOB_DIR 0;
BA_ "GenSigTimeoutTime_DMSM" SG_ 1430 DCSD_TUNEKNOB_DIR 0;
BA_ "GenSigTimeoutTime_BSM" SG_ 1430 DCSD_TUNEKNOB_DIR 0;
BA_ "GenSigTimeoutTime_BCM" SG_ 1430 DCSD_TUNEKNOB_DIR 0;
BA_ "GenSigTimeoutTime_AGSM" SG_ 1430 DCSD_TUNEKNOB_DIR 0;
BA_ "GenSigTimeoutTime_ADCAM" SG_ 1430 DCSD_TUNEKNOB_DIR 0;
BA_ "GenSigSendType" SG_ 1430 DCSD_TUNEKNOB_DIR 3;
BA_ "GenSigTimeoutTime_SGW" SG_ 1430 A2D_DRV_TEMP_DR_POS 0;
BA_ "GenSigTimeoutTime_RFHM" SG_ 1430 A2D_DRV_TEMP_DR_POS 0;
BA_ "GenSigTimeoutTime_MPAD" SG_ 1430 A2D_DRV_TEMP_DR_POS 0;
BA_ "GenSigTimeoutTime_IPC" SG_ 1430 A2D_DRV_TEMP_DR_POS 0;
BA_ "GenSigTimeoutTime_GNMM" SG_ 1430 A2D_DRV_TEMP_DR_POS 0;
BA_ "GenSigTimeoutTime_EVCU2" SG_ 1430 A2D_DRV_TEMP_DR_POS 0;
BA_ "GenSigTimeoutTime_ESL" SG_ 1430 A2D_DRV_TEMP_DR_POS 0;
BA_ "GenSigTimeoutTime_DTCM" SG_ 1430 A2D_DRV_TEMP_DR_POS 0;
BA_ "GenSigTimeoutTime_DMSM" SG_ 1430 A2D_DRV_TEMP_DR_POS 0;
BA_ "GenSigTimeoutTime_BSM" SG_ 1430 A2D_DRV_TEMP_DR_POS 0;
BA_ "GenSigTimeoutTime_BCM" SG_ 1430 A2D_DRV_TEMP_DR_POS 0;
BA_ "GenSigTimeoutTime_AGSM" SG_ 1430 A2D_DRV_TEMP_DR_POS 0;
BA_ "GenSigTimeoutTime_ADCAM" SG_ 1430 A2D_DRV_TEMP_DR_POS 0;
BA_ "GenSigSendType" SG_ 1430 A2D_DRV_TEMP_DR_POS 3;
BA_ "GenSigStartValue" SG_ 1430 A2D_DRV_TEMP_DR_POS 819;
BA_ "GenSigTimeoutTime_RFHM" SG_ 1430 DCSD_Enter 0;
BA_ "GenSigTimeoutTime_MPAD" SG_ 1430 DCSD_Enter 0;
BA_ "GenSigTimeoutTime_IPC" SG_ 1430 DCSD_Enter 0;
BA_ "GenSigTimeoutTime_GNMM" SG_ 1430 DCSD_Enter 0;
BA_ "GenSigTimeoutTime_EVCU2" SG_ 1430 DCSD_Enter 0;
BA_ "GenSigTimeoutTime_ESL" SG_ 1430 DCSD_Enter 0;
BA_ "GenSigTimeoutTime_ECM" SG_ 1430 DCSD_Enter 0;
BA_ "GenSigTimeoutTime_DTCM" SG_ 1430 DCSD_Enter 0;
BA_ "GenSigTimeoutTime_DMSM" SG_ 1430 DCSD_Enter 0;
BA_ "GenSigTimeoutTime_BSM" SG_ 1430 DCSD_Enter 0;
BA_ "GenSigTimeoutTime_BCM" SG_ 1430 DCSD_Enter 0;
BA_ "GenSigTimeoutTime_AGSM" SG_ 1430 DCSD_Enter 0;
BA_ "GenSigTimeoutTime_ADCAM" SG_ 1430 DCSD_Enter 0;
BA_ "GenSigSendType" SG_ 1430 DCSD_Enter 3;
BA_ "GenSigTimeoutTime_RFHM" SG_ 1430 Batt_ST_Crit 0;
BA_ "GenSigTimeoutTime_MPAD" SG_ 1430 Batt_ST_Crit 0;
BA_ "GenSigTimeoutTime_GNMM" SG_ 1430 Batt_ST_Crit 0;
BA_ "GenSigTimeoutTime_EVCU2" SG_ 1430 Batt_ST_Crit 0;
BA_ "GenSigTimeoutTime_ESL" SG_ 1430 Batt_ST_Crit 0;
BA_ "GenSigTimeoutTime_ECM" SG_ 1430 Batt_ST_Crit 0;
BA_ "GenSigTimeoutTime_DTCM" SG_ 1430 Batt_ST_Crit 0;
BA_ "GenSigTimeoutTime_DMSM" SG_ 1430 Batt_ST_Crit 0;
BA_ "GenSigTimeoutTime_BSM" SG_ 1430 Batt_ST_Crit 0;
BA_ "GenSigTimeoutTime_BCM" SG_ 1430 Batt_ST_Crit 0;
BA_ "GenSigTimeoutTime_AGSM" SG_ 1430 Batt_ST_Crit 0;
BA_ "GenSigTimeoutTime_SGW" SG_ 1153 WPR_SYS_AUTO 0;
BA_ "GenSigTimeoutTime_RFHM" SG_ 1153 WPR_SYS_AUTO 0;
BA_ "GenSigTimeoutTime_IPC" SG_ 1153 WPR_SYS_AUTO 0;
BA_ "GenSigTimeoutTime_GNMM" SG_ 1153 WPR_SYS_AUTO 0;
BA_ "GenSigTimeoutTime_EVCU2" SG_ 1153 WPR_SYS_AUTO 0;
BA_ "GenSigTimeoutTime_ESL" SG_ 1153 WPR_SYS_AUTO 0;
BA_ "GenSigTimeoutTime_ECM" SG_ 1153 WPR_SYS_AUTO 0;
BA_ "GenSigTimeoutTime_DTCM" SG_ 1153 WPR_SYS_AUTO 0;
BA_ "GenSigTimeoutTime_DMSM" SG_ 1153 WPR_SYS_AUTO 0;
BA_ "GenSigTimeoutTime_BSM" SG_ 1153 WPR_SYS_AUTO 0;
BA_ "GenSigTimeoutTime_BCM" SG_ 1153 WPR_SYS_AUTO 0;
BA_ "GenSigTimeoutTime_AGSM" SG_ 1153 WPR_SYS_AUTO 0;
BA_ "GenSigSendType" SG_ 1153 WPR_SYS_AUTO 3;
BA_ "GenSigTimeoutTime_SGW" SG_ 1445 MessageCounter_ASCM2 0;
BA_ "GenSigTimeoutTime_RFHM" SG_ 1445 MessageCounter_ASCM2 0;
BA_ "GenSigTimeoutTime_MPAD" SG_ 1445 MessageCounter_ASCM2 0;
BA_ "GenSigTimeoutTime_IPC" SG_ 1445 MessageCounter_ASCM2 0;
BA_ "GenSigTimeoutTime_GNMM" SG_ 1445 MessageCounter_ASCM2 0;
BA_ "GenSigTimeoutTime_EVCU2" SG_ 1445 MessageCounter_ASCM2 0;
BA_ "GenSigTimeoutTime_ESL" SG_ 1445 MessageCounter_ASCM2 0;
BA_ "GenSigTimeoutTime_ECM" SG_ 1445 MessageCounter_ASCM2 0;
BA_ "GenSigTimeoutTime_DTCM" SG_ 1445 MessageCounter_ASCM2 0;
BA_ "GenSigTimeoutTime_DMSM" SG_ 1445 MessageCounter_ASCM2 0;
BA_ "GenSigTimeoutTime_BCM" SG_ 1445 MessageCounter_ASCM2 0;
BA_ "GenSigTimeoutTime_AGSM" SG_ 1445 MessageCounter_ASCM2 0;
BA_ "GenSigTimeoutTime_ADCAM" SG_ 1445 MessageCounter_ASCM2 0;
BA_ "GenSigTimeoutTime_SGW" SG_ 1445 CRC_ASCM2 0;
BA_ "GenSigTimeoutTime_RFHM" SG_ 1445 CRC_ASCM2 0;
BA_ "GenSigTimeoutTime_MPAD" SG_ 1445 CRC_ASCM2 0;
BA_ "GenSigTimeoutTime_IPC" SG_ 1445 CRC_ASCM2 0;
BA_ "GenSigTimeoutTime_GNMM" SG_ 1445 CRC_ASCM2 0;
BA_ "GenSigTimeoutTime_EVCU2" SG_ 1445 CRC_ASCM2 0;
BA_ "GenSigTimeoutTime_ESL" SG_ 1445 CRC_ASCM2 0;
BA_ "GenSigTimeoutTime_ECM" SG_ 1445 CRC_ASCM2 0;
BA_ "GenSigTimeoutTime_DTCM" SG_ 1445 CRC_ASCM2 0;
BA_ "GenSigTimeoutTime_DMSM" SG_ 1445 CRC_ASCM2 0;
BA_ "GenSigTimeoutTime_BCM" SG_ 1445 CRC_ASCM2 0;
BA_ "GenSigTimeoutTime_AGSM" SG_ 1445 CRC_ASCM2 0;
BA_ "GenSigTimeoutTime_ADCAM" SG_ 1445 CRC_ASCM2 0;
BA_ "GenSigTimeoutTime_MPAD" SG_ 256 RemStActvSts 0;
BA_ "GenSigTimeoutTime_GNMM" SG_ 256 RemStActvSts 0;
BA_ "GenSigTimeoutTime_ESL" SG_ 256 RemStActvSts 0;
BA_ "GenSigTimeoutTime_ECM" SG_ 256 RemStActvSts 0;
BA_ "GenSigTimeoutTime_DTCM" SG_ 256 RemStActvSts 0;
BA_ "GenSigTimeoutTime_DMSM" SG_ 256 RemStActvSts 0;
BA_ "GenSigTimeoutTime_BSM" SG_ 256 RemStActvSts 0;
BA_ "GenSigTimeoutTime_BCM" SG_ 256 RemStActvSts 0;
BA_ "GenSigTimeoutTime_AGSM" SG_ 256 RemStActvSts 0;
BA_ "GenSigTimeoutTime_SGW" SG_ 256 RemStActvSts_R 0;
BA_ "GenSigTimeoutTime_RFHM" SG_ 256 RemStActvSts_R 0;
BA_ "GenSigTimeoutTime_IPC" SG_ 256 RemStActvSts_R 0;
BA_ "GenSigTimeoutTime_GNMM" SG_ 256 RemStActvSts_R 0;
BA_ "GenSigTimeoutTime_ESL" SG_ 256 RemStActvSts_R 0;
BA_ "GenSigTimeoutTime_ECM" SG_ 256 RemStActvSts_R 0;
BA_ "GenSigTimeoutTime_DMSM" SG_ 256 RemStActvSts_R 0;
BA_ "GenSigTimeoutTime_BSM" SG_ 256 RemStActvSts_R 0;
BA_ "GenSigTimeoutTime_BCM" SG_ 256 RemStActvSts_R 0;
BA_ "GenSigTimeoutTime_AGSM" SG_ 256 RemStActvSts_R 0;
BA_ "GenSigTimeoutTime_ADCAM" SG_ 256 RemStActvSts_R 0;
BA_ "GenSigTimeoutTime_RFHM" SG_ 256 TurnIndicatorSts 0;
BA_ "GenSigTimeoutTime_IPC" SG_ 256 TurnIndicatorSts 0;
BA_ "GenSigTimeoutTime_GNMM" SG_ 256 TurnIndicatorSts 0;
BA_ "GenSigTimeoutTime_EVCU2" SG_ 256 TurnIndicatorSts 0;
BA_ "GenSigTimeoutTime_ESL" SG_ 256 TurnIndicatorSts 0;
BA_ "GenSigTimeoutTime_ECM" SG_ 256 TurnIndicatorSts 0;
BA_ "GenSigTimeoutTime_DTCM" SG_ 256 TurnIndicatorSts 0;
BA_ "GenSigTimeoutTime_DMSM" SG_ 256 TurnIndicatorSts 0;
BA_ "GenSigTimeoutTime_BSM" SG_ 256 TurnIndicatorSts 0;
BA_ "GenSigTimeoutTime_BCM" SG_ 256 TurnIndicatorSts 0;
BA_ "GenSigTimeoutTime_AGSM" SG_ 256 TurnIndicatorSts 0;
BA_ "GenSigTimeoutTime_ADCAM" SG_ 256 TurnIndicatorSts 0;
BA_ "GenSigTimeoutTime_SGW" SG_ 256 BrkPdlStat_BCM 0;
BA_ "GenSigTimeoutTime_MPAD" SG_ 256 BrkPdlStat_BCM 0;
BA_ "GenSigTimeoutTime_IPC" SG_ 256 BrkPdlStat_BCM 0;
BA_ "GenSigTimeoutTime_GNMM" SG_ 256 BrkPdlStat_BCM 0;
BA_ "GenSigTimeoutTime_EVCU2" SG_ 256 BrkPdlStat_BCM 0;
BA_ "GenSigTimeoutTime_ESL" SG_ 256 BrkPdlStat_BCM 0;
BA_ "GenSigTimeoutTime_ECM" SG_ 256 BrkPdlStat_BCM 0;
BA_ "GenSigTimeoutTime_DTCM" SG_ 256 BrkPdlStat_BCM 0;
BA_ "GenSigTimeoutTime_DMSM" SG_ 256 BrkPdlStat_BCM 0;
BA_ "GenSigTimeoutTime_BSM" SG_ 256 BrkPdlStat_BCM 0;
BA_ "GenSigTimeoutTime_BCM" SG_ 256 BrkPdlStat_BCM 0;
BA_ "GenSigTimeoutTime_AGSM" SG_ 256 BrkPdlStat_BCM 0;
BA_ "GenSigTimeoutTime_ADCAM" SG_ 256 BrkPdlStat_BCM 0;
BA_ "GenSigTimeoutTime_SGW" SG_ 256 CRC_BCM2 0;
BA_ "GenSigTimeoutTime_RFHM" SG_ 256 CRC_BCM2 0;
BA_ "GenSigTimeoutTime_IPC" SG_ 256 CRC_BCM2 0;
BA_ "GenSigTimeoutTime_GNMM" SG_ 256 CRC_BCM2 0;
BA_ "GenSigTimeoutTime_ESL" SG_ 256 CRC_BCM2 0;
BA_ "GenSigTimeoutTime_ECM" SG_ 256 CRC_BCM2 0;
BA_ "GenSigTimeoutTime_DTCM" SG_ 256 CRC_BCM2 0;
BA_ "GenSigTimeoutTime_BCM" SG_ 256 CRC_BCM2 0;
BA_ "GenSigTimeoutTime_AGSM" SG_ 256 CRC_BCM2 0;
BA_ "GenSigTimeoutTime_SGW" SG_ 256 MessageCounter_BCM2 0;
BA_ "GenSigTimeoutTime_RFHM" SG_ 256 MessageCounter_BCM2 0;
BA_ "GenSigTimeoutTime_IPC" SG_ 256 MessageCounter_BCM2 0;
BA_ "GenSigTimeoutTime_GNMM" SG_ 256 MessageCounter_BCM2 0;
BA_ "GenSigTimeoutTime_ESL" SG_ 256 MessageCounter_BCM2 0;
BA_ "GenSigTimeoutTime_ECM" SG_ 256 MessageCounter_BCM2 0;
BA_ "GenSigTimeoutTime_DTCM" SG_ 256 MessageCounter_BCM2 0;
BA_ "GenSigTimeoutTime_BCM" SG_ 256 MessageCounter_BCM2 0;
BA_ "GenSigTimeoutTime_AGSM" SG_ 256 MessageCounter_BCM2 0;
BA_ "GenSigTimeoutTime_SGW" SG_ 256 RefuelRequest 0;
BA_ "GenSigTimeoutTime_RFHM" SG_ 256 RefuelRequest 0;
BA_ "GenSigTimeoutTime_MPAD" SG_ 256 RefuelRequest 0;
BA_ "GenSigTimeoutTime_IPC" SG_ 256 RefuelRequest 0;
BA_ "GenSigTimeoutTime_GNMM" SG_ 256 RefuelRequest 0;
BA_ "GenSigTimeoutTime_EVCU2" SG_ 256 RefuelRequest 0;
BA_ "GenSigTimeoutTime_ESL" SG_ 256 RefuelRequest 0;
BA_ "GenSigTimeoutTime_DTCM" SG_ 256 RefuelRequest 0;
BA_ "GenSigTimeoutTime_DMSM" SG_ 256 RefuelRequest 0;
BA_ "GenSigTimeoutTime_BSM" SG_ 256 RefuelRequest 0;
BA_ "GenSigTimeoutTime_BCM" SG_ 256 RefuelRequest 0;
BA_ "GenSigTimeoutTime_AGSM" SG_ 256 RefuelRequest 0;
BA_ "GenSigTimeoutTime_ADCAM" SG_ 256 RefuelRequest 0;
BA_ "GenSigTimeoutTime_BCM" SG_ 256 OperationalModeSts 0;
BA_ "GenSigTimeoutTime_RFHM" SG_ 256 KeyInIgnSts 0;
BA_ "GenSigTimeoutTime_MPAD" SG_ 256 KeyInIgnSts 0;
BA_ "GenSigTimeoutTime_IPC" SG_ 256 KeyInIgnSts 0;
BA_ "GenSigTimeoutTime_GNMM" SG_ 256 KeyInIgnSts 0;
BA_ "GenSigTimeoutTime_ECM" SG_ 256 KeyInIgnSts 0;
BA_ "GenSigTimeoutTime_DTCM" SG_ 256 KeyInIgnSts 0;
BA_ "GenSigTimeoutTime_DMSM" SG_ 256 KeyInIgnSts 0;
BA_ "GenSigTimeoutTime_BSM" SG_ 256 KeyInIgnSts 0;
BA_ "GenSigTimeoutTime_BCM" SG_ 256 KeyInIgnSts 0;
BA_ "GenSigTimeoutTime_AGSM" SG_ 256 KeyInIgnSts 0;
BA_ "GenSigTimeoutTime_ADCAM" SG_ 256 KeyInIgnSts 0;
BA_ "GenSigTimeoutTime_SGW" SG_ 256 EngineOffRequest 0;
BA_ "GenSigTimeoutTime_RFHM" SG_ 256 EngineOffRequest 0;
BA_ "GenSigTimeoutTime_MPAD" SG_ 256 EngineOffRequest 0;
BA_ "GenSigTimeoutTime_IPC" SG_ 256 EngineOffRequest 0;
BA_ "GenSigTimeoutTime_GNMM" SG_ 256 EngineOffRequest 0;
BA_ "GenSigTimeoutTime_EVCU2" SG_ 256 EngineOffRequest 0;
BA_ "GenSigTimeoutTime_ESL" SG_ 256 EngineOffRequest 0;
BA_ "GenSigTimeoutTime_ECM" SG_ 256 EngineOffRequest 0;
BA_ "GenSigTimeoutTime_DTCM" SG_ 256 EngineOffRequest 0;
BA_ "GenSigTimeoutTime_DMSM" SG_ 256 EngineOffRequest 0;
BA_ "GenSigTimeoutTime_BSM" SG_ 256 EngineOffRequest 0;
BA_ "GenSigTimeoutTime_BCM" SG_ 256 EngineOffRequest 0;
BA_ "GenSigTimeoutTime_AGSM" SG_ 256 EngineOffRequest 0;
BA_ "GenSigTimeoutTime_ADCAM" SG_ 256 EngineOffRequest 0;
BA_ "GenSigTimeoutTime_ECM" SG_ 736 Command_03Sts 0;
BA_ "GenSigTimeoutTime_DTCM" SG_ 736 Command_03Sts 0;
BA_ "GenSigTimeoutTime_DMSM" SG_ 736 Command_03Sts 0;
BA_ "GenSigTimeoutTime_BSM" SG_ 736 Command_03Sts 0;
BA_ "GenSigTimeoutTime_BCM" SG_ 736 Command_03Sts 0;
BA_ "GenSigTimeoutTime_AGSM" SG_ 736 Command_03Sts 0;
BA_ "GenSigSendType" SG_ 736 Command_03Sts 3;
BA_ "GenSigTimeoutTime_RFHM" SG_ 159 ACC_DistSwDec 0;
BA_ "GenSigTimeoutTime_IPC" SG_ 159 ACC_DistSwDec 0;
BA_ "GenSigTimeoutTime_GNMM" SG_ 159 ACC_DistSwDec 0;
BA_ "GenSigTimeoutTime_EVCU2" SG_ 159 ACC_DistSwDec 0;
BA_ "GenSigTimeoutTime_ESL" SG_ 159 ACC_DistSwDec 0;
BA_ "GenSigTimeoutTime_ECM" SG_ 159 ACC_DistSwDec 0;
BA_ "GenSigTimeoutTime_DTCM" SG_ 159 ACC_DistSwDec 0;
BA_ "GenSigTimeoutTime_DMSM" SG_ 159 ACC_DistSwDec 0;
BA_ "GenSigTimeoutTime_BSM" SG_ 159 ACC_DistSwDec 0;
BA_ "GenSigTimeoutTime_BCM" SG_ 159 ACC_DistSwDec 0;
BA_ "GenSigTimeoutTime_AGSM" SG_ 159 ACC_DistSwDec 0;
BA_ "GenSigSendType" SG_ 159 ACC_DistSwDec 1;
BA_ "GenSigTimeoutTime_SGW" SG_ 1431 Switch1_Rq 0;
BA_ "GenSigTimeoutTime_RFHM" SG_ 1431 Switch1_Rq 0;
BA_ "GenSigTimeoutTime_MPAD" SG_ 1431 Switch1_Rq 0;
BA_ "GenSigTimeoutTime_IPC" SG_ 1431 Switch1_Rq 0;
BA_ "GenSigTimeoutTime_GNMM" SG_ 1431 Switch1_Rq 0;
BA_ "GenSigTimeoutTime_EVCU2" SG_ 1431 Switch1_Rq 0;
BA_ "GenSigTimeoutTime_ESL" SG_ 1431 Switch1_Rq 0;
BA_ "GenSigTimeoutTime_ECM" SG_ 1431 Switch1_Rq 0;
BA_ "GenSigTimeoutTime_DMSM" SG_ 1431 Switch1_Rq 0;
BA_ "GenSigTimeoutTime_BSM" SG_ 1431 Switch1_Rq 0;
BA_ "GenSigTimeoutTime_BCM" SG_ 1431 Switch1_Rq 0;
BA_ "GenSigTimeoutTime_AGSM" SG_ 1431 Switch1_Rq 0;
BA_ "GenSigTimeoutTime_ADCAM" SG_ 1431 Switch1_Rq 0;
BA_ "GenSigSendType" SG_ 1431 Switch1_Rq 3;
BA_ "GenSigStartValue" SG_ 1431 Switch1_Rq 3;
BA_ "GenSigTimeoutTime_SGW" SG_ 1431 Switch2_Rq 0;
BA_ "GenSigTimeoutTime_RFHM" SG_ 1431 Switch2_Rq 0;
BA_ "GenSigTimeoutTime_MPAD" SG_ 1431 Switch2_Rq 0;
BA_ "GenSigTimeoutTime_IPC" SG_ 1431 Switch2_Rq 0;
BA_ "GenSigTimeoutTime_GNMM" SG_ 1431 Switch2_Rq 0;
BA_ "GenSigTimeoutTime_EVCU2" SG_ 1431 Switch2_Rq 0;
BA_ "GenSigTimeoutTime_ESL" SG_ 1431 Switch2_Rq 0;
BA_ "GenSigTimeoutTime_ECM" SG_ 1431 Switch2_Rq 0;
BA_ "GenSigTimeoutTime_DMSM" SG_ 1431 Switch2_Rq 0;
BA_ "GenSigTimeoutTime_BSM" SG_ 1431 Switch2_Rq 0;
BA_ "GenSigTimeoutTime_BCM" SG_ 1431 Switch2_Rq 0;
BA_ "GenSigTimeoutTime_AGSM" SG_ 1431 Switch2_Rq 0;
BA_ "GenSigTimeoutTime_ADCAM" SG_ 1431 Switch2_Rq 0;
BA_ "GenSigSendType" SG_ 1431 Switch2_Rq 3;
BA_ "GenSigStartValue" SG_ 1431 Switch2_Rq 3;
BA_ "GenSigTimeoutTime_RFHM" SG_ 159 ACC_DistSwInc 0;
BA_ "GenSigTimeoutTime_IPC" SG_ 159 ACC_DistSwInc 0;
BA_ "GenSigTimeoutTime_GNMM" SG_ 159 ACC_DistSwInc 0;
BA_ "GenSigTimeoutTime_EVCU2" SG_ 159 ACC_DistSwInc 0;
BA_ "GenSigTimeoutTime_ESL" SG_ 159 ACC_DistSwInc 0;
BA_ "GenSigTimeoutTime_ECM" SG_ 159 ACC_DistSwInc 0;
BA_ "GenSigTimeoutTime_DTCM" SG_ 159 ACC_DistSwInc 0;
BA_ "GenSigTimeoutTime_DMSM" SG_ 159 ACC_DistSwInc 0;
BA_ "GenSigTimeoutTime_BSM" SG_ 159 ACC_DistSwInc 0;
BA_ "GenSigTimeoutTime_BCM" SG_ 159 ACC_DistSwInc 0;
BA_ "GenSigTimeoutTime_AGSM" SG_ 159 ACC_DistSwInc 0;
BA_ "GenSigSendType" SG_ 159 ACC_DistSwInc 1;
BA_ "GenSigTimeoutTime_RFHM" SG_ 159 ACC_On 0;
BA_ "GenSigTimeoutTime_IPC" SG_ 159 ACC_On 0;
BA_ "GenSigTimeoutTime_GNMM" SG_ 159 ACC_On 0;
BA_ "GenSigTimeoutTime_ESL" SG_ 159 ACC_On 0;
BA_ "GenSigTimeoutTime_ECM" SG_ 159 ACC_On 0;
BA_ "GenSigTimeoutTime_DTCM" SG_ 159 ACC_On 0;
BA_ "GenSigTimeoutTime_DMSM" SG_ 159 ACC_On 0;
BA_ "GenSigTimeoutTime_BCM" SG_ 159 ACC_On 0;
BA_ "GenSigTimeoutTime_AGSM" SG_ 159 ACC_On 0;
BA_ "GenSigSendType" SG_ 159 ACC_On 1;
BA_ "GenSigTimeoutTime_SGW" SG_ 159 CRC_CSWC_1 0;
BA_ "GenSigTimeoutTime_RFHM" SG_ 159 CRC_CSWC_1 0;
BA_ "GenSigTimeoutTime_MPAD" SG_ 159 CRC_CSWC_1 0;
BA_ "GenSigTimeoutTime_IPC" SG_ 159 CRC_CSWC_1 0;
BA_ "GenSigTimeoutTime_GNMM" SG_ 159 CRC_CSWC_1 0;
BA_ "GenSigTimeoutTime_ESL" SG_ 159 CRC_CSWC_1 0;
BA_ "GenSigTimeoutTime_ECM" SG_ 159 CRC_CSWC_1 0;
BA_ "GenSigTimeoutTime_DTCM" SG_ 159 CRC_CSWC_1 0;
BA_ "GenSigTimeoutTime_DMSM" SG_ 159 CRC_CSWC_1 0;
BA_ "GenSigTimeoutTime_BSM" SG_ 159 CRC_CSWC_1 0;
BA_ "GenSigTimeoutTime_BCM" SG_ 159 CRC_CSWC_1 0;
BA_ "GenSigTimeoutTime_AGSM" SG_ 159 CRC_CSWC_1 0;
BA_ "GenSigTimeoutTime_ADCAM" SG_ 159 CRC_CSWC_1 0;
BA_ "GenSigStartValue" SG_ 159 CRC_CSWC_1 255;
BA_ "GenSigTimeoutTime_RFHM" SG_ 159 CrusCnclSwitch 0;
BA_ "GenSigTimeoutTime_IPC" SG_ 159 CrusCnclSwitch 0;
BA_ "GenSigTimeoutTime_GNMM" SG_ 159 CrusCnclSwitch 0;
BA_ "GenSigTimeoutTime_ESL" SG_ 159 CrusCnclSwitch 0;
BA_ "GenSigTimeoutTime_ECM" SG_ 159 CrusCnclSwitch 0;
BA_ "GenSigTimeoutTime_DTCM" SG_ 159 CrusCnclSwitch 0;
BA_ "GenSigTimeoutTime_DMSM" SG_ 159 CrusCnclSwitch 0;
BA_ "GenSigTimeoutTime_BCM" SG_ 159 CrusCnclSwitch 0;
BA_ "GenSigTimeoutTime_AGSM" SG_ 159 CrusCnclSwitch 0;
BA_ "GenSigSendType" SG_ 159 CrusCnclSwitch 3;
BA_ "GenSigTimeoutTime_SGW" SG_ 159 SpeedLimiterOnOffSts 0;
BA_ "GenSigTimeoutTime_RFHM" SG_ 159 SpeedLimiterOnOffSts 0;
BA_ "GenSigTimeoutTime_IPC" SG_ 159 SpeedLimiterOnOffSts 0;
BA_ "GenSigTimeoutTime_GNMM" SG_ 159 SpeedLimiterOnOffSts 0;
BA_ "GenSigTimeoutTime_ESL" SG_ 159 SpeedLimiterOnOffSts 0;
BA_ "GenSigTimeoutTime_ECM" SG_ 159 SpeedLimiterOnOffSts 0;
BA_ "GenSigTimeoutTime_DTCM" SG_ 159 SpeedLimiterOnOffSts 0;
BA_ "GenSigTimeoutTime_DMSM" SG_ 159 SpeedLimiterOnOffSts 0;
BA_ "GenSigTimeoutTime_BSM" SG_ 159 SpeedLimiterOnOffSts 0;
BA_ "GenSigTimeoutTime_BCM" SG_ 159 SpeedLimiterOnOffSts 0;
BA_ "GenSigTimeoutTime_AGSM" SG_ 159 SpeedLimiterOnOffSts 0;
BA_ "GenSigSendType" SG_ 159 SpeedLimiterOnOffSts 3;
BA_ "GenSigTimeoutTime_SGW" SG_ 159 MC_CSWC_1 0;
BA_ "GenSigTimeoutTime_RFHM" SG_ 159 MC_CSWC_1 0;
BA_ "GenSigTimeoutTime_MPAD" SG_ 159 MC_CSWC_1 0;
BA_ "GenSigTimeoutTime_IPC" SG_ 159 MC_CSWC_1 0;
BA_ "GenSigTimeoutTime_GNMM" SG_ 159 MC_CSWC_1 0;
BA_ "GenSigTimeoutTime_ESL" SG_ 159 MC_CSWC_1 0;
BA_ "GenSigTimeoutTime_ECM" SG_ 159 MC_CSWC_1 0;
BA_ "GenSigTimeoutTime_DTCM" SG_ 159 MC_CSWC_1 0;
BA_ "GenSigTimeoutTime_DMSM" SG_ 159 MC_CSWC_1 0;
BA_ "GenSigTimeoutTime_BSM" SG_ 159 MC_CSWC_1 0;
BA_ "GenSigTimeoutTime_BCM" SG_ 159 MC_CSWC_1 0;
BA_ "GenSigTimeoutTime_AGSM" SG_ 159 MC_CSWC_1 0;
BA_ "GenSigTimeoutTime_ADCAM" SG_ 159 MC_CSWC_1 0;
BA_ "GenSigTimeoutTime_RFHM" SG_ 736 Command_01Sts 0;
BA_ "GenSigTimeoutTime_IPC" SG_ 736 Command_01Sts 0;
BA_ "GenSigTimeoutTime_GNMM" SG_ 736 Command_01Sts 0;
BA_ "GenSigTimeoutTime_EVCU2" SG_ 736 Command_01Sts 0;
BA_ "GenSigTimeoutTime_ESL" SG_ 736 Command_01Sts 0;
BA_ "GenSigTimeoutTime_ECM" SG_ 736 Command_01Sts 0;
BA_ "GenSigTimeoutTime_DTCM" SG_ 736 Command_01Sts 0;
BA_ "GenSigTimeoutTime_DMSM" SG_ 736 Command_01Sts 0;
BA_ "GenSigTimeoutTime_BSM" SG_ 736 Command_01Sts 0;
BA_ "GenSigTimeoutTime_BCM" SG_ 736 Command_01Sts 0;
BA_ "GenSigTimeoutTime_AGSM" SG_ 736 Command_01Sts 0;
BA_ "GenSigSendType" SG_ 736 Command_01Sts 3;
BA_ "GenSigTimeoutTime_RFHM" SG_ 736 Command_02Sts 0;
BA_ "GenSigTimeoutTime_IPC" SG_ 736 Command_02Sts 0;
BA_ "GenSigTimeoutTime_GNMM" SG_ 736 Command_02Sts 0;
BA_ "GenSigTimeoutTime_EVCU2" SG_ 736 Command_02Sts 0;
BA_ "GenSigTimeoutTime_ESL" SG_ 736 Command_02Sts 0;
BA_ "GenSigTimeoutTime_ECM" SG_ 736 Command_02Sts 0;
BA_ "GenSigTimeoutTime_DTCM" SG_ 736 Command_02Sts 0;
BA_ "GenSigTimeoutTime_DMSM" SG_ 736 Command_02Sts 0;
BA_ "GenSigTimeoutTime_BSM" SG_ 736 Command_02Sts 0;
BA_ "GenSigTimeoutTime_BCM" SG_ 736 Command_02Sts 0;
BA_ "GenSigTimeoutTime_AGSM" SG_ 736 Command_02Sts 0;
BA_ "GenSigSendType" SG_ 736 Command_02Sts 3;
BA_ "GenSigTimeoutTime_SGW" SG_ 1431 TRAC_PSD 0;
BA_ "GenSigTimeoutTime_RFHM" SG_ 1431 TRAC_PSD 0;
BA_ "GenSigTimeoutTime_MPAD" SG_ 1431 TRAC_PSD 0;
BA_ "GenSigTimeoutTime_IPC" SG_ 1431 TRAC_PSD 0;
BA_ "GenSigTimeoutTime_GNMM" SG_ 1431 TRAC_PSD 0;
BA_ "GenSigTimeoutTime_EVCU2" SG_ 1431 TRAC_PSD 0;
BA_ "GenSigTimeoutTime_ESL" SG_ 1431 TRAC_PSD 0;
BA_ "GenSigTimeoutTime_ECM" SG_ 1431 TRAC_PSD 0;
BA_ "GenSigTimeoutTime_DTCM" SG_ 1431 TRAC_PSD 0;
BA_ "GenSigTimeoutTime_DMSM" SG_ 1431 TRAC_PSD 0;
BA_ "GenSigTimeoutTime_BCM" SG_ 1431 TRAC_PSD 0;
BA_ "GenSigTimeoutTime_AGSM" SG_ 1431 TRAC_PSD 0;
BA_ "GenSigTimeoutTime_ADCAM" SG_ 1431 TRAC_PSD 0;
BA_ "GenSigSendType" SG_ 1431 TRAC_PSD 3;
BA_ "GenSigTimeoutTime_SGW" SG_ 159 CRC_BCM13 0;
BA_ "GenSigTimeoutTime_RFHM" SG_ 159 CRC_BCM13 0;
BA_ "GenSigTimeoutTime_IPC" SG_ 159 CRC_BCM13 0;
BA_ "GenSigTimeoutTime_GNMM" SG_ 159 CRC_BCM13 0;
BA_ "GenSigTimeoutTime_EVCU2" SG_ 159 CRC_BCM13 0;
BA_ "GenSigTimeoutTime_ESL" SG_ 159 CRC_BCM13 0;
BA_ "GenSigTimeoutTime_ECM" SG_ 159 CRC_BCM13 0;
BA_ "GenSigTimeoutTime_DTCM" SG_ 159 CRC_BCM13 0;
BA_ "GenSigTimeoutTime_DMSM" SG_ 159 CRC_BCM13 0;
BA_ "GenSigTimeoutTime_BCM" SG_ 159 CRC_BCM13 0;
BA_ "GenSigTimeoutTime_AGSM" SG_ 159 CRC_BCM13 0;
BA_ "GenSigTimeoutTime_SGW" SG_ 159 MessageCounter_BCM13 0;
BA_ "GenSigTimeoutTime_RFHM" SG_ 159 MessageCounter_BCM13 0;
BA_ "GenSigTimeoutTime_IPC" SG_ 159 MessageCounter_BCM13 0;
BA_ "GenSigTimeoutTime_GNMM" SG_ 159 MessageCounter_BCM13 0;
BA_ "GenSigTimeoutTime_EVCU2" SG_ 159 MessageCounter_BCM13 0;
BA_ "GenSigTimeoutTime_ESL" SG_ 159 MessageCounter_BCM13 0;
BA_ "GenSigTimeoutTime_ECM" SG_ 159 MessageCounter_BCM13 0;
BA_ "GenSigTimeoutTime_DTCM" SG_ 159 MessageCounter_BCM13 0;
BA_ "GenSigTimeoutTime_DMSM" SG_ 159 MessageCounter_BCM13 0;
BA_ "GenSigTimeoutTime_BCM" SG_ 159 MessageCounter_BCM13 0;
BA_ "GenSigTimeoutTime_AGSM" SG_ 159 MessageCounter_BCM13 0;
BA_ "GenSigTimeoutTime_SGW" SG_ 1431 TerrainSwStat 0;
BA_ "GenSigTimeoutTime_RFHM" SG_ 1431 TerrainSwStat 0;
BA_ "GenSigTimeoutTime_MPAD" SG_ 1431 TerrainSwStat 0;
BA_ "GenSigTimeoutTime_IPC" SG_ 1431 TerrainSwStat 0;
BA_ "GenSigTimeoutTime_GNMM" SG_ 1431 TerrainSwStat 0;
BA_ "GenSigTimeoutTime_ESL" SG_ 1431 TerrainSwStat 0;
BA_ "GenSigTimeoutTime_ECM" SG_ 1431 TerrainSwStat 0;
BA_ "GenSigTimeoutTime_DTCM" SG_ 1431 TerrainSwStat 0;
BA_ "GenSigTimeoutTime_DMSM" SG_ 1431 TerrainSwStat 0;
BA_ "GenSigTimeoutTime_BSM" SG_ 1431 TerrainSwStat 0;
BA_ "GenSigTimeoutTime_BCM" SG_ 1431 TerrainSwStat 0;
BA_ "GenSigTimeoutTime_AGSM" SG_ 1431 TerrainSwStat 0;
BA_ "GenSigTimeoutTime_ADCAM" SG_ 1431 TerrainSwStat 0;
BA_ "GenSigSendType" SG_ 1431 TerrainSwStat 3;
BA_ "GenSigTimeoutTime_SGW" SG_ 247 MiniCryptFCode_TRM_Rq 0;
BA_ "GenSigTimeoutTime_MPAD" SG_ 247 MiniCryptFCode_TRM_Rq 0;
BA_ "GenSigTimeoutTime_IPC" SG_ 247 MiniCryptFCode_TRM_Rq 0;
BA_ "GenSigTimeoutTime_GNMM" SG_ 247 MiniCryptFCode_TRM_Rq 0;
BA_ "GenSigTimeoutTime_EVCU2" SG_ 247 MiniCryptFCode_TRM_Rq 0;
BA_ "GenSigTimeoutTime_ESL" SG_ 247 MiniCryptFCode_TRM_Rq 0;
BA_ "GenSigTimeoutTime_ECM" SG_ 247 MiniCryptFCode_TRM_Rq 0;
BA_ "GenSigTimeoutTime_DTCM" SG_ 247 MiniCryptFCode_TRM_Rq 0;
BA_ "GenSigTimeoutTime_DMSM" SG_ 247 MiniCryptFCode_TRM_Rq 0;
BA_ "GenSigTimeoutTime_BSM" SG_ 247 MiniCryptFCode_TRM_Rq 0;
BA_ "GenSigTimeoutTime_BCM" SG_ 247 MiniCryptFCode_TRM_Rq 0;
BA_ "GenSigTimeoutTime_AGSM" SG_ 247 MiniCryptFCode_TRM_Rq 0;
BA_ "GenSigTimeoutTime_ADCAM" SG_ 247 MiniCryptFCode_TRM_Rq 0;
BA_ "GenSigTimeoutTime_SGW" SG_ 1153 CompressorACReqSts 0;
BA_ "GenSigTimeoutTime_RFHM" SG_ 1153 CompressorACReqSts 0;
BA_ "GenSigTimeoutTime_MPAD" SG_ 1153 CompressorACReqSts 0;
BA_ "GenSigTimeoutTime_IPC" SG_ 1153 CompressorACReqSts 0;
BA_ "GenSigTimeoutTime_GNMM" SG_ 1153 CompressorACReqSts 0;
BA_ "GenSigTimeoutTime_ESL" SG_ 1153 CompressorACReqSts 0;
BA_ "GenSigTimeoutTime_ECM" SG_ 1153 CompressorACReqSts 0;
BA_ "GenSigTimeoutTime_DTCM" SG_ 1153 CompressorACReqSts 0;
BA_ "GenSigTimeoutTime_DMSM" SG_ 1153 CompressorACReqSts 0;
BA_ "GenSigTimeoutTime_BSM" SG_ 1153 CompressorACReqSts 0;
BA_ "GenSigTimeoutTime_BCM" SG_ 1153 CompressorACReqSts 0;
BA_ "GenSigTimeoutTime_AGSM" SG_ 1153 CompressorACReqSts 0;
BA_ "GenSigTimeoutTime_ADCAM" SG_ 1153 CompressorACReqSts 0;
BA_ "GenSigSendType" SG_ 1153 CompressorACReqSts 3;
BA_ "GenSigTimeoutTime_BCM" SG_ 1153 CmdIgnSts 0;
BA_ "GenSigSendType" SG_ 1153 CmdIgnSts 3;
BA_ "GenSigTimeoutTime_SGW" SG_ 246 ControlEncoding_ESL_Rq 0;
BA_ "GenSigTimeoutTime_RFHM" SG_ 246 ControlEncoding_ESL_Rq 0;
BA_ "GenSigTimeoutTime_MPAD" SG_ 246 ControlEncoding_ESL_Rq 0;
BA_ "GenSigTimeoutTime_IPC" SG_ 246 ControlEncoding_ESL_Rq 0;
BA_ "GenSigTimeoutTime_GNMM" SG_ 246 ControlEncoding_ESL_Rq 0;
BA_ "GenSigTimeoutTime_EVCU2" SG_ 246 ControlEncoding_ESL_Rq 0;
BA_ "GenSigTimeoutTime_ECM" SG_ 246 ControlEncoding_ESL_Rq 0;
BA_ "GenSigTimeoutTime_DTCM" SG_ 246 ControlEncoding_ESL_Rq 0;
BA_ "GenSigTimeoutTime_DMSM" SG_ 246 ControlEncoding_ESL_Rq 0;
BA_ "GenSigTimeoutTime_BSM" SG_ 246 ControlEncoding_ESL_Rq 0;
BA_ "GenSigTimeoutTime_BCM" SG_ 246 ControlEncoding_ESL_Rq 0;
BA_ "GenSigTimeoutTime_AGSM" SG_ 246 ControlEncoding_ESL_Rq 0;
BA_ "GenSigTimeoutTime_ADCAM" SG_ 246 ControlEncoding_ESL_Rq 0;
BA_ "GenSigSendType" SG_ 246 ControlEncoding_ESL_Rq 1;
BA_ "GenSigTimeoutTime_SGW" SG_ 246 ESLLockUnlockReq_ESL_Rq 0;
BA_ "GenSigTimeoutTime_RFHM" SG_ 246 ESLLockUnlockReq_ESL_Rq 0;
BA_ "GenSigTimeoutTime_MPAD" SG_ 246 ESLLockUnlockReq_ESL_Rq 0;
BA_ "GenSigTimeoutTime_IPC" SG_ 246 ESLLockUnlockReq_ESL_Rq 0;
BA_ "GenSigTimeoutTime_GNMM" SG_ 246 ESLLockUnlockReq_ESL_Rq 0;
BA_ "GenSigTimeoutTime_EVCU2" SG_ 246 ESLLockUnlockReq_ESL_Rq 0;
BA_ "GenSigTimeoutTime_ECM" SG_ 246 ESLLockUnlockReq_ESL_Rq 0;
BA_ "GenSigTimeoutTime_DTCM" SG_ 246 ESLLockUnlockReq_ESL_Rq 0;
BA_ "GenSigTimeoutTime_DMSM" SG_ 246 ESLLockUnlockReq_ESL_Rq 0;
BA_ "GenSigTimeoutTime_BSM" SG_ 246 ESLLockUnlockReq_ESL_Rq 0;
BA_ "GenSigTimeoutTime_BCM" SG_ 246 ESLLockUnlockReq_ESL_Rq 0;
BA_ "GenSigTimeoutTime_AGSM" SG_ 246 ESLLockUnlockReq_ESL_Rq 0;
BA_ "GenSigTimeoutTime_ADCAM" SG_ 246 ESLLockUnlockReq_ESL_Rq 0;
BA_ "GenSigTimeoutTime_SGW" SG_ 246 MiniCrypt_Rnd_ESL_Rq 0;
BA_ "GenSigTimeoutTime_RFHM" SG_ 246 MiniCrypt_Rnd_ESL_Rq 0;
BA_ "GenSigTimeoutTime_MPAD" SG_ 246 MiniCrypt_Rnd_ESL_Rq 0;
BA_ "GenSigTimeoutTime_IPC" SG_ 246 MiniCrypt_Rnd_ESL_Rq 0;
BA_ "GenSigTimeoutTime_GNMM" SG_ 246 MiniCrypt_Rnd_ESL_Rq 0;
BA_ "GenSigTimeoutTime_EVCU2" SG_ 246 MiniCrypt_Rnd_ESL_Rq 0;
BA_ "GenSigTimeoutTime_ECM" SG_ 246 MiniCrypt_Rnd_ESL_Rq 0;
BA_ "GenSigTimeoutTime_DTCM" SG_ 246 MiniCrypt_Rnd_ESL_Rq 0;
BA_ "GenSigTimeoutTime_DMSM" SG_ 246 MiniCrypt_Rnd_ESL_Rq 0;
BA_ "GenSigTimeoutTime_BSM" SG_ 246 MiniCrypt_Rnd_ESL_Rq 0;
BA_ "GenSigTimeoutTime_BCM" SG_ 246 MiniCrypt_Rnd_ESL_Rq 0;
BA_ "GenSigTimeoutTime_AGSM" SG_ 246 MiniCrypt_Rnd_ESL_Rq 0;
BA_ "GenSigTimeoutTime_ADCAM" SG_ 246 MiniCrypt_Rnd_ESL_Rq 0;
BA_ "GenSigTimeoutTime_SGW" SG_ 246 MiniCryptFCode_ESL_Rq 0;
BA_ "GenSigTimeoutTime_RFHM" SG_ 246 MiniCryptFCode_ESL_Rq 0;
BA_ "GenSigTimeoutTime_MPAD" SG_ 246 MiniCryptFCode_ESL_Rq 0;
BA_ "GenSigTimeoutTime_IPC" SG_ 246 MiniCryptFCode_ESL_Rq 0;
BA_ "GenSigTimeoutTime_GNMM" SG_ 246 MiniCryptFCode_ESL_Rq 0;
BA_ "GenSigTimeoutTime_EVCU2" SG_ 246 MiniCryptFCode_ESL_Rq 0;
BA_ "GenSigTimeoutTime_ECM" SG_ 246 MiniCryptFCode_ESL_Rq 0;
BA_ "GenSigTimeoutTime_DTCM" SG_ 246 MiniCryptFCode_ESL_Rq 0;
BA_ "GenSigTimeoutTime_DMSM" SG_ 246 MiniCryptFCode_ESL_Rq 0;
BA_ "GenSigTimeoutTime_BSM" SG_ 246 MiniCryptFCode_ESL_Rq 0;
BA_ "GenSigTimeoutTime_BCM" SG_ 246 MiniCryptFCode_ESL_Rq 0;
BA_ "GenSigTimeoutTime_AGSM" SG_ 246 MiniCryptFCode_ESL_Rq 0;
BA_ "GenSigTimeoutTime_ADCAM" SG_ 246 MiniCryptFCode_ESL_Rq 0;
BA_ "GenSigTimeoutTime_SGW" SG_ 247 ControlEncoding_TRM_Rq 0;
BA_ "GenSigTimeoutTime_MPAD" SG_ 247 ControlEncoding_TRM_Rq 0;
BA_ "GenSigTimeoutTime_IPC" SG_ 247 ControlEncoding_TRM_Rq 0;
BA_ "GenSigTimeoutTime_GNMM" SG_ 247 ControlEncoding_TRM_Rq 0;
BA_ "GenSigTimeoutTime_EVCU2" SG_ 247 ControlEncoding_TRM_Rq 0;
BA_ "GenSigTimeoutTime_ESL" SG_ 247 ControlEncoding_TRM_Rq 0;
BA_ "GenSigTimeoutTime_ECM" SG_ 247 ControlEncoding_TRM_Rq 0;
BA_ "GenSigTimeoutTime_DTCM" SG_ 247 ControlEncoding_TRM_Rq 0;
BA_ "GenSigTimeoutTime_DMSM" SG_ 247 ControlEncoding_TRM_Rq 0;
BA_ "GenSigTimeoutTime_BSM" SG_ 247 ControlEncoding_TRM_Rq 0;
BA_ "GenSigTimeoutTime_BCM" SG_ 247 ControlEncoding_TRM_Rq 0;
BA_ "GenSigTimeoutTime_AGSM" SG_ 247 ControlEncoding_TRM_Rq 0;
BA_ "GenSigTimeoutTime_ADCAM" SG_ 247 ControlEncoding_TRM_Rq 0;
BA_ "GenSigSendType" SG_ 247 ControlEncoding_TRM_Rq 1;
BA_ "GenSigTimeoutTime_SGW" SG_ 247 MiniCrypt_Rnd_TRM_Rq 0;
BA_ "GenSigTimeoutTime_MPAD" SG_ 247 MiniCrypt_Rnd_TRM_Rq 0;
BA_ "GenSigTimeoutTime_IPC" SG_ 247 MiniCrypt_Rnd_TRM_Rq 0;
BA_ "GenSigTimeoutTime_GNMM" SG_ 247 MiniCrypt_Rnd_TRM_Rq 0;
BA_ "GenSigTimeoutTime_EVCU2" SG_ 247 MiniCrypt_Rnd_TRM_Rq 0;
BA_ "GenSigTimeoutTime_ESL" SG_ 247 MiniCrypt_Rnd_TRM_Rq 0;
BA_ "GenSigTimeoutTime_ECM" SG_ 247 MiniCrypt_Rnd_TRM_Rq 0;
BA_ "GenSigTimeoutTime_DTCM" SG_ 247 MiniCrypt_Rnd_TRM_Rq 0;
BA_ "GenSigTimeoutTime_DMSM" SG_ 247 MiniCrypt_Rnd_TRM_Rq 0;
BA_ "GenSigTimeoutTime_BSM" SG_ 247 MiniCrypt_Rnd_TRM_Rq 0;
BA_ "GenSigTimeoutTime_BCM" SG_ 247 MiniCrypt_Rnd_TRM_Rq 0;
BA_ "GenSigTimeoutTime_AGSM" SG_ 247 MiniCrypt_Rnd_TRM_Rq 0;
BA_ "GenSigTimeoutTime_ADCAM" SG_ 247 MiniCrypt_Rnd_TRM_Rq 0;
BA_ "GenSigTimeoutTime_RFHM" SG_ 736 Command_03Sts 0;
BA_ "GenSigTimeoutTime_IPC" SG_ 736 Command_03Sts 0;
BA_ "GenSigTimeoutTime_GNMM" SG_ 736 Command_03Sts 0;
BA_ "GenSigTimeoutTime_EVCU2" SG_ 736 Command_03Sts 0;
BA_ "GenSigTimeoutTime_ESL" SG_ 736 Command_03Sts 0;
BA_ "GenSigTimeoutTime_RFHM" SG_ 736 Command_04Sts 0;
BA_ "GenSigTimeoutTime_IPC" SG_ 736 Command_04Sts 0;
BA_ "GenSigTimeoutTime_GNMM" SG_ 736 Command_04Sts 0;
BA_ "GenSigTimeoutTime_EVCU2" SG_ 736 Command_04Sts 0;
BA_ "GenSigTimeoutTime_ESL" SG_ 736 Command_04Sts 0;
BA_ "GenSigTimeoutTime_ECM" SG_ 736 Command_04Sts 0;
BA_ "GenSigTimeoutTime_DTCM" SG_ 736 Command_04Sts 0;
BA_ "GenSigTimeoutTime_DMSM" SG_ 736 Command_04Sts 0;
BA_ "GenSigTimeoutTime_BSM" SG_ 736 Command_04Sts 0;
BA_ "GenSigTimeoutTime_BCM" SG_ 736 Command_04Sts 0;
BA_ "GenSigTimeoutTime_AGSM" SG_ 736 Command_04Sts 0;
BA_ "GenSigSendType" SG_ 736 Command_04Sts 3;
BA_ "GenSigTimeoutTime_RFHM" SG_ 736 Command_05Sts 0;
BA_ "GenSigTimeoutTime_IPC" SG_ 736 Command_05Sts 0;
BA_ "GenSigTimeoutTime_GNMM" SG_ 736 Command_05Sts 0;
BA_ "GenSigTimeoutTime_EVCU2" SG_ 736 Command_05Sts 0;
BA_ "GenSigTimeoutTime_ESL" SG_ 736 Command_05Sts 0;
BA_ "GenSigTimeoutTime_ECM" SG_ 736 Command_05Sts 0;
BA_ "GenSigTimeoutTime_DTCM" SG_ 736 Command_05Sts 0;
BA_ "GenSigTimeoutTime_DMSM" SG_ 736 Command_05Sts 0;
BA_ "GenSigTimeoutTime_BSM" SG_ 736 Command_05Sts 0;
BA_ "GenSigTimeoutTime_BCM" SG_ 736 Command_05Sts 0;
BA_ "GenSigTimeoutTime_AGSM" SG_ 736 Command_05Sts 0;
BA_ "GenSigSendType" SG_ 736 Command_05Sts 3;
BA_ "GenSigTimeoutTime_DMSM" SG_ 736 Command_06Sts 0;
BA_ "GenSigTimeoutTime_BSM" SG_ 736 Command_06Sts 0;
BA_ "GenSigTimeoutTime_BCM" SG_ 736 Command_06Sts 0;
BA_ "GenSigTimeoutTime_AGSM" SG_ 736 Command_06Sts 0;
BA_ "GenSigSendType" SG_ 736 Command_06Sts 3;
BA_ "GenSigTimeoutTime_RFHM" SG_ 736 Command_06Sts 0;
BA_ "GenSigTimeoutTime_IPC" SG_ 736 Command_06Sts 0;
BA_ "GenSigTimeoutTime_GNMM" SG_ 736 Command_06Sts 0;
BA_ "GenSigTimeoutTime_EVCU2" SG_ 736 Command_06Sts 0;
BA_ "GenSigTimeoutTime_ESL" SG_ 736 Command_06Sts 0;
BA_ "GenSigTimeoutTime_ECM" SG_ 736 Command_06Sts 0;
BA_ "GenSigTimeoutTime_DTCM" SG_ 736 Command_06Sts 0;
BA_ "GenSigTimeoutTime_RFHM" SG_ 736 Command_07Sts 0;
BA_ "GenSigTimeoutTime_IPC" SG_ 736 Command_07Sts 0;
BA_ "GenSigTimeoutTime_GNMM" SG_ 736 Command_07Sts 0;
BA_ "GenSigTimeoutTime_EVCU2" SG_ 736 Command_07Sts 0;
BA_ "GenSigTimeoutTime_ESL" SG_ 736 Command_07Sts 0;
BA_ "GenSigTimeoutTime_ECM" SG_ 736 Command_07Sts 0;
BA_ "GenSigTimeoutTime_DTCM" SG_ 736 Command_07Sts 0;
BA_ "GenSigTimeoutTime_DMSM" SG_ 736 Command_07Sts 0;
BA_ "GenSigTimeoutTime_BSM" SG_ 736 Command_07Sts 0;
BA_ "GenSigTimeoutTime_BCM" SG_ 736 Command_07Sts 0;
BA_ "GenSigTimeoutTime_AGSM" SG_ 736 Command_07Sts 0;
BA_ "GenSigSendType" SG_ 736 Command_07Sts 3;
BA_ "GenSigTimeoutTime_RFHM" SG_ 736 Command_08Sts 0;
BA_ "GenSigTimeoutTime_IPC" SG_ 736 Command_08Sts 0;
BA_ "GenSigTimeoutTime_GNMM" SG_ 736 Command_08Sts 0;
BA_ "GenSigTimeoutTime_EVCU2" SG_ 736 Command_08Sts 0;
BA_ "GenSigTimeoutTime_ESL" SG_ 736 Command_08Sts 0;
BA_ "GenSigTimeoutTime_ECM" SG_ 736 Command_08Sts 0;
BA_ "GenSigTimeoutTime_DTCM" SG_ 736 Command_08Sts 0;
BA_ "GenSigTimeoutTime_DMSM" SG_ 736 Command_08Sts 0;
BA_ "GenSigTimeoutTime_BSM" SG_ 736 Command_08Sts 0;
BA_ "GenSigTimeoutTime_BCM" SG_ 736 Command_08Sts 0;
BA_ "GenSigTimeoutTime_AGSM" SG_ 736 Command_08Sts 0;
BA_ "GenSigSendType" SG_ 736 Command_08Sts 3;
BA_ "GenSigTimeoutTime_RFHM" SG_ 736 Command_09Sts 0;
BA_ "GenSigTimeoutTime_IPC" SG_ 736 Command_09Sts 0;
BA_ "GenSigTimeoutTime_GNMM" SG_ 736 Command_09Sts 0;
BA_ "GenSigTimeoutTime_EVCU2" SG_ 736 Command_09Sts 0;
BA_ "GenSigTimeoutTime_ESL" SG_ 736 Command_09Sts 0;
BA_ "GenSigTimeoutTime_ECM" SG_ 736 Command_09Sts 0;
BA_ "GenSigTimeoutTime_DTCM" SG_ 736 Command_09Sts 0;
BA_ "GenSigTimeoutTime_DMSM" SG_ 736 Command_09Sts 0;
BA_ "GenSigTimeoutTime_BSM" SG_ 736 Command_09Sts 0;
BA_ "GenSigTimeoutTime_BCM" SG_ 736 Command_09Sts 0;
BA_ "GenSigTimeoutTime_AGSM" SG_ 736 Command_09Sts 0;
BA_ "GenSigSendType" SG_ 736 Command_09Sts 3;
BA_ "GenSigTimeoutTime_RFHM" SG_ 736 Command_10Sts 0;
BA_ "GenSigTimeoutTime_GNMM" SG_ 736 Command_10Sts 0;
BA_ "GenSigTimeoutTime_EVCU2" SG_ 736 Command_10Sts 0;
BA_ "GenSigTimeoutTime_ESL" SG_ 736 Command_10Sts 0;
BA_ "GenSigTimeoutTime_ECM" SG_ 736 Command_10Sts 0;
BA_ "GenSigTimeoutTime_DTCM" SG_ 736 Command_10Sts 0;
BA_ "GenSigTimeoutTime_DMSM" SG_ 736 Command_10Sts 0;
BA_ "GenSigTimeoutTime_BSM" SG_ 736 Command_10Sts 0;
BA_ "GenSigTimeoutTime_BCM" SG_ 736 Command_10Sts 0;
BA_ "GenSigTimeoutTime_AGSM" SG_ 736 Command_10Sts 0;
BA_ "GenSigSendType" SG_ 736 Command_10Sts 3;
BA_ "GenSigTimeoutTime_RFHM" SG_ 736 Command_11Sts 0;
BA_ "GenSigTimeoutTime_GNMM" SG_ 736 Command_11Sts 0;
BA_ "GenSigTimeoutTime_EVCU2" SG_ 736 Command_11Sts 0;
BA_ "GenSigTimeoutTime_ESL" SG_ 736 Command_11Sts 0;
BA_ "GenSigTimeoutTime_ECM" SG_ 736 Command_11Sts 0;
BA_ "GenSigTimeoutTime_DTCM" SG_ 736 Command_11Sts 0;
BA_ "GenSigTimeoutTime_DMSM" SG_ 736 Command_11Sts 0;
BA_ "GenSigTimeoutTime_BSM" SG_ 736 Command_11Sts 0;
BA_ "GenSigTimeoutTime_BCM" SG_ 736 Command_11Sts 0;
BA_ "GenSigTimeoutTime_AGSM" SG_ 736 Command_11Sts 0;
BA_ "GenSigSendType" SG_ 736 Command_11Sts 3;
BA_ "GenSigTimeoutTime_RFHM" SG_ 736 Command_12Sts 0;
BA_ "GenSigTimeoutTime_GNMM" SG_ 736 Command_12Sts 0;
BA_ "GenSigTimeoutTime_EVCU2" SG_ 736 Command_12Sts 0;
BA_ "GenSigTimeoutTime_ESL" SG_ 736 Command_12Sts 0;
BA_ "GenSigTimeoutTime_ECM" SG_ 736 Command_12Sts 0;
BA_ "GenSigTimeoutTime_DTCM" SG_ 736 Command_12Sts 0;
BA_ "GenSigTimeoutTime_DMSM" SG_ 736 Command_12Sts 0;
BA_ "GenSigTimeoutTime_BSM" SG_ 736 Command_12Sts 0;
BA_ "GenSigTimeoutTime_BCM" SG_ 736 Command_12Sts 0;
BA_ "GenSigTimeoutTime_AGSM" SG_ 736 Command_12Sts 0;
BA_ "GenSigSendType" SG_ 736 Command_12Sts 3;
BA_ "GenSigTimeoutTime_RFHM" SG_ 736 Command_13Sts 0;
BA_ "GenSigTimeoutTime_GNMM" SG_ 736 Command_13Sts 0;
BA_ "GenSigTimeoutTime_EVCU2" SG_ 736 Command_13Sts 0;
BA_ "GenSigTimeoutTime_ESL" SG_ 736 Command_13Sts 0;
BA_ "GenSigTimeoutTime_ECM" SG_ 736 Command_13Sts 0;
BA_ "GenSigTimeoutTime_DTCM" SG_ 736 Command_13Sts 0;
BA_ "GenSigTimeoutTime_DMSM" SG_ 736 Command_13Sts 0;
BA_ "GenSigTimeoutTime_BSM" SG_ 736 Command_13Sts 0;
BA_ "GenSigTimeoutTime_BCM" SG_ 736 Command_13Sts 0;
BA_ "GenSigTimeoutTime_AGSM" SG_ 736 Command_13Sts 0;
BA_ "GenSigSendType" SG_ 736 Command_13Sts 3;
BA_ "GenSigTimeoutTime_RFHM" SG_ 736 Command_14Sts 0;
BA_ "GenSigTimeoutTime_GNMM" SG_ 736 Command_14Sts 0;
BA_ "GenSigTimeoutTime_EVCU2" SG_ 736 Command_14Sts 0;
BA_ "GenSigTimeoutTime_ESL" SG_ 736 Command_14Sts 0;
BA_ "GenSigTimeoutTime_ECM" SG_ 736 Command_14Sts 0;
BA_ "GenSigTimeoutTime_DTCM" SG_ 736 Command_14Sts 0;
BA_ "GenSigTimeoutTime_DMSM" SG_ 736 Command_14Sts 0;
BA_ "GenSigTimeoutTime_BSM" SG_ 736 Command_14Sts 0;
BA_ "GenSigTimeoutTime_BCM" SG_ 736 Command_14Sts 0;
BA_ "GenSigTimeoutTime_AGSM" SG_ 736 Command_14Sts 0;
BA_ "GenSigSendType" SG_ 736 Command_14Sts 3;
BA_ "GenSigTimeoutTime_RFHM" SG_ 736 Command_15Sts 0;
BA_ "GenSigTimeoutTime_GNMM" SG_ 736 Command_15Sts 0;
BA_ "GenSigTimeoutTime_EVCU2" SG_ 736 Command_15Sts 0;
BA_ "GenSigTimeoutTime_ESL" SG_ 736 Command_15Sts 0;
BA_ "GenSigTimeoutTime_ECM" SG_ 736 Command_15Sts 0;
BA_ "GenSigTimeoutTime_DTCM" SG_ 736 Command_15Sts 0;
BA_ "GenSigTimeoutTime_DMSM" SG_ 736 Command_15Sts 0;
BA_ "GenSigTimeoutTime_BSM" SG_ 736 Command_15Sts 0;
BA_ "GenSigTimeoutTime_BCM" SG_ 736 Command_15Sts 0;
BA_ "GenSigTimeoutTime_AGSM" SG_ 736 Command_15Sts 0;
BA_ "GenSigSendType" SG_ 736 Command_15Sts 3;
BA_ "GenSigTimeoutTime_SGW" SG_ 736 CRC_BCM14 0;
BA_ "GenSigTimeoutTime_RFHM" SG_ 736 CRC_BCM14 0;
BA_ "GenSigTimeoutTime_IPC" SG_ 736 CRC_BCM14 0;
BA_ "GenSigTimeoutTime_GNMM" SG_ 736 CRC_BCM14 0;
BA_ "GenSigTimeoutTime_EVCU2" SG_ 736 CRC_BCM14 0;
BA_ "GenSigTimeoutTime_ESL" SG_ 736 CRC_BCM14 0;
BA_ "GenSigTimeoutTime_ECM" SG_ 736 CRC_BCM14 0;
BA_ "GenSigTimeoutTime_DTCM" SG_ 736 CRC_BCM14 0;
BA_ "GenSigTimeoutTime_DMSM" SG_ 736 CRC_BCM14 0;
BA_ "GenSigTimeoutTime_BSM" SG_ 736 CRC_BCM14 0;
BA_ "GenSigTimeoutTime_BCM" SG_ 736 CRC_BCM14 0;
BA_ "GenSigTimeoutTime_AGSM" SG_ 736 CRC_BCM14 0;
BA_ "GenSigTimeoutTime_SGW" SG_ 736 MessageCounter_BCM14 0;
BA_ "GenSigTimeoutTime_RFHM" SG_ 736 MessageCounter_BCM14 0;
BA_ "GenSigTimeoutTime_IPC" SG_ 736 MessageCounter_BCM14 0;
BA_ "GenSigTimeoutTime_GNMM" SG_ 736 MessageCounter_BCM14 0;
BA_ "GenSigTimeoutTime_EVCU2" SG_ 736 MessageCounter_BCM14 0;
BA_ "GenSigTimeoutTime_ESL" SG_ 736 MessageCounter_BCM14 0;
BA_ "GenSigTimeoutTime_ECM" SG_ 736 MessageCounter_BCM14 0;
BA_ "GenSigTimeoutTime_DTCM" SG_ 736 MessageCounter_BCM14 0;
BA_ "GenSigTimeoutTime_DMSM" SG_ 736 MessageCounter_BCM14 0;
BA_ "GenSigTimeoutTime_BSM" SG_ 736 MessageCounter_BCM14 0;
BA_ "GenSigTimeoutTime_BCM" SG_ 736 MessageCounter_BCM14 0;
BA_ "GenSigTimeoutTime_AGSM" SG_ 736 MessageCounter_BCM14 0;
BA_ "GenSigTimeoutTime_SGW" SG_ 512 LeakCheckTimerExpired 0;
BA_ "GenSigTimeoutTime_RFHM" SG_ 512 LeakCheckTimerExpired 0;
BA_ "GenSigTimeoutTime_MPAD" SG_ 512 LeakCheckTimerExpired 0;
BA_ "GenSigTimeoutTime_IPC" SG_ 512 LeakCheckTimerExpired 0;
BA_ "GenSigTimeoutTime_GNMM" SG_ 512 LeakCheckTimerExpired 0;
BA_ "GenSigTimeoutTime_EVCU2" SG_ 512 LeakCheckTimerExpired 0;
BA_ "GenSigTimeoutTime_ESL" SG_ 512 LeakCheckTimerExpired 0;
BA_ "GenSigTimeoutTime_DTCM" SG_ 512 LeakCheckTimerExpired 0;
BA_ "GenSigTimeoutTime_DMSM" SG_ 512 LeakCheckTimerExpired 0;
BA_ "GenSigTimeoutTime_BSM" SG_ 512 LeakCheckTimerExpired 0;
BA_ "GenSigTimeoutTime_BCM" SG_ 512 LeakCheckTimerExpired 0;
BA_ "GenSigTimeoutTime_AGSM" SG_ 512 LeakCheckTimerExpired 0;
BA_ "GenSigTimeoutTime_ADCAM" SG_ 512 LeakCheckTimerExpired 0;
BA_ "GenSigTimeoutTime_SGW" SG_ 512 BonnetAjarRawValSts_8 0;
BA_ "GenSigTimeoutTime_RFHM" SG_ 512 BonnetAjarRawValSts_8 0;
BA_ "GenSigTimeoutTime_MPAD" SG_ 512 BonnetAjarRawValSts_8 0;
BA_ "GenSigTimeoutTime_IPC" SG_ 512 BonnetAjarRawValSts_8 0;
BA_ "GenSigTimeoutTime_GNMM" SG_ 512 BonnetAjarRawValSts_8 0;
BA_ "GenSigTimeoutTime_ESL" SG_ 512 BonnetAjarRawValSts_8 0;
BA_ "GenSigTimeoutTime_DTCM" SG_ 512 BonnetAjarRawValSts_8 0;
BA_ "GenSigTimeoutTime_DMSM" SG_ 512 BonnetAjarRawValSts_8 0;
BA_ "GenSigTimeoutTime_BCM" SG_ 512 BonnetAjarRawValSts_8 0;
BA_ "GenSigTimeoutTime_AGSM" SG_ 512 BonnetAjarRawValSts_8 0;
BA_ "GenSigTimeoutTime_ADCAM" SG_ 512 BonnetAjarRawValSts_8 0;
BA_ "GenSigTimeoutTime_SGW" SG_ 512 DRV_DR_UNLOCKING 0;
BA_ "GenSigTimeoutTime_RFHM" SG_ 512 DRV_DR_UNLOCKING 0;
BA_ "GenSigTimeoutTime_MPAD" SG_ 512 DRV_DR_UNLOCKING 0;
BA_ "GenSigTimeoutTime_IPC" SG_ 512 DRV_DR_UNLOCKING 0;
BA_ "GenSigTimeoutTime_GNMM" SG_ 512 DRV_DR_UNLOCKING 0;
BA_ "GenSigTimeoutTime_ESL" SG_ 512 DRV_DR_UNLOCKING 0;
BA_ "GenSigTimeoutTime_ECM" SG_ 512 DRV_DR_UNLOCKING 0;
BA_ "GenSigTimeoutTime_DTCM" SG_ 512 DRV_DR_UNLOCKING 0;
BA_ "GenSigTimeoutTime_DMSM" SG_ 512 DRV_DR_UNLOCKING 0;
BA_ "GenSigTimeoutTime_BSM" SG_ 512 DRV_DR_UNLOCKING 0;
BA_ "GenSigTimeoutTime_BCM" SG_ 512 DRV_DR_UNLOCKING 0;
BA_ "GenSigTimeoutTime_AGSM" SG_ 512 DRV_DR_UNLOCKING 0;
BA_ "GenSigTimeoutTime_ADCAM" SG_ 512 DRV_DR_UNLOCKING 0;
BA_ "GenSigTimeoutTime_RFHM" SG_ 1431 PAMRequestSts 0;
BA_ "GenSigTimeoutTime_MPAD" SG_ 1431 PAMRequestSts 0;
BA_ "GenSigTimeoutTime_IPC" SG_ 1431 PAMRequestSts 0;
BA_ "GenSigTimeoutTime_GNMM" SG_ 1431 PAMRequestSts 0;
BA_ "GenSigTimeoutTime_EVCU2" SG_ 1431 PAMRequestSts 0;
BA_ "GenSigTimeoutTime_ESL" SG_ 1431 PAMRequestSts 0;
BA_ "GenSigTimeoutTime_ECM" SG_ 1431 PAMRequestSts 0;
BA_ "GenSigTimeoutTime_DTCM" SG_ 1431 PAMRequestSts 0;
BA_ "GenSigTimeoutTime_DMSM" SG_ 1431 PAMRequestSts 0;
BA_ "GenSigTimeoutTime_BSM" SG_ 1431 PAMRequestSts 0;
BA_ "GenSigTimeoutTime_BCM" SG_ 1431 PAMRequestSts 0;
BA_ "GenSigTimeoutTime_AGSM" SG_ 1431 PAMRequestSts 0;
BA_ "GenSigTimeoutTime_ADCAM" SG_ 1431 PAMRequestSts 0;
BA_ "GenSigSendType" SG_ 1431 PAMRequestSts 3;
BA_ "GenSigTimeoutTime_SGW" SG_ 1431 MessageCounter_BCM12 0;
BA_ "GenSigTimeoutTime_RFHM" SG_ 1431 MessageCounter_BCM12 0;
BA_ "GenSigTimeoutTime_IPC" SG_ 1431 MessageCounter_BCM12 0;
BA_ "GenSigTimeoutTime_GNMM" SG_ 1431 MessageCounter_BCM12 0;
BA_ "GenSigTimeoutTime_EVCU2" SG_ 1431 MessageCounter_BCM12 0;
BA_ "GenSigTimeoutTime_ESL" SG_ 1431 MessageCounter_BCM12 0;
BA_ "GenSigTimeoutTime_ECM" SG_ 1431 MessageCounter_BCM12 0;
BA_ "GenSigTimeoutTime_DMSM" SG_ 1431 MessageCounter_BCM12 0;
BA_ "GenSigTimeoutTime_BCM" SG_ 1431 MessageCounter_BCM12 0;
BA_ "GenSigTimeoutTime_AGSM" SG_ 1431 MessageCounter_BCM12 0;
BA_ "GenSigTimeoutTime_ADCAM" SG_ 1431 MessageCounter_BCM12 0;
BA_ "GenSigTimeoutTime_RFHM" SG_ 1431 APARequestSts 0;
BA_ "GenSigTimeoutTime_MPAD" SG_ 1431 APARequestSts 0;
BA_ "GenSigTimeoutTime_IPC" SG_ 1431 APARequestSts 0;
BA_ "GenSigTimeoutTime_GNMM" SG_ 1431 APARequestSts 0;
BA_ "GenSigTimeoutTime_EVCU2" SG_ 1431 APARequestSts 0;
BA_ "GenSigTimeoutTime_ESL" SG_ 1431 APARequestSts 0;
BA_ "GenSigTimeoutTime_ECM" SG_ 1431 APARequestSts 0;
BA_ "GenSigTimeoutTime_DTCM" SG_ 1431 APARequestSts 0;
BA_ "GenSigTimeoutTime_DMSM" SG_ 1431 APARequestSts 0;
BA_ "GenSigTimeoutTime_BSM" SG_ 1431 APARequestSts 0;
BA_ "GenSigTimeoutTime_BCM" SG_ 1431 APARequestSts 0;
BA_ "GenSigTimeoutTime_AGSM" SG_ 1431 APARequestSts 0;
BA_ "GenSigTimeoutTime_ADCAM" SG_ 1431 APARequestSts 0;
BA_ "GenSigSendType" SG_ 1431 APARequestSts 3;
BA_ "GenSigTimeoutTime_SGW" SG_ 1431 CRC_BCM12 0;
BA_ "GenSigTimeoutTime_RFHM" SG_ 1431 CRC_BCM12 0;
BA_ "GenSigTimeoutTime_IPC" SG_ 1431 CRC_BCM12 0;
BA_ "GenSigTimeoutTime_GNMM" SG_ 1431 CRC_BCM12 0;
BA_ "GenSigTimeoutTime_EVCU2" SG_ 1431 CRC_BCM12 0;
BA_ "GenSigTimeoutTime_ESL" SG_ 1431 CRC_BCM12 0;
BA_ "GenSigTimeoutTime_ECM" SG_ 1431 CRC_BCM12 0;
BA_ "GenSigTimeoutTime_DMSM" SG_ 1431 CRC_BCM12 0;
BA_ "GenSigTimeoutTime_BCM" SG_ 1431 CRC_BCM12 0;
BA_ "GenSigTimeoutTime_AGSM" SG_ 1431 CRC_BCM12 0;
BA_ "GenSigTimeoutTime_ADCAM" SG_ 1431 CRC_BCM12 0;
BA_ "GenSigTimeoutTime_SGW" SG_ 1431 PreCondCabinSts 0;
BA_ "GenSigTimeoutTime_RFHM" SG_ 1431 PreCondCabinSts 0;
BA_ "GenSigTimeoutTime_MPAD" SG_ 1431 PreCondCabinSts 0;
BA_ "GenSigTimeoutTime_IPC" SG_ 1431 PreCondCabinSts 0;
BA_ "GenSigTimeoutTime_GNMM" SG_ 1431 PreCondCabinSts 0;
BA_ "GenSigTimeoutTime_ESL" SG_ 1431 PreCondCabinSts 0;
BA_ "GenSigTimeoutTime_ECM" SG_ 1431 PreCondCabinSts 0;
BA_ "GenSigTimeoutTime_DTCM" SG_ 1431 PreCondCabinSts 0;
BA_ "GenSigTimeoutTime_DMSM" SG_ 1431 PreCondCabinSts 0;
BA_ "GenSigTimeoutTime_BSM" SG_ 1431 PreCondCabinSts 0;
BA_ "GenSigTimeoutTime_BCM" SG_ 1431 PreCondCabinSts 0;
BA_ "GenSigTimeoutTime_AGSM" SG_ 1431 PreCondCabinSts 0;
BA_ "GenSigTimeoutTime_ADCAM" SG_ 1431 PreCondCabinSts 0;
BA_ "GenSigSendType" SG_ 1431 PreCondCabinSts 3;
BA_ "GenSigTimeoutTime_SGW" SG_ 1431 EPS_MODE_CFG_STAT 0;
BA_ "GenSigTimeoutTime_RFHM" SG_ 1431 EPS_MODE_CFG_STAT 0;
BA_ "GenSigTimeoutTime_MPAD" SG_ 1431 EPS_MODE_CFG_STAT 0;
BA_ "GenSigTimeoutTime_IPC" SG_ 1431 EPS_MODE_CFG_STAT 0;
BA_ "GenSigTimeoutTime_GNMM" SG_ 1431 EPS_MODE_CFG_STAT 0;
BA_ "GenSigTimeoutTime_EVCU2" SG_ 1431 EPS_MODE_CFG_STAT 0;
BA_ "GenSigTimeoutTime_ESL" SG_ 1431 EPS_MODE_CFG_STAT 0;
BA_ "GenSigTimeoutTime_ECM" SG_ 1431 EPS_MODE_CFG_STAT 0;
BA_ "GenSigTimeoutTime_DTCM" SG_ 1431 EPS_MODE_CFG_STAT 0;
BA_ "GenSigTimeoutTime_DMSM" SG_ 1431 EPS_MODE_CFG_STAT 0;
BA_ "GenSigTimeoutTime_BSM" SG_ 1431 EPS_MODE_CFG_STAT 0;
BA_ "GenSigTimeoutTime_BCM" SG_ 1431 EPS_MODE_CFG_STAT 0;
BA_ "GenSigTimeoutTime_AGSM" SG_ 1431 EPS_MODE_CFG_STAT 0;
BA_ "GenSigTimeoutTime_ADCAM" SG_ 1431 EPS_MODE_CFG_STAT 0;
BA_ "GenSigSendType" SG_ 1431 EPS_MODE_CFG_STAT 3;
BA_ "GenSigTimeoutTime_SGW" SG_ 1431 IGN_OFF_TIME_LNG 0;
BA_ "GenSigTimeoutTime_RFHM" SG_ 1431 IGN_OFF_TIME_LNG 0;
BA_ "GenSigTimeoutTime_MPAD" SG_ 1431 IGN_OFF_TIME_LNG 0;
BA_ "GenSigTimeoutTime_IPC" SG_ 1431 IGN_OFF_TIME_LNG 0;
BA_ "GenSigTimeoutTime_GNMM" SG_ 1431 IGN_OFF_TIME_LNG 0;
BA_ "GenSigTimeoutTime_EVCU2" SG_ 1431 IGN_OFF_TIME_LNG 0;
BA_ "GenSigTimeoutTime_ESL" SG_ 1431 IGN_OFF_TIME_LNG 0;
BA_ "GenSigTimeoutTime_ECM" SG_ 1431 IGN_OFF_TIME_LNG 0;
BA_ "GenSigTimeoutTime_DMSM" SG_ 1431 IGN_OFF_TIME_LNG 0;
BA_ "GenSigTimeoutTime_BCM" SG_ 1431 IGN_OFF_TIME_LNG 0;
BA_ "GenSigTimeoutTime_AGSM" SG_ 1431 IGN_OFF_TIME_LNG 0;
BA_ "GenSigTimeoutTime_ADCAM" SG_ 1431 IGN_OFF_TIME_LNG 0;
BA_ "GenSigStartValue" SG_ 1431 IGN_OFF_TIME_LNG 4095;
BA_ "GenSigTimeoutTime_RFHM" SG_ 1430 PanicModeActive 0;
BA_ "GenSigTimeoutTime_MPAD" SG_ 1430 PanicModeActive 0;
BA_ "GenSigTimeoutTime_IPC" SG_ 1430 PanicModeActive 0;
BA_ "GenSigTimeoutTime_GNMM" SG_ 1430 PanicModeActive 0;
BA_ "GenSigTimeoutTime_EVCU2" SG_ 1430 PanicModeActive 0;
BA_ "GenSigTimeoutTime_ESL" SG_ 1430 PanicModeActive 0;
BA_ "GenSigTimeoutTime_ECM" SG_ 1430 PanicModeActive 0;
BA_ "GenSigTimeoutTime_DTCM" SG_ 1430 PanicModeActive 0;
BA_ "GenSigTimeoutTime_DMSM" SG_ 1430 PanicModeActive 0;
BA_ "GenSigTimeoutTime_BSM" SG_ 1430 PanicModeActive 0;
BA_ "GenSigTimeoutTime_BCM" SG_ 1430 PanicModeActive 0;
BA_ "GenSigTimeoutTime_AGSM" SG_ 1430 PanicModeActive 0;
BA_ "GenSigTimeoutTime_ADCAM" SG_ 1430 PanicModeActive 0;
BA_ "GenSigSendType" SG_ 1430 PanicModeActive 3;
BA_ "GenSigTimeoutTime_SGW" SG_ 1431 AirTemp_Outsd 0;
BA_ "GenSigTimeoutTime_RFHM" SG_ 1431 AirTemp_Outsd 0;
BA_ "GenSigTimeoutTime_MPAD" SG_ 1431 AirTemp_Outsd 0;
BA_ "GenSigTimeoutTime_IPC" SG_ 1431 AirTemp_Outsd 0;
BA_ "GenSigTimeoutTime_GNMM" SG_ 1431 AirTemp_Outsd 0;
BA_ "GenSigTimeoutTime_EVCU2" SG_ 1431 AirTemp_Outsd 0;
BA_ "GenSigTimeoutTime_ESL" SG_ 1431 AirTemp_Outsd 0;
BA_ "GenSigTimeoutTime_ECM" SG_ 1431 AirTemp_Outsd 0;
BA_ "GenSigTimeoutTime_DTCM" SG_ 1431 AirTemp_Outsd 0;
BA_ "GenSigTimeoutTime_DMSM" SG_ 1431 AirTemp_Outsd 0;
BA_ "GenSigTimeoutTime_BSM" SG_ 1431 AirTemp_Outsd 0;
BA_ "GenSigTimeoutTime_BCM" SG_ 1431 AirTemp_Outsd 0;
BA_ "GenSigTimeoutTime_AGSM" SG_ 1431 AirTemp_Outsd 0;
BA_ "GenSigTimeoutTime_ADCAM" SG_ 1431 AirTemp_Outsd 0;
BA_ "GenSigSendType" SG_ 1431 AirTemp_Outsd 3;
BA_ "GenSigStartValue" SG_ 1431 AirTemp_Outsd 255;
BA_ "GenSigTimeoutTime_RFHM" SG_ 1430 PN14_LS_Actv 0;
BA_ "GenSigTimeoutTime_MPAD" SG_ 1430 PN14_LS_Actv 0;
BA_ "GenSigTimeoutTime_GNMM" SG_ 1430 PN14_LS_Actv 0;
BA_ "GenSigTimeoutTime_ESL" SG_ 1430 PN14_LS_Actv 0;
BA_ "GenSigTimeoutTime_ECM" SG_ 1430 PN14_LS_Actv 0;
BA_ "GenSigTimeoutTime_DTCM" SG_ 1430 PN14_LS_Actv 0;
BA_ "GenSigTimeoutTime_DMSM" SG_ 1430 PN14_LS_Actv 0;
BA_ "GenSigTimeoutTime_BSM" SG_ 1430 PN14_LS_Actv 0;
BA_ "GenSigTimeoutTime_BCM" SG_ 1430 PN14_LS_Actv 0;
BA_ "GenSigTimeoutTime_AGSM" SG_ 1430 PN14_LS_Actv 0;
BA_ "GenSigTimeoutTime_RFHM" SG_ 1430 PN14_LS_Lvl7 0;
BA_ "GenSigTimeoutTime_MPAD" SG_ 1430 PN14_LS_Lvl7 0;
BA_ "GenSigTimeoutTime_IPC" SG_ 1430 PN14_LS_Lvl7 0;
BA_ "GenSigTimeoutTime_GNMM" SG_ 1430 PN14_LS_Lvl7 0;
BA_ "GenSigTimeoutTime_EVCU2" SG_ 1430 PN14_LS_Lvl7 0;
BA_ "GenSigTimeoutTime_ESL" SG_ 1430 PN14_LS_Lvl7 0;
BA_ "GenSigTimeoutTime_ECM" SG_ 1430 PN14_LS_Lvl7 0;
BA_ "GenSigTimeoutTime_DTCM" SG_ 1430 PN14_LS_Lvl7 0;
BA_ "GenSigTimeoutTime_DMSM" SG_ 1430 PN14_LS_Lvl7 0;
BA_ "GenSigTimeoutTime_BSM" SG_ 1430 PN14_LS_Lvl7 0;
BA_ "GenSigTimeoutTime_BCM" SG_ 1430 PN14_LS_Lvl7 0;
BA_ "GenSigTimeoutTime_AGSM" SG_ 1430 PN14_LS_Lvl7 0;
BA_ "GenSigTimeoutTime_SGW" SG_ 1430 EngineOffTimer 0;
BA_ "GenSigTimeoutTime_RFHM" SG_ 1430 EngineOffTimer 0;
BA_ "GenSigTimeoutTime_MPAD" SG_ 1430 EngineOffTimer 0;
BA_ "GenSigTimeoutTime_IPC" SG_ 1430 EngineOffTimer 0;
BA_ "GenSigTimeoutTime_GNMM" SG_ 1430 EngineOffTimer 0;
BA_ "GenSigTimeoutTime_EVCU2" SG_ 1430 EngineOffTimer 0;
BA_ "GenSigTimeoutTime_ESL" SG_ 1430 EngineOffTimer 0;
BA_ "GenSigTimeoutTime_ECM" SG_ 1430 EngineOffTimer 0;
BA_ "GenSigTimeoutTime_DTCM" SG_ 1430 EngineOffTimer 0;
BA_ "GenSigTimeoutTime_DMSM" SG_ 1430 EngineOffTimer 0;
BA_ "GenSigTimeoutTime_BSM" SG_ 1430 EngineOffTimer 0;
BA_ "GenSigTimeoutTime_BCM" SG_ 1430 EngineOffTimer 0;
BA_ "GenSigTimeoutTime_AGSM" SG_ 1430 EngineOffTimer 0;
BA_ "GenSigTimeoutTime_ADCAM" SG_ 1430 EngineOffTimer 0;
BA_ "GenSigTimeoutTime_RFHM" SG_ 1430 StopStartClimateInfo 0;
BA_ "GenSigTimeoutTime_MPAD" SG_ 1430 StopStartClimateInfo 0;
BA_ "GenSigTimeoutTime_IPC" SG_ 1430 StopStartClimateInfo 0;
BA_ "GenSigTimeoutTime_GNMM" SG_ 1430 StopStartClimateInfo 0;
BA_ "GenSigTimeoutTime_EVCU2" SG_ 1430 StopStartClimateInfo 0;
BA_ "GenSigTimeoutTime_ESL" SG_ 1430 StopStartClimateInfo 0;
BA_ "GenSigTimeoutTime_DTCM" SG_ 1430 StopStartClimateInfo 0;
BA_ "GenSigTimeoutTime_DMSM" SG_ 1430 StopStartClimateInfo 0;
BA_ "GenSigTimeoutTime_BSM" SG_ 1430 StopStartClimateInfo 0;
BA_ "GenSigTimeoutTime_BCM" SG_ 1430 StopStartClimateInfo 0;
BA_ "GenSigTimeoutTime_AGSM" SG_ 1430 StopStartClimateInfo 0;
BA_ "GenSigTimeoutTime_ADCAM" SG_ 1430 StopStartClimateInfo 0;
BA_ "GenSigSendType" SG_ 1430 StopStartClimateInfo 3;
BA_ "GenSigTimeoutTime_MPAD" SG_ 1430 Gate_Req_PE 0;
BA_ "GenSigTimeoutTime_IPC" SG_ 1430 Gate_Req_PE 0;
BA_ "GenSigTimeoutTime_GNMM" SG_ 1430 Gate_Req_PE 0;
BA_ "GenSigTimeoutTime_EVCU2" SG_ 1430 Gate_Req_PE 0;
BA_ "GenSigTimeoutTime_ESL" SG_ 1430 Gate_Req_PE 0;
BA_ "GenSigTimeoutTime_ECM" SG_ 1430 Gate_Req_PE 0;
BA_ "GenSigTimeoutTime_DTCM" SG_ 1430 Gate_Req_PE 0;
BA_ "GenSigTimeoutTime_DMSM" SG_ 1430 Gate_Req_PE 0;
BA_ "GenSigTimeoutTime_BSM" SG_ 1430 Gate_Req_PE 0;
BA_ "GenSigTimeoutTime_BCM" SG_ 1430 Gate_Req_PE 0;
BA_ "GenSigTimeoutTime_AGSM" SG_ 1430 Gate_Req_PE 0;
BA_ "GenSigTimeoutTime_ADCAM" SG_ 1430 Gate_Req_PE 0;
BA_ "GenSigSendType" SG_ 1430 Gate_Req_PE 3;
BA_ "GenSigTimeoutTime_MPAD" SG_ 1153 StTypSts 0;
BA_ "GenSigTimeoutTime_IPC" SG_ 1153 StTypSts 0;
BA_ "GenSigTimeoutTime_GNMM" SG_ 1153 StTypSts 0;
BA_ "GenSigTimeoutTime_EVCU2" SG_ 1153 StTypSts 0;
BA_ "GenSigTimeoutTime_ESL" SG_ 1153 StTypSts 0;
BA_ "GenSigTimeoutTime_ECM" SG_ 1153 StTypSts 0;
BA_ "GenSigTimeoutTime_DTCM" SG_ 1153 StTypSts 0;
BA_ "GenSigTimeoutTime_DMSM" SG_ 1153 StTypSts 0;
BA_ "GenSigTimeoutTime_BSM" SG_ 1153 StTypSts 0;
BA_ "GenSigTimeoutTime_BCM" SG_ 1153 StTypSts 0;
BA_ "GenSigTimeoutTime_AGSM" SG_ 1153 StTypSts 0;
BA_ "GenSigTimeoutTime_ADCAM" SG_ 1153 StTypSts 0;
BA_ "GenSigSendType" SG_ 1153 StTypSts 3;
BA_ "GenSigTimeoutTime_BCM" SG_ 1153 ExternalTemperatureC 0;
BA_ "GenSigStartValue" SG_ 1153 ExternalTemperatureC 511;
BA_ "GenSigStartValue" SG_ 1153 ExternalTemperatureF 511;
BA_ "GenSigTimeoutTime_RFHM" SG_ 1153 ExternalTemperatureF 0;
BA_ "GenSigTimeoutTime_GNMM" SG_ 1153 ExternalTemperatureF 0;
BA_ "GenSigTimeoutTime_EVCU2" SG_ 1153 ExternalTemperatureF 0;
BA_ "GenSigTimeoutTime_ESL" SG_ 1153 ExternalTemperatureF 0;
BA_ "GenSigTimeoutTime_ECM" SG_ 1153 ExternalTemperatureF 0;
BA_ "GenSigTimeoutTime_DTCM" SG_ 1153 ExternalTemperatureF 0;
BA_ "GenSigTimeoutTime_DMSM" SG_ 1153 ExternalTemperatureF 0;
BA_ "GenSigTimeoutTime_BSM" SG_ 1153 ExternalTemperatureF 0;
BA_ "GenSigTimeoutTime_BCM" SG_ 1153 ExternalTemperatureF 0;
BA_ "GenSigTimeoutTime_AGSM" SG_ 1153 ExternalTemperatureF 0;
BA_ "GenSigTimeoutTime_ADCAM" SG_ 1153 ExternalTemperatureF 0;
BA_ "GenSigTimeoutTime_SGW" SG_ 1153 FOBSearchRequest 0;
BA_ "GenSigTimeoutTime_MPAD" SG_ 1153 FOBSearchRequest 0;
BA_ "GenSigTimeoutTime_IPC" SG_ 1153 FOBSearchRequest 0;
BA_ "GenSigTimeoutTime_GNMM" SG_ 1153 FOBSearchRequest 0;
BA_ "GenSigTimeoutTime_EVCU2" SG_ 1153 FOBSearchRequest 0;
BA_ "GenSigTimeoutTime_ESL" SG_ 1153 FOBSearchRequest 0;
BA_ "GenSigTimeoutTime_ECM" SG_ 1153 FOBSearchRequest 0;
BA_ "GenSigTimeoutTime_DTCM" SG_ 1153 FOBSearchRequest 0;
BA_ "GenSigTimeoutTime_DMSM" SG_ 1153 FOBSearchRequest 0;
BA_ "GenSigTimeoutTime_BSM" SG_ 1153 FOBSearchRequest 0;
BA_ "GenSigTimeoutTime_BCM" SG_ 1153 FOBSearchRequest 0;
BA_ "GenSigTimeoutTime_AGSM" SG_ 1153 FOBSearchRequest 0;
BA_ "GenSigTimeoutTime_ADCAM" SG_ 1153 FOBSearchRequest 0;
BA_ "GenSigSendType" SG_ 1153 FOBSearchRequest 3;
BA_ "GenSigTimeoutTime_RFHM" SG_ 1153 SpSt_Pad1 0;
BA_ "GenSigTimeoutTime_MPAD" SG_ 1153 SpSt_Pad1 0;
BA_ "GenSigTimeoutTime_IPC" SG_ 1153 SpSt_Pad1 0;
BA_ "GenSigTimeoutTime_GNMM" SG_ 1153 SpSt_Pad1 0;
BA_ "GenSigTimeoutTime_EVCU2" SG_ 1153 SpSt_Pad1 0;
BA_ "GenSigTimeoutTime_ESL" SG_ 1153 SpSt_Pad1 0;
BA_ "GenSigTimeoutTime_ECM" SG_ 1153 SpSt_Pad1 0;
BA_ "GenSigTimeoutTime_DTCM" SG_ 1153 SpSt_Pad1 0;
BA_ "GenSigTimeoutTime_DMSM" SG_ 1153 SpSt_Pad1 0;
BA_ "GenSigTimeoutTime_BSM" SG_ 1153 SpSt_Pad1 0;
BA_ "GenSigTimeoutTime_BCM" SG_ 1153 SpSt_Pad1 0;
BA_ "GenSigTimeoutTime_AGSM" SG_ 1153 SpSt_Pad1 0;
BA_ "GenSigTimeoutTime_ADCAM" SG_ 1153 SpSt_Pad1 0;
BA_ "GenSigSendType" SG_ 1153 SpSt_Pad1 3;
BA_ "GenSigTimeoutTime_RFHM" SG_ 1430 CMP_DIR 0;
BA_ "GenSigTimeoutTime_MPAD" SG_ 1430 CMP_DIR 0;
BA_ "GenSigTimeoutTime_GNMM" SG_ 1430 CMP_DIR 0;
BA_ "GenSigTimeoutTime_EVCU2" SG_ 1430 CMP_DIR 0;
BA_ "GenSigTimeoutTime_ESL" SG_ 1430 CMP_DIR 0;
BA_ "GenSigTimeoutTime_ECM" SG_ 1430 CMP_DIR 0;
BA_ "GenSigTimeoutTime_DTCM" SG_ 1430 CMP_DIR 0;
BA_ "GenSigTimeoutTime_DMSM" SG_ 1430 CMP_DIR 0;
BA_ "GenSigTimeoutTime_BSM" SG_ 1430 CMP_DIR 0;
BA_ "GenSigTimeoutTime_BCM" SG_ 1430 CMP_DIR 0;
BA_ "GenSigTimeoutTime_AGSM" SG_ 1430 CMP_DIR 0;
BA_ "GenSigTimeoutTime_ADCAM" SG_ 1430 CMP_DIR 0;
BA_ "GenSigSendType" SG_ 1430 CMP_DIR 3;
BA_ "GenSigStartValue" SG_ 1430 CMP_DIR 15;
BA_ "GenSigTimeoutTime_SGW" SG_ 1153 CRC_BCM10 0;
BA_ "GenSigTimeoutTime_ESL" SG_ 1153 CRC_BCM10 0;
BA_ "GenSigTimeoutTime_ECM" SG_ 1153 CRC_BCM10 0;
BA_ "GenSigTimeoutTime_DTCM" SG_ 1153 CRC_BCM10 0;
BA_ "GenSigTimeoutTime_BCM" SG_ 1153 CRC_BCM10 0;
BA_ "GenSigTimeoutTime_SGW" SG_ 1153 MessageCounter_BCM10 0;
BA_ "GenSigTimeoutTime_ESL" SG_ 1153 MessageCounter_BCM10 0;
BA_ "GenSigTimeoutTime_ECM" SG_ 1153 MessageCounter_BCM10 0;
BA_ "GenSigTimeoutTime_DTCM" SG_ 1153 MessageCounter_BCM10 0;
BA_ "GenSigTimeoutTime_BCM" SG_ 1153 MessageCounter_BCM10 0;
BA_ "GenSigTimeoutTime_SGW" SG_ 1153 ExteriorRearReleaseSwitchSts 0;
BA_ "GenSigTimeoutTime_MPAD" SG_ 1153 ExteriorRearReleaseSwitchSts 0;
BA_ "GenSigTimeoutTime_IPC" SG_ 1153 ExteriorRearReleaseSwitchSts 0;
BA_ "GenSigTimeoutTime_GNMM" SG_ 1153 ExteriorRearReleaseSwitchSts 0;
BA_ "GenSigTimeoutTime_EVCU2" SG_ 1153 ExteriorRearReleaseSwitchSts 0;
BA_ "GenSigTimeoutTime_ESL" SG_ 1153 ExteriorRearReleaseSwitchSts 0;
BA_ "GenSigTimeoutTime_ECM" SG_ 1153 ExteriorRearReleaseSwitchSts 0;
BA_ "GenSigTimeoutTime_DTCM" SG_ 1153 ExteriorRearReleaseSwitchSts 0;
BA_ "GenSigTimeoutTime_DMSM" SG_ 1153 ExteriorRearReleaseSwitchSts 0;
BA_ "GenSigTimeoutTime_BSM" SG_ 1153 ExteriorRearReleaseSwitchSts 0;
BA_ "GenSigTimeoutTime_BCM" SG_ 1153 ExteriorRearReleaseSwitchSts 0;
BA_ "GenSigTimeoutTime_AGSM" SG_ 1153 ExteriorRearReleaseSwitchSts 0;
BA_ "GenSigTimeoutTime_ADCAM" SG_ 1153 ExteriorRearReleaseSwitchSts 0;
BA_ "GenSigSendType" SG_ 1153 ExteriorRearReleaseSwitchSts 3;
BA_ "GenSigTimeoutTime_MPAD" SG_ 1153 PANEL_INTS 0;
BA_ "GenSigTimeoutTime_IPC" SG_ 1153 PANEL_INTS 0;
BA_ "GenSigTimeoutTime_GNMM" SG_ 1153 PANEL_INTS 0;
BA_ "GenSigTimeoutTime_EVCU2" SG_ 1153 PANEL_INTS 0;
BA_ "GenSigTimeoutTime_ESL" SG_ 1153 PANEL_INTS 0;
BA_ "GenSigTimeoutTime_ECM" SG_ 1153 PANEL_INTS 0;
BA_ "GenSigTimeoutTime_DTCM" SG_ 1153 PANEL_INTS 0;
BA_ "GenSigTimeoutTime_DMSM" SG_ 1153 PANEL_INTS 0;
BA_ "GenSigTimeoutTime_BCM" SG_ 1153 PANEL_INTS 0;
BA_ "GenSigTimeoutTime_ADCAM" SG_ 1153 PANEL_INTS 0;
BA_ "GenSigSendType" SG_ 1153 PANEL_INTS 3;
BA_ "GenSigTimeoutTime_RFHM" SG_ 1153 TurnIndicationSts 0;
BA_ "GenSigTimeoutTime_IPC" SG_ 1153 TurnIndicationSts 0;
BA_ "GenSigTimeoutTime_GNMM" SG_ 1153 TurnIndicationSts 0;
BA_ "GenSigTimeoutTime_EVCU2" SG_ 1153 TurnIndicationSts 0;
BA_ "GenSigTimeoutTime_ESL" SG_ 1153 TurnIndicationSts 0;
BA_ "GenSigTimeoutTime_ECM" SG_ 1153 TurnIndicationSts 0;
BA_ "GenSigTimeoutTime_DTCM" SG_ 1153 TurnIndicationSts 0;
BA_ "GenSigTimeoutTime_DMSM" SG_ 1153 TurnIndicationSts 0;
BA_ "GenSigTimeoutTime_BSM" SG_ 1153 TurnIndicationSts 0;
BA_ "GenSigTimeoutTime_BCM" SG_ 1153 TurnIndicationSts 0;
BA_ "GenSigTimeoutTime_AGSM" SG_ 1153 TurnIndicationSts 0;
BA_ "GenSigSendType" SG_ 1153 TurnIndicationSts 3;
BA_ "GenSigTimeoutTime_RFHM" SG_ 1153 RemSt_InhibitSts 0;
BA_ "GenSigTimeoutTime_MPAD" SG_ 1153 RemSt_InhibitSts 0;
BA_ "GenSigTimeoutTime_GNMM" SG_ 1153 RemSt_InhibitSts 0;
BA_ "GenSigTimeoutTime_EVCU2" SG_ 1153 RemSt_InhibitSts 0;
BA_ "GenSigTimeoutTime_ESL" SG_ 1153 RemSt_InhibitSts 0;
BA_ "GenSigTimeoutTime_ECM" SG_ 1153 RemSt_InhibitSts 0;
BA_ "GenSigTimeoutTime_DTCM" SG_ 1153 RemSt_InhibitSts 0;
BA_ "GenSigTimeoutTime_DMSM" SG_ 1153 RemSt_InhibitSts 0;
BA_ "GenSigTimeoutTime_BSM" SG_ 1153 RemSt_InhibitSts 0;
BA_ "GenSigTimeoutTime_BCM" SG_ 1153 RemSt_InhibitSts 0;
BA_ "GenSigTimeoutTime_AGSM" SG_ 1153 RemSt_InhibitSts 0;
BA_ "GenSigTimeoutTime_ADCAM" SG_ 1153 RemSt_InhibitSts 0;
BA_ "GenSigTimeoutTime_SGW" SG_ 1445 ADS_SrvSys 0;
BA_ "GenSigTimeoutTime_RFHM" SG_ 1445 ADS_SrvSys 0;
BA_ "GenSigTimeoutTime_MPAD" SG_ 1445 ADS_SrvSys 0;
BA_ "GenSigTimeoutTime_GNMM" SG_ 1445 ADS_SrvSys 0;
BA_ "GenSigTimeoutTime_EVCU2" SG_ 1445 ADS_SrvSys 0;
BA_ "GenSigTimeoutTime_ESL" SG_ 1445 ADS_SrvSys 0;
BA_ "GenSigTimeoutTime_ECM" SG_ 1445 ADS_SrvSys 0;
BA_ "GenSigTimeoutTime_DTCM" SG_ 1445 ADS_SrvSys 0;
BA_ "GenSigTimeoutTime_DMSM" SG_ 1445 ADS_SrvSys 0;
BA_ "GenSigTimeoutTime_BSM" SG_ 1445 ADS_SrvSys 0;
BA_ "GenSigTimeoutTime_BCM" SG_ 1445 ADS_SrvSys 0;
BA_ "GenSigTimeoutTime_AGSM" SG_ 1445 ADS_SrvSys 0;
BA_ "GenSigTimeoutTime_ADCAM" SG_ 1445 ADS_SrvSys 0;
BA_ "GenSigSendType" SG_ 1445 ADS_SrvSys 3;
BA_ "GenSigTimeoutTime_SGW" SG_ 2654555935 APPL_ECU_FD_AGSM 0;
BA_ "GenSigTimeoutTime_RFHM" SG_ 2654555935 APPL_ECU_FD_AGSM 0;
BA_ "GenSigTimeoutTime_MPAD" SG_ 2654555935 APPL_ECU_FD_AGSM 0;
BA_ "GenSigTimeoutTime_IPC" SG_ 2654555935 APPL_ECU_FD_AGSM 0;
BA_ "GenSigTimeoutTime_GNMM" SG_ 2654555935 APPL_ECU_FD_AGSM 0;
BA_ "GenSigTimeoutTime_EVCU2" SG_ 2654555935 APPL_ECU_FD_AGSM 0;
BA_ "GenSigTimeoutTime_ESL" SG_ 2654555935 APPL_ECU_FD_AGSM 0;
BA_ "GenSigTimeoutTime_ECM" SG_ 2654555935 APPL_ECU_FD_AGSM 0;
BA_ "GenSigTimeoutTime_DTCM" SG_ 2654555935 APPL_ECU_FD_AGSM 0;
BA_ "GenSigTimeoutTime_DMSM" SG_ 2654555935 APPL_ECU_FD_AGSM 0;
BA_ "GenSigTimeoutTime_BSM" SG_ 2654555935 APPL_ECU_FD_AGSM 0;
BA_ "GenSigTimeoutTime_BCM" SG_ 2654555935 APPL_ECU_FD_AGSM 0;
BA_ "GenSigTimeoutTime_ADCAM" SG_ 2654555935 APPL_ECU_FD_AGSM 0;
BA_ "GenSigTimeoutTime_SGW" SG_ 2654555920 APPL_ECU_FD_ECM 0;
BA_ "GenSigTimeoutTime_RFHM" SG_ 2654555920 APPL_ECU_FD_ECM 0;
BA_ "GenSigTimeoutTime_MPAD" SG_ 2654555920 APPL_ECU_FD_ECM 0;
BA_ "GenSigTimeoutTime_IPC" SG_ 2654555920 APPL_ECU_FD_ECM 0;
BA_ "GenSigTimeoutTime_GNMM" SG_ 2654555920 APPL_ECU_FD_ECM 0;
BA_ "GenSigTimeoutTime_EVCU2" SG_ 2654555920 APPL_ECU_FD_ECM 0;
BA_ "GenSigTimeoutTime_ESL" SG_ 2654555920 APPL_ECU_FD_ECM 0;
BA_ "GenSigTimeoutTime_DTCM" SG_ 2654555920 APPL_ECU_FD_ECM 0;
BA_ "GenSigTimeoutTime_DMSM" SG_ 2654555920 APPL_ECU_FD_ECM 0;
BA_ "GenSigTimeoutTime_BSM" SG_ 2654555920 APPL_ECU_FD_ECM 0;
BA_ "GenSigTimeoutTime_BCM" SG_ 2654555920 APPL_ECU_FD_ECM 0;
BA_ "GenSigTimeoutTime_AGSM" SG_ 2654555920 APPL_ECU_FD_ECM 0;
BA_ "GenSigTimeoutTime_ADCAM" SG_ 2654555920 APPL_ECU_FD_ECM 0;
BA_ "GenSigTimeoutTime_SGW" SG_ 2654555930 APPL_ECU_FD_DTCM 0;
BA_ "GenSigTimeoutTime_RFHM" SG_ 2654555930 APPL_ECU_FD_DTCM 0;
BA_ "GenSigTimeoutTime_MPAD" SG_ 2654555930 APPL_ECU_FD_DTCM 0;
BA_ "GenSigTimeoutTime_IPC" SG_ 2654555930 APPL_ECU_FD_DTCM 0;
BA_ "GenSigTimeoutTime_GNMM" SG_ 2654555930 APPL_ECU_FD_DTCM 0;
BA_ "GenSigTimeoutTime_EVCU2" SG_ 2654555930 APPL_ECU_FD_DTCM 0;
BA_ "GenSigTimeoutTime_ESL" SG_ 2654555930 APPL_ECU_FD_DTCM 0;
BA_ "GenSigTimeoutTime_ECM" SG_ 2654555930 APPL_ECU_FD_DTCM 0;
BA_ "GenSigTimeoutTime_DMSM" SG_ 2654555930 APPL_ECU_FD_DTCM 0;
BA_ "GenSigTimeoutTime_BSM" SG_ 2654555930 APPL_ECU_FD_DTCM 0;
BA_ "GenSigTimeoutTime_BCM" SG_ 2654555930 APPL_ECU_FD_DTCM 0;
BA_ "GenSigTimeoutTime_AGSM" SG_ 2654555930 APPL_ECU_FD_DTCM 0;
BA_ "GenSigTimeoutTime_ADCAM" SG_ 2654555930 APPL_ECU_FD_DTCM 0;
VAL_ 1430 Gate_Req_PE 0 "No PE Request" 1 "Handle PE Request" 2 "Button PE Request" 3 "Hands-Free PE Request";
VAL_ 513 VehicleStandStillSts 0 "True" 1 "False" 3 "SNA";
VAL_ 513 ShftChrDsp_Rq_ESC 0 "SKL0" 1 "SKL1" 2 "SKL2" 3 "SKL3" 4 "SKL4" 5 "SKL5" 6 "SKL6" 7 "SKL7" 8 "SKL8" 9 "SKL9" 10 "SKL10" 11 "SKL11" 12 "SKL12" 15 "SNA";
VAL_ 513 Ft_RrTrqCoupling_ModeRq 0 "FREE" 1 "HOLD" 2 "OPEN" 3 "SNA";
VAL_ 513 ExternalBrkRequestsDisabled 0 "No request" 1 "External Systems temporary off" 2 "External Systems continuous off" 3 "SNA";
VAL_ 513 BrkTrq_Driver 32767 "SNA";
VAL_ 513 BrkTrq 32767 "SNA";
VAL_ 513 Brk_Thermdl 0 "Normal_Temperature" 1 "High_Temperature";
VAL_ 245 MinicryptReceptionSts 0 "Not_Received" 1 "Received";
VAL_ 1066 TheftAlarmStatus 0 "VTA_DISARM" 1 "VTA_PREARM" 2 "VTA_ARM" 3 "VTA_LGT" 4 "VTA_LGT_HORN" 5 "VTA_TAMP" 6 "VTA_ITM_Alarm" 7 "SNA";
VAL_ 1066 StopLightSts 0 "OFF" 1 "ON";
VAL_ 1066 StopLightFault 0 "False" 1 "True";
VAL_ 1066 RHTurnSignalSts 0 "OFF" 1 "ON";
VAL_ 1066 PowerModeSts 0 "Standard_Power" 1 "Logistic_Mode_ON" 2 "Logistic_Mode_PR" 3 "LogisticModeON_and_EngineON";
VAL_ 1066 ParkBrakeSts 0 "OFF" 1 "ON";
VAL_ 1066 LHTurnSignalSts 0 "OFF" 1 "ON";
VAL_ 1066 LHParkingLightSts 0 "OFF" 1 "ON";
VAL_ 1066 HighBeamSts 0 "OFF" 1 "ON";
VAL_ 1066 FuelLevel 255 "SNA";
VAL_ 1066 BonnetSts 0 "Closed" 1 "Open";
VAL_ 1066 AHBFeature 0 "OFF" 1 "ON";
VAL_ 1375 ChkFuelLevelSts 0 "Fault_Not_Present" 1 "Chk_Code_1" 2 "Chk_Code_2" 3 "Chk_Code_3" 4 "Chk_Code_4" 5 "Not_Used" 6 "Not_Used" 7 "Not_Used";
VAL_ 1051 RollAngle 255 "SNA";
VAL_ 1051 PitchAngle 255 "SNA";
VAL_ 1051 FUEL_VOLT 255 "SNA";
VAL_ 256 OperationalModeSts 0 "Initialization" 1 "Ignition_Off_WithoutKey" 2 "Ignition_Off" 3 "Ignition_Acc" 4 "Ignition_On" 5 "Ignition_Pre_Start" 6 "Ignition_Start" 7 "Ignition_Cranking" 8 "Ignition_On_EngOn" 9 "Ignition_Pre_Acc" 10 "Ignition_Pre_Off" 11 "Automatic_Cranking" 12 "Automatic_Stop" 13 "Key_Authenticated" 14 "Not_Used" 15 "SNA";
VAL_ 256 KeyInIgnSts 0 "KEY_DEF" 1 "KEY_NOT_IN_IGN" 2 "KEY_IN_IGN" 3 "SNA";
VAL_ 256 EngineOffRequest 0 "Not_Active" 1 "Active";
VAL_ 736 Command_15Sts 0 "Not_Pressed" 1 "Pressed" 3 "SNA";
VAL_ 736 Command_14Sts 0 "Not_Pressed" 1 "Pressed" 3 "SNA";
VAL_ 736 Command_13Sts 0 "Not_Pressed" 1 "Pressed" 3 "SNA";
VAL_ 736 Command_12Sts 0 "Not_Pressed" 1 "Pressed" 3 "SNA";
VAL_ 736 Command_11Sts 0 "Not_Pressed" 1 "Pressed" 3 "SNA";
VAL_ 736 Command_10Sts 0 "Not_Pressed" 1 "Pressed" 3 "SNA";
VAL_ 736 Command_09Sts 0 "Not_Pressed" 1 "Pressed" 3 "SNA";
VAL_ 736 Command_08Sts 0 "Not_Pressed" 1 "Pressed" 3 "SNA";
VAL_ 736 Command_07Sts 0 "Not_Pressed" 1 "Pressed" 3 "SNA";
VAL_ 736 Command_06Sts 0 "Not_Pressed" 1 "Pressed" 3 "SNA";
VAL_ 736 Command_05Sts 0 "Not_Pressed" 1 "Pressed" 3 "SNA";
VAL_ 736 Command_04Sts 0 "Not_Pressed" 1 "Pressed" 3 "SNA";
VAL_ 736 Command_03Sts 0 "Not_Pressed" 1 "Pressed" 3 "SNA";
VAL_ 736 Command_02Sts 0 "Not_Pressed" 1 "Pressed" 3 "SNA";
VAL_ 736 Command_01Sts 0 "Not_Pressed" 1 "Pressed" 3 "SNA";
VAL_ 159 SpeedLimiterOnOffSts 0 "Not_Active" 1 "Active";
VAL_ 159 CrusCnclSwitch 0 "Not_Active" 1 "Active";
VAL_ 159 ACC_On 0 "Not_Active" 1 "Active";
VAL_ 159 ACC_DistSwInc 0 "Not_Active" 1 "Active";
VAL_ 159 ACC_DistSwDec 0 "Not_Active" 1 "Active";
VAL_ 1431 Switch2_Rq 0 "NOT_PSD" 1 "PSD" 2 "Not_Defined" 3 "SNA";
VAL_ 1431 Switch1_Rq 0 "NOT_PSD" 1 "PSD" 2 "Not_Defined" 3 "SNA";
VAL_ 1430 StopStartClimateInfo 0 "SPST_ON" 1 "CABIN_HI" 2 "CABIN_LO" 3 "MAX_AC" 4 "FT_DEFROST" 5 "EBL" 7 "SNA";
VAL_ 1430 PN14_LS_Lvl7 0 "Not_Active" 1 "Active";
VAL_ 1430 PN14_LS_Actv 0 "Not_Active" 1 "Active";
VAL_ 1430 EngineOffTimer 4095 "SNA";
VAL_ 1153 StTypSts 0 "ST_NOT_ACT" 1 "NOR_ST" 2 "TIP_ST" 3 "REM_ST" 7 "SNA";
VAL_ 1153 FOBSearchRequest 0 "NO_ACTION" 1 "REQUEST_SEARCH" 2 "RESULT_RECEIVED" 3 "RESERVED";
VAL_ 1153 ExternalTemperatureF 511 "SNA";
VAL_ 1153 ExternalTemperatureC 511 "SNA";
VAL_ 1153 CompressorACReqSts 0 "Not_Active" 1 "Active";
VAL_ 1153 CmdIgnSts 0 "Initialization" 1 "IGN_LK" 3 "ACC" 4 "RUN" 5 "START" 7 "SNA";
VAL_ 246 ESLLockUnlockReq_ESL_Rq 0 "Not_Request" 1 "Unlock" 2 "Lock" 3 "Not_Used";
VAL_ 513 SelSpdLmp 0 "OFF" 1 "CONT" 2 "BLINK" 3 "SNA";
VAL_ 513 SelectSpdSts 0 "OFF" 1 "Select Speed Mode" 2 "Select Speed Mode Inhibit" 3 "SNA";
VAL_ 513 REF_VEH_SPEED 1023 "SNA";
VAL_ 513 Ft_RrAxleCoupling_TrqRq 255 "SNA";
VAL_ 1066 WashLightWarningSts 0 "Not_Active" 1 "Active";
VAL_ 1066 RHRDoorSts 0 "Closed" 1 "Open";
VAL_ 1066 RHParkingLightSts 0 "OFF" 1 "ON";
VAL_ 1066 RHatchSts 0 "Closed" 1 "Open";
VAL_ 1066 RearTrunkEnableLastElSts 0 "Disabled" 1 "Enabled";
VAL_ 1066 RearFogLightSts 0 "OFF" 1 "ON";
VAL_ 1066 RainSensorFailSts 0 "Fail_not_present" 1 "Fail_present";
VAL_ 1066 PsngrDoorSts 0 "Closed" 1 "Open";
VAL_ 1066 MoveWheelSts 0 "Not_Active" 1 "Active";
VAL_ 1066 LowFuelWarningSts 0 "OFF" 1 "ON";
VAL_ 1066 LowBeamSts 0 "OFF" 1 "ON";
VAL_ 1066 LHRDoorSts 0 "Closed" 1 "Open";
VAL_ 1066 HDCFnRqstSts 0 "Open" 1 "Closed" 3 "SNA";
VAL_ 1066 FrontWiperMoveSts 0 "Stop" 1 "Moving";
VAL_ 1066 FrontFogLightSts 0 "OFF" 1 "ON";
VAL_ 1066 ExternalTemperature 511 "SNA";
VAL_ 1066 ESLUnlockFailSts_Indication 0 "Not_Failure" 1 "Failure";
VAL_ 1066 ESLLockFailSts_Indication 0 "Not_Failure" 1 "Failure";
VAL_ 1066 DriverDoorSts 0 "Closed" 1 "Open";
VAL_ 1066 DoorLockLastElSts 0 "Locked" 1 "Driver_Door_Unlocked" 2 "All_Door_Unlocked" 3 "SNA";
VAL_ 1066 BrakeFluidLevelSts 0 "OK" 1 "Low_level";
VAL_ 1375 FrontWiperReq 0 "OFF" 1 "INT" 2 "LOW" 3 "HIGH" 4 "AUTO" 5 "MIST";
VAL_ 1051 FUEL_VOLT2 255 "SNA";
VAL_ 256 TurnIndicatorSts 0 "Center" 1 "Right" 2 "Left" 3 "SNA";
VAL_ 256 RemStActvSts_R 0 "Remote Start Not Active" 1 "Remote Start Active";
VAL_ 256 RemStActvSts 0 "Remote Start Not Active" 1 "Remote Start Active";
VAL_ 256 RefuelRequest 0 "NO" 1 "Refuel" 3 "SNA";
VAL_ 256 BrkPdlStat_BCM 0 "UPSTOP" 1 "PSD" 2 "NDEF2" 3 "SNA";
VAL_ 512 LeakCheckTimerExpired 0 "NOT" 1 "ELAPSED" 3 "SNA";
VAL_ 1431 TRAC_PSD 0 "NOT_PRESSED" 1 "PRESSED";
VAL_ 1431 TerrainSwStat 0 "Not_Activated" 1 "Left_Up_Activated" 2 "Right_Down_Activated" 5 "Short_to_Ground_Fault" 6 "Open_Short_to_Power_Fault" 7 "SNA";
VAL_ 1431 PreCondCabinSts 0 "Off" 1 "On" 2 "SPR" 3 "SNA";
VAL_ 1431 IGN_OFF_TIME_LNG 4095 "SNA";
VAL_ 1431 EPS_MODE_CFG_STAT 0 "MODE_1" 1 "MODE_2" 2 "MODE_3" 3 "LAST" 7 "SNA";
VAL_ 1431 AirTemp_Outsd 255 "SNA";
VAL_ 1430 PanicModeActive 0 "Not_Active" 1 "Active";
VAL_ 1430 CMP_DIR 0 "CMP_N" 1 "CMP_N_E" 2 "CMP_E" 3 "CMP_S_E" 4 "CMP_S" 5 "CMP_S_W" 6 "CMP_W" 7 "CMP_N_W" 15 "SNA";
VAL_ 1153 TurnIndicationSts 0 "Center" 1 "Right" 2 "Left" 3 "SNA";
VAL_ 1153 SpSt_Pad1 0 "Not_Selected" 1 "Sw1_Activated" 2 "Sw2_Activated" 3 "Sw1_and_Sw2_Activated" 4 "Invalid_State" 5 "Short_to_Ground" 6 "Short_to_Power" 7 "SNA";
VAL_ 1153 RemSt_InhibitSts 0 "INHIBIT_DEFAUILT" 1 "TIME_OUT_RUN" 2 "TIME_OUT_CUST_MODE" 3 "KEY_IN_RUN" 4 "DRV_DOOR_AJAR" 5 "PASS_DOOR_AJAR" 6 "LR_DOOR_AJAR" 7 "RR_DOOR_AJAR" 8 "START_COUNTER" 9 "FAIL_COUNTER" 10 "LOW_RPM_SHUTDOWN" 11 "KEY_IN_IGN" 12 "BRAKE_PRESSED" 13 "HAZARD_LAMP_ON" 14 "NOT_IN_PARK" 15 "VEH_SPEED_HIGH" 16 "HOOD_AJAR" 17 "TRUNK_LIFTGATE" 18 "VTA_ALARM" 19 "PANIC_MODE" 20 "BATT_VOLT_HIGH" 21 "BATT_VOLT_LOW" 22 "POWER_LOSS" 23 "MIL_ON" 24 "OIL_PRESSURE_LOW" 25 "COOLANT_TEMP_HIGH" 26 "RPM_HIGH" 27 "CRANK_NO_START" 28 "REMOTE_OFF_RQ" 29 "RS_DISABLED_PREV" 30 "NOT_CONFIGURED" 31 "NO_HOOD_SWITCH" 32 "NO_AUTO_TRANS" 33 "NOT_ENABLED" 34 "INVALID_SKIM_KEY" 35 "IGN_SNA" 36 "IGN_NOT_LOCK" 37 "GLOW_PLUG_TIMEOUT" 38 "LOW_FUEL" 39 "ETC_LAMP_ON" 40 "LOGISTIC_MODE" 41 "COLD_START_LAMP_FLASH" 42 "ABORT_CRANKING_ENABLE" 43 "RFHUB_HS_FAIL" 44 "FAIL_HCSS" 45 "FOTA_INSTALL_FAIL" 46 "PSA_NOT_ACTIVE" 47 "ESL_NOT_UNLOCKED" 62 "EPB_NO_RESP" 63 "SNA";
VAL_ 1153 PANEL_INTS 255 "SNA";
VAL_ 1153 ExteriorRearReleaseSwitchSts 0 "Not_Pressed" 1 "Pressed";
VAL_ 1445 ADS_SrvSys 0 "FALSE" 1 "TRUE";
VAL_ 512 DRV_DR_UNLOCKING 0 "Not_Active" 1 "Active";
VAL_ 1431 PAMRequestSts 0 "Not_Pressed" 1 "Pressed";
VAL_ 1431 APARequestSts 0 "Not_Pressed" 1 "Pressed";
VAL_ 513 DASEngReqPos 0 "Not_Allowed" 1 "Allowed";
VAL_ 513 Brk_Jrk_Resp 0 "Not_Executed" 1 "Executed";
VAL_ 1051 EVAP_TEMP_P1C 2047 "SNA";
VAL_ 1051 AM_ECM_Trace 0 "DEFAULT" 2 "AM_ECM_TRACE" 3 "SNA";
VAL_ 1066 TrunkHandleReleaseSts 0 "Not_Active" 1 "Active";
VAL_ 159 ResumeSwitch 0 "Not_Active" 1 "Active";
VAL_ 159 DeceleratorSts 0 "Not_Active" 1 "Active";
VAL_ 159 CruiseControlOnOffSts 0 "Not_Active" 1 "Active";
VAL_ 159 CruiseControlFailSts 0 "Fail_Not_Present" 1 "Fail_Present";
VAL_ 159 AcceleratorSts 0 "Not_Active" 1 "Active";
VAL_ 1431 DALM_Status 0 "No_Fault" 1 "Fault";
VAL_ 1430 Batt_ST_Crit 0 "False" 1 "True";
VAL_ 1153 WPR_SYS_AUTO 0 "SNA";
VAL_ 1430 DCSD_TUNEKNOB_DIR 0 "KNOB_NO_CHNG" 1 "KNOB_INC_POS" 2 "KNOB_DEC_NEG" 3 "KNOB_ENTER";
VAL_ 1430 DCSD_Enter 0 "Enter_Not_Pressed" 1 "Enter_Pressed";
VAL_ 1430 A2D_DRV_TEMP_DR_POS 1023 "SNA";
VAL_ 951 UConnReqFOBNum_TBM 0 "FOB_DEFAULT" 1 "FOB_1" 2 "FOB_2" 3 "FOB_3" 4 "FOB_4" 5 "FOB_5" 6 "FOB_6" 7 "FOB_7" 8 "FOB_8" 15 "SNA";
VAL_ 951 UConnReq_TBM 0 "NO_BASIC_REQUEST" 1 "LOCK_REQUEST" 2 "RELOCK_REQUEST" 3 "DRIVER_UNLOCK_REQUEST" 4 "ALL_UNLOCK_REQUEST" 5 "TRUNK_PLG_TOGGLE_REQUEST" 6 "LEFT_SLIDER_TOGGLE_REQUEST" 7 "RIGHT_SLIDER_TOGGLE_REQUEST" 8 "FLIPPER_GLASS_REQUEST" 9 "REMOTE_START_ON" 10 "REMOTE_START_OFF" 11 "GLOBAL_WINDOW_DOWN_REQUEST" 12 "OPEN_CONVERTIBLE_TOP" 13 "CLOSE_CONVERTIBLE_TOP" 14 "PANIC_TOGGLE_REQUEST" 15 "DRIVER_TOGGLE_REQUEST" 16 "PASSENGER_TOGGLE_REQUEST" 17 "ExtLightReq" 18 "AirSuspReq" 19 "AirSuspCancel" 20 "GLBL_WIN_UP_RQ" 21 "CAR_FINDER_REQUEST" 22 "TRUNK_PLG_BTN_PRESSED" 23 "TRUNK_PLG_STOP_REQUEST" 24 "TRUNK_PLG_OPEN_REQUEST" 25 "TRUNK_PLG_CLOSE_REQUEST" 26 "VTA_RQ" 27 "RAP_UNLOCK_REQUEST" 28 "ABORT_CRANKING_ON_REQUEST" 29 "ABORT_CRANKING_OFF_REQUEST" 30 "Remote_Headlights" 31 "SNA";
VAL_ 1375 ChkFuelLevelSts2 0 "Fault_Not_Present" 1 "Chk_Code_1" 2 "Chk_Code_2" 3 "Chk_Code_3" 4 "Chk_Code_4" 5 "Not_Used" 6 "Not_Used" 7 "Not_Used";
VAL_ 1431 SeatVib_Sts 0 "INIT" 1 "IDLE" 2 "ACTIVE" 3 "FAULTED";
VAL_ 1375 SysEOLSts 0 "EOL_Ready" 1 "EOL_Not_Ready";
VAL_ 513 HILL_DES_STAT 0 "HDC_UNAVL" 1 "HDC_ACT" 2 "HDC_AVL" 3 "HDC_THRML_DEACT" 4 "HDC_OVERRIDE";
VAL_ 1153 FOA_Msg_Req 0 "No_Msg" 1 "FOA_TURNED_OFF_ALERT" 2 "FOA_FAULTED" 3 "FOA_ARMED_ALERT" 4 "FOA_LEVEL1_ALERT" 5 "FOA_LEVEL2_ALERT" 6 "FOA_LEVEL2_ALERT_CONNECTIVITY";
VAL_ 256 SCCActvSts 0 "Remote Start Not Active" 1 "Remote Start Active";
VAL_ 1153 SCC_InhibitSts 0 "INHIBIT_DEFAUILT" 1 "TIME_OUT_RUN" 2 "TIME_OUT_CUST_MODE" 3 "KEY_IN_RUN" 4 "DRV_DOOR_AJAR" 5 "PASS_DOOR_AJAR" 6 "LR_DOOR_AJAR" 7 "RR_DOOR_AJAR" 8 "START_COUNTER" 9 "FAIL_COUNTER" 10 "LOW_RPM_SHUTDOWN" 11 "KEY_IN_IGN" 12 "BRAKE_PRESSED" 13 "HAZARD_LAMP_ON" 14 "NOT_IN_PARK" 15 "VEH_SPEED_HIGH" 16 "HOOD_AJAR" 17 "TRUNK_LIFTGATE" 18 "VTA_ALARM" 19 "PANIC_MODE" 20 "BATT_VOLT_HIGH" 21 "BATT_VOLT_LOW" 22 "POWER_LOSS" 23 "MIL_ON" 24 "OIL_PRESSURE_LOW" 25 "COOLANT_TEMP_HIGH" 26 "RPM_HIGH" 27 "CRANK_NO_START" 28 "REMOTE_OFF_RQ" 29 "RS_DISABLED_PREV" 30 "NOT_CONFIGURED" 31 "NO_HOOD_SWITCH" 32 "NO_AUTO_TRANS" 33 "NOT_ENABLED" 34 "INVALID_SKIM_KEY" 35 "IGN_SNA" 36 "IGN_NOT_LOCK" 37 "GLOW_PLUG_TIMEOUT" 38 "LOW_FUEL" 39 "ETC_LAMP_ON" 40 "LOGISTIC_MODE" 41 "COLD_START_LAMP_FLASH" 44 "FAIL_HCSS" 45 "FOTA_INSTALL_FAIL" 62 "EPB_NO_RESP" 63 "SNA";
VAL_ 1153 DAY_LGT_MD 0 "Night" 1 "Day";
VAL_ 513 eBurn_Stages 0 "Normal_Stage" 1 "Stage_1" 2 "Stage_2" 3 "Stage_3" 7 "SNA";
VAL_ 512 Fuel_Door_Sts 0 "Not_Pressed_Switch_Close" 1 "Pressed_Switch_Open" 2 "Short_Circuit_to_Ground" 3 "Short_to_battery" 7 "SNA";
VAL_ 512 Braking_Mode_Req 0 "Not_Pressed" 1 "Pressed" 2 "Short_to_Ground" 3 "Short_to_Battery" 7 "SNA";
VAL_ 1051 RR_HS_STATFailSts 0 "Fail_Not_Present" 1 "Fail_Present";
VAL_ 1051 RR_HS_STAT 0 "Heated_seat_off" 1 "Heated_seat_low" 2 "Heated_seat_medium" 3 "Heated_seat_high";
VAL_ 1051 RL_HS_STATFailSts 0 "Fail_Not_Present" 1 "Fail_Present";
VAL_ 1051 RL_HS_STAT 0 "Heated_seat_off" 1 "Heated_seat_low" 2 "Heated_seat_medium" 3 "Heated_seat_high";
VAL_ 1051 HSW_StatFailSts 0 "Fail_Not_Present" 1 "Fail_Present";
VAL_ 1051 FR_VS_STATSts 0 "Vented_seat_off" 1 "Vented_seat_low" 2 "Vented_seat_medium" 3 "Vented_seat_high";
VAL_ 1051 FR_VS_STATFailSts 0 "Fail_Not_Present" 1 "Fail_Present";
VAL_ 1051 FL_VS_STATSts 0 "Vented_seat_off" 1 "Vented_seat_low" 2 "Vented_seat_medium" 3 "Vented_seat_high";
VAL_ 1051 FL_VS_STATFailSts 0 "Fail_Not_Present" 1 "Fail_Present";
VAL_ 1051 RR_VS_STATFailSts 0 "Fail_Not_Present" 1 "Fail_Present";
VAL_ 1051 RR_VS_STAT 0 "Vented_seat_off" 1 "Vented_seat_low" 2 "Vented_seat_medium" 3 "Vented_seat_high";
VAL_ 1051 RL_VS_STATFailSts 0 "Fail_Not_Present" 1 "Fail_Present";
VAL_ 1051 RL_VS_STAT 0 "Vented_seat_off" 1 "Vented_seat_low" 2 "Vented_seat_medium" 3 "Vented_seat_high";
VAL_ 1827 AbsoluteTimerSeconds 131071 "SNA";
VAL_ 1827 AbsoluteTimerDays 65535 "SNA";
VAL_ 1431 AxleLckrSEL_SW 0 "NOT_PSD" 1 "UP_PSD" 2 "DOWN_PSD" 3 "SNA";
VAL_ 1153 FOA_Mobile_App_Alert 0 "Not_Active" 1 "Active";
SIG_GROUP_ 513 BRAKE_FD_1_Pkt 1 : VehicleStandStillSts ShftChrDsp_Rq_ESC Ft_RrTrqCoupling_ModeRq ExternalBrkRequestsDisabled BrkTrq_Driver BrkTrq Brk_Thermdl SelSpdLmp SelectSpdSts REF_VEH_SPEED MessageCounter_BRAKE1 Ft_RrAxleCoupling_TrqRq CRC_BRAKE1 DASEngReqPos Brk_Jrk_Resp ACCFSafe HILL_DES_STAT MAC_BRAKE1 eBurn_Stages Cntr_BRAKE1;
SIG_GROUP_ 1066 BCM_FD_9_Pkt 1 : TheftAlarmStatus StopLightSts StopLightFault RHTurnSignalSts PowerModeSts ParkBrakeSts LHTurnSignalSts LHParkingLightSts HighBeamSts FuelLevel BonnetSts AHBFeature WashLightWarningSts RHRDoorSts RHParkingLightSts RHatchSts RearTrunkEnableLastElSts RearFogLightSts RainSensorFailSts PsngrDoorSts MoveWheelSts MessageCounter_BCM9 LowFuelWarningSts LowBeamSts LHRDoorSts HDCFnRqstSts FrontWiperMoveSts FrontFogLightSts ExternalTemperature ESLUnlockFailSts_Indication ESLLockFailSts_Indication DriverDoorSts DoorLockLastElSts CRC_BCM9 BrakeFluidLevelSts TrunkHandleReleaseSts FuelLevel2;
SIG_GROUP_ 1051 BCM_FD_4_Pkt 1 : RollAngle PitchAngle FUEL_VOLT ExternalTemperatureAD_Voltage FUEL_VOLT2 EVAP_TEMP_P1C AM_ECM_Trace MessageCounter_BCM4 CRC_BCM4 RR_HS_STATFailSts RR_HS_STAT RL_HS_STATFailSts RL_HS_STAT HSW_StatFailSts FR_VS_STATSts FR_VS_STATFailSts FL_VS_STATSts FL_VS_STATFailSts RR_VS_STATFailSts RR_VS_STAT RL_VS_STATFailSts RL_VS_STAT;
SIG_GROUP_ 256 BCM_FD_2_Pkt 1 : OperationalModeSts KeyInIgnSts EngineOffRequest TurnIndicatorSts RemStActvSts_R RemStActvSts RefuelRequest MessageCounter_BCM2 CRC_BCM2 BrkPdlStat_BCM SCCActvSts;
SIG_GROUP_ 512 BCM_FD_18_Pkt 1 : LeakCheckTimerExpired DRV_DR_UNLOCKING BonnetAjarRawValSts_8 MessageCounter_BCM18 CRC_BCM18 Fuel_Door_Sts Braking_Mode_Req;
SIG_GROUP_ 159 BCM_FD_13_Pkt 1 : SpeedLimiterOnOffSts MC_CSWC_1 CrusCnclSwitch CRC_CSWC_1 ACC_On ACC_DistSwInc ACC_DistSwDec MessageCounter_BCM13 CRC_BCM13 ResumeSwitch DeceleratorSts CruiseControlOnOffSts CruiseControlFailSts AcceleratorSts;
SIG_GROUP_ 1431 BCM_FD_12_Pkt 1 : Switch2_Rq Switch1_Rq TRAC_PSD TerrainSwStat PreCondCabinSts IGN_OFF_TIME_LNG EPS_MODE_CFG_STAT AirTemp_Outsd PAMRequestSts MessageCounter_BCM12 CRC_BCM12 APARequestSts DALM_Status SeatVib_Sts AxleLckrSEL_SW;
SIG_GROUP_ 1430 BCM_FD_11_Pkt 1 : Gate_Req_PE StopStartClimateInfo PN14_LS_Lvl7 PN14_LS_Actv EngineOffTimer PanicModeActive CMP_DIR Batt_ST_Crit DCSD_TUNEKNOB_VAL DCSD_TUNEKNOB_DIR DCSD_Enter A2D_DRV_TEMP_DR_POS MessageCounter_BCM11 CRC_BCM11;
SIG_GROUP_ 1153 BCM_FD_10_Pkt 1 : StTypSts FOBSearchRequest ExternalTemperatureF ExternalTemperatureC CompressorACReqSts CmdIgnSts TurnIndicationSts SpSt_Pad1 RemSt_InhibitSts PANEL_INTS MessageCounter_BCM10 ExteriorRearReleaseSwitchSts CRC_BCM10 WPR_SYS_AUTO FOA_Msg_Req SCC_InhibitSts DAY_LGT_MD FOA_Mobile_App_Alert;

VERSION ""

NS_ :

BS_:

BU_: SGW RFHM MPAD IPC GNMM EVCU2 ESL ECM DTCM DMSM BSM BCM AGSM ADCAM

BO_ 1842 IPC_FD_13: 32 IPC
 SG_ Total_Range : 34|11@0+ (1,0) [0|2046] "km"  SGW
 SG_ Gas_Range : 49|10@0+ (1,0) [0|1022] "km"  SGW,BCM

BO_ 1844 IPC_FD_12: 32 IPC
 SG_ B_Hybrid_Miles : 87|24@0+ (0.1,0) [0|9999.9] "Mile"  SGW
 SG_ B_Hybrid_Kilometers : 111|24@0+ (0.1,0) [0|16093.3] "km"  SGW
 SG_ B_EV_Miles : 39|24@0+ (0.1,0) [0|9999.9] "Mile"  SGW
 SG_ B_EV_Kilometers : 63|24@0+ (0.1,0) [0|16093.3] "km"  SGW

BO_ 1455 IPC_FD_11: 32 IPC
 SG_ NextNavInstructionPanelTheme : 183|4@0+ (1,0) [0|14] "" SGW
 SG_ NavigationMapPopUP : 6|1@0+ (1,0) [0|1] "-"  SGW
 SG_ IPC_NavigationMap_Req : 5|2@0+ (1,0) [0|2] "-"  SGW
 SG_ IC_ETM_HUDCustom_Req : 2|2@0+ (1,0) [0|3] "-"  SGW
 SG_ Cluster_In_Audio_Md : 10|1@0+ (1,0) [0|1] "-"  SGW
 SG_ Avg_Fuel_Econ : 9|10@0+ (0.05,0) [0|50] "kmpl"  SGW
 SG_ AudioMenuPopup : 0|1@0+ (1,0) [0|1] "-"  SGW
 SG_ A_Hybrid_Miles : 79|24@0+ (0.1,0) [0|9999.9] "Mile"  SGW
 SG_ A_Hybrid_Kilometers : 103|24@0+ (0.1,0) [0|16093.3] "km"  SGW
 SG_ A_EV_Miles : 31|24@0+ (0.1,0) [0|9999.9] "Mile"  SGW
 SG_ A_EV_Kilometers : 55|24@0+ (0.1,0) [0|16093.3] "km"  SGW

BO_ 752 IBS3_DATA_1: 32 BCM
 SG_ IBS3_Vbatt : 96|9@0+ (0.025,5) [5|17.75] "V"  EVCU2,SGW,ECM
 SG_ IBS3_SOF_VC : 118|7@0+ (0.05,5) [5|11.3] "V"  EVCU2
 SG_ IBS3_Ibatt : 87|16@0+ (0.02,-1000) [-1000|310.68] "A"  EVCU2,SGW,ECM
 SG_ VoltBattFailStatus : 102|1@0+ (1,0) [0|1] "" EVCU2,ECM
 SG_ RsErrIBS3 : 100|1@0+ (1,0) [0|1] "" EVCU2,ECM
 SG_ IBS3_Error_Internal : 101|1@0+ (1,0) [0|1] "" EVCU2,ECM
 SG_ CurrBattFailStatus : 103|1@0+ (1,0) [0|1] "" EVCU2,ECM
 SG_ MessageCounter_IBS3DATA1 : 179|4@0+ (1,0) [0|15] ""  EVCU2
 SG_ CRC_IBS3DATA1 : 191|8@0+ (1,0) [0|255] ""  EVCU2
 SG_ IBS3_SOF_V_Accuracy : 99|1@0+ (1,0) [0|1] "" EVCU2

BO_ 1032 HYBRID_THERMAL_COMMAND: 32 EVCU2
 SG_ PECP_PumpSpeedActual : 86|7@0+ (1,0) [0|100] "%"  ECM
 SG_ PE_CoolTempOut : 31|8@0+ (1,-40) [-40|214] "°C"  ECM
 SG_ PE_CoolTempIn : 111|8@0+ (1,-40) [-40|214] "°C"  ECM

BO_ 1956 HYBRID_RM_MOTORS: 32 EVCU2
 SG_ MotorB_Temperature : 151|8@0+ (1,-40) [-40|215] "oC"  SGW
 SG_ MotorB_RPM : 23|16@0+ (1,-32768) [-32768|32767] "RPM"  MPAD,SGW,BCM,ECM,DTCM
 SG_ MotorB_InverterTemp : 159|8@0+ (1,-40) [-40|215] "oC"  SGW
 SG_ MotorB_DC_Voltage : 113|10@0+ (1,0) [0|1023] "V"  SGW
 SG_ MotorB_DC_Current : 54|15@0+ (0.1,-1638.4) [-1638.4|1638.3] "A"  SGW
 SG_ MotorA_Temperature : 135|8@0+ (1,-40) [-40|215] "oC"  SGW
 SG_ MotorA_RPM : 7|16@0+ (1,-32768) [-32768|32767] "RPM"  MPAD,SGW,BCM,DTCM
 SG_ MotorA_InverterTemp : 143|8@0+ (1,-40) [-40|215] "oC"  SGW
 SG_ MotorA_DC_Voltage : 97|10@0+ (1,0) [0|1023] "V"  SGW
 SG_ MotorA_DC_Current : 38|15@0+ (0.1,-1638.4) [-1638.4|1638.3] "A"  SGW
 SG_ Warning_MotorB_Overtemp : 55|1@0+ (1,0) [0|1] "" SGW
 SG_ Warning_MotorA_Overtemp : 39|1@0+ (1,0) [0|1] "" SGW
 SG_ Warning_InverterA_Overtemp : 69|1@0+ (1,0) [0|1] "" SGW
 SG_ Warning_DCDCTemp_DPT : 71|1@0+ (1,0) [0|1] "" SGW
 SG_ Warning_DCDCPerformance_DPT : 85|1@0+ (1,0) [0|1] "" SGW
 SG_ MotorB_InverterState : 117|4@0+ (1,0) [0|15] "" SGW
 SG_ MotorA_InverterState : 101|4@0+ (1,0) [0|15] "" SGW
 SG_ Warning_InverterB_Overtemp : 70|1@0+ (1,0) [0|1] "" SGW
 SG_ MessageCounter_HYBRID_RM_MOTORS : 179|4@0+ (1,0) [0|15] "-"  MPAD
 SG_ CRC_HYBRID_RM_MOTORS : 191|8@0+ (1,0) [0|255] "-"  MPAD
 SG_ MotorB_TorqueAchieved : 84|13@0+ (0.125,-512) [-512|511.875] "Nm"  SGW,BCM
 SG_ MotorA_TorqueAchieved : 68|13@0+ (0.125,-512) [-512|511.875] "Nm"  SGW,BCM

BO_ 1033 HYBRID_POWERTRAIN5: 32 EVCU2
 SG_ HEV_HybPwrtrnRdcdPerfCmnd : 22|1@0+ (1,0) [0|0] "-"  Vector__XXX
 SG_ MessageCounter_HYBRID_POWERTRAIN5 : 179|4@0+ (1,0) [0|15] "-"  ECM
 SG_ CRC_HYBRID_POWERTRAIN5 : 191|8@0+ (1,0) [0|255] "-"  ECM
 SG_ HybridEmissionsMalfunction : 20|1@0+ (1,0) [0|1] "-"  Vector__XXX
 SG_ Hybrid_EVT_ModeSts : 7|1@0+ (1,0) [0|1] "-"  SGW,BCM
 SG_ MotorsPowerUse_DisplayV : 183|1@0+ (1,0) [0|1] "-"  SGW
 SG_ MotorsPowerUse_Display : 162|11@0+ (1,-1023) [-1023|1024] "kW"  SGW
 SG_ Motor2PowerUse_DisplayV : 85|1@0+ (1,0) [0|1] "-"  SGW
 SG_ Motor1PowerUse_DisplayV : 86|1@0+ (1,0) [0|1] "-"  SGW
 SG_ Motor1PowerUse_Display : 96|9@0+ (1,-255) [-255|256] "kW"  SGW
 SG_ BattPowerUse_DisplayV : 87|1@0+ (1,0) [0|1] "-"  SGW,IPC
 SG_ BattPowerUse_Display : 146|11@0+ (1,-750) [-750|1297] "kW"  SGW,IPC
 SG_ Motor2PowerUse_Display : 112|9@0+ (1,-255) [-255|256] "kW"  SGW
 SG_ Hybrid_AGSPosition : 31|7@0+ (1,0) [0|127] "%"  ECM
 SG_ Hybrid_AGS2Position : 103|7@0+ (1,0) [0|127] "%"  ECM

BO_ 1952 HYBRID_HVAC: 32 EVCU2
 SG_ SchCond_Time_Till_Dep : 78|7@0+ (1,0) [0|126] "min"  BCM
 SG_ Sch_PreCondition_Sts : 97|2@0+ (1,0) [0|2] "" BCM
 SG_ HVBatCoolantLevelLow_DPT : 87|2@0+ (1,0) [0|2] "" IPC
 SG_ HTAuxPmpRPMAct : 31|8@0+ (24,0) [0|6096] "rpm"  BCM,ECM
 SG_ HeaterCoreInletTemp : 7|8@0+ (1,-40) [-40|214] "°C"  BCM,ECM
 SG_ ElecCoolantHtrPwr : 23|8@0+ (0.04,0) [0|10.16] "kW"  BCM,ECM
 SG_ CompressorState : 11|4@0+ (1,0) [0|14] "" SGW,BCM
 SG_ CabinPreconditionReqSts : 85|4@0+ (1,0) [0|14] "" IPC
 SG_ CabinConditioningSts : 15|4@0+ (1,0) [0|9] "-"  SGW,BCM
 SG_ HVBatCritCondT : 81|1@0+ (1,0) [0|1] "" BCM
 SG_ HTAuxPmpMontrngRPM : 89|2@0+ (1,0) [0|2] "-"  ECM
 SG_ FRfShVlvSts : 80|1@0+ (1,0) [0|1] "" Vector__XXX
 SG_ MessageCounter_HYBRID_HVAC : 179|4@0+ (1,0) [0|15] "-"  BCM
 SG_ CRC_HYBRID_HVAC : 191|8@0+ (1,0) [0|255] "-"  BCM

BO_ 1049 HYBRID_DISPLAY: 32 EVCU2
 SG_ RefrigerantPressure : 64|9@0+ (0.1,0) [0|40] "bar"  BCM
 SG_ HybridMILRequest : 135|1@0+ (1,0) [0|1] "-"  ECM
 SG_ MessageCounter_HYBRID_DISPLAY : 179|4@0+ (1,0) [0|15] "-"  IPC
 SG_ CRC_HYBRID_DISPLAY : 191|8@0+ (1,0) [0|255] "-"  IPC
 SG_ HVBatterySOC_Display : 119|8@0+ (0.3922,0) [0|100] "%"  SGW,BCM,IPC
 SG_ Lv2_EstChargeTime : 18|11@0+ (1,0) [0|2046] "min"  SGW,IPC
 SG_ Lv1_EstChargeTime : 4|13@0+ (1,0) [0|8190] "min"  SGW,IPC
 SG_ HybridOutputPower : 63|8@0+ (1,-100) [-100|100] "%"  SGW,IPC
 SG_ HybridEfficiencyCoach : 87|8@0+ (1,-100) [-100|100] "%"  Vector__XXX
 SG_ HVACPowerUse_Display : 134|7@0+ (1,0) [0|127] "kW"  SGW
 SG_ HCP_EVServiceLampOn : 20|2@0+ (1,0) [0|2] "-"  SGW,BCM,IPC
 SG_ EnginePowerUse_Display : 33|10@0+ (1,0) [0|1023] "kW"  SGW
 SG_ ChargingLevelForDisplay : 166|4@0+ (1,0) [0|14] "" SGW,IPC
 SG_ ChargeSystemSts_DPT : 7|3@0+ (1,0) [0|6] "-"  SGW,IPC
 SG_ ChargeSystemFault_DPT : 142|1@0+ (1,0) [0|1] "-"  SGW,IPC
 SG_ PopUpMessage9 : 69|1@0+ (1,0) [0|1] "-"  IPC
 SG_ PopUpMessage7 : 39|1@0+ (1,0) [0|1] "-"  IPC
 SG_ PopUpMessage6 : 38|1@0+ (1,0) [0|1] "-"  IPC
 SG_ PopUpMessage5 : 37|1@0+ (1,0) [0|1] "-"  IPC
 SG_ PopUpMessage4 : 36|1@0+ (1,0) [0|1] "-"  IPC
 SG_ PopUpMessage3 : 35|1@0+ (1,0) [0|1] "-"  IPC
 SG_ PopUpMessage2 : 34|1@0+ (1,0) [0|1] "-"  IPC
 SG_ PopUpMessage10 : 70|1@0+ (1,0) [0|1] "-"  IPC
 SG_ PopUpMessage1 : 23|1@0+ (1,0) [0|1] "-"  IPC
 SG_ HybridOutputPowerV : 66|1@0+ (1,0) [0|1] "-"  IPC
 SG_ HybridEfficiencyCoachV : 67|1@0+ (1,0) [0|1] "-"  Vector__XXX
 SG_ HVBatterySOC_DisplayV : 141|1@0+ (1,0) [0|1] "-"  SGW,IPC
 SG_ HVACPowerUse_DisplayV : 140|1@0+ (1,0) [0|1] "-"  SGW
 SG_ EnginePowerUse_DisplayV : 139|1@0+ (1,0) [0|1] "-"  SGW
 SG_ PopUpMessage11 : 71|1@0+ (1,0) [0|1] "-"  IPC
 SG_ FOTA_Schedule_Conflict : 143|1@0+ (1,0) [0|0] "" SGW
 SG_ Regen_Status : 172|3@0+ (1,0) [0|7] "-"  SGW,IPC
 SG_ PlugAndChargeSts : 144|1@0+ (1,0) [0|1] "" SGW
 SG_ OnePedal_Drive_Sts : 169|2@0+ (1,0) [0|3] "-"  BSM,IPC
 SG_ PopUpMessage18 : 175|1@0+ (1,0) [0|1] "" IPC

BO_ 1027 HVBATTERY2: 32 EVCU2
 SG_ HVBatteryMILRequest : 7|1@0+ (1,0) [0|0] "-"  IPC

BO_ 1840 HVBATTERY_RM_CHARGING1: 32 EVCU2
 SG_ Warning_PackTempHigh : 26|1@0+ (1,0) [0|1] "-"  Vector__XXX

BO_ 1036 ENGINE_FD_3: 32 ECM
 SG_ OilLifeLeftRst : 165|1@0+ (1,0) [0|1] "-"  IPC
 SG_ OilLifeLeft : 135|8@0+ (1,0) [0|255] "%"  IPC
 SG_ OIL_TEMP_IND_RQ : 161|2@0+ (1,0) [0|3] "-"  SGW,IPC
 SG_ OIL_IND_LMP_FLSH : 154|1@0+ (1,0) [0|1] "-"  IPC
 SG_ DistOilLifeRst : 143|16@0+ (1,0) [0|65535] "km"  BCM,IPC
 SG_ MessageCounter_ENGINE3 : 179|4@0+ (1,0) [0|15] "-"  Vector__XXX
 SG_ DefFuelEcon : 7|8@0+ (0.2,0) [0|50] "kmpl"  IPC
 SG_ CRC_ENGINE3 : 191|8@0+ (1,0) [0|255] "-"  Vector__XXX
 SG_ EngineOilTemperature : 103|8@0+ (1,-40) [-40|214] "°C"  SGW,IPC
 SG_ AfterRunCoolantPumpFailSts : 166|1@0+ (1,0) [0|1] "-"  IPC

BO_ 2564682271 DIAGNOSTIC_ROE_FD_SHIFTER: 64 AGSM
 SG_ N_PDU : 7|64@0+ (1,0) [0|0] "" SGW

BO_ 2564682439 DIAGNOSTIC_ROE_FD_RFHM: 64 RFHM
 SG_ N_PDU : 7|64@0+ (1,0) [0|0] "" SGW

BO_ 2564682336 DIAGNOSTIC_ROE_FD_IPC: 64 IPC
 SG_ N_PDU : 7|64@0+ (1,0) [0|0] "" SGW

BO_ 2564682436 DIAGNOSTIC_ROE_FD_ESL: 64 ESL
 SG_ N_PDU : 7|64@0+ (1,0) [0|0] "" SGW

BO_ 2564682280 DIAGNOSTIC_ROE_FD_BSM: 64 BSM
 SG_ N_PDU : 7|64@0+ (1,0) [0|0] "" SGW

BO_ 2564485696 DIAGNOSTIC_RESPONSE_FD_BCM: 64 BCM
 SG_ N_PDU : 7|64@0+ (1,0) [0|0] "" SGW

BO_ 2564440306 DIAGNOSTIC_REQUEST_FD_BCM: 64 SGW
 SG_ N_PDU : 7|64@0+ (1,0) [0|0] "" BCM

BO_ 950 CVPAM_FD_Info: 32 BCM
 SG_ SPMControlSts : 183|2@0+ (1,0) [0|1] "-"  IPC
 SG_ SDWSts : 116|1@0+ (1,0) [0|1] "-"  IPC
 SG_ SDWFailSts : 115|1@0+ (1,0) [0|1] "-"  IPC
 SG_ SDW_Warning_Right_2 : 125|2@0+ (1,0) [0|2] "-"  IPC
 SG_ SDW_Warning_Right_1 : 127|2@0+ (1,0) [0|2] "-"  IPC
 SG_ SDW_Warning_Left_2 : 121|2@0+ (1,0) [0|2] "-"  IPC
 SG_ SDW_Warning_Left_1 : 123|2@0+ (1,0) [0|2] "-"  IPC
 SG_ RearSensorSts : 147|2@0+ (1,0) [0|3] "-"  IPC
 SG_ PAMSystemFault : 181|2@0+ (1,0) [0|3] "-"  IPC
 SG_ PAM_PopUpRqst : 167|8@0+ (1,0) [0|255] "-"  IPC
 SG_ PAM_Off_Status : 92|1@0+ (1,0) [0|1] "-"  IPC
 SG_ PAM_LedControlSts : 143|2@0+ (1,0) [0|3] "-"  IPC
 SG_ HMICode : 175|8@0+ (1,0) [0|255] "-"  IPC
 SG_ Graphic_RHR : 135|2@0+ (1,0) [0|3] "-"  IPC
 SG_ Graphic_RHF : 129|2@0+ (1,0) [0|3] "-"  IPC
 SG_ Graphic_LHR : 137|2@0+ (1,0) [0|3] "-"  IPC
 SG_ Graphic_LHF : 131|2@0+ (1,0) [0|3] "-"  IPC
 SG_ Graphic_CHR : 139|2@0+ (1,0) [0|3] "-"  IPC
 SG_ Graphic_CHF : 133|2@0+ (1,0) [0|3] "-"  IPC
 SG_ FrontSensorSts : 145|2@0+ (1,0) [0|3] "-"  IPC
 SG_ Alert_RHR : 108|3@0+ (1,0) [0|7] "-"  IPC
 SG_ Alert_RHF : 95|3@0+ (1,0) [0|7] "-"  IPC
 SG_ Alert_LHR : 111|3@0+ (1,0) [0|7] "-"  IPC
 SG_ Alert_LHF : 100|3@0+ (1,0) [0|7] "-"  IPC
 SG_ Alert_CHR : 114|3@0+ (1,0) [0|7] "-"  IPC
 SG_ Alert_CHF : 103|3@0+ (1,0) [0|7] "-"  IPC
 SG_ ParkingManeuverActive : 66|3@0+ (1,0) [0|6] "-"  AGSM
 SG_ MessageCounter_CVPAM_FD_Info : 179|4@0+ (1,0) [0|15] "-"  AGSM
 SG_ CRC_CVPAM_FD_Info : 191|8@0+ (1,0) [0|255] "-"  AGSM
 SG_ FT_PAM_LedControlSts : 3|2@0+ (1,0) [0|2] "-"  IPC

BO_ 275 CVPAM_FD_Control: 32 BCM
 SG_ RR_PAM_StopControlSts : 151|1@0+ (1,0) [0|1] "-"  IPC
 SG_ RR_PAM_Brk_RqSts : 150|1@0+ (1,0) [0|1] "-"  BSM
 SG_ MessageCounter_CVPAM_FD_Control : 179|4@0+ (1,0) [0|15] "-"  BSM
 SG_ CRC_CVPAM_FD_Control : 191|8@0+ (1,0) [0|255] "-"  BSM
 SG_ RR_PAM_Dist : 161|10@0+ (1,0) [0|1022] "cm"  BSM

CM_ SG_ 1842 Total_Range "Total range or DTE";
CM_ SG_ 1842 Gas_Range "Gas range or DTE";
CM_ SG_ 1844 B_Hybrid_Miles "Trip B hybrid distance in US miles";
CM_ SG_ 1844 B_Hybrid_Kilometers "Trip B hybrid distance in kilometers";
CM_ SG_ 1844 B_EV_Miles "Trip B EV distance in US miles";
CM_ SG_ 1844 B_EV_Kilometers "Trip B EV distance in kilometers";
CM_ SG_ 1455 NextNavInstructionPanelTheme "Next Nav Instruction Panel Theme";
CM_ SG_ 1455 NavigationMapPopUP "Navigation Map PopUP";
CM_ SG_ 1455 IPC_NavigationMap_Req "IPC Navigation Map Req";
CM_ SG_ 1455 IC_ETM_HUDCustom_Req "IC to ETM HUD Customization Request";
CM_ SG_ 1455 Cluster_In_Audio_Md "Cluster display screen for Audio mode";
CM_ SG_ 1455 Avg_Fuel_Econ "Average fuel economy";
CM_ SG_ 1455 AudioMenuPopup "Pop-up present on the Audio Menu";
CM_ SG_ 1455 A_Hybrid_Miles "Trip A hybrid distance in US miles";
CM_ SG_ 1455 A_Hybrid_Kilometers "Trip A hybrid distance in kilometers";
CM_ SG_ 1455 A_EV_Miles "Trip A EV distance in US miles";
CM_ SG_ 1455 A_EV_Kilometers "Trip A EV distance in kilometers";
CM_ SG_ 752 IBS3_Vbatt "Battery voltage measured at the terminals";
CM_ SG_ 752 MessageCounter_IBS3DATA1 "This signal is a counter used for safety checks strategies. This counter is incremented of 1 (one) unit at each frame transmission.";
CM_ SG_ 752 IBS3_SOF_VC "Predicted initial battery voltage dip during cranking (old CG spec)";
CM_ SG_ 752 IBS3_SOF_V_Accuracy "SOF_V accuracy; Data reliable = [0], unreliable = [1]";
CM_ SG_ 752 VoltBattFailStatus "Failure Status of Voltage meas. (internal defect)";
CM_ SG_ 752 RsErrIBS3 "Response Error IBS; Error=[1]";
CM_ SG_ 752 IBS3_Error_Internal "Error in IBS calibration data; No Error = [0], Error = [1]";
CM_ SG_ 752 CurrBattFailStatus "Failure Status of Current meas. (internal defect)";
CM_ SG_ 752 CRC_IBS3DATA1 "CRC according to SAE J1850 standard at each frame transmission.";
CM_ SG_ 752 IBS3_Ibatt "Battery current";
CM_ SG_ 1032 PECP_PumpSpeedActual "Power Electronics Coolant pump actual speed";
CM_ SG_ 1032 PE_CoolTempOut "Coolant temperature at Power Electronics outlet.";
CM_ SG_ 1032 PE_CoolTempIn "Coolant temperature at Power Electronics Inlet";
CM_ SG_ 1956 Warning_MotorB_Overtemp "Motor B over-temperature warning";
CM_ SG_ 1956 Warning_MotorA_Overtemp "Motor A over-temperature warning";
CM_ SG_ 1956 Warning_InverterB_Overtemp "Motor B inverter over-temperature warning";
CM_ SG_ 1956 Warning_InverterA_Overtemp "Motor A inverter over-temperature warning";
CM_ SG_ 1956 Warning_DCDCTemp_DPT "APM temperature warning";
CM_ SG_ 1956 Warning_DCDCPerformance_DPT "APM performance warning";
CM_ SG_ 1956 MotorB_TorqueAchieved "Motor B Torque Achieved";
CM_ SG_ 1956 MotorB_Temperature "Motor B temperature";
CM_ SG_ 1956 MotorB_RPM "Motor B Speed Raw";
CM_ SG_ 1956 MotorB_InverterTemp "Inverter B Temperature";
CM_ SG_ 1956 MotorB_InverterState "Inverter State of Operation";
CM_ SG_ 1956 MotorB_DC_Voltage "Motor B DC Voltage";
CM_ SG_ 1956 MotorB_DC_Current "Motor B DC Current";
CM_ SG_ 1956 MotorA_TorqueAchieved "Motor A Torque Achieved";
CM_ SG_ 1956 MotorA_Temperature "Motor A temperature";
CM_ SG_ 1956 MotorA_InverterTemp "Inverter A Temperature";
CM_ SG_ 1956 MotorA_InverterState "Inverter State of Operation";
CM_ SG_ 1956 MotorA_DC_Voltage "Motor A DC Voltage";
CM_ SG_ 1956 MotorA_DC_Current "Motor A DC Current";
CM_ SG_ 1956 MessageCounter_HYBRID_RM_MOTORS "This signal is a counter used for safety checks strategies. This counter is incremented of 1 (one) unit at each frame transmission.";
CM_ SG_ 1956 CRC_HYBRID_RM_MOTORS "CRC according to SAE J1850 standard at each frame transmission.";
CM_ SG_ 1956 MotorA_RPM "Motor A Speed Raw";
CM_ SG_ 1033 Motor2PowerUse_DisplayV "Validity bit for signal MtrPwrUsageDisp, 0=Valid";
CM_ SG_ 1033 Motor2PowerUse_Display "Motor B power usage for HMI, in KW";
CM_ SG_ 1033 Motor1PowerUse_DisplayV "Validity bit for signal MtrPwrUsageDisp, 0=Valid";
CM_ SG_ 1033 Motor1PowerUse_Display "Motor A power usage for HMI, in KW";
CM_ SG_ 1033 MessageCounter_HYBRID_POWERTRAIN5 "This signal is a counter used for safety checks strategies. This counter is incremented of 1 (one) unit at each frame transmission.";
CM_ SG_ 1033 HybridEmissionsMalfunction "Emissions Related Malfunction Active";
CM_ SG_ 1033 Hybrid_EVT_ModeSts "The system is in EVT mode; Hybrid mode = [0], EV Mode = [1]";
CM_ SG_ 1033 Hybrid_AGSPosition "AGS position sent to ECM on CAN by the hybrid controller";
CM_ SG_ 1033 Hybrid_AGS2Position "AGS2 position sent to ECM on CAN by the hybrid controller";
CM_ SG_ 1033 HEV_HybPwrtrnRdcdPerfCmnd "Driver torque request modifier due to system remedial acion";
CM_ SG_ 1033 CRC_HYBRID_POWERTRAIN5 "CRC according to SAE J1850 standard at each frame transmission.";
CM_ SG_ 1033 BattPowerUse_DisplayV "Validity bit for signal BatPwrUsageDisp, 0=Valid";
CM_ SG_ 1033 BattPowerUse_Display "Battery power usage for HMI, in KW";
CM_ SG_ 1033 MotorsPowerUse_DisplayV "Validity bit for signal MtrPwrUsageDisp, 0=Valid";
CM_ SG_ 1033 MotorsPowerUse_Display "Motor Sum power usage for HMI, in KW";
CM_ SG_ 1952 SchCond_Time_Till_Dep "Schedule Cabin Conditonting - Time till Departure for HVAC";
CM_ SG_ 1952 Sch_PreCondition_Sts "HCP Status for Scheduled Pre Conditioning Request";
CM_ SG_ 1952 MessageCounter_HYBRID_HVAC "This signal is a counter used for safety checks strategies. This counter is incremented of 1 (one) unit at each frame transmission.";
CM_ SG_ 1952 HVBatCritCondT "High Voltage Battery Temperature Critical Condition, [1] = True";
CM_ SG_ 1952 HVBatCoolantLevelLow_DPT "Battery coolant level low";
CM_ SG_ 1952 HTAuxPmpRPMAct "High Temp Aux Pump Status";
CM_ SG_ 1952 HTAuxPmpMontrngRPM "High Temp Aux Pump RPM monitoring active";
CM_ SG_ 1952 HeaterCoreInletTemp "Heater Core Inlet Temp";
CM_ SG_ 1952 FRfShVlvSts "Front Refrigerant Shutoff Valve Status  [0] = Open, [1] = Closed";
CM_ SG_ 1952 ElecCoolantHtrPwr "Electric Coolant Heater Power";
CM_ SG_ 1952 CRC_HYBRID_HVAC "CRC according to SAE J1850 standard at each frame transmission.";
CM_ SG_ 1952 CompressorState "comppressor state";
CM_ SG_ 1952 CabinPreconditionReqSts "Cabin Preconditioning Request Status";
CM_ SG_ 1952 CabinConditioningSts "Cabin condition status";
CM_ SG_ 1049 Regen_Status "Level of regeneration(negative torque)";
CM_ SG_ 1049 RefrigerantPressure "Refrigerant pressure (R134a or R1234YF)";
CM_ SG_ 1049 PopUpMessage9 "Stop safely. Vehicle will shut off soon; True = [1]";
CM_ SG_ 1049 PopUpMessage7 "Please leave key in run - battery conditioning needed; True = [1]";
CM_ SG_ 1049 PopUpMessage6 "There may be a problem with the charging unit; True = [1]";
CM_ SG_ 1049 PopUpMessage5 "Please check plug status before driving; True = [1]";
CM_ SG_ 1049 PopUpMessage4 "Turn on vehicle to use climate controls; True = [1]";
CM_ SG_ 1049 PopUpMessage3 "Remote start canceled - hv battery temperature; True = [1]";
CM_ SG_ 1049 PopUpMessage2 "Plug in vehicle to keep battery warm; True = [1]";
CM_ SG_ 1049 PopUpMessage18 "Stop Vehicle Safely Before Charge Depletes reverse Unavailable";
CM_ SG_ 1049 PopUpMessage11 "Charge port door open; True = [1]";
CM_ SG_ 1049 HVACPowerUse_Display "HVAC power usage for HMI, in KW";
CM_ SG_ 1049 ChargingLevelForDisplay "Charging level and type for display";
CM_ SG_ 1049 ChargeSystemSts_DPT "Charging System status";
CM_ SG_ 1049 ChargeSystemFault_DPT "Charging System Fault status";
CM_ SG_ 1049 PopUpMessage10 "High Voltage Functionalities rejected due to Hood Open; True = [1]";
CM_ SG_ 1049 PopUpMessage1 "Vehicle speed may be limited; True = [1]";
CM_ SG_ 1049 PlugAndChargeSts "EVCU Confirmation of Plug and Change status";
CM_ SG_ 1049 OnePedal_Drive_Sts "Status of the OnePedal Drive feature (OnePedal_Drive_sts on is creep Off)";
CM_ SG_ 1049 MessageCounter_HYBRID_DISPLAY "This signal is a counter used for safety checks strategies. This counter is incremented of 1 (one) unit at each frame transmission.";
CM_ SG_ 1049 HybridEfficiencyCoach "Percentage output acceleration & deceleration to support Efficiency Coaching HMI";
CM_ SG_ 1049 HybridMILRequest "MIL on request from the HCP";
CM_ SG_ 1049 HybridEfficiencyCoachV "Acceleration & deceleration to support Efficiency Coaching validtiy, 0 = Valid, 1 = Invalid";
CM_ SG_ 1049 Lv2_EstChargeTime "Estimated Time to charge on Level 2";
CM_ SG_ 1049 Lv1_EstChargeTime "Estimated Time to charge on Level 1";
CM_ SG_ 1049 HybridOutputPowerV "Percentage output power from HCP for HMI validity, 0 = Valid, 1 = Invalid";
CM_ SG_ 1049 HybridOutputPower "Percentage output power from HCP for HMI";
CM_ SG_ 1049 HVBatterySOC_DisplayV "High voltage battery state of charge validity: invalid = [1]";
CM_ SG_ 1049 HVBatterySOC_Display "High voltage battery state of charge";
CM_ SG_ 1049 HVACPowerUse_DisplayV "Validity bit for signal HVACPwrUsageDisp, 0=Valid";
CM_ SG_ 1049 HCP_EVServiceLampOn "HEV service lamp request";
CM_ SG_ 1049 FOTA_Schedule_Conflict "Scheduled FOTA Installation conflicts present";
CM_ SG_ 1049 EnginePowerUse_DisplayV "Validity bit for signal EngPwrUsageDisp, 0=Valid";
CM_ SG_ 1049 EnginePowerUse_Display "Engine power usage for HMI, in KW";
CM_ SG_ 1049 CRC_HYBRID_DISPLAY "CRC according to SAE J1850 standard at each frame transmission.";
CM_ SG_ 1027 HVBatteryMILRequest "MIL Lamp request from BPCM.";
CM_ SG_ 1840 Warning_PackTempHigh "Battery high temperature warning";
CM_ SG_ 1036 OilLifeLeftRst "This signal is the reset acknowledge";
CM_ SG_ 1036 OilLifeLeft "This signal sends the oil life left percentage.";
CM_ SG_ 1036 MessageCounter_ENGINE3 "This signal is a counter used for safety checks strategies. This counter is incremented of 1 (one) unit at each frame transmission.";
CM_ SG_ 1036 DistOilLifeRst "This signal sends the distance since oil life reset.";
CM_ SG_ 1036 EngineOilTemperature "Engine Oil Temperature";
CM_ SG_ 1036 OIL_TEMP_IND_RQ "Oil temperature indicator request";
CM_ SG_ 1036 OIL_IND_LMP_FLSH "Oil indicator lamp flash (for in plant use)";
CM_ SG_ 1036 AfterRunCoolantPumpFailSts "The signal indicates a fault on AfterRunCoolant Pump";
CM_ SG_ 1036 CRC_ENGINE3 "CRC according to SAE J1850 standard at each frame transmission.";
CM_ SG_ 1036 DefFuelEcon "Provides defined fuel economy for display in the cluster";
CM_ SG_ 2564682271 N_PDU "This signal is used for diagnostic purposes";
CM_ SG_ 2564682439 N_PDU "This signal is used for diagnostic purposes";
CM_ SG_ 2564682336 N_PDU "This signal is used for diagnostic purposes";
CM_ SG_ 2564682436 N_PDU "This signal is used for diagnostic purposes";
CM_ SG_ 2564682280 N_PDU "This signal is used for diagnostic purposes";
CM_ SG_ 2564485696 N_PDU "This signal is used for diagnostic purposes";
CM_ SG_ 2564440306 N_PDU "This signal is used for diagnostic purposes";
CM_ SG_ 950 PAMSystemFault "This signal indicates if the PAM is in a faulted condition";
CM_ SG_ 950 RearSensorSts "This signal indicates the activation state of the rear sensors";
CM_ SG_ 950 SDW_Warning_Left_1 "This signal is used to turn lateral arc";
CM_ SG_ 950 SDW_Warning_Left_2 "This signal is used to turn lateral arc";
CM_ SG_ 950 SDW_Warning_Right_1 "This signal is used to turn lateral arc";
CM_ SG_ 950 SDW_Warning_Right_2 "This signal is used to turn lateral arc";
CM_ SG_ 950 SDWFailSts "The signal is used to indicate a failure in the function";
CM_ SG_ 950 SDWSts "Indicates the status of the side distance warning feature";
CM_ SG_ 950 SPMControlSts "This signal indicates the activation state of the SPM module.";
CM_ SG_ 950 PAM_PopUpRqst "ParkSense HMI pop-up message request";
CM_ SG_ 950 HMICode "This signal indicates the request to display HMI content on the screen";
CM_ SG_ 950 MessageCounter_CVPAM_FD_Info "This signal is a counter used for safety checks strategies. This counter is incremented of 1 (one) unit at each frame transmission.";
CM_ SG_ 950 PAM_LedControlSts "This signal indicates the request to illuminate the PAM LED status indicator";
CM_ SG_ 950 PAM_Off_Status "Gives the status of the module";
CM_ SG_ 950 ParkingManeuverActive "Parking information active";
CM_ SG_ 950 Alert_CHF "This signal indicates which arc shall be displayed in the central hand, front position of the car graphics.";
CM_ SG_ 950 Alert_CHR "This signal indicates which arc shall be displayed in the central hand, rear position of the car graphics.";
CM_ SG_ 950 Alert_LHF "This signal indicates which arc shall be displayed in the left hand, front position of the car graphics.";
CM_ SG_ 950 Alert_LHR "This signal indicates which arc shall be displayed in the left hand, rear position of the car graphics.";
CM_ SG_ 950 Alert_RHF "This signal indicates which arc shall be displayed in the right hand, front position of the car graphics.";
CM_ SG_ 950 Alert_RHR "This signal indicates which arc shall be displayed in the right hand, rear position of the car graphics.";
CM_ SG_ 950 CRC_CVPAM_FD_Info "CRC according to SAE J1850 standard at each frame transmission.";
CM_ SG_ 950 FrontSensorSts "This signal indicates the activation state of the front sensors.";
CM_ SG_ 950 FT_PAM_LedControlSts "Front Park Sense Button LED Status";
CM_ SG_ 950 Graphic_CHF "This signal indicates the flash rate of the arc displayed in the central hand, front position of the car graphics.";
CM_ SG_ 950 Graphic_CHR "This signal indicates the flash rate of the arc displayed in the central hand, rear position of the car graphics.";
CM_ SG_ 950 Graphic_LHF "This signal indicates the flash rate of the arc displayed in the left hand, front position of the car graphics.";
CM_ SG_ 950 Graphic_LHR "This signal indicates the flash rate of the arc displayed in the left hand, rear position of the car graphics.";
CM_ SG_ 950 Graphic_RHF "This signal indicates the flash rate of the arc displayed in the right hand, front position of the car graphics.";
CM_ SG_ 950 Graphic_RHR "This signal indicates the flash rate of the arc displayed in the right hand, rear position of the car graphics.";
CM_ SG_ 275 CRC_CVPAM_FD_Control "CRC according to SAE J1850 standard at each frame transmission.";
CM_ SG_ 275 MessageCounter_CVPAM_FD_Control "This signal is a counter used for safety checks strategies. This counter is incremented of 1 (one) unit at each frame transmission.";
CM_ SG_ 275 RR_PAM_Brk_RqSts "PAM rear brake request";
CM_ SG_ 275 RR_PAM_Dist "Rear Distance to Nearest Obstacle";
CM_ SG_ 275 RR_PAM_StopControlSts "PAM rear stop control status";
BA_DEF_ BO_ "CANFD_BRS" ENUM "0","1";
BA_DEF_ BO_ "VFrameFormat" ENUM "StandardCAN","ExtendedCAN","reserved","reserved","reserved","reserved","reserved","reserved","reserved","reserved","reserved","reserved","reserved","reserved","StandardCAN_FD","ExtendedCAN_FD";
BA_DEF_ BO_ "DiagConnection" HEX 0 65535;
BA_DEF_ BO_ "DiagState" ENUM "No","Yes";
BA_DEF_ BO_ "NmAsrMessage" ENUM "No","Yes";
BA_DEF_ BO_ "GenMsgDelayTime" INT 0 65535;
BA_DEF_ BO_ "GenMsgCycleTime" INT 0 65535;
BA_DEF_ BO_ "GenMsgCycleTimeFast" INT 0 65535;
BA_DEF_ BO_ "GenMsgStartDelayTime" INT 0 65535;
BA_DEF_ BO_ "GenMsgILSupport" ENUM "No","Yes";
BA_DEF_ BO_ "GenMsgNrOfRepetition" INT 0 255;
BA_DEF_ BO_ "GenMsgSendType" ENUM "Cyclic","NotUsed","NotUsed","NotUsed","NotUsed","NotUsed","NotUsed","NotUsed","NoMsgSendType";
BA_DEF_ BO_ "NmMessage" ENUM "No","Yes";
BA_DEF_ BO_ "DiagResponse" ENUM "No","Yes";
BA_DEF_ BO_ "Type" ENUM "P","C","PE","COC","PE_Cntrl","E","E_Cntrl","OC","S","BAF","DC","EM","MM","ISO-TP","-";
BA_DEF_ BO_ "DiagRequest" ENUM "No","Yes";
BA_DEF_ SG_ "GenSigTimeoutTime_SGW" INT 0 65535;
BA_DEF_ SG_ "GenSigTimeoutTime_RFHM" INT 0 65535;
BA_DEF_ SG_ "GenSigTimeoutTime_MPAD" INT 0 65535;
BA_DEF_ SG_ "GenSigTimeoutTime_IPC" INT 0 65535;
BA_DEF_ SG_ "GenSigTimeoutTime_GNMM" INT 0 65535;
BA_DEF_ SG_ "GenSigTimeoutTime_EVCU2" INT 0 65535;
BA_DEF_ SG_ "GenSigTimeoutTime_ESL" INT 0 65535;
BA_DEF_ SG_ "GenSigTimeoutTime_ECM" INT 0 65535;
BA_DEF_ SG_ "GenSigTimeoutTime_DTCM" INT 0 65535;
BA_DEF_ SG_ "GenSigTimeoutTime_DMSM" INT 0 65535;
BA_DEF_ SG_ "GenSigTimeoutTime_BSM" INT 0 65535;
BA_DEF_ SG_ "GenSigTimeoutTime_BCM" INT 0 65535;
BA_DEF_ SG_ "GenSigTimeoutTime_AGSM" INT 0 65535;
BA_DEF_ SG_ "GenSigTimeoutTime_ADCAM" INT 0 65535;
BA_DEF_ SG_ "SystemSignalLongSymbol" STRING ;
BA_DEF_ SG_ "GenSigSendType" ENUM "NotUsed","OnWrite","OnWriteWithRepetition","OnChange","OnChangeWithRepetition","IfActive","IfActiveWithRepetition","NoSigSendType";
BA_DEF_ SG_ "GenSigInactiveValue" INT 0 2147483647;
BA_DEF_ SG_ "GenSigStartValue" INT 0 2147483647;
BA_DEF_DEF_ "CANFD_BRS" "0";
BA_DEF_DEF_ "VFrameFormat" "StandardCAN_FD";
BA_DEF_DEF_ "DiagConnection" 0;
BA_DEF_DEF_ "DiagState" "No";
BA_DEF_DEF_ "NmAsrMessage" "No";
BA_DEF_DEF_ "GenMsgDelayTime" 0;
BA_DEF_DEF_ "GenMsgCycleTime" 0;
BA_DEF_DEF_ "GenMsgCycleTimeFast" 0;
BA_DEF_DEF_ "GenMsgStartDelayTime" 0;
BA_DEF_DEF_ "GenMsgILSupport" "No";
BA_DEF_DEF_ "GenMsgNrOfRepetition" 0;
BA_DEF_DEF_ "GenMsgSendType" "NoMsgSendType";
BA_DEF_DEF_ "NmMessage" "No";
BA_DEF_DEF_ "DiagResponse" "No";
BA_DEF_DEF_ "Type" "-";
BA_DEF_DEF_ "DiagRequest" "No";
BA_DEF_DEF_ "GenSigTimeoutTime_SGW" 2500;
BA_DEF_DEF_ "GenSigTimeoutTime_RFHM" 2500;
BA_DEF_DEF_ "GenSigTimeoutTime_MPAD" 2500;
BA_DEF_DEF_ "GenSigTimeoutTime_IPC" 2500;
BA_DEF_DEF_ "GenSigTimeoutTime_GNMM" 2500;
BA_DEF_DEF_ "GenSigTimeoutTime_EVCU2" 2500;
BA_DEF_DEF_ "GenSigTimeoutTime_ESL" 2500;
BA_DEF_DEF_ "GenSigTimeoutTime_ECM" 2500;
BA_DEF_DEF_ "GenSigTimeoutTime_DTCM" 2500;
BA_DEF_DEF_ "GenSigTimeoutTime_DMSM" 2500;
BA_DEF_DEF_ "GenSigTimeoutTime_BSM" 2500;
BA_DEF_DEF_ "GenSigTimeoutTime_BCM" 2500;
BA_DEF_DEF_ "GenSigTimeoutTime_AGSM" 2500;
BA_DEF_DEF_ "GenSigTimeoutTime_ADCAM" 2500;
BA_DEF_DEF_ "SystemSignalLongSymbol" "";
BA_DEF_DEF_ "GenSigSendType" "NoSigSendType";
BA_DEF_DEF_ "GenSigInactiveValue" 0;
BA_DEF_DEF_ "GenSigStartValue" 0;
BA_ "CANFD_BRS" BO_ 1842 1;
BA_ "GenMsgCycleTime" BO_ 1842 1000;
BA_ "GenMsgILSupport" BO_ 1842 1;
BA_ "GenMsgSendType" BO_ 1842 0;
BA_ "Type" BO_ 1842 1;
BA_ "CANFD_BRS" BO_ 1844 1;
BA_ "GenMsgDelayTime" BO_ 1844 20;
BA_ "GenMsgCycleTime" BO_ 1844 1000;
BA_ "GenMsgCycleTimeFast" BO_ 1844 20;
BA_ "GenMsgILSupport" BO_ 1844 1;
BA_ "GenMsgNrOfRepetition" BO_ 1844 2;
BA_ "GenMsgSendType" BO_ 1844 0;
BA_ "Type" BO_ 1844 1;
BA_ "CANFD_BRS" BO_ 1455 1;
BA_ "GenMsgDelayTime" BO_ 1455 20;
BA_ "GenMsgCycleTime" BO_ 1455 1000;
BA_ "GenMsgCycleTimeFast" BO_ 1455 20;
BA_ "GenMsgILSupport" BO_ 1455 1;
BA_ "GenMsgNrOfRepetition" BO_ 1455 2;
BA_ "GenMsgSendType" BO_ 1455 0;
BA_ "Type" BO_ 1455 3;
BA_ "CANFD_BRS" BO_ 752 1;
BA_ "GenMsgCycleTime" BO_ 752 50;
BA_ "GenMsgStartDelayTime" BO_ 752 40;
BA_ "GenMsgILSupport" BO_ 752 1;
BA_ "GenMsgSendType" BO_ 752 0;
BA_ "Type" BO_ 752 1;
BA_ "CANFD_BRS" BO_ 1032 1;
BA_ "GenMsgCycleTime" BO_ 1032 100;
BA_ "GenMsgILSupport" BO_ 1032 1;
BA_ "GenMsgSendType" BO_ 1032 0;
BA_ "Type" BO_ 1032 1;
BA_ "CANFD_BRS" BO_ 1956 1;
BA_ "GenMsgCycleTime" BO_ 1956 1000;
BA_ "GenMsgILSupport" BO_ 1956 1;
BA_ "GenMsgSendType" BO_ 1956 0;
BA_ "Type" BO_ 1956 1;
BA_ "CANFD_BRS" BO_ 1033 1;
BA_ "GenMsgCycleTime" BO_ 1033 100;
BA_ "GenMsgILSupport" BO_ 1033 1;
BA_ "GenMsgSendType" BO_ 1033 0;
BA_ "Type" BO_ 1033 1;
BA_ "CANFD_BRS" BO_ 1952 1;
BA_ "GenMsgCycleTime" BO_ 1952 1000;
BA_ "GenMsgILSupport" BO_ 1952 1;
BA_ "GenMsgSendType" BO_ 1952 0;
BA_ "Type" BO_ 1952 1;
BA_ "CANFD_BRS" BO_ 1049 1;
BA_ "GenMsgCycleTime" BO_ 1049 100;
BA_ "GenMsgILSupport" BO_ 1049 1;
BA_ "GenMsgSendType" BO_ 1049 0;
BA_ "Type" BO_ 1049 1;
BA_ "CANFD_BRS" BO_ 1027 1;
BA_ "GenMsgCycleTime" BO_ 1027 100;
BA_ "GenMsgILSupport" BO_ 1027 1;
BA_ "GenMsgSendType" BO_ 1027 0;
BA_ "Type" BO_ 1027 1;
BA_ "CANFD_BRS" BO_ 1840 1;
BA_ "GenMsgCycleTime" BO_ 1840 1000;
BA_ "GenMsgILSupport" BO_ 1840 1;
BA_ "GenMsgSendType" BO_ 1840 0;
BA_ "Type" BO_ 1840 1;
BA_ "Type" BO_ 1036 3;
BA_ "CANFD_BRS" BO_ 1036 1;
BA_ "GenMsgDelayTime" BO_ 1036 20;
BA_ "GenMsgCycleTime" BO_ 1036 100;
BA_ "GenMsgCycleTimeFast" BO_ 1036 20;
BA_ "GenMsgILSupport" BO_ 1036 1;
BA_ "GenMsgNrOfRepetition" BO_ 1036 2;
BA_ "GenMsgSendType" BO_ 1036 0;
BA_ "CANFD_BRS" BO_ 2564682271 1;
BA_ "VFrameFormat" BO_ 2564682271 15;
BA_ "DiagConnection" BO_ 2564682271 61983;
BA_ "DiagResponse" BO_ 2564682271 1;
BA_ "Type" BO_ 2564682271 8;
BA_ "CANFD_BRS" BO_ 2564682439 1;
BA_ "VFrameFormat" BO_ 2564682439 15;
BA_ "DiagConnection" BO_ 2564682439 62151;
BA_ "DiagResponse" BO_ 2564682439 1;
BA_ "Type" BO_ 2564682439 8;
BA_ "CANFD_BRS" BO_ 2564682336 1;
BA_ "VFrameFormat" BO_ 2564682336 15;
BA_ "DiagConnection" BO_ 2564682336 62048;
BA_ "DiagResponse" BO_ 2564682336 1;
BA_ "Type" BO_ 2564682336 8;
BA_ "CANFD_BRS" BO_ 2564682436 1;
BA_ "VFrameFormat" BO_ 2564682436 15;
BA_ "DiagConnection" BO_ 2564682436 62148;
BA_ "DiagResponse" BO_ 2564682436 1;
BA_ "Type" BO_ 2564682436 8;
BA_ "CANFD_BRS" BO_ 2564682280 1;
BA_ "VFrameFormat" BO_ 2564682280 15;
BA_ "DiagConnection" BO_ 2564682280 61992;
BA_ "DiagResponse" BO_ 2564682280 1;
BA_ "Type" BO_ 2564682280 8;
BA_ "CANFD_BRS" BO_ 2564485696 1;
BA_ "VFrameFormat" BO_ 2564485696 15;
BA_ "DiagConnection" BO_ 2564485696 62016;
BA_ "DiagResponse" BO_ 2564485696 1;
BA_ "Type" BO_ 2564485696 8;
BA_ "CANFD_BRS" BO_ 2564440306 1;
BA_ "VFrameFormat" BO_ 2564440306 15;
BA_ "DiagConnection" BO_ 2564440306 62016;
BA_ "Type" BO_ 2564440306 8;
BA_ "DiagRequest" BO_ 2564440306 1;
BA_ "CANFD_BRS" BO_ 950 1;
BA_ "GenMsgCycleTime" BO_ 950 250;
BA_ "GenMsgStartDelayTime" BO_ 950 45;
BA_ "GenMsgILSupport" BO_ 950 1;
BA_ "GenMsgSendType" BO_ 950 0;
BA_ "Type" BO_ 950 3;
BA_ "CANFD_BRS" BO_ 275 1;
BA_ "GenMsgCycleTime" BO_ 275 10;
BA_ "GenMsgStartDelayTime" BO_ 275 5;
BA_ "GenMsgILSupport" BO_ 275 1;
BA_ "GenMsgSendType" BO_ 275 0;
BA_ "Type" BO_ 275 1;
BA_ "GenSigTimeoutTime_SGW" SG_ 1036 DistOilLifeRst 0;
BA_ "GenSigTimeoutTime_RFHM" SG_ 1036 DistOilLifeRst 0;
BA_ "GenSigTimeoutTime_MPAD" SG_ 1036 DistOilLifeRst 0;
BA_ "GenSigTimeoutTime_GNMM" SG_ 1036 DistOilLifeRst 0;
BA_ "GenSigTimeoutTime_EVCU2" SG_ 1036 DistOilLifeRst 0;
BA_ "GenSigTimeoutTime_ESL" SG_ 1036 DistOilLifeRst 0;
BA_ "GenSigTimeoutTime_ECM" SG_ 1036 DistOilLifeRst 0;
BA_ "GenSigTimeoutTime_DTCM" SG_ 1036 DistOilLifeRst 0;
BA_ "GenSigTimeoutTime_DMSM" SG_ 1036 DistOilLifeRst 0;
BA_ "GenSigTimeoutTime_BSM" SG_ 1036 DistOilLifeRst 0;
BA_ "GenSigTimeoutTime_AGSM" SG_ 1036 DistOilLifeRst 0;
BA_ "GenSigTimeoutTime_ADCAM" SG_ 1036 DistOilLifeRst 0;
BA_ "GenSigSendType" SG_ 1036 DistOilLifeRst 3;
BA_ "GenSigStartValue" SG_ 1036 DistOilLifeRst 65535;
BA_ "GenSigTimeoutTime_IPC" SG_ 1036 MessageCounter_ENGINE3 0;
BA_ "GenSigTimeoutTime_GNMM" SG_ 1036 MessageCounter_ENGINE3 0;
BA_ "GenSigTimeoutTime_EVCU2" SG_ 1036 MessageCounter_ENGINE3 0;
BA_ "GenSigTimeoutTime_ESL" SG_ 1036 MessageCounter_ENGINE3 0;
BA_ "GenSigTimeoutTime_ECM" SG_ 1036 MessageCounter_ENGINE3 0;
BA_ "GenSigTimeoutTime_DTCM" SG_ 1036 MessageCounter_ENGINE3 0;
BA_ "GenSigTimeoutTime_DMSM" SG_ 1036 MessageCounter_ENGINE3 0;
BA_ "GenSigTimeoutTime_BSM" SG_ 1036 MessageCounter_ENGINE3 0;
BA_ "GenSigTimeoutTime_BCM" SG_ 1036 MessageCounter_ENGINE3 0;
BA_ "GenSigTimeoutTime_AGSM" SG_ 1036 MessageCounter_ENGINE3 0;
BA_ "GenSigTimeoutTime_ADCAM" SG_ 1036 MessageCounter_ENGINE3 0;
BA_ "GenSigTimeoutTime_SGW" SG_ 1036 DefFuelEcon 0;
BA_ "GenSigTimeoutTime_RFHM" SG_ 1036 DefFuelEcon 0;
BA_ "GenSigTimeoutTime_MPAD" SG_ 1036 DefFuelEcon 0;
BA_ "GenSigTimeoutTime_GNMM" SG_ 1036 DefFuelEcon 0;
BA_ "GenSigTimeoutTime_EVCU2" SG_ 1036 DefFuelEcon 0;
BA_ "GenSigTimeoutTime_ESL" SG_ 1036 DefFuelEcon 0;
BA_ "GenSigTimeoutTime_ECM" SG_ 1036 DefFuelEcon 0;
BA_ "GenSigTimeoutTime_DTCM" SG_ 1036 DefFuelEcon 0;
BA_ "GenSigTimeoutTime_DMSM" SG_ 1036 DefFuelEcon 0;
BA_ "GenSigTimeoutTime_BSM" SG_ 1036 DefFuelEcon 0;
BA_ "GenSigTimeoutTime_BCM" SG_ 1036 DefFuelEcon 0;
BA_ "GenSigTimeoutTime_AGSM" SG_ 1036 DefFuelEcon 0;
BA_ "GenSigTimeoutTime_ADCAM" SG_ 1036 DefFuelEcon 0;
BA_ "GenSigStartValue" SG_ 1036 DefFuelEcon 255;
BA_ "GenSigTimeoutTime_SGW" SG_ 1036 CRC_ENGINE3 0;
BA_ "GenSigTimeoutTime_SGW" SG_ 2564682271 N_PDU 0;
BA_ "GenSigTimeoutTime_RFHM" SG_ 2564682271 N_PDU 0;
BA_ "GenSigTimeoutTime_MPAD" SG_ 2564682271 N_PDU 0;
BA_ "GenSigTimeoutTime_IPC" SG_ 2564682271 N_PDU 0;
BA_ "GenSigTimeoutTime_GNMM" SG_ 2564682271 N_PDU 0;
BA_ "GenSigTimeoutTime_EVCU2" SG_ 2564682271 N_PDU 0;
BA_ "GenSigTimeoutTime_ESL" SG_ 2564682271 N_PDU 0;
BA_ "GenSigTimeoutTime_ECM" SG_ 2564682271 N_PDU 0;
BA_ "GenSigTimeoutTime_DTCM" SG_ 2564682271 N_PDU 0;
BA_ "GenSigTimeoutTime_DMSM" SG_ 2564682271 N_PDU 0;
BA_ "GenSigTimeoutTime_BSM" SG_ 2564682271 N_PDU 0;
BA_ "GenSigTimeoutTime_BCM" SG_ 2564682271 N_PDU 0;
BA_ "GenSigTimeoutTime_AGSM" SG_ 2564682271 N_PDU 0;
BA_ "GenSigTimeoutTime_ADCAM" SG_ 2564682271 N_PDU 0;
BA_ "GenSigTimeoutTime_SGW" SG_ 2564682439 N_PDU 0;
BA_ "GenSigTimeoutTime_RFHM" SG_ 2564682439 N_PDU 0;
BA_ "GenSigTimeoutTime_MPAD" SG_ 2564682439 N_PDU 0;
BA_ "GenSigTimeoutTime_IPC" SG_ 2564682439 N_PDU 0;
BA_ "GenSigTimeoutTime_GNMM" SG_ 2564682439 N_PDU 0;
BA_ "GenSigTimeoutTime_EVCU2" SG_ 2564682439 N_PDU 0;
BA_ "GenSigTimeoutTime_ESL" SG_ 2564682439 N_PDU 0;
BA_ "GenSigTimeoutTime_ECM" SG_ 2564682439 N_PDU 0;
BA_ "GenSigTimeoutTime_DTCM" SG_ 2564682439 N_PDU 0;
BA_ "GenSigTimeoutTime_DMSM" SG_ 2564682439 N_PDU 0;
BA_ "GenSigTimeoutTime_BSM" SG_ 2564682439 N_PDU 0;
BA_ "GenSigTimeoutTime_BCM" SG_ 2564682439 N_PDU 0;
BA_ "GenSigTimeoutTime_AGSM" SG_ 2564682439 N_PDU 0;
BA_ "GenSigTimeoutTime_ADCAM" SG_ 2564682439 N_PDU 0;
BA_ "GenSigTimeoutTime_SGW" SG_ 2564682336 N_PDU 0;
BA_ "GenSigTimeoutTime_RFHM" SG_ 2564682336 N_PDU 0;
BA_ "GenSigTimeoutTime_MPAD" SG_ 2564682336 N_PDU 0;
BA_ "GenSigTimeoutTime_IPC" SG_ 2564682336 N_PDU 0;
BA_ "GenSigTimeoutTime_GNMM" SG_ 2564682336 N_PDU 0;
BA_ "GenSigTimeoutTime_EVCU2" SG_ 2564682336 N_PDU 0;
BA_ "GenSigTimeoutTime_ESL" SG_ 2564682336 N_PDU 0;
BA_ "GenSigTimeoutTime_ECM" SG_ 2564682336 N_PDU 0;
BA_ "GenSigTimeoutTime_DTCM" SG_ 2564682336 N_PDU 0;
BA_ "GenSigTimeoutTime_DMSM" SG_ 2564682336 N_PDU 0;
BA_ "GenSigTimeoutTime_BSM" SG_ 2564682336 N_PDU 0;
BA_ "GenSigTimeoutTime_BCM" SG_ 2564682336 N_PDU 0;
BA_ "GenSigTimeoutTime_AGSM" SG_ 2564682336 N_PDU 0;
BA_ "GenSigTimeoutTime_ADCAM" SG_ 2564682336 N_PDU 0;
BA_ "GenSigTimeoutTime_SGW" SG_ 2564682436 N_PDU 0;
BA_ "GenSigTimeoutTime_RFHM" SG_ 2564682436 N_PDU 0;
BA_ "GenSigTimeoutTime_MPAD" SG_ 2564682436 N_PDU 0;
BA_ "GenSigTimeoutTime_IPC" SG_ 2564682436 N_PDU 0;
BA_ "GenSigTimeoutTime_GNMM" SG_ 2564682436 N_PDU 0;
BA_ "GenSigTimeoutTime_EVCU2" SG_ 2564682436 N_PDU 0;
BA_ "GenSigTimeoutTime_ESL" SG_ 2564682436 N_PDU 0;
BA_ "GenSigTimeoutTime_ECM" SG_ 2564682436 N_PDU 0;
BA_ "GenSigTimeoutTime_DTCM" SG_ 2564682436 N_PDU 0;
BA_ "GenSigTimeoutTime_DMSM" SG_ 2564682436 N_PDU 0;
BA_ "GenSigTimeoutTime_BSM" SG_ 2564682436 N_PDU 0;
BA_ "GenSigTimeoutTime_BCM" SG_ 2564682436 N_PDU 0;
BA_ "GenSigTimeoutTime_AGSM" SG_ 2564682436 N_PDU 0;
BA_ "GenSigTimeoutTime_ADCAM" SG_ 2564682436 N_PDU 0;
BA_ "GenSigTimeoutTime_SGW" SG_ 2564682280 N_PDU 0;
BA_ "GenSigTimeoutTime_RFHM" SG_ 2564682280 N_PDU 0;
BA_ "GenSigTimeoutTime_MPAD" SG_ 2564682280 N_PDU 0;
BA_ "GenSigTimeoutTime_IPC" SG_ 2564682280 N_PDU 0;
BA_ "GenSigTimeoutTime_GNMM" SG_ 2564682280 N_PDU 0;
BA_ "GenSigTimeoutTime_EVCU2" SG_ 2564682280 N_PDU 0;
BA_ "GenSigTimeoutTime_ESL" SG_ 2564682280 N_PDU 0;
BA_ "GenSigTimeoutTime_ECM" SG_ 2564682280 N_PDU 0;
BA_ "GenSigTimeoutTime_DTCM" SG_ 2564682280 N_PDU 0;
BA_ "GenSigTimeoutTime_DMSM" SG_ 2564682280 N_PDU 0;
BA_ "GenSigTimeoutTime_BSM" SG_ 2564682280 N_PDU 0;
BA_ "GenSigTimeoutTime_BCM" SG_ 2564682280 N_PDU 0;
BA_ "GenSigTimeoutTime_AGSM" SG_ 2564682280 N_PDU 0;
BA_ "GenSigTimeoutTime_ADCAM" SG_ 2564682280 N_PDU 0;
BA_ "GenSigTimeoutTime_RFHM" SG_ 1455 NextNavInstructionPanelTheme 0;
BA_ "GenSigTimeoutTime_MPAD" SG_ 1455 NextNavInstructionPanelTheme 0;
BA_ "GenSigTimeoutTime_IPC" SG_ 1455 NextNavInstructionPanelTheme 0;
BA_ "GenSigTimeoutTime_GNMM" SG_ 1455 NextNavInstructionPanelTheme 0;
BA_ "GenSigTimeoutTime_EVCU2" SG_ 1455 NextNavInstructionPanelTheme 0;
BA_ "GenSigTimeoutTime_ESL" SG_ 1455 NextNavInstructionPanelTheme 0;
BA_ "GenSigTimeoutTime_ECM" SG_ 1455 NextNavInstructionPanelTheme 0;
BA_ "GenSigTimeoutTime_DTCM" SG_ 1455 NextNavInstructionPanelTheme 0;
BA_ "GenSigTimeoutTime_DMSM" SG_ 1455 NextNavInstructionPanelTheme 0;
BA_ "GenSigTimeoutTime_BSM" SG_ 1455 NextNavInstructionPanelTheme 0;
BA_ "GenSigTimeoutTime_BCM" SG_ 1455 NextNavInstructionPanelTheme 0;
BA_ "GenSigTimeoutTime_AGSM" SG_ 1455 NextNavInstructionPanelTheme 0;
BA_ "GenSigTimeoutTime_ADCAM" SG_ 1455 NextNavInstructionPanelTheme 0;
BA_ "GenSigSendType" SG_ 1455 NextNavInstructionPanelTheme 3;
BA_ "GenSigTimeoutTime_RFHM" SG_ 1455 A_EV_Kilometers 0;
BA_ "GenSigTimeoutTime_MPAD" SG_ 1455 A_EV_Kilometers 0;
BA_ "GenSigTimeoutTime_IPC" SG_ 1455 A_EV_Kilometers 0;
BA_ "GenSigTimeoutTime_GNMM" SG_ 1455 A_EV_Kilometers 0;
BA_ "GenSigTimeoutTime_EVCU2" SG_ 1455 A_EV_Kilometers 0;
BA_ "GenSigTimeoutTime_ESL" SG_ 1455 A_EV_Kilometers 0;
BA_ "GenSigTimeoutTime_ECM" SG_ 1455 A_EV_Kilometers 0;
BA_ "GenSigTimeoutTime_DTCM" SG_ 1455 A_EV_Kilometers 0;
BA_ "GenSigTimeoutTime_DMSM" SG_ 1455 A_EV_Kilometers 0;
BA_ "GenSigTimeoutTime_BSM" SG_ 1455 A_EV_Kilometers 0;
BA_ "GenSigTimeoutTime_BCM" SG_ 1455 A_EV_Kilometers 0;
BA_ "GenSigTimeoutTime_AGSM" SG_ 1455 A_EV_Kilometers 0;
BA_ "GenSigTimeoutTime_ADCAM" SG_ 1455 A_EV_Kilometers 0;
BA_ "GenSigTimeoutTime_RFHM" SG_ 1455 A_EV_Miles 0;
BA_ "GenSigTimeoutTime_MPAD" SG_ 1455 A_EV_Miles 0;
BA_ "GenSigTimeoutTime_IPC" SG_ 1455 A_EV_Miles 0;
BA_ "GenSigTimeoutTime_GNMM" SG_ 1455 A_EV_Miles 0;
BA_ "GenSigTimeoutTime_EVCU2" SG_ 1455 A_EV_Miles 0;
BA_ "GenSigTimeoutTime_ESL" SG_ 1455 A_EV_Miles 0;
BA_ "GenSigTimeoutTime_ECM" SG_ 1455 A_EV_Miles 0;
BA_ "GenSigTimeoutTime_DTCM" SG_ 1455 A_EV_Miles 0;
BA_ "GenSigTimeoutTime_DMSM" SG_ 1455 A_EV_Miles 0;
BA_ "GenSigTimeoutTime_BSM" SG_ 1455 A_EV_Miles 0;
BA_ "GenSigTimeoutTime_BCM" SG_ 1455 A_EV_Miles 0;
BA_ "GenSigTimeoutTime_AGSM" SG_ 1455 A_EV_Miles 0;
BA_ "GenSigTimeoutTime_ADCAM" SG_ 1455 A_EV_Miles 0;
BA_ "GenSigTimeoutTime_RFHM" SG_ 1455 A_Hybrid_Kilometers 0;
BA_ "GenSigTimeoutTime_MPAD" SG_ 1455 A_Hybrid_Kilometers 0;
BA_ "GenSigTimeoutTime_IPC" SG_ 1455 A_Hybrid_Kilometers 0;
BA_ "GenSigTimeoutTime_GNMM" SG_ 1455 A_Hybrid_Kilometers 0;
BA_ "GenSigTimeoutTime_EVCU2" SG_ 1455 A_Hybrid_Kilometers 0;
BA_ "GenSigTimeoutTime_ESL" SG_ 1455 A_Hybrid_Kilometers 0;
BA_ "GenSigTimeoutTime_ECM" SG_ 1455 A_Hybrid_Kilometers 0;
BA_ "GenSigTimeoutTime_DTCM" SG_ 1455 A_Hybrid_Kilometers 0;
BA_ "GenSigTimeoutTime_DMSM" SG_ 1455 A_Hybrid_Kilometers 0;
BA_ "GenSigTimeoutTime_BSM" SG_ 1455 A_Hybrid_Kilometers 0;
BA_ "GenSigTimeoutTime_BCM" SG_ 1455 A_Hybrid_Kilometers 0;
BA_ "GenSigTimeoutTime_AGSM" SG_ 1455 A_Hybrid_Kilometers 0;
BA_ "GenSigTimeoutTime_ADCAM" SG_ 1455 A_Hybrid_Kilometers 0;
BA_ "GenSigTimeoutTime_RFHM" SG_ 1455 A_Hybrid_Miles 0;
BA_ "GenSigTimeoutTime_MPAD" SG_ 1455 A_Hybrid_Miles 0;
BA_ "GenSigTimeoutTime_IPC" SG_ 1455 A_Hybrid_Miles 0;
BA_ "GenSigTimeoutTime_GNMM" SG_ 1455 A_Hybrid_Miles 0;
BA_ "GenSigTimeoutTime_EVCU2" SG_ 1455 A_Hybrid_Miles 0;
BA_ "GenSigTimeoutTime_ESL" SG_ 1455 A_Hybrid_Miles 0;
BA_ "GenSigTimeoutTime_ECM" SG_ 1455 A_Hybrid_Miles 0;
BA_ "GenSigTimeoutTime_DTCM" SG_ 1455 A_Hybrid_Miles 0;
BA_ "GenSigTimeoutTime_DMSM" SG_ 1455 A_Hybrid_Miles 0;
BA_ "GenSigTimeoutTime_BSM" SG_ 1455 A_Hybrid_Miles 0;
BA_ "GenSigTimeoutTime_BCM" SG_ 1455 A_Hybrid_Miles 0;
BA_ "GenSigTimeoutTime_AGSM" SG_ 1455 A_Hybrid_Miles 0;
BA_ "GenSigTimeoutTime_ADCAM" SG_ 1455 A_Hybrid_Miles 0;
BA_ "GenSigTimeoutTime_RFHM" SG_ 1455 AudioMenuPopup 0;
BA_ "GenSigTimeoutTime_MPAD" SG_ 1455 AudioMenuPopup 0;
BA_ "GenSigTimeoutTime_IPC" SG_ 1455 AudioMenuPopup 0;
BA_ "GenSigTimeoutTime_GNMM" SG_ 1455 AudioMenuPopup 0;
BA_ "GenSigTimeoutTime_EVCU2" SG_ 1455 AudioMenuPopup 0;
BA_ "GenSigTimeoutTime_ESL" SG_ 1455 AudioMenuPopup 0;
BA_ "GenSigTimeoutTime_ECM" SG_ 1455 AudioMenuPopup 0;
BA_ "GenSigTimeoutTime_DTCM" SG_ 1455 AudioMenuPopup 0;
BA_ "GenSigTimeoutTime_DMSM" SG_ 1455 AudioMenuPopup 0;
BA_ "GenSigTimeoutTime_BSM" SG_ 1455 AudioMenuPopup 0;
BA_ "GenSigTimeoutTime_BCM" SG_ 1455 AudioMenuPopup 0;
BA_ "GenSigTimeoutTime_AGSM" SG_ 1455 AudioMenuPopup 0;
BA_ "GenSigTimeoutTime_ADCAM" SG_ 1455 AudioMenuPopup 0;
BA_ "GenSigSendType" SG_ 1455 AudioMenuPopup 3;
BA_ "GenSigStartValue" SG_ 1455 AudioMenuPopup 1;
BA_ "GenSigTimeoutTime_RFHM" SG_ 1455 Avg_Fuel_Econ 0;
BA_ "GenSigTimeoutTime_MPAD" SG_ 1455 Avg_Fuel_Econ 0;
BA_ "GenSigTimeoutTime_IPC" SG_ 1455 Avg_Fuel_Econ 0;
BA_ "GenSigTimeoutTime_GNMM" SG_ 1455 Avg_Fuel_Econ 0;
BA_ "GenSigTimeoutTime_EVCU2" SG_ 1455 Avg_Fuel_Econ 0;
BA_ "GenSigTimeoutTime_ESL" SG_ 1455 Avg_Fuel_Econ 0;
BA_ "GenSigTimeoutTime_ECM" SG_ 1455 Avg_Fuel_Econ 0;
BA_ "GenSigTimeoutTime_DTCM" SG_ 1455 Avg_Fuel_Econ 0;
BA_ "GenSigTimeoutTime_DMSM" SG_ 1455 Avg_Fuel_Econ 0;
BA_ "GenSigTimeoutTime_BSM" SG_ 1455 Avg_Fuel_Econ 0;
BA_ "GenSigTimeoutTime_BCM" SG_ 1455 Avg_Fuel_Econ 0;
BA_ "GenSigTimeoutTime_AGSM" SG_ 1455 Avg_Fuel_Econ 0;
BA_ "GenSigTimeoutTime_ADCAM" SG_ 1455 Avg_Fuel_Econ 0;
BA_ "GenSigSendType" SG_ 1455 Avg_Fuel_Econ 3;
BA_ "GenSigStartValue" SG_ 1455 Avg_Fuel_Econ 1023;
BA_ "GenSigTimeoutTime_RFHM" SG_ 1455 Cluster_In_Audio_Md 0;
BA_ "GenSigTimeoutTime_MPAD" SG_ 1455 Cluster_In_Audio_Md 0;
BA_ "GenSigTimeoutTime_IPC" SG_ 1455 Cluster_In_Audio_Md 0;
BA_ "GenSigTimeoutTime_GNMM" SG_ 1455 Cluster_In_Audio_Md 0;
BA_ "GenSigTimeoutTime_EVCU2" SG_ 1455 Cluster_In_Audio_Md 0;
BA_ "GenSigTimeoutTime_ESL" SG_ 1455 Cluster_In_Audio_Md 0;
BA_ "GenSigTimeoutTime_ECM" SG_ 1455 Cluster_In_Audio_Md 0;
BA_ "GenSigTimeoutTime_DTCM" SG_ 1455 Cluster_In_Audio_Md 0;
BA_ "GenSigTimeoutTime_DMSM" SG_ 1455 Cluster_In_Audio_Md 0;
BA_ "GenSigTimeoutTime_BSM" SG_ 1455 Cluster_In_Audio_Md 0;
BA_ "GenSigTimeoutTime_BCM" SG_ 1455 Cluster_In_Audio_Md 0;
BA_ "GenSigTimeoutTime_AGSM" SG_ 1455 Cluster_In_Audio_Md 0;
BA_ "GenSigTimeoutTime_ADCAM" SG_ 1455 Cluster_In_Audio_Md 0;
BA_ "GenSigSendType" SG_ 1455 Cluster_In_Audio_Md 3;
BA_ "GenSigStartValue" SG_ 1455 Cluster_In_Audio_Md 1;
BA_ "GenSigTimeoutTime_RFHM" SG_ 1455 IC_ETM_HUDCustom_Req 0;
BA_ "GenSigTimeoutTime_MPAD" SG_ 1455 IC_ETM_HUDCustom_Req 0;
BA_ "GenSigTimeoutTime_IPC" SG_ 1455 IC_ETM_HUDCustom_Req 0;
BA_ "GenSigTimeoutTime_GNMM" SG_ 1455 IC_ETM_HUDCustom_Req 0;
BA_ "GenSigTimeoutTime_EVCU2" SG_ 1455 IC_ETM_HUDCustom_Req 0;
BA_ "GenSigTimeoutTime_ESL" SG_ 1455 IC_ETM_HUDCustom_Req 0;
BA_ "GenSigTimeoutTime_ECM" SG_ 1455 IC_ETM_HUDCustom_Req 0;
BA_ "GenSigTimeoutTime_DTCM" SG_ 1455 IC_ETM_HUDCustom_Req 0;
BA_ "GenSigTimeoutTime_DMSM" SG_ 1455 IC_ETM_HUDCustom_Req 0;
BA_ "GenSigTimeoutTime_BSM" SG_ 1455 IC_ETM_HUDCustom_Req 0;
BA_ "GenSigTimeoutTime_BCM" SG_ 1455 IC_ETM_HUDCustom_Req 0;
BA_ "GenSigTimeoutTime_AGSM" SG_ 1455 IC_ETM_HUDCustom_Req 0;
BA_ "GenSigTimeoutTime_ADCAM" SG_ 1455 IC_ETM_HUDCustom_Req 0;
BA_ "GenSigSendType" SG_ 1455 IC_ETM_HUDCustom_Req 3;
BA_ "GenSigTimeoutTime_RFHM" SG_ 1455 IPC_NavigationMap_Req 0;
BA_ "GenSigTimeoutTime_MPAD" SG_ 1455 IPC_NavigationMap_Req 0;
BA_ "GenSigTimeoutTime_IPC" SG_ 1455 IPC_NavigationMap_Req 0;
BA_ "GenSigTimeoutTime_GNMM" SG_ 1455 IPC_NavigationMap_Req 0;
BA_ "GenSigTimeoutTime_EVCU2" SG_ 1455 IPC_NavigationMap_Req 0;
BA_ "GenSigTimeoutTime_ESL" SG_ 1455 IPC_NavigationMap_Req 0;
BA_ "GenSigTimeoutTime_ECM" SG_ 1455 IPC_NavigationMap_Req 0;
BA_ "GenSigTimeoutTime_DTCM" SG_ 1455 IPC_NavigationMap_Req 0;
BA_ "GenSigTimeoutTime_DMSM" SG_ 1455 IPC_NavigationMap_Req 0;
BA_ "GenSigTimeoutTime_BSM" SG_ 1455 IPC_NavigationMap_Req 0;
BA_ "GenSigTimeoutTime_BCM" SG_ 1455 IPC_NavigationMap_Req 0;
BA_ "GenSigTimeoutTime_AGSM" SG_ 1455 IPC_NavigationMap_Req 0;
BA_ "GenSigTimeoutTime_ADCAM" SG_ 1455 IPC_NavigationMap_Req 0;
BA_ "GenSigSendType" SG_ 1455 IPC_NavigationMap_Req 3;
BA_ "GenSigStartValue" SG_ 1455 IPC_NavigationMap_Req 1;
BA_ "GenSigTimeoutTime_RFHM" SG_ 1455 NavigationMapPopUP 0;
BA_ "GenSigTimeoutTime_MPAD" SG_ 1455 NavigationMapPopUP 0;
BA_ "GenSigTimeoutTime_IPC" SG_ 1455 NavigationMapPopUP 0;
BA_ "GenSigTimeoutTime_GNMM" SG_ 1455 NavigationMapPopUP 0;
BA_ "GenSigTimeoutTime_EVCU2" SG_ 1455 NavigationMapPopUP 0;
BA_ "GenSigTimeoutTime_ESL" SG_ 1455 NavigationMapPopUP 0;
BA_ "GenSigTimeoutTime_ECM" SG_ 1455 NavigationMapPopUP 0;
BA_ "GenSigTimeoutTime_DTCM" SG_ 1455 NavigationMapPopUP 0;
BA_ "GenSigTimeoutTime_DMSM" SG_ 1455 NavigationMapPopUP 0;
BA_ "GenSigTimeoutTime_BSM" SG_ 1455 NavigationMapPopUP 0;
BA_ "GenSigTimeoutTime_BCM" SG_ 1455 NavigationMapPopUP 0;
BA_ "GenSigTimeoutTime_AGSM" SG_ 1455 NavigationMapPopUP 0;
BA_ "GenSigTimeoutTime_ADCAM" SG_ 1455 NavigationMapPopUP 0;
BA_ "GenSigSendType" SG_ 1455 NavigationMapPopUP 3;
BA_ "GenSigStartValue" SG_ 1455 NavigationMapPopUP 1;
BA_ "GenSigTimeoutTime_SGW" SG_ 752 IBS3_SOF_VC 0;
BA_ "GenSigTimeoutTime_RFHM" SG_ 752 IBS3_SOF_VC 0;
BA_ "GenSigTimeoutTime_MPAD" SG_ 752 IBS3_SOF_VC 0;
BA_ "GenSigTimeoutTime_IPC" SG_ 752 IBS3_SOF_VC 0;
BA_ "GenSigTimeoutTime_GNMM" SG_ 752 IBS3_SOF_VC 0;
BA_ "GenSigTimeoutTime_ESL" SG_ 752 IBS3_SOF_VC 0;
BA_ "GenSigTimeoutTime_ECM" SG_ 752 IBS3_SOF_VC 0;
BA_ "GenSigTimeoutTime_DTCM" SG_ 752 IBS3_SOF_VC 0;
BA_ "GenSigTimeoutTime_DMSM" SG_ 752 IBS3_SOF_VC 0;
BA_ "GenSigTimeoutTime_BSM" SG_ 752 IBS3_SOF_VC 0;
BA_ "GenSigTimeoutTime_BCM" SG_ 752 IBS3_SOF_VC 0;
BA_ "GenSigTimeoutTime_AGSM" SG_ 752 IBS3_SOF_VC 0;
BA_ "GenSigTimeoutTime_ADCAM" SG_ 752 IBS3_SOF_VC 0;
BA_ "GenSigTimeoutTime_RFHM" SG_ 752 IBS3_Ibatt 0;
BA_ "GenSigTimeoutTime_MPAD" SG_ 752 IBS3_Ibatt 0;
BA_ "GenSigTimeoutTime_IPC" SG_ 752 IBS3_Ibatt 0;
BA_ "GenSigTimeoutTime_GNMM" SG_ 752 IBS3_Ibatt 0;
BA_ "GenSigTimeoutTime_ESL" SG_ 752 IBS3_Ibatt 0;
BA_ "GenSigTimeoutTime_DTCM" SG_ 752 IBS3_Ibatt 0;
BA_ "GenSigTimeoutTime_DMSM" SG_ 752 IBS3_Ibatt 0;
BA_ "GenSigTimeoutTime_BSM" SG_ 752 IBS3_Ibatt 0;
BA_ "GenSigTimeoutTime_BCM" SG_ 752 IBS3_Ibatt 0;
BA_ "GenSigTimeoutTime_AGSM" SG_ 752 IBS3_Ibatt 0;
BA_ "GenSigTimeoutTime_ADCAM" SG_ 752 IBS3_Ibatt 0;
BA_ "GenSigStartValue" SG_ 752 IBS3_Ibatt 65535;
BA_ "GenSigTimeoutTime_RFHM" SG_ 752 IBS3_Vbatt 0;
BA_ "GenSigTimeoutTime_MPAD" SG_ 752 IBS3_Vbatt 0;
BA_ "GenSigTimeoutTime_IPC" SG_ 752 IBS3_Vbatt 0;
BA_ "GenSigTimeoutTime_GNMM" SG_ 752 IBS3_Vbatt 0;
BA_ "GenSigTimeoutTime_ESL" SG_ 752 IBS3_Vbatt 0;
BA_ "GenSigTimeoutTime_DTCM" SG_ 752 IBS3_Vbatt 0;
BA_ "GenSigTimeoutTime_DMSM" SG_ 752 IBS3_Vbatt 0;
BA_ "GenSigTimeoutTime_BSM" SG_ 752 IBS3_Vbatt 0;
BA_ "GenSigTimeoutTime_BCM" SG_ 752 IBS3_Vbatt 0;
BA_ "GenSigTimeoutTime_AGSM" SG_ 752 IBS3_Vbatt 0;
BA_ "GenSigTimeoutTime_ADCAM" SG_ 752 IBS3_Vbatt 0;
BA_ "GenSigStartValue" SG_ 752 IBS3_Vbatt 511;
BA_ "GenSigTimeoutTime_SGW" SG_ 1032 PECP_PumpSpeedActual 0;
BA_ "GenSigTimeoutTime_RFHM" SG_ 1032 PECP_PumpSpeedActual 0;
BA_ "GenSigTimeoutTime_MPAD" SG_ 1032 PECP_PumpSpeedActual 0;
BA_ "GenSigTimeoutTime_IPC" SG_ 1032 PECP_PumpSpeedActual 0;
BA_ "GenSigTimeoutTime_GNMM" SG_ 1032 PECP_PumpSpeedActual 0;
BA_ "GenSigTimeoutTime_EVCU2" SG_ 1032 PECP_PumpSpeedActual 0;
BA_ "GenSigTimeoutTime_ESL" SG_ 1032 PECP_PumpSpeedActual 0;
BA_ "GenSigTimeoutTime_DTCM" SG_ 1032 PECP_PumpSpeedActual 0;
BA_ "GenSigTimeoutTime_DMSM" SG_ 1032 PECP_PumpSpeedActual 0;
BA_ "GenSigTimeoutTime_BSM" SG_ 1032 PECP_PumpSpeedActual 0;
BA_ "GenSigTimeoutTime_BCM" SG_ 1032 PECP_PumpSpeedActual 0;
BA_ "GenSigTimeoutTime_AGSM" SG_ 1032 PECP_PumpSpeedActual 0;
BA_ "GenSigTimeoutTime_ADCAM" SG_ 1032 PECP_PumpSpeedActual 0;
BA_ "GenSigTimeoutTime_SGW" SG_ 1032 PE_CoolTempOut 0;
BA_ "GenSigTimeoutTime_RFHM" SG_ 1032 PE_CoolTempOut 0;
BA_ "GenSigTimeoutTime_MPAD" SG_ 1032 PE_CoolTempOut 0;
BA_ "GenSigTimeoutTime_IPC" SG_ 1032 PE_CoolTempOut 0;
BA_ "GenSigTimeoutTime_GNMM" SG_ 1032 PE_CoolTempOut 0;
BA_ "GenSigTimeoutTime_EVCU2" SG_ 1032 PE_CoolTempOut 0;
BA_ "GenSigTimeoutTime_ESL" SG_ 1032 PE_CoolTempOut 0;
BA_ "GenSigTimeoutTime_DTCM" SG_ 1032 PE_CoolTempOut 0;
BA_ "GenSigTimeoutTime_DMSM" SG_ 1032 PE_CoolTempOut 0;
BA_ "GenSigTimeoutTime_BSM" SG_ 1032 PE_CoolTempOut 0;
BA_ "GenSigTimeoutTime_BCM" SG_ 1032 PE_CoolTempOut 0;
BA_ "GenSigTimeoutTime_AGSM" SG_ 1032 PE_CoolTempOut 0;
BA_ "GenSigTimeoutTime_ADCAM" SG_ 1032 PE_CoolTempOut 0;
BA_ "GenSigStartValue" SG_ 1032 PE_CoolTempOut 255;
BA_ "GenSigTimeoutTime_RFHM" SG_ 1956 MotorB_Temperature 0;
BA_ "GenSigTimeoutTime_MPAD" SG_ 1956 MotorB_Temperature 0;
BA_ "GenSigTimeoutTime_IPC" SG_ 1956 MotorB_Temperature 0;
BA_ "GenSigTimeoutTime_GNMM" SG_ 1956 MotorB_Temperature 0;
BA_ "GenSigTimeoutTime_EVCU2" SG_ 1956 MotorB_Temperature 0;
BA_ "GenSigTimeoutTime_ESL" SG_ 1956 MotorB_Temperature 0;
BA_ "GenSigTimeoutTime_ECM" SG_ 1956 MotorB_Temperature 0;
BA_ "GenSigTimeoutTime_DTCM" SG_ 1956 MotorB_Temperature 0;
BA_ "GenSigTimeoutTime_DMSM" SG_ 1956 MotorB_Temperature 0;
BA_ "GenSigTimeoutTime_BSM" SG_ 1956 MotorB_Temperature 0;
BA_ "GenSigTimeoutTime_BCM" SG_ 1956 MotorB_Temperature 0;
BA_ "GenSigTimeoutTime_AGSM" SG_ 1956 MotorB_Temperature 0;
BA_ "GenSigTimeoutTime_ADCAM" SG_ 1956 MotorB_Temperature 0;
BA_ "GenSigStartValue" SG_ 1956 MotorB_Temperature 40;
BA_ "GenSigTimeoutTime_MPAD" SG_ 1956 MotorA_DC_Current 0;
BA_ "GenSigTimeoutTime_IPC" SG_ 1956 MotorA_DC_Current 0;
BA_ "GenSigTimeoutTime_GNMM" SG_ 1956 MotorA_DC_Current 0;
BA_ "GenSigTimeoutTime_EVCU2" SG_ 1956 MotorA_DC_Current 0;
BA_ "GenSigTimeoutTime_ESL" SG_ 1956 MotorA_DC_Current 0;
BA_ "GenSigTimeoutTime_ECM" SG_ 1956 MotorA_DC_Current 0;
BA_ "GenSigTimeoutTime_DTCM" SG_ 1956 MotorA_DC_Current 0;
BA_ "GenSigTimeoutTime_DMSM" SG_ 1956 MotorA_DC_Current 0;
BA_ "GenSigTimeoutTime_BSM" SG_ 1956 MotorA_DC_Current 0;
BA_ "GenSigTimeoutTime_BCM" SG_ 1956 MotorA_DC_Current 0;
BA_ "GenSigTimeoutTime_AGSM" SG_ 1956 MotorA_DC_Current 0;
BA_ "GenSigTimeoutTime_ADCAM" SG_ 1956 MotorA_DC_Current 0;
BA_ "GenSigStartValue" SG_ 1956 MotorA_DC_Current 16384;
BA_ "GenSigTimeoutTime_RFHM" SG_ 1956 MotorA_DC_Current 0;
BA_ "GenSigTimeoutTime_RFHM" SG_ 1956 MotorA_DC_Voltage 0;
BA_ "GenSigTimeoutTime_MPAD" SG_ 1956 MotorA_DC_Voltage 0;
BA_ "GenSigTimeoutTime_IPC" SG_ 1956 MotorA_DC_Voltage 0;
BA_ "GenSigTimeoutTime_GNMM" SG_ 1956 MotorA_DC_Voltage 0;
BA_ "GenSigTimeoutTime_EVCU2" SG_ 1956 MotorA_DC_Voltage 0;
BA_ "GenSigTimeoutTime_ESL" SG_ 1956 MotorA_DC_Voltage 0;
BA_ "GenSigTimeoutTime_ECM" SG_ 1956 MotorA_DC_Voltage 0;
BA_ "GenSigTimeoutTime_DTCM" SG_ 1956 MotorA_DC_Voltage 0;
BA_ "GenSigTimeoutTime_DMSM" SG_ 1956 MotorA_DC_Voltage 0;
BA_ "GenSigTimeoutTime_BSM" SG_ 1956 MotorA_DC_Voltage 0;
BA_ "GenSigTimeoutTime_BCM" SG_ 1956 MotorA_DC_Voltage 0;
BA_ "GenSigTimeoutTime_AGSM" SG_ 1956 MotorA_DC_Voltage 0;
BA_ "GenSigTimeoutTime_ADCAM" SG_ 1956 MotorA_DC_Voltage 0;
BA_ "GenSigTimeoutTime_RFHM" SG_ 1956 MotorA_InverterTemp 0;
BA_ "GenSigTimeoutTime_MPAD" SG_ 1956 MotorA_InverterTemp 0;
BA_ "GenSigTimeoutTime_IPC" SG_ 1956 MotorA_InverterTemp 0;
BA_ "GenSigTimeoutTime_GNMM" SG_ 1956 MotorA_InverterTemp 0;
BA_ "GenSigTimeoutTime_EVCU2" SG_ 1956 MotorA_InverterTemp 0;
BA_ "GenSigTimeoutTime_ESL" SG_ 1956 MotorA_InverterTemp 0;
BA_ "GenSigTimeoutTime_ECM" SG_ 1956 MotorA_InverterTemp 0;
BA_ "GenSigTimeoutTime_DTCM" SG_ 1956 MotorA_InverterTemp 0;
BA_ "GenSigTimeoutTime_DMSM" SG_ 1956 MotorA_InverterTemp 0;
BA_ "GenSigTimeoutTime_BSM" SG_ 1956 MotorA_InverterTemp 0;
BA_ "GenSigTimeoutTime_BCM" SG_ 1956 MotorA_InverterTemp 0;
BA_ "GenSigTimeoutTime_AGSM" SG_ 1956 MotorA_InverterTemp 0;
BA_ "GenSigTimeoutTime_ADCAM" SG_ 1956 MotorA_InverterTemp 0;
BA_ "GenSigStartValue" SG_ 1956 MotorA_InverterTemp 40;
BA_ "GenSigTimeoutTime_RFHM" SG_ 1956 MotorA_RPM 0;
BA_ "GenSigTimeoutTime_IPC" SG_ 1956 MotorA_RPM 0;
BA_ "GenSigTimeoutTime_GNMM" SG_ 1956 MotorA_RPM 0;
BA_ "GenSigTimeoutTime_EVCU2" SG_ 1956 MotorA_RPM 0;
BA_ "GenSigTimeoutTime_ESL" SG_ 1956 MotorA_RPM 0;
BA_ "GenSigTimeoutTime_ECM" SG_ 1956 MotorA_RPM 0;
BA_ "GenSigTimeoutTime_DMSM" SG_ 1956 MotorA_RPM 0;
BA_ "GenSigTimeoutTime_BSM" SG_ 1956 MotorA_RPM 0;
BA_ "GenSigTimeoutTime_AGSM" SG_ 1956 MotorA_RPM 0;
BA_ "GenSigTimeoutTime_ADCAM" SG_ 1956 MotorA_RPM 0;
BA_ "GenSigStartValue" SG_ 1956 MotorA_RPM 32768;
BA_ "GenSigTimeoutTime_RFHM" SG_ 1956 MotorB_RPM 0;
BA_ "GenSigTimeoutTime_IPC" SG_ 1956 MotorB_RPM 0;
BA_ "GenSigTimeoutTime_GNMM" SG_ 1956 MotorB_RPM 0;
BA_ "GenSigTimeoutTime_EVCU2" SG_ 1956 MotorB_RPM 0;
BA_ "GenSigTimeoutTime_ESL" SG_ 1956 MotorB_RPM 0;
BA_ "GenSigTimeoutTime_DMSM" SG_ 1956 MotorB_RPM 0;
BA_ "GenSigTimeoutTime_BSM" SG_ 1956 MotorB_RPM 0;
BA_ "GenSigTimeoutTime_AGSM" SG_ 1956 MotorB_RPM 0;
BA_ "GenSigTimeoutTime_ADCAM" SG_ 1956 MotorB_RPM 0;
BA_ "GenSigStartValue" SG_ 1956 MotorB_RPM 32768;
BA_ "GenSigTimeoutTime_RFHM" SG_ 1956 MotorA_Temperature 0;
BA_ "GenSigTimeoutTime_MPAD" SG_ 1956 MotorA_Temperature 0;
BA_ "GenSigTimeoutTime_IPC" SG_ 1956 MotorA_Temperature 0;
BA_ "GenSigTimeoutTime_GNMM" SG_ 1956 MotorA_Temperature 0;
BA_ "GenSigTimeoutTime_EVCU2" SG_ 1956 MotorA_Temperature 0;
BA_ "GenSigTimeoutTime_ESL" SG_ 1956 MotorA_Temperature 0;
BA_ "GenSigTimeoutTime_ECM" SG_ 1956 MotorA_Temperature 0;
BA_ "GenSigTimeoutTime_DTCM" SG_ 1956 MotorA_Temperature 0;
BA_ "GenSigTimeoutTime_DMSM" SG_ 1956 MotorA_Temperature 0;
BA_ "GenSigTimeoutTime_BSM" SG_ 1956 MotorA_Temperature 0;
BA_ "GenSigTimeoutTime_BCM" SG_ 1956 MotorA_Temperature 0;
BA_ "GenSigTimeoutTime_AGSM" SG_ 1956 MotorA_Temperature 0;
BA_ "GenSigTimeoutTime_ADCAM" SG_ 1956 MotorA_Temperature 0;
BA_ "GenSigStartValue" SG_ 1956 MotorA_Temperature 40;
BA_ "GenSigTimeoutTime_RFHM" SG_ 1956 MotorB_DC_Current 0;
BA_ "GenSigTimeoutTime_MPAD" SG_ 1956 MotorB_DC_Current 0;
BA_ "GenSigTimeoutTime_IPC" SG_ 1956 MotorB_DC_Current 0;
BA_ "GenSigTimeoutTime_GNMM" SG_ 1956 MotorB_DC_Current 0;
BA_ "GenSigTimeoutTime_EVCU2" SG_ 1956 MotorB_DC_Current 0;
BA_ "GenSigTimeoutTime_ESL" SG_ 1956 MotorB_DC_Current 0;
BA_ "GenSigTimeoutTime_ECM" SG_ 1956 MotorB_DC_Current 0;
BA_ "GenSigTimeoutTime_DTCM" SG_ 1956 MotorB_DC_Current 0;
BA_ "GenSigTimeoutTime_DMSM" SG_ 1956 MotorB_DC_Current 0;
BA_ "GenSigTimeoutTime_BSM" SG_ 1956 MotorB_DC_Current 0;
BA_ "GenSigTimeoutTime_BCM" SG_ 1956 MotorB_DC_Current 0;
BA_ "GenSigTimeoutTime_AGSM" SG_ 1956 MotorB_DC_Current 0;
BA_ "GenSigTimeoutTime_ADCAM" SG_ 1956 MotorB_DC_Current 0;
BA_ "GenSigStartValue" SG_ 1956 MotorB_DC_Current 16384;
BA_ "GenSigTimeoutTime_RFHM" SG_ 1956 MotorB_DC_Voltage 0;
BA_ "GenSigTimeoutTime_MPAD" SG_ 1956 MotorB_DC_Voltage 0;
BA_ "GenSigTimeoutTime_IPC" SG_ 1956 MotorB_DC_Voltage 0;
BA_ "GenSigTimeoutTime_GNMM" SG_ 1956 MotorB_DC_Voltage 0;
BA_ "GenSigTimeoutTime_EVCU2" SG_ 1956 MotorB_DC_Voltage 0;
BA_ "GenSigTimeoutTime_ESL" SG_ 1956 MotorB_DC_Voltage 0;
BA_ "GenSigTimeoutTime_ECM" SG_ 1956 MotorB_DC_Voltage 0;
BA_ "GenSigTimeoutTime_DTCM" SG_ 1956 MotorB_DC_Voltage 0;
BA_ "GenSigTimeoutTime_DMSM" SG_ 1956 MotorB_DC_Voltage 0;
BA_ "GenSigTimeoutTime_BSM" SG_ 1956 MotorB_DC_Voltage 0;
BA_ "GenSigTimeoutTime_BCM" SG_ 1956 MotorB_DC_Voltage 0;
BA_ "GenSigTimeoutTime_AGSM" SG_ 1956 MotorB_DC_Voltage 0;
BA_ "GenSigTimeoutTime_ADCAM" SG_ 1956 MotorB_DC_Voltage 0;
BA_ "GenSigTimeoutTime_RFHM" SG_ 1956 MotorB_InverterTemp 0;
BA_ "GenSigTimeoutTime_MPAD" SG_ 1956 MotorB_InverterTemp 0;
BA_ "GenSigTimeoutTime_IPC" SG_ 1956 MotorB_InverterTemp 0;
BA_ "GenSigTimeoutTime_GNMM" SG_ 1956 MotorB_InverterTemp 0;
BA_ "GenSigTimeoutTime_EVCU2" SG_ 1956 MotorB_InverterTemp 0;
BA_ "GenSigTimeoutTime_ESL" SG_ 1956 MotorB_InverterTemp 0;
BA_ "GenSigTimeoutTime_ECM" SG_ 1956 MotorB_InverterTemp 0;
BA_ "GenSigTimeoutTime_DTCM" SG_ 1956 MotorB_InverterTemp 0;
BA_ "GenSigTimeoutTime_DMSM" SG_ 1956 MotorB_InverterTemp 0;
BA_ "GenSigTimeoutTime_BSM" SG_ 1956 MotorB_InverterTemp 0;
BA_ "GenSigTimeoutTime_BCM" SG_ 1956 MotorB_InverterTemp 0;
BA_ "GenSigTimeoutTime_AGSM" SG_ 1956 MotorB_InverterTemp 0;
BA_ "GenSigTimeoutTime_ADCAM" SG_ 1956 MotorB_InverterTemp 0;
BA_ "GenSigStartValue" SG_ 1956 MotorB_InverterTemp 40;
BA_ "GenSigTimeoutTime_SGW" SG_ 1033 HEV_HybPwrtrnRdcdPerfCmnd 0;
BA_ "GenSigTimeoutTime_RFHM" SG_ 1033 HEV_HybPwrtrnRdcdPerfCmnd 0;
BA_ "GenSigTimeoutTime_MPAD" SG_ 1033 HEV_HybPwrtrnRdcdPerfCmnd 0;
BA_ "GenSigTimeoutTime_IPC" SG_ 1033 HEV_HybPwrtrnRdcdPerfCmnd 0;
BA_ "GenSigTimeoutTime_GNMM" SG_ 1033 HEV_HybPwrtrnRdcdPerfCmnd 0;
BA_ "GenSigTimeoutTime_EVCU2" SG_ 1033 HEV_HybPwrtrnRdcdPerfCmnd 0;
BA_ "GenSigTimeoutTime_ESL" SG_ 1033 HEV_HybPwrtrnRdcdPerfCmnd 0;
BA_ "GenSigTimeoutTime_ECM" SG_ 1033 HEV_HybPwrtrnRdcdPerfCmnd 0;
BA_ "GenSigTimeoutTime_DTCM" SG_ 1033 HEV_HybPwrtrnRdcdPerfCmnd 0;
BA_ "GenSigTimeoutTime_DMSM" SG_ 1033 HEV_HybPwrtrnRdcdPerfCmnd 0;
BA_ "GenSigTimeoutTime_BSM" SG_ 1033 HEV_HybPwrtrnRdcdPerfCmnd 0;
BA_ "GenSigTimeoutTime_BCM" SG_ 1033 HEV_HybPwrtrnRdcdPerfCmnd 0;
BA_ "GenSigTimeoutTime_AGSM" SG_ 1033 HEV_HybPwrtrnRdcdPerfCmnd 0;
BA_ "GenSigTimeoutTime_ADCAM" SG_ 1033 HEV_HybPwrtrnRdcdPerfCmnd 0;
BA_ "GenSigTimeoutTime_SGW" SG_ 1033 CRC_HYBRID_POWERTRAIN5 0;
BA_ "GenSigTimeoutTime_RFHM" SG_ 1033 CRC_HYBRID_POWERTRAIN5 0;
BA_ "GenSigTimeoutTime_MPAD" SG_ 1033 CRC_HYBRID_POWERTRAIN5 0;
BA_ "GenSigTimeoutTime_IPC" SG_ 1033 CRC_HYBRID_POWERTRAIN5 0;
BA_ "GenSigTimeoutTime_GNMM" SG_ 1033 CRC_HYBRID_POWERTRAIN5 0;
BA_ "GenSigTimeoutTime_EVCU2" SG_ 1033 CRC_HYBRID_POWERTRAIN5 0;
BA_ "GenSigTimeoutTime_ESL" SG_ 1033 CRC_HYBRID_POWERTRAIN5 0;
BA_ "GenSigTimeoutTime_DTCM" SG_ 1033 CRC_HYBRID_POWERTRAIN5 0;
BA_ "GenSigTimeoutTime_DMSM" SG_ 1033 CRC_HYBRID_POWERTRAIN5 0;
BA_ "GenSigTimeoutTime_BSM" SG_ 1033 CRC_HYBRID_POWERTRAIN5 0;
BA_ "GenSigTimeoutTime_BCM" SG_ 1033 CRC_HYBRID_POWERTRAIN5 0;
BA_ "GenSigTimeoutTime_AGSM" SG_ 1033 CRC_HYBRID_POWERTRAIN5 0;
BA_ "GenSigTimeoutTime_ADCAM" SG_ 1033 CRC_HYBRID_POWERTRAIN5 0;
BA_ "GenSigTimeoutTime_SGW" SG_ 1033 MessageCounter_HYBRID_POWERTRAIN5 0;
BA_ "GenSigTimeoutTime_RFHM" SG_ 1033 MessageCounter_HYBRID_POWERTRAIN5 0;
BA_ "GenSigTimeoutTime_MPAD" SG_ 1033 MessageCounter_HYBRID_POWERTRAIN5 0;
BA_ "GenSigTimeoutTime_IPC" SG_ 1033 MessageCounter_HYBRID_POWERTRAIN5 0;
BA_ "GenSigTimeoutTime_GNMM" SG_ 1033 MessageCounter_HYBRID_POWERTRAIN5 0;
BA_ "GenSigTimeoutTime_EVCU2" SG_ 1033 MessageCounter_HYBRID_POWERTRAIN5 0;
BA_ "GenSigTimeoutTime_ESL" SG_ 1033 MessageCounter_HYBRID_POWERTRAIN5 0;
BA_ "GenSigTimeoutTime_DTCM" SG_ 1033 MessageCounter_HYBRID_POWERTRAIN5 0;
BA_ "GenSigTimeoutTime_DMSM" SG_ 1033 MessageCounter_HYBRID_POWERTRAIN5 0;
BA_ "GenSigTimeoutTime_BSM" SG_ 1033 MessageCounter_HYBRID_POWERTRAIN5 0;
BA_ "GenSigTimeoutTime_BCM" SG_ 1033 MessageCounter_HYBRID_POWERTRAIN5 0;
BA_ "GenSigTimeoutTime_AGSM" SG_ 1033 MessageCounter_HYBRID_POWERTRAIN5 0;
BA_ "GenSigTimeoutTime_ADCAM" SG_ 1033 MessageCounter_HYBRID_POWERTRAIN5 0;
BA_ "SystemSignalLongSymbol" SG_ 1033 MessageCounter_HYBRID_POWERTRAIN5 "MessageCounter_HYBRID_POWERTRAIN5";
BA_ "GenSigTimeoutTime_SGW" SG_ 1952 SchCond_Time_Till_Dep 0;
BA_ "GenSigTimeoutTime_RFHM" SG_ 1952 SchCond_Time_Till_Dep 0;
BA_ "GenSigTimeoutTime_MPAD" SG_ 1952 SchCond_Time_Till_Dep 0;
BA_ "GenSigTimeoutTime_IPC" SG_ 1952 SchCond_Time_Till_Dep 0;
BA_ "GenSigTimeoutTime_GNMM" SG_ 1952 SchCond_Time_Till_Dep 0;
BA_ "GenSigTimeoutTime_EVCU2" SG_ 1952 SchCond_Time_Till_Dep 0;
BA_ "GenSigTimeoutTime_ESL" SG_ 1952 SchCond_Time_Till_Dep 0;
BA_ "GenSigTimeoutTime_ECM" SG_ 1952 SchCond_Time_Till_Dep 0;
BA_ "GenSigTimeoutTime_DTCM" SG_ 1952 SchCond_Time_Till_Dep 0;
BA_ "GenSigTimeoutTime_DMSM" SG_ 1952 SchCond_Time_Till_Dep 0;
BA_ "GenSigTimeoutTime_BSM" SG_ 1952 SchCond_Time_Till_Dep 0;
BA_ "GenSigTimeoutTime_AGSM" SG_ 1952 SchCond_Time_Till_Dep 0;
BA_ "GenSigTimeoutTime_ADCAM" SG_ 1952 SchCond_Time_Till_Dep 0;
BA_ "GenSigTimeoutTime_SGW" SG_ 1952 HVBatCoolantLevelLow_DPT 0;
BA_ "GenSigTimeoutTime_RFHM" SG_ 1952 HVBatCoolantLevelLow_DPT 0;
BA_ "GenSigTimeoutTime_MPAD" SG_ 1952 HVBatCoolantLevelLow_DPT 0;
BA_ "GenSigTimeoutTime_GNMM" SG_ 1952 HVBatCoolantLevelLow_DPT 0;
BA_ "GenSigTimeoutTime_EVCU2" SG_ 1952 HVBatCoolantLevelLow_DPT 0;
BA_ "GenSigTimeoutTime_ESL" SG_ 1952 HVBatCoolantLevelLow_DPT 0;
BA_ "GenSigTimeoutTime_ECM" SG_ 1952 HVBatCoolantLevelLow_DPT 0;
BA_ "GenSigTimeoutTime_DTCM" SG_ 1952 HVBatCoolantLevelLow_DPT 0;
BA_ "GenSigTimeoutTime_DMSM" SG_ 1952 HVBatCoolantLevelLow_DPT 0;
BA_ "GenSigTimeoutTime_BSM" SG_ 1952 HVBatCoolantLevelLow_DPT 0;
BA_ "GenSigTimeoutTime_BCM" SG_ 1952 HVBatCoolantLevelLow_DPT 0;
BA_ "GenSigTimeoutTime_AGSM" SG_ 1952 HVBatCoolantLevelLow_DPT 0;
BA_ "GenSigTimeoutTime_ADCAM" SG_ 1952 HVBatCoolantLevelLow_DPT 0;
BA_ "GenSigSendType" SG_ 1952 HVBatCoolantLevelLow_DPT 3;
BA_ "GenSigTimeoutTime_SGW" SG_ 1952 Sch_PreCondition_Sts 0;
BA_ "GenSigTimeoutTime_RFHM" SG_ 1952 Sch_PreCondition_Sts 0;
BA_ "GenSigTimeoutTime_MPAD" SG_ 1952 Sch_PreCondition_Sts 0;
BA_ "GenSigTimeoutTime_IPC" SG_ 1952 Sch_PreCondition_Sts 0;
BA_ "GenSigTimeoutTime_GNMM" SG_ 1952 Sch_PreCondition_Sts 0;
BA_ "GenSigTimeoutTime_EVCU2" SG_ 1952 Sch_PreCondition_Sts 0;
BA_ "GenSigTimeoutTime_ESL" SG_ 1952 Sch_PreCondition_Sts 0;
BA_ "GenSigTimeoutTime_ECM" SG_ 1952 Sch_PreCondition_Sts 0;
BA_ "GenSigTimeoutTime_DTCM" SG_ 1952 Sch_PreCondition_Sts 0;
BA_ "GenSigTimeoutTime_DMSM" SG_ 1952 Sch_PreCondition_Sts 0;
BA_ "GenSigTimeoutTime_BSM" SG_ 1952 Sch_PreCondition_Sts 0;
BA_ "GenSigTimeoutTime_AGSM" SG_ 1952 Sch_PreCondition_Sts 0;
BA_ "GenSigTimeoutTime_ADCAM" SG_ 1952 Sch_PreCondition_Sts 0;
BA_ "GenSigTimeoutTime_RFHM" SG_ 1952 CompressorState 0;
BA_ "GenSigTimeoutTime_MPAD" SG_ 1952 CompressorState 0;
BA_ "GenSigTimeoutTime_IPC" SG_ 1952 CompressorState 0;
BA_ "GenSigTimeoutTime_GNMM" SG_ 1952 CompressorState 0;
BA_ "GenSigTimeoutTime_EVCU2" SG_ 1952 CompressorState 0;
BA_ "GenSigTimeoutTime_ESL" SG_ 1952 CompressorState 0;
BA_ "GenSigTimeoutTime_ECM" SG_ 1952 CompressorState 0;
BA_ "GenSigTimeoutTime_DTCM" SG_ 1952 CompressorState 0;
BA_ "GenSigTimeoutTime_DMSM" SG_ 1952 CompressorState 0;
BA_ "GenSigTimeoutTime_BSM" SG_ 1952 CompressorState 0;
BA_ "GenSigTimeoutTime_AGSM" SG_ 1952 CompressorState 0;
BA_ "GenSigTimeoutTime_ADCAM" SG_ 1952 CompressorState 0;
BA_ "GenSigSendType" SG_ 1952 CompressorState 3;
BA_ "GenSigTimeoutTime_EVCU2" SG_ 1952 ElecCoolantHtrPwr 0;
BA_ "GenSigTimeoutTime_ESL" SG_ 1952 ElecCoolantHtrPwr 0;
BA_ "GenSigTimeoutTime_DTCM" SG_ 1952 ElecCoolantHtrPwr 0;
BA_ "GenSigTimeoutTime_DMSM" SG_ 1952 ElecCoolantHtrPwr 0;
BA_ "GenSigTimeoutTime_BSM" SG_ 1952 ElecCoolantHtrPwr 0;
BA_ "GenSigTimeoutTime_AGSM" SG_ 1952 ElecCoolantHtrPwr 0;
BA_ "GenSigTimeoutTime_ADCAM" SG_ 1952 ElecCoolantHtrPwr 0;
BA_ "GenSigSendType" SG_ 1952 ElecCoolantHtrPwr 3;
BA_ "GenSigTimeoutTime_SGW" SG_ 1952 ElecCoolantHtrPwr 0;
BA_ "GenSigTimeoutTime_RFHM" SG_ 1952 ElecCoolantHtrPwr 0;
BA_ "GenSigTimeoutTime_MPAD" SG_ 1952 ElecCoolantHtrPwr 0;
BA_ "GenSigTimeoutTime_IPC" SG_ 1952 ElecCoolantHtrPwr 0;
BA_ "GenSigTimeoutTime_GNMM" SG_ 1952 ElecCoolantHtrPwr 0;
BA_ "GenSigTimeoutTime_SGW" SG_ 1952 HeaterCoreInletTemp 0;
BA_ "GenSigTimeoutTime_RFHM" SG_ 1952 HeaterCoreInletTemp 0;
BA_ "GenSigTimeoutTime_MPAD" SG_ 1952 HeaterCoreInletTemp 0;
BA_ "GenSigTimeoutTime_IPC" SG_ 1952 HeaterCoreInletTemp 0;
BA_ "GenSigTimeoutTime_GNMM" SG_ 1952 HeaterCoreInletTemp 0;
BA_ "GenSigTimeoutTime_EVCU2" SG_ 1952 HeaterCoreInletTemp 0;
BA_ "GenSigTimeoutTime_ESL" SG_ 1952 HeaterCoreInletTemp 0;
BA_ "GenSigTimeoutTime_DTCM" SG_ 1952 HeaterCoreInletTemp 0;
BA_ "GenSigTimeoutTime_DMSM" SG_ 1952 HeaterCoreInletTemp 0;
BA_ "GenSigTimeoutTime_BSM" SG_ 1952 HeaterCoreInletTemp 0;
BA_ "GenSigTimeoutTime_AGSM" SG_ 1952 HeaterCoreInletTemp 0;
BA_ "GenSigTimeoutTime_ADCAM" SG_ 1952 HeaterCoreInletTemp 0;
BA_ "GenSigSendType" SG_ 1952 HeaterCoreInletTemp 3;
BA_ "GenSigTimeoutTime_SGW" SG_ 1952 HTAuxPmpRPMAct 0;
BA_ "GenSigTimeoutTime_RFHM" SG_ 1952 HTAuxPmpRPMAct 0;
BA_ "GenSigTimeoutTime_MPAD" SG_ 1952 HTAuxPmpRPMAct 0;
BA_ "GenSigTimeoutTime_IPC" SG_ 1952 HTAuxPmpRPMAct 0;
BA_ "GenSigTimeoutTime_GNMM" SG_ 1952 HTAuxPmpRPMAct 0;
BA_ "GenSigTimeoutTime_EVCU2" SG_ 1952 HTAuxPmpRPMAct 0;
BA_ "GenSigTimeoutTime_ESL" SG_ 1952 HTAuxPmpRPMAct 0;
BA_ "GenSigTimeoutTime_DTCM" SG_ 1952 HTAuxPmpRPMAct 0;
BA_ "GenSigTimeoutTime_DMSM" SG_ 1952 HTAuxPmpRPMAct 0;
BA_ "GenSigTimeoutTime_BSM" SG_ 1952 HTAuxPmpRPMAct 0;
BA_ "GenSigTimeoutTime_AGSM" SG_ 1952 HTAuxPmpRPMAct 0;
BA_ "GenSigTimeoutTime_ADCAM" SG_ 1952 HTAuxPmpRPMAct 0;
BA_ "GenSigSendType" SG_ 1952 HTAuxPmpRPMAct 3;
BA_ "GenSigTimeoutTime_SGW" SG_ 1049 RefrigerantPressure 0;
BA_ "GenSigTimeoutTime_RFHM" SG_ 1049 RefrigerantPressure 0;
BA_ "GenSigTimeoutTime_MPAD" SG_ 1049 RefrigerantPressure 0;
BA_ "GenSigTimeoutTime_IPC" SG_ 1049 RefrigerantPressure 0;
BA_ "GenSigTimeoutTime_GNMM" SG_ 1049 RefrigerantPressure 0;
BA_ "GenSigTimeoutTime_EVCU2" SG_ 1049 RefrigerantPressure 0;
BA_ "GenSigTimeoutTime_ESL" SG_ 1049 RefrigerantPressure 0;
BA_ "GenSigTimeoutTime_ECM" SG_ 1049 RefrigerantPressure 0;
BA_ "GenSigTimeoutTime_DTCM" SG_ 1049 RefrigerantPressure 0;
BA_ "GenSigTimeoutTime_DMSM" SG_ 1049 RefrigerantPressure 0;
BA_ "GenSigTimeoutTime_BSM" SG_ 1049 RefrigerantPressure 0;
BA_ "GenSigTimeoutTime_AGSM" SG_ 1049 RefrigerantPressure 0;
BA_ "GenSigTimeoutTime_ADCAM" SG_ 1049 RefrigerantPressure 0;
BA_ "GenSigTimeoutTime_SGW" SG_ 1952 CabinPreconditionReqSts 0;
BA_ "GenSigTimeoutTime_RFHM" SG_ 1952 CabinPreconditionReqSts 0;
BA_ "GenSigTimeoutTime_MPAD" SG_ 1952 CabinPreconditionReqSts 0;
BA_ "GenSigTimeoutTime_GNMM" SG_ 1952 CabinPreconditionReqSts 0;
BA_ "GenSigTimeoutTime_EVCU2" SG_ 1952 CabinPreconditionReqSts 0;
BA_ "GenSigTimeoutTime_ESL" SG_ 1952 CabinPreconditionReqSts 0;
BA_ "GenSigTimeoutTime_ECM" SG_ 1952 CabinPreconditionReqSts 0;
BA_ "GenSigTimeoutTime_DTCM" SG_ 1952 CabinPreconditionReqSts 0;
BA_ "GenSigTimeoutTime_DMSM" SG_ 1952 CabinPreconditionReqSts 0;
BA_ "GenSigTimeoutTime_BSM" SG_ 1952 CabinPreconditionReqSts 0;
BA_ "GenSigTimeoutTime_BCM" SG_ 1952 CabinPreconditionReqSts 0;
BA_ "GenSigTimeoutTime_AGSM" SG_ 1952 CabinPreconditionReqSts 0;
BA_ "GenSigTimeoutTime_ADCAM" SG_ 1952 CabinPreconditionReqSts 0;
BA_ "GenSigSendType" SG_ 1952 CabinPreconditionReqSts 3;
BA_ "GenSigTimeoutTime_SGW" SG_ 1049 HybridMILRequest 0;
BA_ "GenSigTimeoutTime_RFHM" SG_ 1049 HybridMILRequest 0;
BA_ "GenSigTimeoutTime_MPAD" SG_ 1049 HybridMILRequest 0;
BA_ "GenSigTimeoutTime_IPC" SG_ 1049 HybridMILRequest 0;
BA_ "GenSigTimeoutTime_GNMM" SG_ 1049 HybridMILRequest 0;
BA_ "GenSigTimeoutTime_EVCU2" SG_ 1049 HybridMILRequest 0;
BA_ "GenSigTimeoutTime_ESL" SG_ 1049 HybridMILRequest 0;
BA_ "GenSigTimeoutTime_DTCM" SG_ 1049 HybridMILRequest 0;
BA_ "GenSigTimeoutTime_DMSM" SG_ 1049 HybridMILRequest 0;
BA_ "GenSigTimeoutTime_BSM" SG_ 1049 HybridMILRequest 0;
BA_ "GenSigTimeoutTime_BCM" SG_ 1049 HybridMILRequest 0;
BA_ "GenSigTimeoutTime_AGSM" SG_ 1049 HybridMILRequest 0;
BA_ "GenSigTimeoutTime_ADCAM" SG_ 1049 HybridMILRequest 0;
BA_ "GenSigTimeoutTime_SGW" SG_ 1049 MessageCounter_HYBRID_DISPLAY 0;
BA_ "GenSigTimeoutTime_RFHM" SG_ 1049 MessageCounter_HYBRID_DISPLAY 0;
BA_ "GenSigTimeoutTime_MPAD" SG_ 1049 MessageCounter_HYBRID_DISPLAY 0;
BA_ "GenSigTimeoutTime_GNMM" SG_ 1049 MessageCounter_HYBRID_DISPLAY 0;
BA_ "GenSigTimeoutTime_EVCU2" SG_ 1049 MessageCounter_HYBRID_DISPLAY 0;
BA_ "GenSigTimeoutTime_ESL" SG_ 1049 MessageCounter_HYBRID_DISPLAY 0;
BA_ "GenSigTimeoutTime_ECM" SG_ 1049 MessageCounter_HYBRID_DISPLAY 0;
BA_ "GenSigTimeoutTime_DTCM" SG_ 1049 MessageCounter_HYBRID_DISPLAY 0;
BA_ "GenSigTimeoutTime_DMSM" SG_ 1049 MessageCounter_HYBRID_DISPLAY 0;
BA_ "GenSigTimeoutTime_BSM" SG_ 1049 MessageCounter_HYBRID_DISPLAY 0;
BA_ "GenSigTimeoutTime_BCM" SG_ 1049 MessageCounter_HYBRID_DISPLAY 0;
BA_ "GenSigTimeoutTime_AGSM" SG_ 1049 MessageCounter_HYBRID_DISPLAY 0;
BA_ "GenSigTimeoutTime_ADCAM" SG_ 1049 MessageCounter_HYBRID_DISPLAY 0;
BA_ "GenSigTimeoutTime_SGW" SG_ 1840 Warning_PackTempHigh 0;
BA_ "GenSigTimeoutTime_RFHM" SG_ 1840 Warning_PackTempHigh 0;
BA_ "GenSigTimeoutTime_MPAD" SG_ 1840 Warning_PackTempHigh 0;
BA_ "GenSigTimeoutTime_IPC" SG_ 1840 Warning_PackTempHigh 0;
BA_ "GenSigTimeoutTime_GNMM" SG_ 1840 Warning_PackTempHigh 0;
BA_ "GenSigTimeoutTime_EVCU2" SG_ 1840 Warning_PackTempHigh 0;
BA_ "GenSigTimeoutTime_ESL" SG_ 1840 Warning_PackTempHigh 0;
BA_ "GenSigTimeoutTime_ECM" SG_ 1840 Warning_PackTempHigh 0;
BA_ "GenSigTimeoutTime_DTCM" SG_ 1840 Warning_PackTempHigh 0;
BA_ "GenSigTimeoutTime_DMSM" SG_ 1840 Warning_PackTempHigh 0;
BA_ "GenSigTimeoutTime_BSM" SG_ 1840 Warning_PackTempHigh 0;
BA_ "GenSigTimeoutTime_BCM" SG_ 1840 Warning_PackTempHigh 0;
BA_ "GenSigTimeoutTime_AGSM" SG_ 1840 Warning_PackTempHigh 0;
BA_ "GenSigTimeoutTime_ADCAM" SG_ 1840 Warning_PackTempHigh 0;
BA_ "GenSigTimeoutTime_ECM" SG_ 1049 HVBatterySOC_DisplayV 0;
BA_ "GenSigTimeoutTime_DTCM" SG_ 1049 HVBatterySOC_DisplayV 0;
BA_ "GenSigTimeoutTime_DMSM" SG_ 1049 HVBatterySOC_DisplayV 0;
BA_ "GenSigTimeoutTime_BSM" SG_ 1049 HVBatterySOC_DisplayV 0;
BA_ "GenSigTimeoutTime_BCM" SG_ 1049 HVBatterySOC_DisplayV 0;
BA_ "GenSigTimeoutTime_AGSM" SG_ 1049 HVBatterySOC_DisplayV 0;
BA_ "GenSigTimeoutTime_ADCAM" SG_ 1049 HVBatterySOC_DisplayV 0;
BA_ "GenSigTimeoutTime_RFHM" SG_ 1049 HVACPowerUse_DisplayV 0;
BA_ "GenSigTimeoutTime_MPAD" SG_ 1049 HVACPowerUse_DisplayV 0;
BA_ "GenSigTimeoutTime_IPC" SG_ 1049 HVACPowerUse_DisplayV 0;
BA_ "GenSigTimeoutTime_GNMM" SG_ 1049 HVACPowerUse_DisplayV 0;
BA_ "GenSigTimeoutTime_EVCU2" SG_ 1049 HVACPowerUse_DisplayV 0;
BA_ "GenSigTimeoutTime_ESL" SG_ 1049 HVACPowerUse_DisplayV 0;
BA_ "GenSigTimeoutTime_ECM" SG_ 1049 HVACPowerUse_DisplayV 0;
BA_ "GenSigTimeoutTime_DTCM" SG_ 1049 HVACPowerUse_DisplayV 0;
BA_ "GenSigTimeoutTime_DMSM" SG_ 1049 HVACPowerUse_DisplayV 0;
BA_ "GenSigTimeoutTime_BSM" SG_ 1049 HVACPowerUse_DisplayV 0;
BA_ "GenSigTimeoutTime_BCM" SG_ 1049 HVACPowerUse_DisplayV 0;
BA_ "GenSigTimeoutTime_AGSM" SG_ 1049 HVACPowerUse_DisplayV 0;
BA_ "GenSigTimeoutTime_ADCAM" SG_ 1049 HVACPowerUse_DisplayV 0;
BA_ "GenSigTimeoutTime_RFHM" SG_ 1049 EnginePowerUse_DisplayV 0;
BA_ "GenSigTimeoutTime_MPAD" SG_ 1049 EnginePowerUse_DisplayV 0;
BA_ "GenSigTimeoutTime_IPC" SG_ 1049 EnginePowerUse_DisplayV 0;
BA_ "GenSigTimeoutTime_GNMM" SG_ 1049 EnginePowerUse_DisplayV 0;
BA_ "GenSigTimeoutTime_EVCU2" SG_ 1049 EnginePowerUse_DisplayV 0;
BA_ "GenSigTimeoutTime_ESL" SG_ 1049 EnginePowerUse_DisplayV 0;
BA_ "GenSigTimeoutTime_ECM" SG_ 1049 EnginePowerUse_DisplayV 0;
BA_ "GenSigTimeoutTime_DTCM" SG_ 1049 EnginePowerUse_DisplayV 0;
BA_ "GenSigTimeoutTime_DMSM" SG_ 1049 EnginePowerUse_DisplayV 0;
BA_ "GenSigTimeoutTime_BSM" SG_ 1049 EnginePowerUse_DisplayV 0;
BA_ "GenSigTimeoutTime_BCM" SG_ 1049 EnginePowerUse_DisplayV 0;
BA_ "GenSigTimeoutTime_AGSM" SG_ 1049 EnginePowerUse_DisplayV 0;
BA_ "GenSigTimeoutTime_ADCAM" SG_ 1049 EnginePowerUse_DisplayV 0;
BA_ "GenSigTimeoutTime_RFHM" SG_ 1049 FOTA_Schedule_Conflict 0;
BA_ "GenSigTimeoutTime_MPAD" SG_ 1049 FOTA_Schedule_Conflict 0;
BA_ "GenSigTimeoutTime_IPC" SG_ 1049 FOTA_Schedule_Conflict 0;
BA_ "GenSigTimeoutTime_GNMM" SG_ 1049 FOTA_Schedule_Conflict 0;
BA_ "GenSigTimeoutTime_EVCU2" SG_ 1049 FOTA_Schedule_Conflict 0;
BA_ "GenSigTimeoutTime_ESL" SG_ 1049 FOTA_Schedule_Conflict 0;
BA_ "GenSigTimeoutTime_ECM" SG_ 1049 FOTA_Schedule_Conflict 0;
BA_ "GenSigTimeoutTime_DTCM" SG_ 1049 FOTA_Schedule_Conflict 0;
BA_ "GenSigTimeoutTime_DMSM" SG_ 1049 FOTA_Schedule_Conflict 0;
BA_ "GenSigTimeoutTime_BSM" SG_ 1049 FOTA_Schedule_Conflict 0;
BA_ "GenSigTimeoutTime_BCM" SG_ 1049 FOTA_Schedule_Conflict 0;
BA_ "GenSigTimeoutTime_AGSM" SG_ 1049 FOTA_Schedule_Conflict 0;
BA_ "GenSigTimeoutTime_ADCAM" SG_ 1049 FOTA_Schedule_Conflict 0;
BA_ "GenSigTimeoutTime_RFHM" SG_ 1049 HVBatterySOC_Display 0;
BA_ "GenSigTimeoutTime_MPAD" SG_ 1049 HVBatterySOC_Display 0;
BA_ "GenSigTimeoutTime_GNMM" SG_ 1049 HVBatterySOC_Display 0;
BA_ "GenSigTimeoutTime_EVCU2" SG_ 1049 HVBatterySOC_Display 0;
BA_ "GenSigTimeoutTime_ESL" SG_ 1049 HVBatterySOC_Display 0;
BA_ "GenSigTimeoutTime_ECM" SG_ 1049 HVBatterySOC_Display 0;
BA_ "GenSigTimeoutTime_DTCM" SG_ 1049 HVBatterySOC_Display 0;
BA_ "GenSigTimeoutTime_DMSM" SG_ 1049 HVBatterySOC_Display 0;
BA_ "GenSigTimeoutTime_BSM" SG_ 1049 HVBatterySOC_Display 0;
BA_ "GenSigTimeoutTime_AGSM" SG_ 1049 HVBatterySOC_Display 0;
BA_ "GenSigTimeoutTime_ADCAM" SG_ 1049 HVBatterySOC_Display 0;
BA_ "GenSigTimeoutTime_RFHM" SG_ 1049 HCP_EVServiceLampOn 0;
BA_ "GenSigTimeoutTime_MPAD" SG_ 1049 HCP_EVServiceLampOn 0;
BA_ "GenSigTimeoutTime_GNMM" SG_ 1049 HCP_EVServiceLampOn 0;
BA_ "GenSigTimeoutTime_EVCU2" SG_ 1049 HCP_EVServiceLampOn 0;
BA_ "GenSigTimeoutTime_ESL" SG_ 1049 HCP_EVServiceLampOn 0;
BA_ "GenSigTimeoutTime_ECM" SG_ 1049 HCP_EVServiceLampOn 0;
BA_ "GenSigTimeoutTime_DTCM" SG_ 1049 HCP_EVServiceLampOn 0;
BA_ "GenSigTimeoutTime_DMSM" SG_ 1049 HCP_EVServiceLampOn 0;
BA_ "GenSigTimeoutTime_BSM" SG_ 1049 HCP_EVServiceLampOn 0;
BA_ "GenSigTimeoutTime_AGSM" SG_ 1049 HCP_EVServiceLampOn 0;
BA_ "GenSigTimeoutTime_ADCAM" SG_ 1049 HCP_EVServiceLampOn 0;
BA_ "GenSigTimeoutTime_RFHM" SG_ 1049 ChargeSystemFault_DPT 0;
BA_ "GenSigTimeoutTime_MPAD" SG_ 1049 ChargeSystemFault_DPT 0;
BA_ "GenSigTimeoutTime_GNMM" SG_ 1049 ChargeSystemFault_DPT 0;
BA_ "GenSigTimeoutTime_EVCU2" SG_ 1049 ChargeSystemFault_DPT 0;
BA_ "GenSigTimeoutTime_ESL" SG_ 1049 ChargeSystemFault_DPT 0;
BA_ "GenSigTimeoutTime_ECM" SG_ 1049 ChargeSystemFault_DPT 0;
BA_ "GenSigTimeoutTime_DTCM" SG_ 1049 ChargeSystemFault_DPT 0;
BA_ "GenSigTimeoutTime_DMSM" SG_ 1049 ChargeSystemFault_DPT 0;
BA_ "GenSigTimeoutTime_BSM" SG_ 1049 ChargeSystemFault_DPT 0;
BA_ "GenSigTimeoutTime_BCM" SG_ 1049 ChargeSystemFault_DPT 0;
BA_ "GenSigTimeoutTime_AGSM" SG_ 1049 ChargeSystemFault_DPT 0;
BA_ "GenSigTimeoutTime_ADCAM" SG_ 1049 ChargeSystemFault_DPT 0;
BA_ "GenSigTimeoutTime_RFHM" SG_ 1049 ChargeSystemSts_DPT 0;
BA_ "GenSigTimeoutTime_MPAD" SG_ 1049 ChargeSystemSts_DPT 0;
BA_ "GenSigTimeoutTime_GNMM" SG_ 1049 ChargeSystemSts_DPT 0;
BA_ "GenSigTimeoutTime_EVCU2" SG_ 1049 ChargeSystemSts_DPT 0;
BA_ "GenSigTimeoutTime_ESL" SG_ 1049 ChargeSystemSts_DPT 0;
BA_ "GenSigTimeoutTime_ECM" SG_ 1049 ChargeSystemSts_DPT 0;
BA_ "GenSigTimeoutTime_DTCM" SG_ 1049 ChargeSystemSts_DPT 0;
BA_ "GenSigTimeoutTime_DMSM" SG_ 1049 ChargeSystemSts_DPT 0;
BA_ "GenSigTimeoutTime_BSM" SG_ 1049 ChargeSystemSts_DPT 0;
BA_ "GenSigTimeoutTime_BCM" SG_ 1049 ChargeSystemSts_DPT 0;
BA_ "GenSigTimeoutTime_AGSM" SG_ 1049 ChargeSystemSts_DPT 0;
BA_ "GenSigTimeoutTime_ADCAM" SG_ 1049 ChargeSystemSts_DPT 0;
BA_ "GenSigSendType" SG_ 1049 ChargeSystemSts_DPT 3;
BA_ "GenSigTimeoutTime_RFHM" SG_ 1049 ChargingLevelForDisplay 0;
BA_ "GenSigTimeoutTime_MPAD" SG_ 1049 ChargingLevelForDisplay 0;
BA_ "GenSigTimeoutTime_GNMM" SG_ 1049 ChargingLevelForDisplay 0;
BA_ "GenSigTimeoutTime_EVCU2" SG_ 1049 ChargingLevelForDisplay 0;
BA_ "GenSigTimeoutTime_ESL" SG_ 1049 ChargingLevelForDisplay 0;
BA_ "GenSigTimeoutTime_ECM" SG_ 1049 ChargingLevelForDisplay 0;
BA_ "GenSigTimeoutTime_DTCM" SG_ 1049 ChargingLevelForDisplay 0;
BA_ "GenSigTimeoutTime_DMSM" SG_ 1049 ChargingLevelForDisplay 0;
BA_ "GenSigTimeoutTime_BSM" SG_ 1049 ChargingLevelForDisplay 0;
BA_ "GenSigTimeoutTime_BCM" SG_ 1049 ChargingLevelForDisplay 0;
BA_ "GenSigTimeoutTime_AGSM" SG_ 1049 ChargingLevelForDisplay 0;
BA_ "GenSigTimeoutTime_ADCAM" SG_ 1049 ChargingLevelForDisplay 0;
BA_ "GenSigTimeoutTime_RFHM" SG_ 1049 EnginePowerUse_Display 0;
BA_ "GenSigTimeoutTime_MPAD" SG_ 1049 EnginePowerUse_Display 0;
BA_ "GenSigTimeoutTime_IPC" SG_ 1049 EnginePowerUse_Display 0;
BA_ "GenSigTimeoutTime_GNMM" SG_ 1049 EnginePowerUse_Display 0;
BA_ "GenSigTimeoutTime_EVCU2" SG_ 1049 EnginePowerUse_Display 0;
BA_ "GenSigTimeoutTime_ESL" SG_ 1049 EnginePowerUse_Display 0;
BA_ "GenSigTimeoutTime_ECM" SG_ 1049 EnginePowerUse_Display 0;
BA_ "GenSigTimeoutTime_DTCM" SG_ 1049 EnginePowerUse_Display 0;
BA_ "GenSigTimeoutTime_DMSM" SG_ 1049 EnginePowerUse_Display 0;
BA_ "GenSigTimeoutTime_BSM" SG_ 1049 EnginePowerUse_Display 0;
BA_ "GenSigTimeoutTime_BCM" SG_ 1049 EnginePowerUse_Display 0;
BA_ "GenSigTimeoutTime_AGSM" SG_ 1049 EnginePowerUse_Display 0;
BA_ "GenSigTimeoutTime_ADCAM" SG_ 1049 EnginePowerUse_Display 0;
BA_ "GenSigTimeoutTime_RFHM" SG_ 1049 HVACPowerUse_Display 0;
BA_ "GenSigTimeoutTime_MPAD" SG_ 1049 HVACPowerUse_Display 0;
BA_ "GenSigTimeoutTime_IPC" SG_ 1049 HVACPowerUse_Display 0;
BA_ "GenSigTimeoutTime_GNMM" SG_ 1049 HVACPowerUse_Display 0;
BA_ "GenSigTimeoutTime_EVCU2" SG_ 1049 HVACPowerUse_Display 0;
BA_ "GenSigTimeoutTime_ESL" SG_ 1049 HVACPowerUse_Display 0;
BA_ "GenSigTimeoutTime_ECM" SG_ 1049 HVACPowerUse_Display 0;
BA_ "GenSigTimeoutTime_DTCM" SG_ 1049 HVACPowerUse_Display 0;
BA_ "GenSigTimeoutTime_DMSM" SG_ 1049 HVACPowerUse_Display 0;
BA_ "GenSigTimeoutTime_BSM" SG_ 1049 HVACPowerUse_Display 0;
BA_ "GenSigTimeoutTime_BCM" SG_ 1049 HVACPowerUse_Display 0;
BA_ "GenSigTimeoutTime_AGSM" SG_ 1049 HVACPowerUse_Display 0;
BA_ "GenSigTimeoutTime_ADCAM" SG_ 1049 HVACPowerUse_Display 0;
BA_ "GenSigTimeoutTime_RFHM" SG_ 1036 CRC_ENGINE3 0;
BA_ "GenSigTimeoutTime_MPAD" SG_ 1036 CRC_ENGINE3 0;
BA_ "GenSigTimeoutTime_IPC" SG_ 1036 CRC_ENGINE3 0;
BA_ "GenSigTimeoutTime_GNMM" SG_ 1036 CRC_ENGINE3 0;
BA_ "GenSigTimeoutTime_EVCU2" SG_ 1036 CRC_ENGINE3 0;
BA_ "GenSigTimeoutTime_ESL" SG_ 1036 CRC_ENGINE3 0;
BA_ "GenSigTimeoutTime_ECM" SG_ 1036 CRC_ENGINE3 0;
BA_ "GenSigTimeoutTime_DTCM" SG_ 1036 CRC_ENGINE3 0;
BA_ "GenSigTimeoutTime_DMSM" SG_ 1036 CRC_ENGINE3 0;
BA_ "GenSigTimeoutTime_BSM" SG_ 1036 CRC_ENGINE3 0;
BA_ "GenSigTimeoutTime_BCM" SG_ 1036 CRC_ENGINE3 0;
BA_ "GenSigTimeoutTime_AGSM" SG_ 1036 CRC_ENGINE3 0;
BA_ "GenSigTimeoutTime_ADCAM" SG_ 1036 CRC_ENGINE3 0;
BA_ "GenSigTimeoutTime_SGW" SG_ 2564440306 N_PDU 0;
BA_ "GenSigTimeoutTime_RFHM" SG_ 2564440306 N_PDU 0;
BA_ "GenSigTimeoutTime_MPAD" SG_ 2564440306 N_PDU 0;
BA_ "GenSigTimeoutTime_IPC" SG_ 2564440306 N_PDU 0;
BA_ "GenSigTimeoutTime_GNMM" SG_ 2564440306 N_PDU 0;
BA_ "GenSigTimeoutTime_EVCU2" SG_ 2564440306 N_PDU 0;
BA_ "GenSigTimeoutTime_ESL" SG_ 2564440306 N_PDU 0;
BA_ "GenSigTimeoutTime_ECM" SG_ 2564440306 N_PDU 0;
BA_ "GenSigTimeoutTime_DTCM" SG_ 2564440306 N_PDU 0;
BA_ "GenSigTimeoutTime_DMSM" SG_ 2564440306 N_PDU 0;
BA_ "GenSigTimeoutTime_BSM" SG_ 2564440306 N_PDU 0;
BA_ "GenSigTimeoutTime_BCM" SG_ 2564440306 N_PDU 0;
BA_ "GenSigTimeoutTime_AGSM" SG_ 2564440306 N_PDU 0;
BA_ "GenSigTimeoutTime_ADCAM" SG_ 2564440306 N_PDU 0;
BA_ "GenSigTimeoutTime_SGW" SG_ 950 SPMControlSts 0;
BA_ "GenSigTimeoutTime_RFHM" SG_ 950 SPMControlSts 0;
BA_ "GenSigTimeoutTime_MPAD" SG_ 950 SPMControlSts 0;
BA_ "GenSigTimeoutTime_GNMM" SG_ 950 SPMControlSts 0;
BA_ "GenSigTimeoutTime_EVCU2" SG_ 950 SPMControlSts 0;
BA_ "GenSigTimeoutTime_ESL" SG_ 950 SPMControlSts 0;
BA_ "GenSigTimeoutTime_ECM" SG_ 950 SPMControlSts 0;
BA_ "GenSigTimeoutTime_DTCM" SG_ 950 SPMControlSts 0;
BA_ "GenSigTimeoutTime_DMSM" SG_ 950 SPMControlSts 0;
BA_ "GenSigTimeoutTime_BSM" SG_ 950 SPMControlSts 0;
BA_ "GenSigTimeoutTime_BCM" SG_ 950 SPMControlSts 0;
BA_ "GenSigTimeoutTime_AGSM" SG_ 950 SPMControlSts 0;
BA_ "GenSigTimeoutTime_ADCAM" SG_ 950 SPMControlSts 0;
BA_ "GenSigSendType" SG_ 950 SPMControlSts 3;
BA_ "GenSigTimeoutTime_SGW" SG_ 950 SDWSts 0;
BA_ "GenSigTimeoutTime_RFHM" SG_ 950 SDWSts 0;
BA_ "GenSigTimeoutTime_MPAD" SG_ 950 SDWSts 0;
BA_ "GenSigTimeoutTime_GNMM" SG_ 950 SDWSts 0;
BA_ "GenSigTimeoutTime_EVCU2" SG_ 950 SDWSts 0;
BA_ "GenSigTimeoutTime_ESL" SG_ 950 SDWSts 0;
BA_ "GenSigTimeoutTime_ECM" SG_ 950 SDWSts 0;
BA_ "GenSigTimeoutTime_DTCM" SG_ 950 SDWSts 0;
BA_ "GenSigTimeoutTime_DMSM" SG_ 950 SDWSts 0;
BA_ "GenSigTimeoutTime_BSM" SG_ 950 SDWSts 0;
BA_ "GenSigTimeoutTime_BCM" SG_ 950 SDWSts 0;
BA_ "GenSigTimeoutTime_AGSM" SG_ 950 SDWSts 0;
BA_ "GenSigTimeoutTime_ADCAM" SG_ 950 SDWSts 0;
BA_ "GenSigSendType" SG_ 950 SDWSts 3;
BA_ "GenSigTimeoutTime_SGW" SG_ 950 SDWFailSts 0;
BA_ "GenSigTimeoutTime_RFHM" SG_ 950 SDWFailSts 0;
BA_ "GenSigTimeoutTime_MPAD" SG_ 950 SDWFailSts 0;
BA_ "GenSigTimeoutTime_GNMM" SG_ 950 SDWFailSts 0;
BA_ "GenSigTimeoutTime_EVCU2" SG_ 950 SDWFailSts 0;
BA_ "GenSigTimeoutTime_ESL" SG_ 950 SDWFailSts 0;
BA_ "GenSigTimeoutTime_ECM" SG_ 950 SDWFailSts 0;
BA_ "GenSigTimeoutTime_DTCM" SG_ 950 SDWFailSts 0;
BA_ "GenSigTimeoutTime_DMSM" SG_ 950 SDWFailSts 0;
BA_ "GenSigTimeoutTime_BSM" SG_ 950 SDWFailSts 0;
BA_ "GenSigTimeoutTime_BCM" SG_ 950 SDWFailSts 0;
BA_ "GenSigTimeoutTime_AGSM" SG_ 950 SDWFailSts 0;
BA_ "GenSigTimeoutTime_ADCAM" SG_ 950 SDWFailSts 0;
BA_ "GenSigSendType" SG_ 950 SDWFailSts 3;
BA_ "GenSigTimeoutTime_SGW" SG_ 950 SDW_Warning_Right_2 0;
BA_ "GenSigTimeoutTime_RFHM" SG_ 950 SDW_Warning_Right_2 0;
BA_ "GenSigTimeoutTime_MPAD" SG_ 950 SDW_Warning_Right_2 0;
BA_ "GenSigTimeoutTime_GNMM" SG_ 950 SDW_Warning_Right_2 0;
BA_ "GenSigTimeoutTime_EVCU2" SG_ 950 SDW_Warning_Right_2 0;
BA_ "GenSigTimeoutTime_ESL" SG_ 950 SDW_Warning_Right_2 0;
BA_ "GenSigTimeoutTime_ECM" SG_ 950 SDW_Warning_Right_2 0;
BA_ "GenSigTimeoutTime_DTCM" SG_ 950 SDW_Warning_Right_2 0;
BA_ "GenSigTimeoutTime_DMSM" SG_ 950 SDW_Warning_Right_2 0;
BA_ "GenSigTimeoutTime_BSM" SG_ 950 SDW_Warning_Right_2 0;
BA_ "GenSigTimeoutTime_BCM" SG_ 950 SDW_Warning_Right_2 0;
BA_ "GenSigTimeoutTime_AGSM" SG_ 950 SDW_Warning_Right_2 0;
BA_ "GenSigTimeoutTime_ADCAM" SG_ 950 SDW_Warning_Right_2 0;
BA_ "GenSigSendType" SG_ 950 SDW_Warning_Right_2 3;
BA_ "GenSigTimeoutTime_SGW" SG_ 950 SDW_Warning_Right_1 0;
BA_ "GenSigTimeoutTime_RFHM" SG_ 950 SDW_Warning_Right_1 0;
BA_ "GenSigTimeoutTime_MPAD" SG_ 950 SDW_Warning_Right_1 0;
BA_ "GenSigTimeoutTime_GNMM" SG_ 950 SDW_Warning_Right_1 0;
BA_ "GenSigTimeoutTime_EVCU2" SG_ 950 SDW_Warning_Right_1 0;
BA_ "GenSigTimeoutTime_ESL" SG_ 950 SDW_Warning_Right_1 0;
BA_ "GenSigTimeoutTime_ECM" SG_ 950 SDW_Warning_Right_1 0;
BA_ "GenSigTimeoutTime_DTCM" SG_ 950 SDW_Warning_Right_1 0;
BA_ "GenSigTimeoutTime_DMSM" SG_ 950 SDW_Warning_Right_1 0;
BA_ "GenSigTimeoutTime_BSM" SG_ 950 SDW_Warning_Right_1 0;
BA_ "GenSigTimeoutTime_BCM" SG_ 950 SDW_Warning_Right_1 0;
BA_ "GenSigTimeoutTime_AGSM" SG_ 950 SDW_Warning_Right_1 0;
BA_ "GenSigTimeoutTime_ADCAM" SG_ 950 SDW_Warning_Right_1 0;
BA_ "GenSigSendType" SG_ 950 SDW_Warning_Right_1 3;
BA_ "GenSigTimeoutTime_SGW" SG_ 950 SDW_Warning_Left_2 0;
BA_ "GenSigTimeoutTime_RFHM" SG_ 950 SDW_Warning_Left_2 0;
BA_ "GenSigTimeoutTime_MPAD" SG_ 950 SDW_Warning_Left_2 0;
BA_ "GenSigTimeoutTime_GNMM" SG_ 950 SDW_Warning_Left_2 0;
BA_ "GenSigTimeoutTime_EVCU2" SG_ 950 SDW_Warning_Left_2 0;
BA_ "GenSigTimeoutTime_ESL" SG_ 950 SDW_Warning_Left_2 0;
BA_ "GenSigTimeoutTime_ECM" SG_ 950 SDW_Warning_Left_2 0;
BA_ "GenSigTimeoutTime_DTCM" SG_ 950 SDW_Warning_Left_2 0;
BA_ "GenSigTimeoutTime_DMSM" SG_ 950 SDW_Warning_Left_2 0;
BA_ "GenSigTimeoutTime_BSM" SG_ 950 SDW_Warning_Left_2 0;
BA_ "GenSigTimeoutTime_BCM" SG_ 950 SDW_Warning_Left_2 0;
BA_ "GenSigTimeoutTime_AGSM" SG_ 950 SDW_Warning_Left_2 0;
BA_ "GenSigTimeoutTime_ADCAM" SG_ 950 SDW_Warning_Left_2 0;
BA_ "GenSigSendType" SG_ 950 SDW_Warning_Left_2 3;
BA_ "GenSigTimeoutTime_SGW" SG_ 950 RearSensorSts 0;
BA_ "GenSigTimeoutTime_RFHM" SG_ 950 RearSensorSts 0;
BA_ "GenSigTimeoutTime_MPAD" SG_ 950 RearSensorSts 0;
BA_ "GenSigTimeoutTime_GNMM" SG_ 950 RearSensorSts 0;
BA_ "GenSigTimeoutTime_EVCU2" SG_ 950 RearSensorSts 0;
BA_ "GenSigTimeoutTime_ESL" SG_ 950 RearSensorSts 0;
BA_ "GenSigTimeoutTime_ECM" SG_ 950 RearSensorSts 0;
BA_ "GenSigTimeoutTime_DTCM" SG_ 950 RearSensorSts 0;
BA_ "GenSigTimeoutTime_DMSM" SG_ 950 RearSensorSts 0;
BA_ "GenSigTimeoutTime_BSM" SG_ 950 RearSensorSts 0;
BA_ "GenSigTimeoutTime_BCM" SG_ 950 RearSensorSts 0;
BA_ "GenSigTimeoutTime_AGSM" SG_ 950 RearSensorSts 0;
BA_ "GenSigTimeoutTime_ADCAM" SG_ 950 RearSensorSts 0;
BA_ "GenSigSendType" SG_ 950 RearSensorSts 3;
BA_ "GenSigTimeoutTime_SGW" SG_ 950 PAMSystemFault 0;
BA_ "GenSigTimeoutTime_RFHM" SG_ 950 PAMSystemFault 0;
BA_ "GenSigTimeoutTime_MPAD" SG_ 950 PAMSystemFault 0;
BA_ "GenSigTimeoutTime_GNMM" SG_ 950 PAMSystemFault 0;
BA_ "GenSigTimeoutTime_EVCU2" SG_ 950 PAMSystemFault 0;
BA_ "GenSigTimeoutTime_ESL" SG_ 950 PAMSystemFault 0;
BA_ "GenSigTimeoutTime_SGW" SG_ 950 SDW_Warning_Left_1 0;
BA_ "GenSigTimeoutTime_RFHM" SG_ 950 SDW_Warning_Left_1 0;
BA_ "GenSigTimeoutTime_MPAD" SG_ 950 SDW_Warning_Left_1 0;
BA_ "GenSigTimeoutTime_GNMM" SG_ 950 SDW_Warning_Left_1 0;
BA_ "GenSigTimeoutTime_EVCU2" SG_ 950 SDW_Warning_Left_1 0;
BA_ "GenSigTimeoutTime_ESL" SG_ 950 SDW_Warning_Left_1 0;
BA_ "GenSigTimeoutTime_ECM" SG_ 950 SDW_Warning_Left_1 0;
BA_ "GenSigTimeoutTime_DTCM" SG_ 950 SDW_Warning_Left_1 0;
BA_ "GenSigTimeoutTime_DMSM" SG_ 950 SDW_Warning_Left_1 0;
BA_ "GenSigTimeoutTime_BSM" SG_ 950 SDW_Warning_Left_1 0;
BA_ "GenSigTimeoutTime_BCM" SG_ 950 SDW_Warning_Left_1 0;
BA_ "GenSigTimeoutTime_AGSM" SG_ 950 SDW_Warning_Left_1 0;
BA_ "GenSigTimeoutTime_ADCAM" SG_ 950 SDW_Warning_Left_1 0;
BA_ "GenSigSendType" SG_ 950 SDW_Warning_Left_1 3;
BA_ "GenSigTimeoutTime_SGW" SG_ 950 PAM_PopUpRqst 0;
BA_ "GenSigTimeoutTime_RFHM" SG_ 950 PAM_PopUpRqst 0;
BA_ "GenSigTimeoutTime_MPAD" SG_ 950 PAM_PopUpRqst 0;
BA_ "GenSigTimeoutTime_GNMM" SG_ 950 PAM_PopUpRqst 0;
BA_ "GenSigTimeoutTime_EVCU2" SG_ 950 PAM_PopUpRqst 0;
BA_ "GenSigTimeoutTime_ESL" SG_ 950 PAM_PopUpRqst 0;
BA_ "GenSigTimeoutTime_ECM" SG_ 950 PAM_PopUpRqst 0;
BA_ "GenSigTimeoutTime_DTCM" SG_ 950 PAM_PopUpRqst 0;
BA_ "GenSigTimeoutTime_DMSM" SG_ 950 PAM_PopUpRqst 0;
BA_ "GenSigTimeoutTime_BSM" SG_ 950 PAM_PopUpRqst 0;
BA_ "GenSigTimeoutTime_BCM" SG_ 950 PAM_PopUpRqst 0;
BA_ "GenSigTimeoutTime_AGSM" SG_ 950 PAM_PopUpRqst 0;
BA_ "GenSigTimeoutTime_ADCAM" SG_ 950 PAM_PopUpRqst 0;
BA_ "GenSigSendType" SG_ 950 PAM_PopUpRqst 3;
BA_ "GenSigTimeoutTime_ECM" SG_ 950 PAMSystemFault 0;
BA_ "GenSigTimeoutTime_DTCM" SG_ 950 PAMSystemFault 0;
BA_ "GenSigTimeoutTime_DMSM" SG_ 950 PAMSystemFault 0;
BA_ "GenSigTimeoutTime_BSM" SG_ 950 PAMSystemFault 0;
BA_ "GenSigTimeoutTime_BCM" SG_ 950 PAMSystemFault 0;
BA_ "GenSigTimeoutTime_AGSM" SG_ 950 PAMSystemFault 0;
BA_ "GenSigTimeoutTime_ADCAM" SG_ 950 PAMSystemFault 0;
BA_ "GenSigSendType" SG_ 950 PAMSystemFault 3;
BA_ "GenSigTimeoutTime_SGW" SG_ 950 PAM_Off_Status 0;
BA_ "GenSigTimeoutTime_RFHM" SG_ 950 PAM_Off_Status 0;
BA_ "GenSigTimeoutTime_MPAD" SG_ 950 PAM_Off_Status 0;
BA_ "GenSigTimeoutTime_GNMM" SG_ 950 PAM_Off_Status 0;
BA_ "GenSigTimeoutTime_EVCU2" SG_ 950 PAM_Off_Status 0;
BA_ "GenSigTimeoutTime_ESL" SG_ 950 PAM_Off_Status 0;
BA_ "GenSigTimeoutTime_ECM" SG_ 950 PAM_Off_Status 0;
BA_ "GenSigTimeoutTime_DTCM" SG_ 950 PAM_Off_Status 0;
BA_ "GenSigTimeoutTime_DMSM" SG_ 950 PAM_Off_Status 0;
BA_ "GenSigTimeoutTime_BSM" SG_ 950 PAM_Off_Status 0;
BA_ "GenSigTimeoutTime_BCM" SG_ 950 PAM_Off_Status 0;
BA_ "GenSigTimeoutTime_AGSM" SG_ 950 PAM_Off_Status 0;
BA_ "GenSigTimeoutTime_ADCAM" SG_ 950 PAM_Off_Status 0;
BA_ "GenSigSendType" SG_ 950 PAM_Off_Status 3;
BA_ "GenSigTimeoutTime_SGW" SG_ 950 PAM_LedControlSts 0;
BA_ "GenSigTimeoutTime_RFHM" SG_ 950 PAM_LedControlSts 0;
BA_ "GenSigTimeoutTime_MPAD" SG_ 950 PAM_LedControlSts 0;
BA_ "GenSigTimeoutTime_GNMM" SG_ 950 PAM_LedControlSts 0;
BA_ "GenSigTimeoutTime_EVCU2" SG_ 950 PAM_LedControlSts 0;
BA_ "GenSigTimeoutTime_ESL" SG_ 950 PAM_LedControlSts 0;
BA_ "GenSigTimeoutTime_ECM" SG_ 950 PAM_LedControlSts 0;
BA_ "GenSigTimeoutTime_DTCM" SG_ 950 PAM_LedControlSts 0;
BA_ "GenSigTimeoutTime_DMSM" SG_ 950 PAM_LedControlSts 0;
BA_ "GenSigTimeoutTime_BSM" SG_ 950 PAM_LedControlSts 0;
BA_ "GenSigTimeoutTime_BCM" SG_ 950 PAM_LedControlSts 0;
BA_ "GenSigTimeoutTime_AGSM" SG_ 950 PAM_LedControlSts 0;
BA_ "GenSigTimeoutTime_ADCAM" SG_ 950 PAM_LedControlSts 0;
BA_ "GenSigSendType" SG_ 950 PAM_LedControlSts 3;
BA_ "GenSigTimeoutTime_SGW" SG_ 950 HMICode 0;
BA_ "GenSigTimeoutTime_RFHM" SG_ 950 HMICode 0;
BA_ "GenSigTimeoutTime_MPAD" SG_ 950 HMICode 0;
BA_ "GenSigTimeoutTime_GNMM" SG_ 950 HMICode 0;
BA_ "GenSigTimeoutTime_EVCU2" SG_ 950 HMICode 0;
BA_ "GenSigTimeoutTime_ESL" SG_ 950 HMICode 0;
BA_ "GenSigTimeoutTime_ECM" SG_ 950 HMICode 0;
BA_ "GenSigTimeoutTime_DTCM" SG_ 950 HMICode 0;
BA_ "GenSigTimeoutTime_DMSM" SG_ 950 HMICode 0;
BA_ "GenSigTimeoutTime_BSM" SG_ 950 HMICode 0;
BA_ "GenSigTimeoutTime_BCM" SG_ 950 HMICode 0;
BA_ "GenSigTimeoutTime_AGSM" SG_ 950 HMICode 0;
BA_ "GenSigTimeoutTime_ADCAM" SG_ 950 HMICode 0;
BA_ "GenSigSendType" SG_ 950 HMICode 3;
BA_ "GenSigTimeoutTime_SGW" SG_ 950 Graphic_RHR 0;
BA_ "GenSigTimeoutTime_RFHM" SG_ 950 Graphic_RHR 0;
BA_ "GenSigTimeoutTime_MPAD" SG_ 950 Graphic_RHR 0;
BA_ "GenSigTimeoutTime_GNMM" SG_ 950 Graphic_RHR 0;
BA_ "GenSigTimeoutTime_EVCU2" SG_ 950 Graphic_RHR 0;
BA_ "GenSigTimeoutTime_ESL" SG_ 950 Graphic_RHR 0;
BA_ "GenSigTimeoutTime_ECM" SG_ 950 Graphic_RHR 0;
BA_ "GenSigTimeoutTime_DTCM" SG_ 950 Graphic_RHR 0;
BA_ "GenSigTimeoutTime_DMSM" SG_ 950 Graphic_RHR 0;
BA_ "GenSigTimeoutTime_BSM" SG_ 950 Graphic_RHR 0;
BA_ "GenSigTimeoutTime_BCM" SG_ 950 Graphic_RHR 0;
BA_ "GenSigTimeoutTime_AGSM" SG_ 950 Graphic_RHR 0;
BA_ "GenSigTimeoutTime_ADCAM" SG_ 950 Graphic_RHR 0;
BA_ "GenSigSendType" SG_ 950 Graphic_RHR 3;
BA_ "GenSigTimeoutTime_SGW" SG_ 950 Graphic_RHF 0;
BA_ "GenSigTimeoutTime_RFHM" SG_ 950 Graphic_RHF 0;
BA_ "GenSigTimeoutTime_MPAD" SG_ 950 Graphic_RHF 0;
BA_ "GenSigTimeoutTime_GNMM" SG_ 950 Graphic_RHF 0;
BA_ "GenSigTimeoutTime_EVCU2" SG_ 950 Graphic_RHF 0;
BA_ "GenSigTimeoutTime_ESL" SG_ 950 Graphic_RHF 0;
BA_ "GenSigTimeoutTime_ECM" SG_ 950 Graphic_RHF 0;
BA_ "GenSigTimeoutTime_DTCM" SG_ 950 Graphic_RHF 0;
BA_ "GenSigTimeoutTime_DMSM" SG_ 950 Graphic_RHF 0;
BA_ "GenSigTimeoutTime_BSM" SG_ 950 Graphic_RHF 0;
BA_ "GenSigTimeoutTime_BCM" SG_ 950 Graphic_RHF 0;
BA_ "GenSigTimeoutTime_AGSM" SG_ 950 Graphic_RHF 0;
BA_ "GenSigTimeoutTime_ADCAM" SG_ 950 Graphic_RHF 0;
BA_ "GenSigSendType" SG_ 950 Graphic_RHF 3;
BA_ "GenSigTimeoutTime_SGW" SG_ 950 Graphic_LHR 0;
BA_ "GenSigTimeoutTime_RFHM" SG_ 950 Graphic_LHR 0;
BA_ "GenSigTimeoutTime_MPAD" SG_ 950 Graphic_LHR 0;
BA_ "GenSigTimeoutTime_GNMM" SG_ 950 Graphic_LHR 0;
BA_ "GenSigTimeoutTime_EVCU2" SG_ 950 Graphic_LHR 0;
BA_ "GenSigTimeoutTime_ESL" SG_ 950 Graphic_LHR 0;
BA_ "GenSigTimeoutTime_ECM" SG_ 950 Graphic_LHR 0;
BA_ "GenSigTimeoutTime_DTCM" SG_ 950 Graphic_LHR 0;
BA_ "GenSigTimeoutTime_DMSM" SG_ 950 Graphic_LHR 0;
BA_ "GenSigTimeoutTime_BSM" SG_ 950 Graphic_LHR 0;
BA_ "GenSigTimeoutTime_BCM" SG_ 950 Graphic_LHR 0;
BA_ "GenSigTimeoutTime_AGSM" SG_ 950 Graphic_LHR 0;
BA_ "GenSigTimeoutTime_ADCAM" SG_ 950 Graphic_LHR 0;
BA_ "GenSigSendType" SG_ 950 Graphic_LHR 3;
BA_ "GenSigTimeoutTime_SGW" SG_ 950 Graphic_LHF 0;
BA_ "GenSigTimeoutTime_RFHM" SG_ 950 Graphic_LHF 0;
BA_ "GenSigTimeoutTime_MPAD" SG_ 950 Graphic_LHF 0;
BA_ "GenSigTimeoutTime_GNMM" SG_ 950 Graphic_LHF 0;
BA_ "GenSigTimeoutTime_EVCU2" SG_ 950 Graphic_LHF 0;
BA_ "GenSigTimeoutTime_ESL" SG_ 950 Graphic_LHF 0;
BA_ "GenSigTimeoutTime_ECM" SG_ 950 Graphic_LHF 0;
BA_ "GenSigTimeoutTime_DTCM" SG_ 950 Graphic_LHF 0;
BA_ "GenSigTimeoutTime_DMSM" SG_ 950 Graphic_LHF 0;
BA_ "GenSigTimeoutTime_BSM" SG_ 950 Graphic_LHF 0;
BA_ "GenSigTimeoutTime_BCM" SG_ 950 Graphic_LHF 0;
BA_ "GenSigTimeoutTime_AGSM" SG_ 950 Graphic_LHF 0;
BA_ "GenSigTimeoutTime_ADCAM" SG_ 950 Graphic_LHF 0;
BA_ "GenSigSendType" SG_ 950 Graphic_LHF 3;
BA_ "GenSigTimeoutTime_SGW" SG_ 950 Graphic_CHR 0;
BA_ "GenSigTimeoutTime_RFHM" SG_ 950 Graphic_CHR 0;
BA_ "GenSigTimeoutTime_MPAD" SG_ 950 Graphic_CHR 0;
BA_ "GenSigTimeoutTime_GNMM" SG_ 950 Graphic_CHR 0;
BA_ "GenSigTimeoutTime_EVCU2" SG_ 950 Graphic_CHR 0;
BA_ "GenSigTimeoutTime_ESL" SG_ 950 Graphic_CHR 0;
BA_ "GenSigTimeoutTime_ECM" SG_ 950 Graphic_CHR 0;
BA_ "GenSigTimeoutTime_DTCM" SG_ 950 Graphic_CHR 0;
BA_ "GenSigTimeoutTime_DMSM" SG_ 950 Graphic_CHR 0;
BA_ "GenSigTimeoutTime_BSM" SG_ 950 Graphic_CHR 0;
BA_ "GenSigTimeoutTime_BCM" SG_ 950 Graphic_CHR 0;
BA_ "GenSigTimeoutTime_AGSM" SG_ 950 Graphic_CHR 0;
BA_ "GenSigTimeoutTime_ADCAM" SG_ 950 Graphic_CHR 0;
BA_ "GenSigSendType" SG_ 950 Graphic_CHR 3;
BA_ "GenSigTimeoutTime_SGW" SG_ 950 Graphic_CHF 0;
BA_ "GenSigTimeoutTime_RFHM" SG_ 950 Graphic_CHF 0;
BA_ "GenSigTimeoutTime_MPAD" SG_ 950 Graphic_CHF 0;
BA_ "GenSigTimeoutTime_GNMM" SG_ 950 Graphic_CHF 0;
BA_ "GenSigTimeoutTime_EVCU2" SG_ 950 Graphic_CHF 0;
BA_ "GenSigTimeoutTime_ESL" SG_ 950 Graphic_CHF 0;
BA_ "GenSigTimeoutTime_ECM" SG_ 950 Graphic_CHF 0;
BA_ "GenSigTimeoutTime_DTCM" SG_ 950 Graphic_CHF 0;
BA_ "GenSigTimeoutTime_DMSM" SG_ 950 Graphic_CHF 0;
BA_ "GenSigTimeoutTime_BSM" SG_ 950 Graphic_CHF 0;
BA_ "GenSigTimeoutTime_BCM" SG_ 950 Graphic_CHF 0;
BA_ "GenSigTimeoutTime_AGSM" SG_ 950 Graphic_CHF 0;
BA_ "GenSigTimeoutTime_ADCAM" SG_ 950 Graphic_CHF 0;
BA_ "GenSigSendType" SG_ 950 Graphic_CHF 3;
BA_ "GenSigTimeoutTime_SGW" SG_ 950 FrontSensorSts 0;
BA_ "GenSigTimeoutTime_RFHM" SG_ 950 FrontSensorSts 0;
BA_ "GenSigTimeoutTime_MPAD" SG_ 950 FrontSensorSts 0;
BA_ "GenSigTimeoutTime_GNMM" SG_ 950 FrontSensorSts 0;
BA_ "GenSigTimeoutTime_EVCU2" SG_ 950 FrontSensorSts 0;
BA_ "GenSigTimeoutTime_ESL" SG_ 950 FrontSensorSts 0;
BA_ "GenSigTimeoutTime_ECM" SG_ 950 FrontSensorSts 0;
BA_ "GenSigTimeoutTime_DTCM" SG_ 950 FrontSensorSts 0;
BA_ "GenSigTimeoutTime_DMSM" SG_ 950 FrontSensorSts 0;
BA_ "GenSigTimeoutTime_BSM" SG_ 950 FrontSensorSts 0;
BA_ "GenSigTimeoutTime_BCM" SG_ 950 FrontSensorSts 0;
BA_ "GenSigTimeoutTime_AGSM" SG_ 950 FrontSensorSts 0;
BA_ "GenSigTimeoutTime_ADCAM" SG_ 950 FrontSensorSts 0;
BA_ "GenSigSendType" SG_ 950 FrontSensorSts 3;
BA_ "GenSigTimeoutTime_SGW" SG_ 950 Alert_RHR 0;
BA_ "GenSigTimeoutTime_RFHM" SG_ 950 Alert_RHR 0;
BA_ "GenSigTimeoutTime_MPAD" SG_ 950 Alert_RHR 0;
BA_ "GenSigTimeoutTime_GNMM" SG_ 950 Alert_RHR 0;
BA_ "GenSigTimeoutTime_EVCU2" SG_ 950 Alert_RHR 0;
BA_ "GenSigTimeoutTime_ESL" SG_ 950 Alert_RHR 0;
BA_ "GenSigTimeoutTime_ECM" SG_ 950 Alert_RHR 0;
BA_ "GenSigTimeoutTime_DTCM" SG_ 950 Alert_RHR 0;
BA_ "GenSigTimeoutTime_DMSM" SG_ 950 Alert_RHR 0;
BA_ "GenSigTimeoutTime_BSM" SG_ 950 Alert_RHR 0;
BA_ "GenSigTimeoutTime_BCM" SG_ 950 Alert_RHR 0;
BA_ "GenSigTimeoutTime_AGSM" SG_ 950 Alert_RHR 0;
BA_ "GenSigTimeoutTime_ADCAM" SG_ 950 Alert_RHR 0;
BA_ "GenSigSendType" SG_ 950 Alert_RHR 3;
BA_ "GenSigTimeoutTime_ECM" SG_ 950 Alert_RHF 0;
BA_ "GenSigTimeoutTime_DTCM" SG_ 950 Alert_RHF 0;
BA_ "GenSigTimeoutTime_DMSM" SG_ 950 Alert_RHF 0;
BA_ "GenSigTimeoutTime_BSM" SG_ 950 Alert_RHF 0;
BA_ "GenSigTimeoutTime_BCM" SG_ 950 Alert_RHF 0;
BA_ "GenSigTimeoutTime_AGSM" SG_ 950 Alert_RHF 0;
BA_ "GenSigTimeoutTime_ADCAM" SG_ 950 Alert_RHF 0;
BA_ "GenSigSendType" SG_ 950 Alert_RHF 3;
BA_ "GenSigTimeoutTime_SGW" SG_ 950 Alert_RHF 0;
BA_ "GenSigTimeoutTime_RFHM" SG_ 950 Alert_RHF 0;
BA_ "GenSigTimeoutTime_MPAD" SG_ 950 Alert_RHF 0;
BA_ "GenSigTimeoutTime_GNMM" SG_ 950 Alert_RHF 0;
BA_ "GenSigTimeoutTime_EVCU2" SG_ 950 Alert_RHF 0;
BA_ "GenSigTimeoutTime_ESL" SG_ 950 Alert_RHF 0;
BA_ "GenSigTimeoutTime_SGW" SG_ 950 Alert_LHR 0;
BA_ "GenSigTimeoutTime_RFHM" SG_ 950 Alert_LHR 0;
BA_ "GenSigTimeoutTime_MPAD" SG_ 950 Alert_LHR 0;
BA_ "GenSigTimeoutTime_GNMM" SG_ 950 Alert_LHR 0;
BA_ "GenSigTimeoutTime_EVCU2" SG_ 950 Alert_LHR 0;
BA_ "GenSigTimeoutTime_ESL" SG_ 950 Alert_LHR 0;
BA_ "GenSigTimeoutTime_ECM" SG_ 950 Alert_LHR 0;
BA_ "GenSigTimeoutTime_DTCM" SG_ 950 Alert_LHR 0;
BA_ "GenSigTimeoutTime_DMSM" SG_ 950 Alert_LHR 0;
BA_ "GenSigTimeoutTime_DTCM" SG_ 950 FT_PAM_LedControlSts 0;
BA_ "GenSigTimeoutTime_DMSM" SG_ 950 FT_PAM_LedControlSts 0;
BA_ "GenSigTimeoutTime_BSM" SG_ 950 FT_PAM_LedControlSts 0;
BA_ "GenSigTimeoutTime_BCM" SG_ 950 FT_PAM_LedControlSts 0;
BA_ "GenSigTimeoutTime_AGSM" SG_ 950 FT_PAM_LedControlSts 0;
BA_ "GenSigTimeoutTime_ADCAM" SG_ 950 FT_PAM_LedControlSts 0;
BA_ "GenSigSendType" SG_ 950 FT_PAM_LedControlSts 3;
BA_ "GenSigTimeoutTime_SGW" SG_ 2564485696 N_PDU 0;
BA_ "GenSigTimeoutTime_RFHM" SG_ 2564485696 N_PDU 0;
BA_ "GenSigTimeoutTime_MPAD" SG_ 2564485696 N_PDU 0;
BA_ "GenSigTimeoutTime_IPC" SG_ 2564485696 N_PDU 0;
BA_ "GenSigTimeoutTime_GNMM" SG_ 2564485696 N_PDU 0;
BA_ "GenSigTimeoutTime_EVCU2" SG_ 2564485696 N_PDU 0;
BA_ "GenSigTimeoutTime_ESL" SG_ 2564485696 N_PDU 0;
BA_ "GenSigTimeoutTime_ECM" SG_ 2564485696 N_PDU 0;
BA_ "GenSigTimeoutTime_DTCM" SG_ 2564485696 N_PDU 0;
BA_ "GenSigTimeoutTime_DMSM" SG_ 2564485696 N_PDU 0;
BA_ "GenSigTimeoutTime_BSM" SG_ 2564485696 N_PDU 0;
BA_ "GenSigTimeoutTime_BCM" SG_ 2564485696 N_PDU 0;
BA_ "GenSigTimeoutTime_AGSM" SG_ 2564485696 N_PDU 0;
BA_ "GenSigTimeoutTime_ADCAM" SG_ 2564485696 N_PDU 0;
BA_ "GenSigTimeoutTime_SGW" SG_ 950 ParkingManeuverActive 0;
BA_ "GenSigTimeoutTime_RFHM" SG_ 950 ParkingManeuverActive 0;
BA_ "GenSigTimeoutTime_MPAD" SG_ 950 ParkingManeuverActive 0;
BA_ "GenSigTimeoutTime_IPC" SG_ 950 ParkingManeuverActive 0;
BA_ "GenSigTimeoutTime_GNMM" SG_ 950 ParkingManeuverActive 0;
BA_ "GenSigTimeoutTime_EVCU2" SG_ 950 ParkingManeuverActive 0;
BA_ "GenSigTimeoutTime_ESL" SG_ 950 ParkingManeuverActive 0;
BA_ "GenSigTimeoutTime_ECM" SG_ 950 ParkingManeuverActive 0;
BA_ "GenSigTimeoutTime_DTCM" SG_ 950 ParkingManeuverActive 0;
BA_ "GenSigTimeoutTime_DMSM" SG_ 950 ParkingManeuverActive 0;
BA_ "GenSigTimeoutTime_BSM" SG_ 950 ParkingManeuverActive 0;
BA_ "GenSigTimeoutTime_BCM" SG_ 950 ParkingManeuverActive 0;
BA_ "GenSigTimeoutTime_ADCAM" SG_ 950 ParkingManeuverActive 0;
BA_ "GenSigSendType" SG_ 950 ParkingManeuverActive 3;
BA_ "GenSigTimeoutTime_SGW" SG_ 950 MessageCounter_CVPAM_FD_Info 0;
BA_ "GenSigTimeoutTime_RFHM" SG_ 950 MessageCounter_CVPAM_FD_Info 0;
BA_ "GenSigTimeoutTime_MPAD" SG_ 950 MessageCounter_CVPAM_FD_Info 0;
BA_ "GenSigTimeoutTime_IPC" SG_ 950 MessageCounter_CVPAM_FD_Info 0;
BA_ "GenSigTimeoutTime_GNMM" SG_ 950 MessageCounter_CVPAM_FD_Info 0;
BA_ "GenSigTimeoutTime_EVCU2" SG_ 950 MessageCounter_CVPAM_FD_Info 0;
BA_ "GenSigTimeoutTime_ESL" SG_ 950 MessageCounter_CVPAM_FD_Info 0;
BA_ "GenSigTimeoutTime_ECM" SG_ 950 MessageCounter_CVPAM_FD_Info 0;
BA_ "GenSigTimeoutTime_DTCM" SG_ 950 MessageCounter_CVPAM_FD_Info 0;
BA_ "GenSigTimeoutTime_DMSM" SG_ 950 MessageCounter_CVPAM_FD_Info 0;
BA_ "GenSigTimeoutTime_BSM" SG_ 950 MessageCounter_CVPAM_FD_Info 0;
BA_ "GenSigTimeoutTime_BCM" SG_ 950 MessageCounter_CVPAM_FD_Info 0;
BA_ "GenSigTimeoutTime_ADCAM" SG_ 950 MessageCounter_CVPAM_FD_Info 0;
BA_ "GenSigTimeoutTime_SGW" SG_ 950 CRC_CVPAM_FD_Info 0;
BA_ "GenSigTimeoutTime_RFHM" SG_ 950 CRC_CVPAM_FD_Info 0;
BA_ "GenSigTimeoutTime_MPAD" SG_ 950 CRC_CVPAM_FD_Info 0;
BA_ "GenSigTimeoutTime_IPC" SG_ 950 CRC_CVPAM_FD_Info 0;
BA_ "GenSigTimeoutTime_GNMM" SG_ 950 CRC_CVPAM_FD_Info 0;
BA_ "GenSigTimeoutTime_EVCU2" SG_ 950 CRC_CVPAM_FD_Info 0;
BA_ "GenSigTimeoutTime_ESL" SG_ 950 CRC_CVPAM_FD_Info 0;
BA_ "GenSigTimeoutTime_ECM" SG_ 950 CRC_CVPAM_FD_Info 0;
BA_ "GenSigTimeoutTime_DTCM" SG_ 950 CRC_CVPAM_FD_Info 0;
BA_ "GenSigTimeoutTime_DMSM" SG_ 950 CRC_CVPAM_FD_Info 0;
BA_ "GenSigTimeoutTime_BSM" SG_ 950 CRC_CVPAM_FD_Info 0;
BA_ "GenSigTimeoutTime_BCM" SG_ 950 CRC_CVPAM_FD_Info 0;
BA_ "GenSigTimeoutTime_ADCAM" SG_ 950 CRC_CVPAM_FD_Info 0;
BA_ "GenSigTimeoutTime_SGW" SG_ 950 FT_PAM_LedControlSts 0;
BA_ "GenSigTimeoutTime_RFHM" SG_ 950 FT_PAM_LedControlSts 0;
BA_ "GenSigTimeoutTime_MPAD" SG_ 950 FT_PAM_LedControlSts 0;
BA_ "GenSigTimeoutTime_GNMM" SG_ 950 FT_PAM_LedControlSts 0;
BA_ "GenSigTimeoutTime_EVCU2" SG_ 950 FT_PAM_LedControlSts 0;
BA_ "GenSigTimeoutTime_ESL" SG_ 950 FT_PAM_LedControlSts 0;
BA_ "GenSigTimeoutTime_ECM" SG_ 950 FT_PAM_LedControlSts 0;
BA_ "GenSigTimeoutTime_RFHM" SG_ 1842 Total_Range 0;
BA_ "GenSigTimeoutTime_MPAD" SG_ 1842 Total_Range 0;
BA_ "GenSigTimeoutTime_IPC" SG_ 1842 Total_Range 0;
BA_ "GenSigTimeoutTime_GNMM" SG_ 1842 Total_Range 0;
BA_ "GenSigTimeoutTime_EVCU2" SG_ 1842 Total_Range 0;
BA_ "GenSigTimeoutTime_ESL" SG_ 1842 Total_Range 0;
BA_ "GenSigTimeoutTime_ECM" SG_ 1842 Total_Range 0;
BA_ "GenSigTimeoutTime_DTCM" SG_ 1842 Total_Range 0;
BA_ "GenSigTimeoutTime_DMSM" SG_ 1842 Total_Range 0;
BA_ "GenSigTimeoutTime_BSM" SG_ 1842 Total_Range 0;
BA_ "GenSigTimeoutTime_BCM" SG_ 1842 Total_Range 0;
BA_ "GenSigTimeoutTime_AGSM" SG_ 1842 Total_Range 0;
BA_ "GenSigTimeoutTime_ADCAM" SG_ 1842 Total_Range 0;
BA_ "GenSigSendType" SG_ 1842 Total_Range 3;
BA_ "GenSigStartValue" SG_ 1842 Total_Range 2047;
BA_ "GenSigTimeoutTime_RFHM" SG_ 1842 Gas_Range 0;
BA_ "GenSigTimeoutTime_MPAD" SG_ 1842 Gas_Range 0;
BA_ "GenSigTimeoutTime_IPC" SG_ 1842 Gas_Range 0;
BA_ "GenSigTimeoutTime_GNMM" SG_ 1842 Gas_Range 0;
BA_ "GenSigTimeoutTime_EVCU2" SG_ 1842 Gas_Range 0;
BA_ "GenSigTimeoutTime_ESL" SG_ 1842 Gas_Range 0;
BA_ "GenSigTimeoutTime_ECM" SG_ 1842 Gas_Range 0;
BA_ "GenSigTimeoutTime_DTCM" SG_ 1842 Gas_Range 0;
BA_ "GenSigTimeoutTime_DMSM" SG_ 1842 Gas_Range 0;
BA_ "GenSigTimeoutTime_BSM" SG_ 1842 Gas_Range 0;
BA_ "GenSigTimeoutTime_AGSM" SG_ 1842 Gas_Range 0;
BA_ "GenSigTimeoutTime_ADCAM" SG_ 1842 Gas_Range 0;
BA_ "GenSigSendType" SG_ 1842 Gas_Range 3;
BA_ "GenSigStartValue" SG_ 1842 Gas_Range 1023;
BA_ "GenSigTimeoutTime_RFHM" SG_ 1844 B_Hybrid_Miles 0;
BA_ "GenSigTimeoutTime_MPAD" SG_ 1844 B_Hybrid_Miles 0;
BA_ "GenSigTimeoutTime_IPC" SG_ 1844 B_Hybrid_Miles 0;
BA_ "GenSigTimeoutTime_GNMM" SG_ 1844 B_Hybrid_Miles 0;
BA_ "GenSigTimeoutTime_EVCU2" SG_ 1844 B_Hybrid_Miles 0;
BA_ "GenSigTimeoutTime_ESL" SG_ 1844 B_Hybrid_Miles 0;
BA_ "GenSigTimeoutTime_ECM" SG_ 1844 B_Hybrid_Miles 0;
BA_ "GenSigTimeoutTime_DTCM" SG_ 1844 B_Hybrid_Miles 0;
BA_ "GenSigTimeoutTime_DMSM" SG_ 1844 B_Hybrid_Miles 0;
BA_ "GenSigTimeoutTime_BSM" SG_ 1844 B_Hybrid_Miles 0;
BA_ "GenSigTimeoutTime_BCM" SG_ 1844 B_Hybrid_Miles 0;
BA_ "GenSigTimeoutTime_AGSM" SG_ 1844 B_Hybrid_Miles 0;
BA_ "GenSigTimeoutTime_ADCAM" SG_ 1844 B_Hybrid_Miles 0;
BA_ "GenSigTimeoutTime_RFHM" SG_ 1844 B_EV_Miles 0;
BA_ "GenSigTimeoutTime_MPAD" SG_ 1844 B_EV_Miles 0;
BA_ "GenSigTimeoutTime_IPC" SG_ 1844 B_EV_Miles 0;
BA_ "GenSigTimeoutTime_GNMM" SG_ 1844 B_EV_Miles 0;
BA_ "GenSigTimeoutTime_EVCU2" SG_ 1844 B_EV_Miles 0;
BA_ "GenSigTimeoutTime_ESL" SG_ 1844 B_EV_Miles 0;
BA_ "GenSigTimeoutTime_ECM" SG_ 1844 B_EV_Miles 0;
BA_ "GenSigTimeoutTime_DTCM" SG_ 1844 B_EV_Miles 0;
BA_ "GenSigTimeoutTime_DMSM" SG_ 1844 B_EV_Miles 0;
BA_ "GenSigTimeoutTime_BSM" SG_ 1844 B_EV_Miles 0;
BA_ "GenSigTimeoutTime_BCM" SG_ 1844 B_EV_Miles 0;
BA_ "GenSigTimeoutTime_AGSM" SG_ 1844 B_EV_Miles 0;
BA_ "GenSigTimeoutTime_ADCAM" SG_ 1844 B_EV_Miles 0;
BA_ "GenSigTimeoutTime_RFHM" SG_ 1844 B_Hybrid_Kilometers 0;
BA_ "GenSigTimeoutTime_MPAD" SG_ 1844 B_Hybrid_Kilometers 0;
BA_ "GenSigTimeoutTime_IPC" SG_ 1844 B_Hybrid_Kilometers 0;
BA_ "GenSigTimeoutTime_GNMM" SG_ 1844 B_Hybrid_Kilometers 0;
BA_ "GenSigTimeoutTime_EVCU2" SG_ 1844 B_Hybrid_Kilometers 0;
BA_ "GenSigTimeoutTime_ESL" SG_ 1844 B_Hybrid_Kilometers 0;
BA_ "GenSigTimeoutTime_ECM" SG_ 1844 B_Hybrid_Kilometers 0;
BA_ "GenSigTimeoutTime_DTCM" SG_ 1844 B_Hybrid_Kilometers 0;
BA_ "GenSigTimeoutTime_DMSM" SG_ 1844 B_Hybrid_Kilometers 0;
BA_ "GenSigTimeoutTime_BSM" SG_ 1844 B_Hybrid_Kilometers 0;
BA_ "GenSigTimeoutTime_BCM" SG_ 1844 B_Hybrid_Kilometers 0;
BA_ "GenSigTimeoutTime_AGSM" SG_ 1844 B_Hybrid_Kilometers 0;
BA_ "GenSigTimeoutTime_ADCAM" SG_ 1844 B_Hybrid_Kilometers 0;
BA_ "GenSigTimeoutTime_RFHM" SG_ 1844 B_EV_Kilometers 0;
BA_ "GenSigTimeoutTime_MPAD" SG_ 1844 B_EV_Kilometers 0;
BA_ "GenSigTimeoutTime_IPC" SG_ 1844 B_EV_Kilometers 0;
BA_ "GenSigTimeoutTime_GNMM" SG_ 1844 B_EV_Kilometers 0;
BA_ "GenSigTimeoutTime_EVCU2" SG_ 1844 B_EV_Kilometers 0;
BA_ "GenSigTimeoutTime_ESL" SG_ 1844 B_EV_Kilometers 0;
BA_ "GenSigTimeoutTime_ECM" SG_ 1844 B_EV_Kilometers 0;
BA_ "GenSigTimeoutTime_DTCM" SG_ 1844 B_EV_Kilometers 0;
BA_ "GenSigTimeoutTime_DMSM" SG_ 1844 B_EV_Kilometers 0;
BA_ "GenSigTimeoutTime_BSM" SG_ 1844 B_EV_Kilometers 0;
BA_ "GenSigTimeoutTime_BCM" SG_ 1844 B_EV_Kilometers 0;
BA_ "GenSigTimeoutTime_AGSM" SG_ 1844 B_EV_Kilometers 0;
BA_ "GenSigTimeoutTime_ADCAM" SG_ 1844 B_EV_Kilometers 0;
BA_ "GenSigTimeoutTime_SGW" SG_ 752 CRC_IBS3DATA1 0;
BA_ "GenSigTimeoutTime_RFHM" SG_ 752 CRC_IBS3DATA1 0;
BA_ "GenSigTimeoutTime_MPAD" SG_ 752 CRC_IBS3DATA1 0;
BA_ "GenSigTimeoutTime_IPC" SG_ 752 CRC_IBS3DATA1 0;
BA_ "GenSigTimeoutTime_GNMM" SG_ 752 CRC_IBS3DATA1 0;
BA_ "GenSigTimeoutTime_ESL" SG_ 752 CRC_IBS3DATA1 0;
BA_ "GenSigTimeoutTime_ECM" SG_ 752 CRC_IBS3DATA1 0;
BA_ "GenSigTimeoutTime_DTCM" SG_ 752 CRC_IBS3DATA1 0;
BA_ "GenSigTimeoutTime_DMSM" SG_ 752 CRC_IBS3DATA1 0;
BA_ "GenSigTimeoutTime_BSM" SG_ 752 CRC_IBS3DATA1 0;
BA_ "GenSigTimeoutTime_BCM" SG_ 752 CRC_IBS3DATA1 0;
BA_ "GenSigTimeoutTime_AGSM" SG_ 752 CRC_IBS3DATA1 0;
BA_ "GenSigTimeoutTime_ADCAM" SG_ 752 CRC_IBS3DATA1 0;
BA_ "GenSigTimeoutTime_SGW" SG_ 752 MessageCounter_IBS3DATA1 0;
BA_ "GenSigTimeoutTime_RFHM" SG_ 752 MessageCounter_IBS3DATA1 0;
BA_ "GenSigTimeoutTime_MPAD" SG_ 752 MessageCounter_IBS3DATA1 0;
BA_ "GenSigTimeoutTime_IPC" SG_ 752 MessageCounter_IBS3DATA1 0;
BA_ "GenSigTimeoutTime_GNMM" SG_ 752 MessageCounter_IBS3DATA1 0;
BA_ "GenSigTimeoutTime_ESL" SG_ 752 MessageCounter_IBS3DATA1 0;
BA_ "GenSigTimeoutTime_ECM" SG_ 752 MessageCounter_IBS3DATA1 0;
BA_ "GenSigTimeoutTime_DTCM" SG_ 752 MessageCounter_IBS3DATA1 0;
BA_ "GenSigTimeoutTime_DMSM" SG_ 752 MessageCounter_IBS3DATA1 0;
BA_ "GenSigTimeoutTime_BSM" SG_ 752 MessageCounter_IBS3DATA1 0;
BA_ "GenSigTimeoutTime_BCM" SG_ 752 MessageCounter_IBS3DATA1 0;
BA_ "GenSigTimeoutTime_AGSM" SG_ 752 MessageCounter_IBS3DATA1 0;
BA_ "GenSigTimeoutTime_ADCAM" SG_ 752 MessageCounter_IBS3DATA1 0;
BA_ "GenSigTimeoutTime_SGW" SG_ 752 RsErrIBS3 0;
BA_ "GenSigTimeoutTime_RFHM" SG_ 752 RsErrIBS3 0;
BA_ "GenSigTimeoutTime_MPAD" SG_ 752 RsErrIBS3 0;
BA_ "GenSigTimeoutTime_IPC" SG_ 752 RsErrIBS3 0;
BA_ "GenSigTimeoutTime_GNMM" SG_ 752 RsErrIBS3 0;
BA_ "GenSigTimeoutTime_ESL" SG_ 752 RsErrIBS3 0;
BA_ "GenSigTimeoutTime_DTCM" SG_ 752 RsErrIBS3 0;
BA_ "GenSigTimeoutTime_DMSM" SG_ 752 RsErrIBS3 0;
BA_ "GenSigTimeoutTime_BSM" SG_ 752 RsErrIBS3 0;
BA_ "GenSigTimeoutTime_BCM" SG_ 752 RsErrIBS3 0;
BA_ "GenSigTimeoutTime_AGSM" SG_ 752 RsErrIBS3 0;
BA_ "GenSigTimeoutTime_ADCAM" SG_ 752 RsErrIBS3 0;
BA_ "GenSigTimeoutTime_SGW" SG_ 752 VoltBattFailStatus 0;
BA_ "GenSigTimeoutTime_RFHM" SG_ 752 VoltBattFailStatus 0;
BA_ "GenSigTimeoutTime_MPAD" SG_ 752 VoltBattFailStatus 0;
BA_ "GenSigTimeoutTime_IPC" SG_ 752 VoltBattFailStatus 0;
BA_ "GenSigTimeoutTime_GNMM" SG_ 752 VoltBattFailStatus 0;
BA_ "GenSigTimeoutTime_ESL" SG_ 752 VoltBattFailStatus 0;
BA_ "GenSigTimeoutTime_DTCM" SG_ 752 VoltBattFailStatus 0;
BA_ "GenSigTimeoutTime_DMSM" SG_ 752 VoltBattFailStatus 0;
BA_ "GenSigTimeoutTime_BSM" SG_ 752 VoltBattFailStatus 0;
BA_ "GenSigTimeoutTime_BCM" SG_ 752 VoltBattFailStatus 0;
BA_ "GenSigTimeoutTime_AGSM" SG_ 752 VoltBattFailStatus 0;
BA_ "GenSigTimeoutTime_ADCAM" SG_ 752 VoltBattFailStatus 0;
BA_ "GenSigTimeoutTime_SGW" SG_ 1032 PE_CoolTempIn 0;
BA_ "GenSigTimeoutTime_RFHM" SG_ 1032 PE_CoolTempIn 0;
BA_ "GenSigTimeoutTime_MPAD" SG_ 1032 PE_CoolTempIn 0;
BA_ "GenSigTimeoutTime_IPC" SG_ 1032 PE_CoolTempIn 0;
BA_ "GenSigTimeoutTime_GNMM" SG_ 1032 PE_CoolTempIn 0;
BA_ "GenSigTimeoutTime_EVCU2" SG_ 1032 PE_CoolTempIn 0;
BA_ "GenSigTimeoutTime_ESL" SG_ 1032 PE_CoolTempIn 0;
BA_ "GenSigTimeoutTime_DTCM" SG_ 1032 PE_CoolTempIn 0;
BA_ "GenSigTimeoutTime_DMSM" SG_ 1032 PE_CoolTempIn 0;
BA_ "GenSigTimeoutTime_BSM" SG_ 1032 PE_CoolTempIn 0;
BA_ "GenSigTimeoutTime_BCM" SG_ 1032 PE_CoolTempIn 0;
BA_ "GenSigTimeoutTime_AGSM" SG_ 1032 PE_CoolTempIn 0;
BA_ "GenSigTimeoutTime_ADCAM" SG_ 1032 PE_CoolTempIn 0;
BA_ "GenSigStartValue" SG_ 1032 PE_CoolTempIn 255;
BA_ "GenSigTimeoutTime_SGW" SG_ 752 CurrBattFailStatus 0;
BA_ "GenSigTimeoutTime_RFHM" SG_ 752 CurrBattFailStatus 0;
BA_ "GenSigTimeoutTime_MPAD" SG_ 752 CurrBattFailStatus 0;
BA_ "GenSigTimeoutTime_IPC" SG_ 752 CurrBattFailStatus 0;
BA_ "GenSigTimeoutTime_GNMM" SG_ 752 CurrBattFailStatus 0;
BA_ "GenSigTimeoutTime_ESL" SG_ 752 CurrBattFailStatus 0;
BA_ "GenSigTimeoutTime_DTCM" SG_ 752 CurrBattFailStatus 0;
BA_ "GenSigTimeoutTime_DMSM" SG_ 752 CurrBattFailStatus 0;
BA_ "GenSigTimeoutTime_BSM" SG_ 752 CurrBattFailStatus 0;
BA_ "GenSigTimeoutTime_BCM" SG_ 752 CurrBattFailStatus 0;
BA_ "GenSigTimeoutTime_AGSM" SG_ 752 CurrBattFailStatus 0;
BA_ "GenSigTimeoutTime_ADCAM" SG_ 752 CurrBattFailStatus 0;
BA_ "GenSigTimeoutTime_SGW" SG_ 752 IBS3_Error_Internal 0;
BA_ "GenSigTimeoutTime_RFHM" SG_ 752 IBS3_Error_Internal 0;
BA_ "GenSigTimeoutTime_MPAD" SG_ 752 IBS3_Error_Internal 0;
BA_ "GenSigTimeoutTime_IPC" SG_ 752 IBS3_Error_Internal 0;
BA_ "GenSigTimeoutTime_GNMM" SG_ 752 IBS3_Error_Internal 0;
BA_ "GenSigTimeoutTime_ESL" SG_ 752 IBS3_Error_Internal 0;
BA_ "GenSigTimeoutTime_DTCM" SG_ 752 IBS3_Error_Internal 0;
BA_ "GenSigTimeoutTime_DMSM" SG_ 752 IBS3_Error_Internal 0;
BA_ "GenSigTimeoutTime_BSM" SG_ 752 IBS3_Error_Internal 0;
BA_ "GenSigTimeoutTime_BCM" SG_ 752 IBS3_Error_Internal 0;
BA_ "GenSigTimeoutTime_AGSM" SG_ 752 IBS3_Error_Internal 0;
BA_ "GenSigTimeoutTime_ADCAM" SG_ 752 IBS3_Error_Internal 0;
BA_ "GenSigTimeoutTime_SGW" SG_ 752 IBS3_SOF_V_Accuracy 0;
BA_ "GenSigTimeoutTime_RFHM" SG_ 752 IBS3_SOF_V_Accuracy 0;
BA_ "GenSigTimeoutTime_MPAD" SG_ 752 IBS3_SOF_V_Accuracy 0;
BA_ "GenSigTimeoutTime_IPC" SG_ 752 IBS3_SOF_V_Accuracy 0;
BA_ "GenSigTimeoutTime_GNMM" SG_ 752 IBS3_SOF_V_Accuracy 0;
BA_ "GenSigTimeoutTime_ESL" SG_ 752 IBS3_SOF_V_Accuracy 0;
BA_ "GenSigTimeoutTime_ECM" SG_ 752 IBS3_SOF_V_Accuracy 0;
BA_ "GenSigTimeoutTime_DTCM" SG_ 752 IBS3_SOF_V_Accuracy 0;
BA_ "GenSigTimeoutTime_DMSM" SG_ 752 IBS3_SOF_V_Accuracy 0;
BA_ "GenSigTimeoutTime_BSM" SG_ 752 IBS3_SOF_V_Accuracy 0;
BA_ "GenSigTimeoutTime_BCM" SG_ 752 IBS3_SOF_V_Accuracy 0;
BA_ "GenSigTimeoutTime_AGSM" SG_ 752 IBS3_SOF_V_Accuracy 0;
BA_ "GenSigTimeoutTime_ADCAM" SG_ 752 IBS3_SOF_V_Accuracy 0;
BA_ "GenSigStartValue" SG_ 752 IBS3_SOF_V_Accuracy 1;
BA_ "GenSigTimeoutTime_RFHM" SG_ 1956 Warning_MotorA_Overtemp 0;
BA_ "GenSigTimeoutTime_MPAD" SG_ 1956 Warning_MotorA_Overtemp 0;
BA_ "GenSigTimeoutTime_IPC" SG_ 1956 Warning_MotorA_Overtemp 0;
BA_ "GenSigTimeoutTime_GNMM" SG_ 1956 Warning_MotorA_Overtemp 0;
BA_ "GenSigTimeoutTime_EVCU2" SG_ 1956 Warning_MotorA_Overtemp 0;
BA_ "GenSigTimeoutTime_ESL" SG_ 1956 Warning_MotorA_Overtemp 0;
BA_ "GenSigTimeoutTime_ECM" SG_ 1956 Warning_MotorA_Overtemp 0;
BA_ "GenSigTimeoutTime_DTCM" SG_ 1956 Warning_MotorA_Overtemp 0;
BA_ "GenSigTimeoutTime_DMSM" SG_ 1956 Warning_MotorA_Overtemp 0;
BA_ "GenSigTimeoutTime_BSM" SG_ 1956 Warning_MotorA_Overtemp 0;
BA_ "GenSigTimeoutTime_BCM" SG_ 1956 Warning_MotorA_Overtemp 0;
BA_ "GenSigTimeoutTime_AGSM" SG_ 1956 Warning_MotorA_Overtemp 0;
BA_ "GenSigTimeoutTime_ADCAM" SG_ 1956 Warning_MotorA_Overtemp 0;
BA_ "GenSigTimeoutTime_RFHM" SG_ 1956 Warning_MotorB_Overtemp 0;
BA_ "GenSigTimeoutTime_MPAD" SG_ 1956 Warning_MotorB_Overtemp 0;
BA_ "GenSigTimeoutTime_IPC" SG_ 1956 Warning_MotorB_Overtemp 0;
BA_ "GenSigTimeoutTime_GNMM" SG_ 1956 Warning_MotorB_Overtemp 0;
BA_ "GenSigTimeoutTime_EVCU2" SG_ 1956 Warning_MotorB_Overtemp 0;
BA_ "GenSigTimeoutTime_ESL" SG_ 1956 Warning_MotorB_Overtemp 0;
BA_ "GenSigTimeoutTime_ECM" SG_ 1956 Warning_MotorB_Overtemp 0;
BA_ "GenSigTimeoutTime_DTCM" SG_ 1956 Warning_MotorB_Overtemp 0;
BA_ "GenSigTimeoutTime_DMSM" SG_ 1956 Warning_MotorB_Overtemp 0;
BA_ "GenSigTimeoutTime_BSM" SG_ 1956 Warning_MotorB_Overtemp 0;
BA_ "GenSigTimeoutTime_BCM" SG_ 1956 Warning_MotorB_Overtemp 0;
BA_ "GenSigTimeoutTime_AGSM" SG_ 1956 Warning_MotorB_Overtemp 0;
BA_ "GenSigTimeoutTime_ADCAM" SG_ 1956 Warning_MotorB_Overtemp 0;
BA_ "GenSigTimeoutTime_RFHM" SG_ 1956 Warning_InverterB_Overtemp 0;
BA_ "GenSigTimeoutTime_MPAD" SG_ 1956 Warning_InverterB_Overtemp 0;
BA_ "GenSigTimeoutTime_IPC" SG_ 1956 Warning_InverterB_Overtemp 0;
BA_ "GenSigTimeoutTime_GNMM" SG_ 1956 Warning_InverterB_Overtemp 0;
BA_ "GenSigTimeoutTime_EVCU2" SG_ 1956 Warning_InverterB_Overtemp 0;
BA_ "GenSigTimeoutTime_ESL" SG_ 1956 Warning_InverterB_Overtemp 0;
BA_ "GenSigTimeoutTime_ECM" SG_ 1956 Warning_InverterB_Overtemp 0;
BA_ "GenSigTimeoutTime_DTCM" SG_ 1956 Warning_InverterB_Overtemp 0;
BA_ "GenSigTimeoutTime_DMSM" SG_ 1956 Warning_InverterB_Overtemp 0;
BA_ "GenSigTimeoutTime_BSM" SG_ 1956 Warning_InverterB_Overtemp 0;
BA_ "GenSigTimeoutTime_BCM" SG_ 1956 Warning_InverterB_Overtemp 0;
BA_ "GenSigTimeoutTime_AGSM" SG_ 1956 Warning_InverterB_Overtemp 0;
BA_ "GenSigTimeoutTime_ADCAM" SG_ 1956 Warning_InverterB_Overtemp 0;
BA_ "GenSigTimeoutTime_RFHM" SG_ 1956 Warning_DCDCTemp_DPT 0;
BA_ "GenSigTimeoutTime_MPAD" SG_ 1956 Warning_DCDCTemp_DPT 0;
BA_ "GenSigTimeoutTime_IPC" SG_ 1956 Warning_DCDCTemp_DPT 0;
BA_ "GenSigTimeoutTime_GNMM" SG_ 1956 Warning_DCDCTemp_DPT 0;
BA_ "GenSigTimeoutTime_EVCU2" SG_ 1956 Warning_DCDCTemp_DPT 0;
BA_ "GenSigTimeoutTime_ESL" SG_ 1956 Warning_DCDCTemp_DPT 0;
BA_ "GenSigTimeoutTime_ECM" SG_ 1956 Warning_DCDCTemp_DPT 0;
BA_ "GenSigTimeoutTime_DTCM" SG_ 1956 Warning_DCDCTemp_DPT 0;
BA_ "GenSigTimeoutTime_DMSM" SG_ 1956 Warning_DCDCTemp_DPT 0;
BA_ "GenSigTimeoutTime_BSM" SG_ 1956 Warning_DCDCTemp_DPT 0;
BA_ "GenSigTimeoutTime_BCM" SG_ 1956 Warning_DCDCTemp_DPT 0;
BA_ "GenSigTimeoutTime_AGSM" SG_ 1956 Warning_DCDCTemp_DPT 0;
BA_ "GenSigTimeoutTime_ADCAM" SG_ 1956 Warning_DCDCTemp_DPT 0;
BA_ "GenSigTimeoutTime_RFHM" SG_ 1956 Warning_InverterA_Overtemp 0;
BA_ "GenSigTimeoutTime_MPAD" SG_ 1956 Warning_InverterA_Overtemp 0;
BA_ "GenSigTimeoutTime_IPC" SG_ 1956 Warning_InverterA_Overtemp 0;
BA_ "GenSigTimeoutTime_GNMM" SG_ 1956 Warning_InverterA_Overtemp 0;
BA_ "GenSigTimeoutTime_EVCU2" SG_ 1956 Warning_InverterA_Overtemp 0;
BA_ "GenSigTimeoutTime_ESL" SG_ 1956 Warning_InverterA_Overtemp 0;
BA_ "GenSigTimeoutTime_ECM" SG_ 1956 Warning_InverterA_Overtemp 0;
BA_ "GenSigTimeoutTime_DTCM" SG_ 1956 Warning_InverterA_Overtemp 0;
BA_ "GenSigTimeoutTime_DMSM" SG_ 1956 Warning_InverterA_Overtemp 0;
BA_ "GenSigTimeoutTime_BSM" SG_ 1956 Warning_InverterA_Overtemp 0;
BA_ "GenSigTimeoutTime_BCM" SG_ 1956 Warning_InverterA_Overtemp 0;
BA_ "GenSigTimeoutTime_AGSM" SG_ 1956 Warning_InverterA_Overtemp 0;
BA_ "GenSigTimeoutTime_ADCAM" SG_ 1956 Warning_InverterA_Overtemp 0;
BA_ "GenSigTimeoutTime_RFHM" SG_ 1956 MotorA_InverterState 0;
BA_ "GenSigTimeoutTime_MPAD" SG_ 1956 MotorA_InverterState 0;
BA_ "GenSigTimeoutTime_IPC" SG_ 1956 MotorA_InverterState 0;
BA_ "GenSigTimeoutTime_GNMM" SG_ 1956 MotorA_InverterState 0;
BA_ "GenSigTimeoutTime_EVCU2" SG_ 1956 MotorA_InverterState 0;
BA_ "GenSigTimeoutTime_ESL" SG_ 1956 MotorA_InverterState 0;
BA_ "GenSigTimeoutTime_ECM" SG_ 1956 MotorA_InverterState 0;
BA_ "GenSigTimeoutTime_DTCM" SG_ 1956 MotorA_InverterState 0;
BA_ "GenSigTimeoutTime_DMSM" SG_ 1956 MotorA_InverterState 0;
BA_ "GenSigTimeoutTime_BSM" SG_ 1956 MotorA_InverterState 0;
BA_ "GenSigTimeoutTime_BCM" SG_ 1956 MotorA_InverterState 0;
BA_ "GenSigTimeoutTime_AGSM" SG_ 1956 MotorA_InverterState 0;
BA_ "GenSigTimeoutTime_ADCAM" SG_ 1956 MotorA_InverterState 0;
BA_ "GenSigTimeoutTime_RFHM" SG_ 1956 MotorB_InverterState 0;
BA_ "GenSigTimeoutTime_MPAD" SG_ 1956 MotorB_InverterState 0;
BA_ "GenSigTimeoutTime_IPC" SG_ 1956 MotorB_InverterState 0;
BA_ "GenSigTimeoutTime_GNMM" SG_ 1956 MotorB_InverterState 0;
BA_ "GenSigTimeoutTime_EVCU2" SG_ 1956 MotorB_InverterState 0;
BA_ "GenSigTimeoutTime_ESL" SG_ 1956 MotorB_InverterState 0;
BA_ "GenSigTimeoutTime_ECM" SG_ 1956 MotorB_InverterState 0;
BA_ "GenSigTimeoutTime_DTCM" SG_ 1956 MotorB_InverterState 0;
BA_ "GenSigTimeoutTime_DMSM" SG_ 1956 MotorB_InverterState 0;
BA_ "GenSigTimeoutTime_BSM" SG_ 1956 MotorB_InverterState 0;
BA_ "GenSigTimeoutTime_BCM" SG_ 1956 MotorB_InverterState 0;
BA_ "GenSigTimeoutTime_AGSM" SG_ 1956 MotorB_InverterState 0;
BA_ "GenSigTimeoutTime_ADCAM" SG_ 1956 MotorB_InverterState 0;
BA_ "GenSigTimeoutTime_RFHM" SG_ 1956 Warning_DCDCPerformance_DPT 0;
BA_ "GenSigTimeoutTime_MPAD" SG_ 1956 Warning_DCDCPerformance_DPT 0;
BA_ "GenSigTimeoutTime_IPC" SG_ 1956 Warning_DCDCPerformance_DPT 0;
BA_ "GenSigTimeoutTime_GNMM" SG_ 1956 Warning_DCDCPerformance_DPT 0;
BA_ "GenSigTimeoutTime_EVCU2" SG_ 1956 Warning_DCDCPerformance_DPT 0;
BA_ "GenSigTimeoutTime_ESL" SG_ 1956 Warning_DCDCPerformance_DPT 0;
BA_ "GenSigTimeoutTime_ECM" SG_ 1956 Warning_DCDCPerformance_DPT 0;
BA_ "GenSigTimeoutTime_DTCM" SG_ 1956 Warning_DCDCPerformance_DPT 0;
BA_ "GenSigTimeoutTime_DMSM" SG_ 1956 Warning_DCDCPerformance_DPT 0;
BA_ "GenSigTimeoutTime_BSM" SG_ 1956 Warning_DCDCPerformance_DPT 0;
BA_ "GenSigTimeoutTime_BCM" SG_ 1956 Warning_DCDCPerformance_DPT 0;
BA_ "GenSigTimeoutTime_AGSM" SG_ 1956 Warning_DCDCPerformance_DPT 0;
BA_ "GenSigTimeoutTime_ADCAM" SG_ 1956 Warning_DCDCPerformance_DPT 0;
BA_ "GenSigTimeoutTime_RFHM" SG_ 1956 MotorB_TorqueAchieved 0;
BA_ "GenSigTimeoutTime_MPAD" SG_ 1956 MotorB_TorqueAchieved 0;
BA_ "GenSigTimeoutTime_IPC" SG_ 1956 MotorB_TorqueAchieved 0;
BA_ "GenSigTimeoutTime_GNMM" SG_ 1956 MotorB_TorqueAchieved 0;
BA_ "GenSigTimeoutTime_EVCU2" SG_ 1956 MotorB_TorqueAchieved 0;
BA_ "GenSigTimeoutTime_ESL" SG_ 1956 MotorB_TorqueAchieved 0;
BA_ "GenSigTimeoutTime_ECM" SG_ 1956 MotorB_TorqueAchieved 0;
BA_ "GenSigTimeoutTime_DTCM" SG_ 1956 MotorB_TorqueAchieved 0;
BA_ "GenSigTimeoutTime_DMSM" SG_ 1956 MotorB_TorqueAchieved 0;
BA_ "GenSigTimeoutTime_BSM" SG_ 1956 MotorB_TorqueAchieved 0;
BA_ "GenSigTimeoutTime_AGSM" SG_ 1956 MotorB_TorqueAchieved 0;
BA_ "GenSigTimeoutTime_ADCAM" SG_ 1956 MotorB_TorqueAchieved 0;
BA_ "GenSigStartValue" SG_ 1956 MotorB_TorqueAchieved 4096;
BA_ "GenSigTimeoutTime_SGW" SG_ 1956 CRC_HYBRID_RM_MOTORS 0;
BA_ "GenSigTimeoutTime_RFHM" SG_ 1956 CRC_HYBRID_RM_MOTORS 0;
BA_ "GenSigTimeoutTime_IPC" SG_ 1956 CRC_HYBRID_RM_MOTORS 0;
BA_ "GenSigTimeoutTime_GNMM" SG_ 1956 CRC_HYBRID_RM_MOTORS 0;
BA_ "GenSigTimeoutTime_EVCU2" SG_ 1956 CRC_HYBRID_RM_MOTORS 0;
BA_ "GenSigTimeoutTime_ESL" SG_ 1956 CRC_HYBRID_RM_MOTORS 0;
BA_ "GenSigTimeoutTime_ECM" SG_ 1956 CRC_HYBRID_RM_MOTORS 0;
BA_ "GenSigTimeoutTime_DTCM" SG_ 1956 CRC_HYBRID_RM_MOTORS 0;
BA_ "GenSigTimeoutTime_SGW" SG_ 1956 MessageCounter_HYBRID_RM_MOTORS 0;
BA_ "GenSigTimeoutTime_RFHM" SG_ 1956 MessageCounter_HYBRID_RM_MOTORS 0;
BA_ "GenSigTimeoutTime_IPC" SG_ 1956 MessageCounter_HYBRID_RM_MOTORS 0;
BA_ "GenSigTimeoutTime_GNMM" SG_ 1956 MessageCounter_HYBRID_RM_MOTORS 0;
BA_ "GenSigTimeoutTime_EVCU2" SG_ 1956 MessageCounter_HYBRID_RM_MOTORS 0;
BA_ "GenSigTimeoutTime_ESL" SG_ 1956 MessageCounter_HYBRID_RM_MOTORS 0;
BA_ "GenSigTimeoutTime_ECM" SG_ 1956 MessageCounter_HYBRID_RM_MOTORS 0;
BA_ "GenSigTimeoutTime_DTCM" SG_ 1956 MessageCounter_HYBRID_RM_MOTORS 0;
BA_ "GenSigTimeoutTime_DMSM" SG_ 1956 MessageCounter_HYBRID_RM_MOTORS 0;
BA_ "GenSigTimeoutTime_BSM" SG_ 1956 MessageCounter_HYBRID_RM_MOTORS 0;
BA_ "GenSigTimeoutTime_BCM" SG_ 1956 MessageCounter_HYBRID_RM_MOTORS 0;
BA_ "GenSigTimeoutTime_AGSM" SG_ 1956 MessageCounter_HYBRID_RM_MOTORS 0;
BA_ "GenSigTimeoutTime_ADCAM" SG_ 1956 MessageCounter_HYBRID_RM_MOTORS 0;
BA_ "GenSigTimeoutTime_RFHM" SG_ 1956 MotorA_TorqueAchieved 0;
BA_ "GenSigTimeoutTime_MPAD" SG_ 1956 MotorA_TorqueAchieved 0;
BA_ "GenSigTimeoutTime_IPC" SG_ 1956 MotorA_TorqueAchieved 0;
BA_ "GenSigTimeoutTime_GNMM" SG_ 1956 MotorA_TorqueAchieved 0;
BA_ "GenSigTimeoutTime_EVCU2" SG_ 1956 MotorA_TorqueAchieved 0;
BA_ "GenSigTimeoutTime_ESL" SG_ 1956 MotorA_TorqueAchieved 0;
BA_ "GenSigTimeoutTime_ECM" SG_ 1956 MotorA_TorqueAchieved 0;
BA_ "GenSigTimeoutTime_DTCM" SG_ 1956 MotorA_TorqueAchieved 0;
BA_ "GenSigTimeoutTime_DMSM" SG_ 1956 MotorA_TorqueAchieved 0;
BA_ "GenSigTimeoutTime_BSM" SG_ 1956 MotorA_TorqueAchieved 0;
BA_ "GenSigTimeoutTime_AGSM" SG_ 1956 MotorA_TorqueAchieved 0;
BA_ "GenSigTimeoutTime_ADCAM" SG_ 1956 MotorA_TorqueAchieved 0;
BA_ "GenSigStartValue" SG_ 1956 MotorA_TorqueAchieved 4096;
BA_ "GenSigTimeoutTime_DMSM" SG_ 1956 CRC_HYBRID_RM_MOTORS 0;
BA_ "GenSigTimeoutTime_BSM" SG_ 1956 CRC_HYBRID_RM_MOTORS 0;
BA_ "GenSigTimeoutTime_BCM" SG_ 1956 CRC_HYBRID_RM_MOTORS 0;
BA_ "GenSigTimeoutTime_AGSM" SG_ 1956 CRC_HYBRID_RM_MOTORS 0;
BA_ "GenSigTimeoutTime_ADCAM" SG_ 1956 CRC_HYBRID_RM_MOTORS 0;
BA_ "GenSigTimeoutTime_SGW" SG_ 1033 Hybrid_AGSPosition 0;
BA_ "GenSigTimeoutTime_RFHM" SG_ 1033 Hybrid_AGSPosition 0;
BA_ "GenSigTimeoutTime_MPAD" SG_ 1033 Hybrid_AGSPosition 0;
BA_ "GenSigTimeoutTime_IPC" SG_ 1033 Hybrid_AGSPosition 0;
BA_ "GenSigTimeoutTime_GNMM" SG_ 1033 Hybrid_AGSPosition 0;
BA_ "GenSigTimeoutTime_EVCU2" SG_ 1033 Hybrid_AGSPosition 0;
BA_ "GenSigTimeoutTime_ESL" SG_ 1033 Hybrid_AGSPosition 0;
BA_ "GenSigTimeoutTime_DTCM" SG_ 1033 Hybrid_AGSPosition 0;
BA_ "GenSigTimeoutTime_DMSM" SG_ 1033 Hybrid_AGSPosition 0;
BA_ "GenSigTimeoutTime_BSM" SG_ 1033 Hybrid_AGSPosition 0;
BA_ "GenSigTimeoutTime_BCM" SG_ 1033 Hybrid_AGSPosition 0;
BA_ "GenSigTimeoutTime_AGSM" SG_ 1033 Hybrid_AGSPosition 0;
BA_ "GenSigTimeoutTime_ADCAM" SG_ 1033 Hybrid_AGSPosition 0;
BA_ "GenSigTimeoutTime_SGW" SG_ 1033 Hybrid_AGS2Position 0;
BA_ "GenSigTimeoutTime_RFHM" SG_ 1033 Hybrid_AGS2Position 0;
BA_ "GenSigTimeoutTime_MPAD" SG_ 1033 Hybrid_AGS2Position 0;
BA_ "GenSigTimeoutTime_IPC" SG_ 1033 Hybrid_AGS2Position 0;
BA_ "GenSigTimeoutTime_GNMM" SG_ 1033 Hybrid_AGS2Position 0;
BA_ "GenSigTimeoutTime_EVCU2" SG_ 1033 Hybrid_AGS2Position 0;
BA_ "GenSigTimeoutTime_ESL" SG_ 1033 Hybrid_AGS2Position 0;
BA_ "GenSigTimeoutTime_DTCM" SG_ 1033 Hybrid_AGS2Position 0;
BA_ "GenSigTimeoutTime_DMSM" SG_ 1033 Hybrid_AGS2Position 0;
BA_ "GenSigTimeoutTime_BSM" SG_ 1033 Hybrid_AGS2Position 0;
BA_ "GenSigTimeoutTime_BCM" SG_ 1033 Hybrid_AGS2Position 0;
BA_ "GenSigTimeoutTime_AGSM" SG_ 1033 Hybrid_AGS2Position 0;
BA_ "GenSigTimeoutTime_ADCAM" SG_ 1033 Hybrid_AGS2Position 0;
BA_ "GenSigTimeoutTime_RFHM" SG_ 1033 BattPowerUse_Display 0;
BA_ "GenSigTimeoutTime_MPAD" SG_ 1033 BattPowerUse_Display 0;
BA_ "GenSigTimeoutTime_GNMM" SG_ 1033 BattPowerUse_Display 0;
BA_ "GenSigTimeoutTime_EVCU2" SG_ 1033 BattPowerUse_Display 0;
BA_ "GenSigTimeoutTime_ESL" SG_ 1033 BattPowerUse_Display 0;
BA_ "GenSigTimeoutTime_ECM" SG_ 1033 BattPowerUse_Display 0;
BA_ "GenSigTimeoutTime_DTCM" SG_ 1033 BattPowerUse_Display 0;
BA_ "GenSigTimeoutTime_DMSM" SG_ 1033 BattPowerUse_Display 0;
BA_ "GenSigTimeoutTime_BSM" SG_ 1033 BattPowerUse_Display 0;
BA_ "GenSigTimeoutTime_BCM" SG_ 1033 BattPowerUse_Display 0;
BA_ "GenSigTimeoutTime_AGSM" SG_ 1033 BattPowerUse_Display 0;
BA_ "GenSigTimeoutTime_ADCAM" SG_ 1033 BattPowerUse_Display 0;
BA_ "GenSigTimeoutTime_RFHM" SG_ 1033 MotorsPowerUse_Display 0;
BA_ "GenSigTimeoutTime_MPAD" SG_ 1033 MotorsPowerUse_Display 0;
BA_ "GenSigTimeoutTime_IPC" SG_ 1033 MotorsPowerUse_Display 0;
BA_ "GenSigTimeoutTime_GNMM" SG_ 1033 MotorsPowerUse_Display 0;
BA_ "GenSigTimeoutTime_EVCU2" SG_ 1033 MotorsPowerUse_Display 0;
BA_ "GenSigTimeoutTime_ESL" SG_ 1033 MotorsPowerUse_Display 0;
BA_ "GenSigTimeoutTime_ECM" SG_ 1033 MotorsPowerUse_Display 0;
BA_ "GenSigTimeoutTime_DTCM" SG_ 1033 MotorsPowerUse_Display 0;
BA_ "GenSigTimeoutTime_DMSM" SG_ 1033 MotorsPowerUse_Display 0;
BA_ "GenSigTimeoutTime_BSM" SG_ 1033 MotorsPowerUse_Display 0;
BA_ "GenSigTimeoutTime_BCM" SG_ 1033 MotorsPowerUse_Display 0;
BA_ "GenSigTimeoutTime_AGSM" SG_ 1033 MotorsPowerUse_Display 0;
BA_ "GenSigTimeoutTime_ADCAM" SG_ 1033 MotorsPowerUse_Display 0;
BA_ "GenSigTimeoutTime_RFHM" SG_ 1033 MotorsPowerUse_DisplayV 0;
BA_ "GenSigTimeoutTime_MPAD" SG_ 1033 MotorsPowerUse_DisplayV 0;
BA_ "GenSigTimeoutTime_IPC" SG_ 1033 MotorsPowerUse_DisplayV 0;
BA_ "GenSigTimeoutTime_GNMM" SG_ 1033 MotorsPowerUse_DisplayV 0;
BA_ "GenSigTimeoutTime_EVCU2" SG_ 1033 MotorsPowerUse_DisplayV 0;
BA_ "GenSigTimeoutTime_ESL" SG_ 1033 MotorsPowerUse_DisplayV 0;
BA_ "GenSigTimeoutTime_ECM" SG_ 1033 MotorsPowerUse_DisplayV 0;
BA_ "GenSigTimeoutTime_DTCM" SG_ 1033 MotorsPowerUse_DisplayV 0;
BA_ "GenSigTimeoutTime_DMSM" SG_ 1033 MotorsPowerUse_DisplayV 0;
BA_ "GenSigTimeoutTime_BSM" SG_ 1033 MotorsPowerUse_DisplayV 0;
BA_ "GenSigTimeoutTime_BCM" SG_ 1033 MotorsPowerUse_DisplayV 0;
BA_ "GenSigTimeoutTime_AGSM" SG_ 1033 MotorsPowerUse_DisplayV 0;
BA_ "GenSigTimeoutTime_ADCAM" SG_ 1033 MotorsPowerUse_DisplayV 0;
BA_ "GenSigTimeoutTime_RFHM" SG_ 1033 BattPowerUse_DisplayV 0;
BA_ "GenSigTimeoutTime_MPAD" SG_ 1033 BattPowerUse_DisplayV 0;
BA_ "GenSigTimeoutTime_GNMM" SG_ 1033 BattPowerUse_DisplayV 0;
BA_ "GenSigTimeoutTime_EVCU2" SG_ 1033 BattPowerUse_DisplayV 0;
BA_ "GenSigTimeoutTime_ESL" SG_ 1033 BattPowerUse_DisplayV 0;
BA_ "GenSigTimeoutTime_ECM" SG_ 1033 BattPowerUse_DisplayV 0;
BA_ "GenSigTimeoutTime_DTCM" SG_ 1033 BattPowerUse_DisplayV 0;
BA_ "GenSigTimeoutTime_DMSM" SG_ 1033 BattPowerUse_DisplayV 0;
BA_ "GenSigTimeoutTime_BSM" SG_ 1033 BattPowerUse_DisplayV 0;
BA_ "GenSigTimeoutTime_BCM" SG_ 1033 BattPowerUse_DisplayV 0;
BA_ "GenSigTimeoutTime_AGSM" SG_ 1033 BattPowerUse_DisplayV 0;
BA_ "GenSigTimeoutTime_ADCAM" SG_ 1033 BattPowerUse_DisplayV 0;
BA_ "GenSigTimeoutTime_RFHM" SG_ 1033 Motor1PowerUse_Display 0;
BA_ "GenSigTimeoutTime_MPAD" SG_ 1033 Motor1PowerUse_Display 0;
BA_ "GenSigTimeoutTime_IPC" SG_ 1033 Motor1PowerUse_Display 0;
BA_ "GenSigTimeoutTime_GNMM" SG_ 1033 Motor1PowerUse_Display 0;
BA_ "GenSigTimeoutTime_EVCU2" SG_ 1033 Motor1PowerUse_Display 0;
BA_ "GenSigTimeoutTime_ESL" SG_ 1033 Motor1PowerUse_Display 0;
BA_ "GenSigTimeoutTime_ECM" SG_ 1033 Motor1PowerUse_Display 0;
BA_ "GenSigTimeoutTime_DTCM" SG_ 1033 Motor1PowerUse_Display 0;
BA_ "GenSigTimeoutTime_DMSM" SG_ 1033 Motor1PowerUse_Display 0;
BA_ "GenSigTimeoutTime_BSM" SG_ 1033 Motor1PowerUse_Display 0;
BA_ "GenSigTimeoutTime_BCM" SG_ 1033 Motor1PowerUse_Display 0;
BA_ "GenSigTimeoutTime_AGSM" SG_ 1033 Motor1PowerUse_Display 0;
BA_ "GenSigTimeoutTime_ADCAM" SG_ 1033 Motor1PowerUse_Display 0;
BA_ "GenSigTimeoutTime_RFHM" SG_ 1033 Motor1PowerUse_DisplayV 0;
BA_ "GenSigTimeoutTime_MPAD" SG_ 1033 Motor1PowerUse_DisplayV 0;
BA_ "GenSigTimeoutTime_IPC" SG_ 1033 Motor1PowerUse_DisplayV 0;
BA_ "GenSigTimeoutTime_GNMM" SG_ 1033 Motor1PowerUse_DisplayV 0;
BA_ "GenSigTimeoutTime_EVCU2" SG_ 1033 Motor1PowerUse_DisplayV 0;
BA_ "GenSigTimeoutTime_ESL" SG_ 1033 Motor1PowerUse_DisplayV 0;
BA_ "GenSigTimeoutTime_ECM" SG_ 1033 Motor1PowerUse_DisplayV 0;
BA_ "GenSigTimeoutTime_DTCM" SG_ 1033 Motor1PowerUse_DisplayV 0;
BA_ "GenSigTimeoutTime_DMSM" SG_ 1033 Motor1PowerUse_DisplayV 0;
BA_ "GenSigTimeoutTime_BSM" SG_ 1033 Motor1PowerUse_DisplayV 0;
BA_ "GenSigTimeoutTime_BCM" SG_ 1033 Motor1PowerUse_DisplayV 0;
BA_ "GenSigTimeoutTime_AGSM" SG_ 1033 Motor1PowerUse_DisplayV 0;
BA_ "GenSigTimeoutTime_ADCAM" SG_ 1033 Motor1PowerUse_DisplayV 0;
BA_ "GenSigTimeoutTime_RFHM" SG_ 1033 Motor2PowerUse_DisplayV 0;
BA_ "GenSigTimeoutTime_MPAD" SG_ 1033 Motor2PowerUse_DisplayV 0;
BA_ "GenSigTimeoutTime_IPC" SG_ 1033 Motor2PowerUse_DisplayV 0;
BA_ "GenSigTimeoutTime_GNMM" SG_ 1033 Motor2PowerUse_DisplayV 0;
BA_ "GenSigTimeoutTime_EVCU2" SG_ 1033 Motor2PowerUse_DisplayV 0;
BA_ "GenSigTimeoutTime_ESL" SG_ 1033 Motor2PowerUse_DisplayV 0;
BA_ "GenSigTimeoutTime_ECM" SG_ 1033 Motor2PowerUse_DisplayV 0;
BA_ "GenSigTimeoutTime_DTCM" SG_ 1033 Motor2PowerUse_DisplayV 0;
BA_ "GenSigTimeoutTime_DMSM" SG_ 1033 Motor2PowerUse_DisplayV 0;
BA_ "GenSigTimeoutTime_BSM" SG_ 1033 Motor2PowerUse_DisplayV 0;
BA_ "GenSigTimeoutTime_BCM" SG_ 1033 Motor2PowerUse_DisplayV 0;
BA_ "GenSigTimeoutTime_AGSM" SG_ 1033 Motor2PowerUse_DisplayV 0;
BA_ "GenSigTimeoutTime_ADCAM" SG_ 1033 Motor2PowerUse_DisplayV 0;
BA_ "GenSigTimeoutTime_SGW" SG_ 1033 HybridEmissionsMalfunction 0;
BA_ "GenSigTimeoutTime_RFHM" SG_ 1033 HybridEmissionsMalfunction 0;
BA_ "GenSigTimeoutTime_MPAD" SG_ 1033 HybridEmissionsMalfunction 0;
BA_ "GenSigTimeoutTime_IPC" SG_ 1033 HybridEmissionsMalfunction 0;
BA_ "GenSigTimeoutTime_GNMM" SG_ 1033 HybridEmissionsMalfunction 0;
BA_ "GenSigTimeoutTime_EVCU2" SG_ 1033 HybridEmissionsMalfunction 0;
BA_ "GenSigTimeoutTime_ESL" SG_ 1033 HybridEmissionsMalfunction 0;
BA_ "GenSigTimeoutTime_ECM" SG_ 1033 HybridEmissionsMalfunction 0;
BA_ "GenSigTimeoutTime_DTCM" SG_ 1033 HybridEmissionsMalfunction 0;
BA_ "GenSigTimeoutTime_DMSM" SG_ 1033 HybridEmissionsMalfunction 0;
BA_ "GenSigTimeoutTime_BSM" SG_ 1033 HybridEmissionsMalfunction 0;
BA_ "GenSigTimeoutTime_BCM" SG_ 1033 HybridEmissionsMalfunction 0;
BA_ "GenSigTimeoutTime_AGSM" SG_ 1033 HybridEmissionsMalfunction 0;
BA_ "GenSigTimeoutTime_ADCAM" SG_ 1033 HybridEmissionsMalfunction 0;
BA_ "GenSigTimeoutTime_RFHM" SG_ 1033 Hybrid_EVT_ModeSts 0;
BA_ "GenSigTimeoutTime_MPAD" SG_ 1033 Hybrid_EVT_ModeSts 0;
BA_ "GenSigTimeoutTime_IPC" SG_ 1033 Hybrid_EVT_ModeSts 0;
BA_ "GenSigTimeoutTime_GNMM" SG_ 1033 Hybrid_EVT_ModeSts 0;
BA_ "GenSigTimeoutTime_EVCU2" SG_ 1033 Hybrid_EVT_ModeSts 0;
BA_ "GenSigTimeoutTime_ESL" SG_ 1033 Hybrid_EVT_ModeSts 0;
BA_ "GenSigTimeoutTime_ECM" SG_ 1033 Hybrid_EVT_ModeSts 0;
BA_ "GenSigTimeoutTime_DTCM" SG_ 1033 Hybrid_EVT_ModeSts 0;
BA_ "GenSigTimeoutTime_DMSM" SG_ 1033 Hybrid_EVT_ModeSts 0;
BA_ "GenSigTimeoutTime_BSM" SG_ 1033 Hybrid_EVT_ModeSts 0;
BA_ "GenSigTimeoutTime_AGSM" SG_ 1033 Hybrid_EVT_ModeSts 0;
BA_ "GenSigTimeoutTime_ADCAM" SG_ 1033 Hybrid_EVT_ModeSts 0;
BA_ "GenSigTimeoutTime_RFHM" SG_ 1033 Motor2PowerUse_Display 0;
BA_ "GenSigTimeoutTime_MPAD" SG_ 1033 Motor2PowerUse_Display 0;
BA_ "GenSigTimeoutTime_IPC" SG_ 1033 Motor2PowerUse_Display 0;
BA_ "GenSigTimeoutTime_GNMM" SG_ 1033 Motor2PowerUse_Display 0;
BA_ "GenSigTimeoutTime_EVCU2" SG_ 1033 Motor2PowerUse_Display 0;
BA_ "GenSigTimeoutTime_ESL" SG_ 1033 Motor2PowerUse_Display 0;
BA_ "GenSigTimeoutTime_ECM" SG_ 1033 Motor2PowerUse_Display 0;
BA_ "GenSigTimeoutTime_DTCM" SG_ 1033 Motor2PowerUse_Display 0;
BA_ "GenSigTimeoutTime_DMSM" SG_ 1033 Motor2PowerUse_Display 0;
BA_ "GenSigTimeoutTime_BSM" SG_ 1033 Motor2PowerUse_Display 0;
BA_ "GenSigTimeoutTime_BCM" SG_ 1033 Motor2PowerUse_Display 0;
BA_ "GenSigTimeoutTime_AGSM" SG_ 1033 Motor2PowerUse_Display 0;
BA_ "GenSigTimeoutTime_ADCAM" SG_ 1033 Motor2PowerUse_Display 0;
BA_ "GenSigTimeoutTime_SGW" SG_ 1952 HVBatCritCondT 0;
BA_ "GenSigTimeoutTime_RFHM" SG_ 1952 HVBatCritCondT 0;
BA_ "GenSigTimeoutTime_MPAD" SG_ 1952 HVBatCritCondT 0;
BA_ "GenSigTimeoutTime_IPC" SG_ 1952 HVBatCritCondT 0;
BA_ "GenSigTimeoutTime_GNMM" SG_ 1952 HVBatCritCondT 0;
BA_ "GenSigTimeoutTime_EVCU2" SG_ 1952 HVBatCritCondT 0;
BA_ "GenSigTimeoutTime_ESL" SG_ 1952 HVBatCritCondT 0;
BA_ "GenSigTimeoutTime_ECM" SG_ 1952 HVBatCritCondT 0;
BA_ "GenSigTimeoutTime_DTCM" SG_ 1952 HVBatCritCondT 0;
BA_ "GenSigTimeoutTime_DMSM" SG_ 1952 HVBatCritCondT 0;
BA_ "GenSigTimeoutTime_BSM" SG_ 1952 HVBatCritCondT 0;
BA_ "GenSigTimeoutTime_AGSM" SG_ 1952 HVBatCritCondT 0;
BA_ "GenSigTimeoutTime_ADCAM" SG_ 1952 HVBatCritCondT 0;
BA_ "GenSigSendType" SG_ 1952 HVBatCritCondT 3;
BA_ "GenSigTimeoutTime_SGW" SG_ 1952 FRfShVlvSts 0;
BA_ "GenSigTimeoutTime_RFHM" SG_ 1952 FRfShVlvSts 0;
BA_ "GenSigTimeoutTime_MPAD" SG_ 1952 FRfShVlvSts 0;
BA_ "GenSigTimeoutTime_IPC" SG_ 1952 FRfShVlvSts 0;
BA_ "GenSigTimeoutTime_GNMM" SG_ 1952 FRfShVlvSts 0;
BA_ "GenSigTimeoutTime_EVCU2" SG_ 1952 FRfShVlvSts 0;
BA_ "GenSigTimeoutTime_ESL" SG_ 1952 FRfShVlvSts 0;
BA_ "GenSigTimeoutTime_ECM" SG_ 1952 FRfShVlvSts 0;
BA_ "GenSigTimeoutTime_DTCM" SG_ 1952 FRfShVlvSts 0;
BA_ "GenSigTimeoutTime_DMSM" SG_ 1952 FRfShVlvSts 0;
BA_ "GenSigTimeoutTime_BSM" SG_ 1952 FRfShVlvSts 0;
BA_ "GenSigTimeoutTime_BCM" SG_ 1952 FRfShVlvSts 0;
BA_ "GenSigTimeoutTime_AGSM" SG_ 1952 FRfShVlvSts 0;
BA_ "GenSigTimeoutTime_ADCAM" SG_ 1952 FRfShVlvSts 0;
BA_ "GenSigSendType" SG_ 1952 FRfShVlvSts 3;
BA_ "GenSigTimeoutTime_SGW" SG_ 1952 HTAuxPmpMontrngRPM 0;
BA_ "GenSigTimeoutTime_RFHM" SG_ 1952 HTAuxPmpMontrngRPM 0;
BA_ "GenSigTimeoutTime_MPAD" SG_ 1952 HTAuxPmpMontrngRPM 0;
BA_ "GenSigTimeoutTime_IPC" SG_ 1952 HTAuxPmpMontrngRPM 0;
BA_ "GenSigTimeoutTime_GNMM" SG_ 1952 HTAuxPmpMontrngRPM 0;
BA_ "GenSigTimeoutTime_EVCU2" SG_ 1952 HTAuxPmpMontrngRPM 0;
BA_ "GenSigTimeoutTime_ESL" SG_ 1952 HTAuxPmpMontrngRPM 0;
BA_ "GenSigTimeoutTime_DTCM" SG_ 1952 HTAuxPmpMontrngRPM 0;
BA_ "GenSigTimeoutTime_DMSM" SG_ 1952 HTAuxPmpMontrngRPM 0;
BA_ "GenSigTimeoutTime_BSM" SG_ 1952 HTAuxPmpMontrngRPM 0;
BA_ "GenSigTimeoutTime_BCM" SG_ 1952 HTAuxPmpMontrngRPM 0;
BA_ "GenSigTimeoutTime_AGSM" SG_ 1952 HTAuxPmpMontrngRPM 0;
BA_ "GenSigTimeoutTime_ADCAM" SG_ 1952 HTAuxPmpMontrngRPM 0;
BA_ "GenSigSendType" SG_ 1952 HTAuxPmpMontrngRPM 3;
BA_ "GenSigStartValue" SG_ 1952 HTAuxPmpMontrngRPM 3;
BA_ "GenSigTimeoutTime_SGW" SG_ 1952 MessageCounter_HYBRID_HVAC 0;
BA_ "GenSigTimeoutTime_RFHM" SG_ 1952 MessageCounter_HYBRID_HVAC 0;
BA_ "GenSigTimeoutTime_MPAD" SG_ 1952 MessageCounter_HYBRID_HVAC 0;
BA_ "GenSigTimeoutTime_IPC" SG_ 1952 MessageCounter_HYBRID_HVAC 0;
BA_ "GenSigTimeoutTime_GNMM" SG_ 1952 MessageCounter_HYBRID_HVAC 0;
BA_ "GenSigTimeoutTime_EVCU2" SG_ 1952 MessageCounter_HYBRID_HVAC 0;
BA_ "GenSigTimeoutTime_ESL" SG_ 1952 MessageCounter_HYBRID_HVAC 0;
BA_ "GenSigTimeoutTime_ECM" SG_ 1952 MessageCounter_HYBRID_HVAC 0;
BA_ "GenSigTimeoutTime_DTCM" SG_ 1952 MessageCounter_HYBRID_HVAC 0;
BA_ "GenSigTimeoutTime_DMSM" SG_ 1952 MessageCounter_HYBRID_HVAC 0;
BA_ "GenSigTimeoutTime_BSM" SG_ 1952 MessageCounter_HYBRID_HVAC 0;
BA_ "GenSigTimeoutTime_AGSM" SG_ 1952 MessageCounter_HYBRID_HVAC 0;
BA_ "GenSigTimeoutTime_ADCAM" SG_ 1952 MessageCounter_HYBRID_HVAC 0;
BA_ "GenSigTimeoutTime_SGW" SG_ 1952 CRC_HYBRID_HVAC 0;
BA_ "GenSigTimeoutTime_RFHM" SG_ 1952 CRC_HYBRID_HVAC 0;
BA_ "GenSigTimeoutTime_MPAD" SG_ 1952 CRC_HYBRID_HVAC 0;
BA_ "GenSigTimeoutTime_IPC" SG_ 1952 CRC_HYBRID_HVAC 0;
BA_ "GenSigTimeoutTime_GNMM" SG_ 1952 CRC_HYBRID_HVAC 0;
BA_ "GenSigTimeoutTime_EVCU2" SG_ 1952 CRC_HYBRID_HVAC 0;
BA_ "GenSigTimeoutTime_ESL" SG_ 1952 CRC_HYBRID_HVAC 0;
BA_ "GenSigTimeoutTime_ECM" SG_ 1952 CRC_HYBRID_HVAC 0;
BA_ "GenSigTimeoutTime_DTCM" SG_ 1952 CRC_HYBRID_HVAC 0;
BA_ "GenSigTimeoutTime_DMSM" SG_ 1952 CRC_HYBRID_HVAC 0;
BA_ "GenSigTimeoutTime_BSM" SG_ 1952 CRC_HYBRID_HVAC 0;
BA_ "GenSigTimeoutTime_AGSM" SG_ 1952 CRC_HYBRID_HVAC 0;
BA_ "GenSigTimeoutTime_ADCAM" SG_ 1952 CRC_HYBRID_HVAC 0;
BA_ "GenSigTimeoutTime_RFHM" SG_ 1049 Regen_Status 0;
BA_ "GenSigTimeoutTime_MPAD" SG_ 1049 Regen_Status 0;
BA_ "GenSigTimeoutTime_GNMM" SG_ 1049 Regen_Status 0;
BA_ "GenSigTimeoutTime_EVCU2" SG_ 1049 Regen_Status 0;
BA_ "GenSigTimeoutTime_ESL" SG_ 1049 Regen_Status 0;
BA_ "GenSigTimeoutTime_ECM" SG_ 1049 Regen_Status 0;
BA_ "GenSigTimeoutTime_DTCM" SG_ 1049 Regen_Status 0;
BA_ "GenSigTimeoutTime_DMSM" SG_ 1049 Regen_Status 0;
BA_ "GenSigTimeoutTime_BSM" SG_ 1049 Regen_Status 0;
BA_ "GenSigTimeoutTime_BCM" SG_ 1049 Regen_Status 0;
BA_ "GenSigTimeoutTime_AGSM" SG_ 1049 Regen_Status 0;
BA_ "GenSigTimeoutTime_ADCAM" SG_ 1049 Regen_Status 0;
BA_ "GenSigTimeoutTime_GNMM" SG_ 1049 PopUpMessage9 0;
BA_ "GenSigTimeoutTime_EVCU2" SG_ 1049 PopUpMessage9 0;
BA_ "GenSigTimeoutTime_ESL" SG_ 1049 PopUpMessage9 0;
BA_ "GenSigTimeoutTime_ECM" SG_ 1049 PopUpMessage9 0;
BA_ "GenSigTimeoutTime_DTCM" SG_ 1049 PopUpMessage9 0;
BA_ "GenSigTimeoutTime_DMSM" SG_ 1049 PopUpMessage9 0;
BA_ "GenSigTimeoutTime_BSM" SG_ 1049 PopUpMessage9 0;
BA_ "GenSigTimeoutTime_BCM" SG_ 1049 PopUpMessage9 0;
BA_ "GenSigTimeoutTime_AGSM" SG_ 1049 PopUpMessage9 0;
BA_ "GenSigTimeoutTime_ADCAM" SG_ 1049 PopUpMessage9 0;
BA_ "GenSigTimeoutTime_SGW" SG_ 1049 PopUpMessage9 0;
BA_ "GenSigTimeoutTime_RFHM" SG_ 1049 PopUpMessage9 0;
BA_ "GenSigTimeoutTime_MPAD" SG_ 1049 PopUpMessage9 0;
BA_ "GenSigTimeoutTime_SGW" SG_ 1049 PopUpMessage6 0;
BA_ "GenSigTimeoutTime_RFHM" SG_ 1049 PopUpMessage6 0;
BA_ "GenSigTimeoutTime_MPAD" SG_ 1049 PopUpMessage6 0;
BA_ "GenSigTimeoutTime_GNMM" SG_ 1049 PopUpMessage6 0;
BA_ "GenSigTimeoutTime_EVCU2" SG_ 1049 PopUpMessage6 0;
BA_ "GenSigTimeoutTime_ESL" SG_ 1049 PopUpMessage6 0;
BA_ "GenSigTimeoutTime_ECM" SG_ 1049 PopUpMessage6 0;
BA_ "GenSigTimeoutTime_DTCM" SG_ 1049 PopUpMessage6 0;
BA_ "GenSigTimeoutTime_DMSM" SG_ 1049 PopUpMessage6 0;
BA_ "GenSigTimeoutTime_BSM" SG_ 1049 PopUpMessage6 0;
BA_ "GenSigTimeoutTime_BCM" SG_ 1049 PopUpMessage6 0;
BA_ "GenSigTimeoutTime_SGW" SG_ 1049 PopUpMessage7 0;
BA_ "GenSigTimeoutTime_RFHM" SG_ 1049 PopUpMessage7 0;
BA_ "GenSigTimeoutTime_MPAD" SG_ 1049 PopUpMessage7 0;
BA_ "GenSigTimeoutTime_GNMM" SG_ 1049 PopUpMessage7 0;
BA_ "GenSigTimeoutTime_EVCU2" SG_ 1049 PopUpMessage7 0;
BA_ "GenSigTimeoutTime_ESL" SG_ 1049 PopUpMessage7 0;
BA_ "GenSigTimeoutTime_ECM" SG_ 1049 PopUpMessage7 0;
BA_ "GenSigTimeoutTime_DTCM" SG_ 1049 PopUpMessage7 0;
BA_ "GenSigTimeoutTime_DMSM" SG_ 1049 PopUpMessage7 0;
BA_ "GenSigTimeoutTime_BSM" SG_ 1049 PopUpMessage7 0;
BA_ "GenSigTimeoutTime_BCM" SG_ 1049 PopUpMessage7 0;
BA_ "GenSigTimeoutTime_AGSM" SG_ 1049 PopUpMessage7 0;
BA_ "GenSigTimeoutTime_ADCAM" SG_ 1049 PopUpMessage7 0;
BA_ "GenSigTimeoutTime_RFHM" SG_ 1952 CabinConditioningSts 0;
BA_ "GenSigTimeoutTime_MPAD" SG_ 1952 CabinConditioningSts 0;
BA_ "GenSigTimeoutTime_IPC" SG_ 1952 CabinConditioningSts 0;
BA_ "GenSigTimeoutTime_GNMM" SG_ 1952 CabinConditioningSts 0;
BA_ "GenSigTimeoutTime_EVCU2" SG_ 1952 CabinConditioningSts 0;
BA_ "GenSigTimeoutTime_ESL" SG_ 1952 CabinConditioningSts 0;
BA_ "GenSigTimeoutTime_ECM" SG_ 1952 CabinConditioningSts 0;
BA_ "GenSigTimeoutTime_DTCM" SG_ 1952 CabinConditioningSts 0;
BA_ "GenSigTimeoutTime_DMSM" SG_ 1952 CabinConditioningSts 0;
BA_ "GenSigTimeoutTime_BSM" SG_ 1952 CabinConditioningSts 0;
BA_ "GenSigTimeoutTime_AGSM" SG_ 1952 CabinConditioningSts 0;
BA_ "GenSigTimeoutTime_ADCAM" SG_ 1952 CabinConditioningSts 0;
BA_ "GenSigSendType" SG_ 1952 CabinConditioningSts 3;
BA_ "GenSigTimeoutTime_RFHM" SG_ 1049 Lv2_EstChargeTime 0;
BA_ "GenSigTimeoutTime_MPAD" SG_ 1049 Lv2_EstChargeTime 0;
BA_ "GenSigTimeoutTime_GNMM" SG_ 1049 Lv2_EstChargeTime 0;
BA_ "GenSigTimeoutTime_EVCU2" SG_ 1049 Lv2_EstChargeTime 0;
BA_ "GenSigTimeoutTime_ESL" SG_ 1049 Lv2_EstChargeTime 0;
BA_ "GenSigTimeoutTime_ECM" SG_ 1049 Lv2_EstChargeTime 0;
BA_ "GenSigTimeoutTime_DTCM" SG_ 1049 Lv2_EstChargeTime 0;
BA_ "GenSigTimeoutTime_DMSM" SG_ 1049 Lv2_EstChargeTime 0;
BA_ "GenSigTimeoutTime_BSM" SG_ 1049 Lv2_EstChargeTime 0;
BA_ "GenSigTimeoutTime_BCM" SG_ 1049 Lv2_EstChargeTime 0;
BA_ "GenSigTimeoutTime_AGSM" SG_ 1049 Lv2_EstChargeTime 0;
BA_ "GenSigTimeoutTime_ADCAM" SG_ 1049 Lv2_EstChargeTime 0;
BA_ "GenSigSendType" SG_ 1049 Lv2_EstChargeTime 3;
BA_ "GenSigTimeoutTime_SGW" SG_ 1049 HybridEfficiencyCoach 0;
BA_ "GenSigTimeoutTime_RFHM" SG_ 1049 HybridEfficiencyCoach 0;
BA_ "GenSigTimeoutTime_MPAD" SG_ 1049 HybridEfficiencyCoach 0;
BA_ "GenSigTimeoutTime_IPC" SG_ 1049 HybridEfficiencyCoach 0;
BA_ "GenSigTimeoutTime_GNMM" SG_ 1049 HybridEfficiencyCoach 0;
BA_ "GenSigTimeoutTime_EVCU2" SG_ 1049 HybridEfficiencyCoach 0;
BA_ "GenSigTimeoutTime_ESL" SG_ 1049 HybridEfficiencyCoach 0;
BA_ "GenSigTimeoutTime_ECM" SG_ 1049 HybridEfficiencyCoach 0;
BA_ "GenSigTimeoutTime_DTCM" SG_ 1049 HybridEfficiencyCoach 0;
BA_ "GenSigTimeoutTime_DMSM" SG_ 1049 HybridEfficiencyCoach 0;
BA_ "GenSigTimeoutTime_BSM" SG_ 1049 HybridEfficiencyCoach 0;
BA_ "GenSigTimeoutTime_BCM" SG_ 1049 HybridEfficiencyCoach 0;
BA_ "GenSigTimeoutTime_AGSM" SG_ 1049 HybridEfficiencyCoach 0;
BA_ "GenSigTimeoutTime_ADCAM" SG_ 1049 HybridEfficiencyCoach 0;
BA_ "GenSigStartValue" SG_ 1049 HybridEfficiencyCoach 64;
BA_ "GenSigTimeoutTime_RFHM" SG_ 1049 HybridOutputPower 0;
BA_ "GenSigTimeoutTime_MPAD" SG_ 1049 HybridOutputPower 0;
BA_ "GenSigTimeoutTime_GNMM" SG_ 1049 HybridOutputPower 0;
BA_ "GenSigTimeoutTime_EVCU2" SG_ 1049 HybridOutputPower 0;
BA_ "GenSigTimeoutTime_ESL" SG_ 1049 HybridOutputPower 0;
BA_ "GenSigTimeoutTime_ECM" SG_ 1049 HybridOutputPower 0;
BA_ "GenSigTimeoutTime_DTCM" SG_ 1049 HybridOutputPower 0;
BA_ "GenSigTimeoutTime_DMSM" SG_ 1049 HybridOutputPower 0;
BA_ "GenSigTimeoutTime_BSM" SG_ 1049 HybridOutputPower 0;
BA_ "GenSigTimeoutTime_BCM" SG_ 1049 HybridOutputPower 0;
BA_ "GenSigTimeoutTime_AGSM" SG_ 1049 HybridOutputPower 0;
BA_ "GenSigTimeoutTime_ADCAM" SG_ 1049 HybridOutputPower 0;
BA_ "GenSigStartValue" SG_ 1049 HybridOutputPower 64;
BA_ "GenSigTimeoutTime_RFHM" SG_ 1049 Lv1_EstChargeTime 0;
BA_ "GenSigTimeoutTime_MPAD" SG_ 1049 Lv1_EstChargeTime 0;
BA_ "GenSigTimeoutTime_GNMM" SG_ 1049 Lv1_EstChargeTime 0;
BA_ "GenSigTimeoutTime_EVCU2" SG_ 1049 Lv1_EstChargeTime 0;
BA_ "GenSigTimeoutTime_ESL" SG_ 1049 Lv1_EstChargeTime 0;
BA_ "GenSigTimeoutTime_ECM" SG_ 1049 Lv1_EstChargeTime 0;
BA_ "GenSigTimeoutTime_DTCM" SG_ 1049 Lv1_EstChargeTime 0;
BA_ "GenSigTimeoutTime_DMSM" SG_ 1049 Lv1_EstChargeTime 0;
BA_ "GenSigTimeoutTime_BSM" SG_ 1049 Lv1_EstChargeTime 0;
BA_ "GenSigTimeoutTime_BCM" SG_ 1049 Lv1_EstChargeTime 0;
BA_ "GenSigTimeoutTime_AGSM" SG_ 1049 Lv1_EstChargeTime 0;
BA_ "GenSigTimeoutTime_ADCAM" SG_ 1049 Lv1_EstChargeTime 0;
BA_ "GenSigSendType" SG_ 1049 Lv1_EstChargeTime 3;
BA_ "GenSigTimeoutTime_AGSM" SG_ 1049 PopUpMessage6 0;
BA_ "GenSigTimeoutTime_ADCAM" SG_ 1049 PopUpMessage6 0;
BA_ "GenSigTimeoutTime_SGW" SG_ 1049 PopUpMessage4 0;
BA_ "GenSigTimeoutTime_RFHM" SG_ 1049 PopUpMessage4 0;
BA_ "GenSigTimeoutTime_MPAD" SG_ 1049 PopUpMessage4 0;
BA_ "GenSigTimeoutTime_GNMM" SG_ 1049 PopUpMessage4 0;
BA_ "GenSigTimeoutTime_EVCU2" SG_ 1049 PopUpMessage4 0;
BA_ "GenSigTimeoutTime_ESL" SG_ 1049 PopUpMessage4 0;
BA_ "GenSigTimeoutTime_ECM" SG_ 1049 PopUpMessage4 0;
BA_ "GenSigTimeoutTime_DTCM" SG_ 1049 PopUpMessage4 0;
BA_ "GenSigTimeoutTime_DMSM" SG_ 1049 PopUpMessage4 0;
BA_ "GenSigTimeoutTime_BSM" SG_ 1049 PopUpMessage4 0;
BA_ "GenSigTimeoutTime_BCM" SG_ 1049 PopUpMessage4 0;
BA_ "GenSigTimeoutTime_AGSM" SG_ 1049 PopUpMessage4 0;
BA_ "GenSigTimeoutTime_ADCAM" SG_ 1049 PopUpMessage4 0;
BA_ "GenSigTimeoutTime_SGW" SG_ 1049 PopUpMessage5 0;
BA_ "GenSigTimeoutTime_RFHM" SG_ 1049 PopUpMessage5 0;
BA_ "GenSigTimeoutTime_MPAD" SG_ 1049 PopUpMessage5 0;
BA_ "GenSigTimeoutTime_GNMM" SG_ 1049 PopUpMessage5 0;
BA_ "GenSigTimeoutTime_EVCU2" SG_ 1049 PopUpMessage5 0;
BA_ "GenSigTimeoutTime_ESL" SG_ 1049 PopUpMessage5 0;
BA_ "GenSigTimeoutTime_ECM" SG_ 1049 PopUpMessage5 0;
BA_ "GenSigTimeoutTime_DTCM" SG_ 1049 PopUpMessage5 0;
BA_ "GenSigTimeoutTime_DMSM" SG_ 1049 PopUpMessage5 0;
BA_ "GenSigTimeoutTime_BSM" SG_ 1049 PopUpMessage5 0;
BA_ "GenSigTimeoutTime_BCM" SG_ 1049 PopUpMessage5 0;
BA_ "GenSigTimeoutTime_AGSM" SG_ 1049 PopUpMessage5 0;
BA_ "GenSigTimeoutTime_ADCAM" SG_ 1049 PopUpMessage5 0;
BA_ "GenSigTimeoutTime_SGW" SG_ 1049 PopUpMessage1 0;
BA_ "GenSigTimeoutTime_RFHM" SG_ 1049 PopUpMessage1 0;
BA_ "GenSigTimeoutTime_MPAD" SG_ 1049 PopUpMessage1 0;
BA_ "GenSigTimeoutTime_GNMM" SG_ 1049 PopUpMessage1 0;
BA_ "GenSigTimeoutTime_EVCU2" SG_ 1049 PopUpMessage1 0;
BA_ "GenSigTimeoutTime_ESL" SG_ 1049 PopUpMessage1 0;
BA_ "GenSigTimeoutTime_ECM" SG_ 1049 PopUpMessage1 0;
BA_ "GenSigTimeoutTime_DTCM" SG_ 1049 PopUpMessage1 0;
BA_ "GenSigTimeoutTime_DMSM" SG_ 1049 PopUpMessage1 0;
BA_ "GenSigTimeoutTime_BSM" SG_ 1049 PopUpMessage1 0;
BA_ "GenSigTimeoutTime_BCM" SG_ 1049 PopUpMessage1 0;
BA_ "GenSigTimeoutTime_AGSM" SG_ 1049 PopUpMessage1 0;
BA_ "GenSigTimeoutTime_ADCAM" SG_ 1049 PopUpMessage1 0;
BA_ "GenSigTimeoutTime_SGW" SG_ 1049 PopUpMessage3 0;
BA_ "GenSigTimeoutTime_RFHM" SG_ 1049 PopUpMessage3 0;
BA_ "GenSigTimeoutTime_MPAD" SG_ 1049 PopUpMessage3 0;
BA_ "GenSigTimeoutTime_GNMM" SG_ 1049 PopUpMessage3 0;
BA_ "GenSigTimeoutTime_EVCU2" SG_ 1049 PopUpMessage3 0;
BA_ "GenSigTimeoutTime_ESL" SG_ 1049 PopUpMessage3 0;
BA_ "GenSigTimeoutTime_ECM" SG_ 1049 PopUpMessage3 0;
BA_ "GenSigTimeoutTime_DTCM" SG_ 1049 PopUpMessage3 0;
BA_ "GenSigTimeoutTime_DMSM" SG_ 1049 PopUpMessage3 0;
BA_ "GenSigTimeoutTime_BSM" SG_ 1049 PopUpMessage3 0;
BA_ "GenSigTimeoutTime_BCM" SG_ 1049 PopUpMessage3 0;
BA_ "GenSigTimeoutTime_AGSM" SG_ 1049 PopUpMessage3 0;
BA_ "GenSigTimeoutTime_ADCAM" SG_ 1049 PopUpMessage3 0;
BA_ "GenSigTimeoutTime_SGW" SG_ 1049 PopUpMessage2 0;
BA_ "GenSigTimeoutTime_RFHM" SG_ 1049 PopUpMessage2 0;
BA_ "GenSigTimeoutTime_MPAD" SG_ 1049 PopUpMessage2 0;
BA_ "GenSigTimeoutTime_GNMM" SG_ 1049 PopUpMessage2 0;
BA_ "GenSigTimeoutTime_EVCU2" SG_ 1049 PopUpMessage2 0;
BA_ "GenSigTimeoutTime_ESL" SG_ 1049 PopUpMessage2 0;
BA_ "GenSigTimeoutTime_ECM" SG_ 1049 PopUpMessage2 0;
BA_ "GenSigTimeoutTime_DTCM" SG_ 1049 PopUpMessage2 0;
BA_ "GenSigTimeoutTime_DMSM" SG_ 1049 PopUpMessage2 0;
BA_ "GenSigTimeoutTime_BSM" SG_ 1049 PopUpMessage2 0;
BA_ "GenSigTimeoutTime_BCM" SG_ 1049 PopUpMessage2 0;
BA_ "GenSigTimeoutTime_AGSM" SG_ 1049 PopUpMessage2 0;
BA_ "GenSigTimeoutTime_ADCAM" SG_ 1049 PopUpMessage2 0;
BA_ "GenSigTimeoutTime_SGW" SG_ 1049 PopUpMessage10 0;
BA_ "GenSigTimeoutTime_RFHM" SG_ 1049 PopUpMessage10 0;
BA_ "GenSigTimeoutTime_MPAD" SG_ 1049 PopUpMessage10 0;
BA_ "GenSigTimeoutTime_GNMM" SG_ 1049 PopUpMessage10 0;
BA_ "GenSigTimeoutTime_EVCU2" SG_ 1049 PopUpMessage10 0;
BA_ "GenSigTimeoutTime_ESL" SG_ 1049 PopUpMessage10 0;
BA_ "GenSigTimeoutTime_ECM" SG_ 1049 PopUpMessage10 0;
BA_ "GenSigTimeoutTime_DTCM" SG_ 1049 PopUpMessage10 0;
BA_ "GenSigTimeoutTime_DMSM" SG_ 1049 PopUpMessage10 0;
BA_ "GenSigTimeoutTime_BSM" SG_ 1049 PopUpMessage10 0;
BA_ "GenSigTimeoutTime_BCM" SG_ 1049 PopUpMessage10 0;
BA_ "GenSigTimeoutTime_AGSM" SG_ 1049 PopUpMessage10 0;
BA_ "GenSigTimeoutTime_ADCAM" SG_ 1049 PopUpMessage10 0;
BA_ "GenSigTimeoutTime_SGW" SG_ 1049 HybridEfficiencyCoachV 0;
BA_ "GenSigTimeoutTime_RFHM" SG_ 1049 HybridEfficiencyCoachV 0;
BA_ "GenSigTimeoutTime_MPAD" SG_ 1049 HybridEfficiencyCoachV 0;
BA_ "GenSigTimeoutTime_IPC" SG_ 1049 HybridEfficiencyCoachV 0;
BA_ "GenSigTimeoutTime_GNMM" SG_ 1049 HybridEfficiencyCoachV 0;
BA_ "GenSigTimeoutTime_EVCU2" SG_ 1049 HybridEfficiencyCoachV 0;
BA_ "GenSigTimeoutTime_ESL" SG_ 1049 HybridEfficiencyCoachV 0;
BA_ "GenSigTimeoutTime_ECM" SG_ 1049 HybridEfficiencyCoachV 0;
BA_ "GenSigTimeoutTime_DTCM" SG_ 1049 HybridEfficiencyCoachV 0;
BA_ "GenSigTimeoutTime_DMSM" SG_ 1049 HybridEfficiencyCoachV 0;
BA_ "GenSigTimeoutTime_BSM" SG_ 1049 HybridEfficiencyCoachV 0;
BA_ "GenSigTimeoutTime_BCM" SG_ 1049 HybridEfficiencyCoachV 0;
BA_ "GenSigTimeoutTime_AGSM" SG_ 1049 HybridEfficiencyCoachV 0;
BA_ "GenSigTimeoutTime_ADCAM" SG_ 1049 HybridEfficiencyCoachV 0;
BA_ "GenSigTimeoutTime_SGW" SG_ 1049 HybridOutputPowerV 0;
BA_ "GenSigTimeoutTime_RFHM" SG_ 1049 HybridOutputPowerV 0;
BA_ "GenSigTimeoutTime_MPAD" SG_ 1049 HybridOutputPowerV 0;
BA_ "GenSigTimeoutTime_GNMM" SG_ 1049 HybridOutputPowerV 0;
BA_ "GenSigTimeoutTime_EVCU2" SG_ 1049 HybridOutputPowerV 0;
BA_ "GenSigTimeoutTime_ESL" SG_ 1049 HybridOutputPowerV 0;
BA_ "GenSigTimeoutTime_ECM" SG_ 1049 HybridOutputPowerV 0;
BA_ "GenSigTimeoutTime_DTCM" SG_ 1049 HybridOutputPowerV 0;
BA_ "GenSigTimeoutTime_DMSM" SG_ 1049 HybridOutputPowerV 0;
BA_ "GenSigTimeoutTime_BSM" SG_ 1049 HybridOutputPowerV 0;
BA_ "GenSigTimeoutTime_BCM" SG_ 1049 HybridOutputPowerV 0;
BA_ "GenSigTimeoutTime_AGSM" SG_ 1049 HybridOutputPowerV 0;
BA_ "GenSigTimeoutTime_ADCAM" SG_ 1049 HybridOutputPowerV 0;
BA_ "GenSigTimeoutTime_RFHM" SG_ 1049 HVBatterySOC_DisplayV 0;
BA_ "GenSigTimeoutTime_MPAD" SG_ 1049 HVBatterySOC_DisplayV 0;
BA_ "GenSigTimeoutTime_GNMM" SG_ 1049 HVBatterySOC_DisplayV 0;
BA_ "GenSigTimeoutTime_EVCU2" SG_ 1049 HVBatterySOC_DisplayV 0;
BA_ "GenSigTimeoutTime_ESL" SG_ 1049 HVBatterySOC_DisplayV 0;
BA_ "GenSigTimeoutTime_SGW" SG_ 1049 PopUpMessage11 0;
BA_ "GenSigTimeoutTime_RFHM" SG_ 1049 PopUpMessage11 0;
BA_ "GenSigTimeoutTime_MPAD" SG_ 1049 PopUpMessage11 0;
BA_ "GenSigTimeoutTime_GNMM" SG_ 1049 PopUpMessage11 0;
BA_ "GenSigTimeoutTime_EVCU2" SG_ 1049 PopUpMessage11 0;
BA_ "GenSigTimeoutTime_ESL" SG_ 1049 PopUpMessage11 0;
BA_ "GenSigTimeoutTime_ECM" SG_ 1049 PopUpMessage11 0;
BA_ "GenSigTimeoutTime_DTCM" SG_ 1049 PopUpMessage11 0;
BA_ "GenSigTimeoutTime_DMSM" SG_ 1049 PopUpMessage11 0;
BA_ "GenSigTimeoutTime_BSM" SG_ 1049 PopUpMessage11 0;
BA_ "GenSigTimeoutTime_BCM" SG_ 1049 PopUpMessage11 0;
BA_ "GenSigTimeoutTime_AGSM" SG_ 1049 PopUpMessage11 0;
BA_ "GenSigTimeoutTime_ADCAM" SG_ 1049 PopUpMessage11 0;
BA_ "GenSigTimeoutTime_SGW" SG_ 1049 OnePedal_Drive_Sts 0;
BA_ "GenSigTimeoutTime_RFHM" SG_ 1049 OnePedal_Drive_Sts 0;
BA_ "GenSigTimeoutTime_MPAD" SG_ 1049 OnePedal_Drive_Sts 0;
BA_ "GenSigTimeoutTime_GNMM" SG_ 1049 OnePedal_Drive_Sts 0;
BA_ "GenSigTimeoutTime_EVCU2" SG_ 1049 OnePedal_Drive_Sts 0;
BA_ "GenSigTimeoutTime_ESL" SG_ 1049 OnePedal_Drive_Sts 0;
BA_ "GenSigTimeoutTime_ECM" SG_ 1049 OnePedal_Drive_Sts 0;
BA_ "GenSigTimeoutTime_DTCM" SG_ 1049 OnePedal_Drive_Sts 0;
BA_ "GenSigTimeoutTime_DMSM" SG_ 1049 OnePedal_Drive_Sts 0;
BA_ "GenSigTimeoutTime_BCM" SG_ 1049 OnePedal_Drive_Sts 0;
BA_ "GenSigTimeoutTime_AGSM" SG_ 1049 OnePedal_Drive_Sts 0;
BA_ "GenSigTimeoutTime_ADCAM" SG_ 1049 OnePedal_Drive_Sts 0;
BA_ "GenSigTimeoutTime_RFHM" SG_ 1049 PlugAndChargeSts 0;
BA_ "GenSigTimeoutTime_MPAD" SG_ 1049 PlugAndChargeSts 0;
BA_ "GenSigTimeoutTime_IPC" SG_ 1049 PlugAndChargeSts 0;
BA_ "GenSigTimeoutTime_GNMM" SG_ 1049 PlugAndChargeSts 0;
BA_ "GenSigTimeoutTime_EVCU2" SG_ 1049 PlugAndChargeSts 0;
BA_ "GenSigTimeoutTime_ESL" SG_ 1049 PlugAndChargeSts 0;
BA_ "GenSigTimeoutTime_ECM" SG_ 1049 PlugAndChargeSts 0;
BA_ "GenSigTimeoutTime_DTCM" SG_ 1049 PlugAndChargeSts 0;
BA_ "GenSigTimeoutTime_DMSM" SG_ 1049 PlugAndChargeSts 0;
BA_ "GenSigTimeoutTime_BSM" SG_ 1049 PlugAndChargeSts 0;
BA_ "GenSigTimeoutTime_BCM" SG_ 1049 PlugAndChargeSts 0;
BA_ "GenSigTimeoutTime_AGSM" SG_ 1049 PlugAndChargeSts 0;
BA_ "GenSigTimeoutTime_ADCAM" SG_ 1049 PlugAndChargeSts 0;
BA_ "GenSigTimeoutTime_SGW" SG_ 1049 PopUpMessage18 0;
BA_ "GenSigTimeoutTime_RFHM" SG_ 1049 PopUpMessage18 0;
BA_ "GenSigTimeoutTime_MPAD" SG_ 1049 PopUpMessage18 0;
BA_ "GenSigTimeoutTime_GNMM" SG_ 1049 PopUpMessage18 0;
BA_ "GenSigTimeoutTime_EVCU2" SG_ 1049 PopUpMessage18 0;
BA_ "GenSigTimeoutTime_ESL" SG_ 1049 PopUpMessage18 0;
BA_ "GenSigTimeoutTime_ECM" SG_ 1049 PopUpMessage18 0;
BA_ "GenSigTimeoutTime_DTCM" SG_ 1049 PopUpMessage18 0;
BA_ "GenSigTimeoutTime_DMSM" SG_ 1049 PopUpMessage18 0;
BA_ "GenSigTimeoutTime_BSM" SG_ 1049 PopUpMessage18 0;
BA_ "GenSigTimeoutTime_BCM" SG_ 1049 PopUpMessage18 0;
BA_ "GenSigTimeoutTime_AGSM" SG_ 1049 PopUpMessage18 0;
BA_ "GenSigTimeoutTime_ADCAM" SG_ 1049 PopUpMessage18 0;
BA_ "GenSigTimeoutTime_BSM" SG_ 950 Alert_LHR 0;
BA_ "GenSigTimeoutTime_BCM" SG_ 950 Alert_LHR 0;
BA_ "GenSigTimeoutTime_AGSM" SG_ 950 Alert_LHR 0;
BA_ "GenSigTimeoutTime_ADCAM" SG_ 950 Alert_LHR 0;
BA_ "GenSigSendType" SG_ 950 Alert_LHR 3;
BA_ "GenSigTimeoutTime_SGW" SG_ 950 Alert_LHF 0;
BA_ "GenSigTimeoutTime_RFHM" SG_ 950 Alert_LHF 0;
BA_ "GenSigTimeoutTime_MPAD" SG_ 950 Alert_LHF 0;
BA_ "GenSigTimeoutTime_GNMM" SG_ 950 Alert_LHF 0;
BA_ "GenSigTimeoutTime_EVCU2" SG_ 950 Alert_LHF 0;
BA_ "GenSigTimeoutTime_ESL" SG_ 950 Alert_LHF 0;
BA_ "GenSigTimeoutTime_ECM" SG_ 950 Alert_LHF 0;
BA_ "GenSigTimeoutTime_DTCM" SG_ 950 Alert_LHF 0;
BA_ "GenSigTimeoutTime_DMSM" SG_ 950 Alert_LHF 0;
BA_ "GenSigTimeoutTime_BSM" SG_ 950 Alert_LHF 0;
BA_ "GenSigTimeoutTime_BCM" SG_ 950 Alert_LHF 0;
BA_ "GenSigTimeoutTime_AGSM" SG_ 950 Alert_LHF 0;
BA_ "GenSigTimeoutTime_ADCAM" SG_ 950 Alert_LHF 0;
BA_ "GenSigSendType" SG_ 950 Alert_LHF 3;
BA_ "GenSigTimeoutTime_SGW" SG_ 950 Alert_CHR 0;
BA_ "GenSigTimeoutTime_RFHM" SG_ 950 Alert_CHR 0;
BA_ "GenSigTimeoutTime_MPAD" SG_ 950 Alert_CHR 0;
BA_ "GenSigTimeoutTime_GNMM" SG_ 950 Alert_CHR 0;
BA_ "GenSigTimeoutTime_EVCU2" SG_ 950 Alert_CHR 0;
BA_ "GenSigTimeoutTime_ESL" SG_ 950 Alert_CHR 0;
BA_ "GenSigTimeoutTime_ECM" SG_ 950 Alert_CHR 0;
BA_ "GenSigTimeoutTime_DTCM" SG_ 950 Alert_CHR 0;
BA_ "GenSigTimeoutTime_DMSM" SG_ 950 Alert_CHR 0;
BA_ "GenSigTimeoutTime_BSM" SG_ 950 Alert_CHR 0;
BA_ "GenSigTimeoutTime_BCM" SG_ 950 Alert_CHR 0;
BA_ "GenSigTimeoutTime_AGSM" SG_ 950 Alert_CHR 0;
BA_ "GenSigTimeoutTime_ADCAM" SG_ 950 Alert_CHR 0;
BA_ "GenSigSendType" SG_ 950 Alert_CHR 3;
BA_ "GenSigTimeoutTime_SGW" SG_ 950 Alert_CHF 0;
BA_ "GenSigTimeoutTime_RFHM" SG_ 950 Alert_CHF 0;
BA_ "GenSigTimeoutTime_MPAD" SG_ 950 Alert_CHF 0;
BA_ "GenSigTimeoutTime_GNMM" SG_ 950 Alert_CHF 0;
BA_ "GenSigTimeoutTime_EVCU2" SG_ 950 Alert_CHF 0;
BA_ "GenSigTimeoutTime_ESL" SG_ 950 Alert_CHF 0;
BA_ "GenSigTimeoutTime_ECM" SG_ 950 Alert_CHF 0;
BA_ "GenSigTimeoutTime_DTCM" SG_ 950 Alert_CHF 0;
BA_ "GenSigTimeoutTime_DMSM" SG_ 950 Alert_CHF 0;
BA_ "GenSigTimeoutTime_BSM" SG_ 950 Alert_CHF 0;
BA_ "GenSigTimeoutTime_BCM" SG_ 950 Alert_CHF 0;
BA_ "GenSigTimeoutTime_AGSM" SG_ 950 Alert_CHF 0;
BA_ "GenSigTimeoutTime_ADCAM" SG_ 950 Alert_CHF 0;
BA_ "GenSigSendType" SG_ 950 Alert_CHF 3;
BA_ "GenSigTimeoutTime_SGW" SG_ 275 RR_PAM_StopControlSts 0;
BA_ "GenSigTimeoutTime_RFHM" SG_ 275 RR_PAM_StopControlSts 0;
BA_ "GenSigTimeoutTime_MPAD" SG_ 275 RR_PAM_StopControlSts 0;
BA_ "GenSigTimeoutTime_GNMM" SG_ 275 RR_PAM_StopControlSts 0;
BA_ "GenSigTimeoutTime_EVCU2" SG_ 275 RR_PAM_StopControlSts 0;
BA_ "GenSigTimeoutTime_ESL" SG_ 275 RR_PAM_StopControlSts 0;
BA_ "GenSigTimeoutTime_ECM" SG_ 275 RR_PAM_StopControlSts 0;
BA_ "GenSigTimeoutTime_DTCM" SG_ 275 RR_PAM_StopControlSts 0;
BA_ "GenSigTimeoutTime_DMSM" SG_ 275 RR_PAM_StopControlSts 0;
BA_ "GenSigTimeoutTime_BSM" SG_ 275 RR_PAM_StopControlSts 0;
BA_ "GenSigTimeoutTime_BCM" SG_ 275 RR_PAM_StopControlSts 0;
BA_ "GenSigTimeoutTime_AGSM" SG_ 275 RR_PAM_StopControlSts 0;
BA_ "GenSigTimeoutTime_ADCAM" SG_ 275 RR_PAM_StopControlSts 0;
BA_ "GenSigTimeoutTime_SGW" SG_ 275 RR_PAM_Brk_RqSts 0;
BA_ "GenSigTimeoutTime_RFHM" SG_ 275 RR_PAM_Brk_RqSts 0;
BA_ "GenSigTimeoutTime_MPAD" SG_ 275 RR_PAM_Brk_RqSts 0;
BA_ "GenSigTimeoutTime_IPC" SG_ 275 RR_PAM_Brk_RqSts 0;
BA_ "GenSigTimeoutTime_GNMM" SG_ 275 RR_PAM_Brk_RqSts 0;
BA_ "GenSigTimeoutTime_EVCU2" SG_ 275 RR_PAM_Brk_RqSts 0;
BA_ "GenSigTimeoutTime_ESL" SG_ 275 RR_PAM_Brk_RqSts 0;
BA_ "GenSigTimeoutTime_ECM" SG_ 275 RR_PAM_Brk_RqSts 0;
BA_ "GenSigTimeoutTime_DTCM" SG_ 275 RR_PAM_Brk_RqSts 0;
BA_ "GenSigTimeoutTime_DMSM" SG_ 275 RR_PAM_Brk_RqSts 0;
BA_ "GenSigTimeoutTime_BCM" SG_ 275 RR_PAM_Brk_RqSts 0;
BA_ "GenSigTimeoutTime_AGSM" SG_ 275 RR_PAM_Brk_RqSts 0;
BA_ "GenSigTimeoutTime_ADCAM" SG_ 275 RR_PAM_Brk_RqSts 0;
BA_ "GenSigTimeoutTime_SGW" SG_ 275 MessageCounter_CVPAM_FD_Control 0;
BA_ "GenSigTimeoutTime_RFHM" SG_ 275 MessageCounter_CVPAM_FD_Control 0;
BA_ "GenSigTimeoutTime_MPAD" SG_ 275 MessageCounter_CVPAM_FD_Control 0;
BA_ "GenSigTimeoutTime_IPC" SG_ 275 MessageCounter_CVPAM_FD_Control 0;
BA_ "GenSigTimeoutTime_GNMM" SG_ 275 MessageCounter_CVPAM_FD_Control 0;
BA_ "GenSigTimeoutTime_EVCU2" SG_ 275 MessageCounter_CVPAM_FD_Control 0;
BA_ "GenSigTimeoutTime_ESL" SG_ 275 MessageCounter_CVPAM_FD_Control 0;
BA_ "GenSigTimeoutTime_ECM" SG_ 275 MessageCounter_CVPAM_FD_Control 0;
BA_ "GenSigTimeoutTime_DTCM" SG_ 275 MessageCounter_CVPAM_FD_Control 0;
BA_ "GenSigTimeoutTime_DMSM" SG_ 275 MessageCounter_CVPAM_FD_Control 0;
BA_ "GenSigTimeoutTime_BCM" SG_ 275 MessageCounter_CVPAM_FD_Control 0;
BA_ "GenSigTimeoutTime_AGSM" SG_ 275 MessageCounter_CVPAM_FD_Control 0;
BA_ "GenSigTimeoutTime_ADCAM" SG_ 275 MessageCounter_CVPAM_FD_Control 0;
BA_ "GenSigTimeoutTime_SGW" SG_ 275 CRC_CVPAM_FD_Control 0;
BA_ "GenSigTimeoutTime_RFHM" SG_ 275 CRC_CVPAM_FD_Control 0;
BA_ "GenSigTimeoutTime_MPAD" SG_ 275 CRC_CVPAM_FD_Control 0;
BA_ "GenSigTimeoutTime_IPC" SG_ 275 CRC_CVPAM_FD_Control 0;
BA_ "GenSigTimeoutTime_GNMM" SG_ 275 CRC_CVPAM_FD_Control 0;
BA_ "GenSigTimeoutTime_EVCU2" SG_ 275 CRC_CVPAM_FD_Control 0;
BA_ "GenSigTimeoutTime_ESL" SG_ 275 CRC_CVPAM_FD_Control 0;
BA_ "GenSigTimeoutTime_ECM" SG_ 275 CRC_CVPAM_FD_Control 0;
BA_ "GenSigTimeoutTime_DTCM" SG_ 275 CRC_CVPAM_FD_Control 0;
BA_ "GenSigTimeoutTime_DMSM" SG_ 275 CRC_CVPAM_FD_Control 0;
BA_ "GenSigTimeoutTime_BCM" SG_ 275 CRC_CVPAM_FD_Control 0;
BA_ "GenSigTimeoutTime_AGSM" SG_ 275 CRC_CVPAM_FD_Control 0;
BA_ "GenSigTimeoutTime_ADCAM" SG_ 275 CRC_CVPAM_FD_Control 0;
BA_ "GenSigTimeoutTime_SGW" SG_ 275 RR_PAM_Dist 0;
BA_ "GenSigTimeoutTime_RFHM" SG_ 275 RR_PAM_Dist 0;
BA_ "GenSigTimeoutTime_MPAD" SG_ 275 RR_PAM_Dist 0;
BA_ "GenSigTimeoutTime_IPC" SG_ 275 RR_PAM_Dist 0;
BA_ "GenSigTimeoutTime_GNMM" SG_ 275 RR_PAM_Dist 0;
BA_ "GenSigTimeoutTime_EVCU2" SG_ 275 RR_PAM_Dist 0;
BA_ "GenSigTimeoutTime_ESL" SG_ 275 RR_PAM_Dist 0;
BA_ "GenSigTimeoutTime_ECM" SG_ 275 RR_PAM_Dist 0;
BA_ "GenSigTimeoutTime_DTCM" SG_ 275 RR_PAM_Dist 0;
BA_ "GenSigTimeoutTime_DMSM" SG_ 275 RR_PAM_Dist 0;
BA_ "GenSigTimeoutTime_BCM" SG_ 275 RR_PAM_Dist 0;
BA_ "GenSigTimeoutTime_AGSM" SG_ 275 RR_PAM_Dist 0;
BA_ "GenSigTimeoutTime_ADCAM" SG_ 275 RR_PAM_Dist 0;
BA_ "GenSigTimeoutTime_SGW" SG_ 1036 AfterRunCoolantPumpFailSts 0;
BA_ "GenSigTimeoutTime_RFHM" SG_ 1036 AfterRunCoolantPumpFailSts 0;
BA_ "GenSigTimeoutTime_MPAD" SG_ 1036 AfterRunCoolantPumpFailSts 0;
BA_ "GenSigTimeoutTime_GNMM" SG_ 1036 AfterRunCoolantPumpFailSts 0;
BA_ "GenSigTimeoutTime_EVCU2" SG_ 1036 AfterRunCoolantPumpFailSts 0;
BA_ "GenSigTimeoutTime_ESL" SG_ 1036 AfterRunCoolantPumpFailSts 0;
BA_ "GenSigTimeoutTime_ECM" SG_ 1036 AfterRunCoolantPumpFailSts 0;
BA_ "GenSigTimeoutTime_DTCM" SG_ 1036 AfterRunCoolantPumpFailSts 0;
BA_ "GenSigTimeoutTime_DMSM" SG_ 1036 AfterRunCoolantPumpFailSts 0;
BA_ "GenSigTimeoutTime_BSM" SG_ 1036 AfterRunCoolantPumpFailSts 0;
BA_ "GenSigTimeoutTime_BCM" SG_ 1036 AfterRunCoolantPumpFailSts 0;
BA_ "GenSigTimeoutTime_AGSM" SG_ 1036 AfterRunCoolantPumpFailSts 0;
BA_ "GenSigTimeoutTime_ADCAM" SG_ 1036 AfterRunCoolantPumpFailSts 0;
BA_ "GenSigSendType" SG_ 1036 AfterRunCoolantPumpFailSts 3;
BA_ "GenSigTimeoutTime_RFHM" SG_ 1036 EngineOilTemperature 0;
BA_ "GenSigTimeoutTime_MPAD" SG_ 1036 EngineOilTemperature 0;
BA_ "GenSigTimeoutTime_GNMM" SG_ 1036 EngineOilTemperature 0;
BA_ "GenSigTimeoutTime_EVCU2" SG_ 1036 EngineOilTemperature 0;
BA_ "GenSigTimeoutTime_ESL" SG_ 1036 EngineOilTemperature 0;
BA_ "GenSigTimeoutTime_ECM" SG_ 1036 EngineOilTemperature 0;
BA_ "GenSigTimeoutTime_DTCM" SG_ 1036 EngineOilTemperature 0;
BA_ "GenSigTimeoutTime_DMSM" SG_ 1036 EngineOilTemperature 0;
BA_ "GenSigTimeoutTime_BSM" SG_ 1036 EngineOilTemperature 0;
BA_ "GenSigTimeoutTime_BCM" SG_ 1036 EngineOilTemperature 0;
BA_ "GenSigTimeoutTime_AGSM" SG_ 1036 EngineOilTemperature 0;
BA_ "GenSigTimeoutTime_ADCAM" SG_ 1036 EngineOilTemperature 0;
BA_ "GenSigStartValue" SG_ 1036 EngineOilTemperature 255;
BA_ "GenSigTimeoutTime_SGW" SG_ 1049 CRC_HYBRID_DISPLAY 0;
BA_ "GenSigTimeoutTime_RFHM" SG_ 1049 CRC_HYBRID_DISPLAY 0;
BA_ "GenSigTimeoutTime_MPAD" SG_ 1049 CRC_HYBRID_DISPLAY 0;
BA_ "GenSigTimeoutTime_GNMM" SG_ 1049 CRC_HYBRID_DISPLAY 0;
BA_ "GenSigTimeoutTime_EVCU2" SG_ 1049 CRC_HYBRID_DISPLAY 0;
BA_ "GenSigTimeoutTime_ESL" SG_ 1049 CRC_HYBRID_DISPLAY 0;
BA_ "GenSigTimeoutTime_ECM" SG_ 1049 CRC_HYBRID_DISPLAY 0;
BA_ "GenSigTimeoutTime_DTCM" SG_ 1049 CRC_HYBRID_DISPLAY 0;
BA_ "GenSigTimeoutTime_DMSM" SG_ 1049 CRC_HYBRID_DISPLAY 0;
BA_ "GenSigTimeoutTime_BSM" SG_ 1049 CRC_HYBRID_DISPLAY 0;
BA_ "GenSigTimeoutTime_BCM" SG_ 1049 CRC_HYBRID_DISPLAY 0;
BA_ "GenSigTimeoutTime_AGSM" SG_ 1049 CRC_HYBRID_DISPLAY 0;
BA_ "GenSigTimeoutTime_ADCAM" SG_ 1049 CRC_HYBRID_DISPLAY 0;
BA_ "GenSigTimeoutTime_SGW" SG_ 1027 HVBatteryMILRequest 0;
BA_ "GenSigTimeoutTime_RFHM" SG_ 1027 HVBatteryMILRequest 0;
BA_ "GenSigTimeoutTime_MPAD" SG_ 1027 HVBatteryMILRequest 0;
BA_ "GenSigTimeoutTime_GNMM" SG_ 1027 HVBatteryMILRequest 0;
BA_ "GenSigTimeoutTime_EVCU2" SG_ 1027 HVBatteryMILRequest 0;
BA_ "GenSigTimeoutTime_ESL" SG_ 1027 HVBatteryMILRequest 0;
BA_ "GenSigTimeoutTime_ECM" SG_ 1027 HVBatteryMILRequest 0;
BA_ "GenSigTimeoutTime_DTCM" SG_ 1027 HVBatteryMILRequest 0;
BA_ "GenSigTimeoutTime_DMSM" SG_ 1027 HVBatteryMILRequest 0;
BA_ "GenSigTimeoutTime_BSM" SG_ 1027 HVBatteryMILRequest 0;
BA_ "GenSigTimeoutTime_BCM" SG_ 1027 HVBatteryMILRequest 0;
BA_ "GenSigTimeoutTime_AGSM" SG_ 1027 HVBatteryMILRequest 0;
BA_ "GenSigTimeoutTime_ADCAM" SG_ 1027 HVBatteryMILRequest 0;
BA_ "GenSigTimeoutTime_SGW" SG_ 1036 MessageCounter_ENGINE3 0;
BA_ "GenSigTimeoutTime_RFHM" SG_ 1036 MessageCounter_ENGINE3 0;
BA_ "GenSigTimeoutTime_MPAD" SG_ 1036 MessageCounter_ENGINE3 0;
BA_ "GenSigTimeoutTime_SGW" SG_ 1036 OilLifeLeftRst 0;
BA_ "GenSigTimeoutTime_RFHM" SG_ 1036 OilLifeLeftRst 0;
BA_ "GenSigTimeoutTime_MPAD" SG_ 1036 OilLifeLeftRst 0;
BA_ "GenSigTimeoutTime_GNMM" SG_ 1036 OilLifeLeftRst 0;
BA_ "GenSigTimeoutTime_EVCU2" SG_ 1036 OilLifeLeftRst 0;
BA_ "GenSigTimeoutTime_ESL" SG_ 1036 OilLifeLeftRst 0;
BA_ "GenSigTimeoutTime_ECM" SG_ 1036 OilLifeLeftRst 0;
BA_ "GenSigTimeoutTime_DTCM" SG_ 1036 OilLifeLeftRst 0;
BA_ "GenSigTimeoutTime_DMSM" SG_ 1036 OilLifeLeftRst 0;
BA_ "GenSigTimeoutTime_BSM" SG_ 1036 OilLifeLeftRst 0;
BA_ "GenSigTimeoutTime_BCM" SG_ 1036 OilLifeLeftRst 0;
BA_ "GenSigTimeoutTime_AGSM" SG_ 1036 OilLifeLeftRst 0;
BA_ "GenSigTimeoutTime_ADCAM" SG_ 1036 OilLifeLeftRst 0;
BA_ "GenSigSendType" SG_ 1036 OilLifeLeftRst 3;
BA_ "GenSigTimeoutTime_RFHM" SG_ 1036 OIL_TEMP_IND_RQ 0;
BA_ "GenSigTimeoutTime_MPAD" SG_ 1036 OIL_TEMP_IND_RQ 0;
BA_ "GenSigTimeoutTime_GNMM" SG_ 1036 OIL_TEMP_IND_RQ 0;
BA_ "GenSigTimeoutTime_EVCU2" SG_ 1036 OIL_TEMP_IND_RQ 0;
BA_ "GenSigTimeoutTime_ESL" SG_ 1036 OIL_TEMP_IND_RQ 0;
BA_ "GenSigTimeoutTime_ECM" SG_ 1036 OIL_TEMP_IND_RQ 0;
BA_ "GenSigTimeoutTime_DTCM" SG_ 1036 OIL_TEMP_IND_RQ 0;
BA_ "GenSigTimeoutTime_DMSM" SG_ 1036 OIL_TEMP_IND_RQ 0;
BA_ "GenSigTimeoutTime_BSM" SG_ 1036 OIL_TEMP_IND_RQ 0;
BA_ "GenSigTimeoutTime_BCM" SG_ 1036 OIL_TEMP_IND_RQ 0;
BA_ "GenSigTimeoutTime_AGSM" SG_ 1036 OIL_TEMP_IND_RQ 0;
BA_ "GenSigTimeoutTime_ADCAM" SG_ 1036 OIL_TEMP_IND_RQ 0;
BA_ "GenSigSendType" SG_ 1036 OIL_TEMP_IND_RQ 3;
BA_ "GenSigTimeoutTime_BCM" SG_ 1036 OilLifeLeft 0;
BA_ "GenSigTimeoutTime_AGSM" SG_ 1036 OilLifeLeft 0;
BA_ "GenSigTimeoutTime_ADCAM" SG_ 1036 OilLifeLeft 0;
BA_ "GenSigSendType" SG_ 1036 OilLifeLeft 3;
BA_ "GenSigStartValue" SG_ 1036 OilLifeLeft 255;
BA_ "GenSigTimeoutTime_SGW" SG_ 1036 OilLifeLeft 0;
BA_ "GenSigTimeoutTime_RFHM" SG_ 1036 OilLifeLeft 0;
BA_ "GenSigTimeoutTime_MPAD" SG_ 1036 OilLifeLeft 0;
BA_ "GenSigTimeoutTime_GNMM" SG_ 1036 OilLifeLeft 0;
BA_ "GenSigTimeoutTime_EVCU2" SG_ 1036 OilLifeLeft 0;
BA_ "GenSigTimeoutTime_ESL" SG_ 1036 OilLifeLeft 0;
BA_ "GenSigTimeoutTime_ECM" SG_ 1036 OilLifeLeft 0;
BA_ "GenSigTimeoutTime_DTCM" SG_ 1036 OilLifeLeft 0;
BA_ "GenSigTimeoutTime_DMSM" SG_ 1036 OilLifeLeft 0;
BA_ "GenSigTimeoutTime_BSM" SG_ 1036 OilLifeLeft 0;
BA_ "GenSigTimeoutTime_SGW" SG_ 1036 OIL_IND_LMP_FLSH 0;
BA_ "GenSigTimeoutTime_RFHM" SG_ 1036 OIL_IND_LMP_FLSH 0;
BA_ "GenSigTimeoutTime_MPAD" SG_ 1036 OIL_IND_LMP_FLSH 0;
BA_ "GenSigTimeoutTime_GNMM" SG_ 1036 OIL_IND_LMP_FLSH 0;
BA_ "GenSigTimeoutTime_EVCU2" SG_ 1036 OIL_IND_LMP_FLSH 0;
BA_ "GenSigTimeoutTime_ESL" SG_ 1036 OIL_IND_LMP_FLSH 0;
BA_ "GenSigTimeoutTime_ECM" SG_ 1036 OIL_IND_LMP_FLSH 0;
BA_ "GenSigTimeoutTime_DTCM" SG_ 1036 OIL_IND_LMP_FLSH 0;
BA_ "GenSigTimeoutTime_DMSM" SG_ 1036 OIL_IND_LMP_FLSH 0;
BA_ "GenSigTimeoutTime_BSM" SG_ 1036 OIL_IND_LMP_FLSH 0;
BA_ "GenSigTimeoutTime_BCM" SG_ 1036 OIL_IND_LMP_FLSH 0;
BA_ "GenSigTimeoutTime_AGSM" SG_ 1036 OIL_IND_LMP_FLSH 0;
BA_ "GenSigTimeoutTime_ADCAM" SG_ 1036 OIL_IND_LMP_FLSH 0;
BA_ "GenSigSendType" SG_ 1036 OIL_IND_LMP_FLSH 3;
VAL_ 752 IBS3_Vbatt 511 "SNA";
VAL_ 752 IBS3_SOF_VC 127 "SNA";
VAL_ 752 IBS3_Ibatt 65535 "SNA";
VAL_ 1036 OilLifeLeftRst 0 "Not_Active" 1 "Active";
VAL_ 1036 OilLifeLeft 255 "SNA";
VAL_ 1036 OIL_TEMP_IND_RQ 0 "OFF" 1 "ON" 2 "FLASH" 3 "SNA";
VAL_ 1036 OIL_IND_LMP_FLSH 0 "Not_active" 1 "Active";
VAL_ 1036 DistOilLifeRst 65535 "SNA";
VAL_ 1455 NextNavInstructionPanelTheme 0 "Analog" 1 "Digital" 15 "SNA";
VAL_ 1455 NavigationMapPopUP 0 "Active" 1 "NotActive";
VAL_ 1455 IPC_NavigationMap_Req 0 "Send_Nav_Map" 1 "Not_Active" 2 "Disable_Projection";
VAL_ 1455 IC_ETM_HUDCustom_Req 0 "Default" 1 "ETM Settings Being Active work by User" 2 "ETM Settings Saved by Cutomer" 3 "SNA";
VAL_ 1455 Cluster_In_Audio_Md 0 "Not_Active" 1 "Active";
VAL_ 1455 Avg_Fuel_Econ 1023 "SNA";
VAL_ 1455 AudioMenuPopup 0 "Not_Active" 1 "Active";
VAL_ 1455 A_Hybrid_Miles 16777215 "SNA";
VAL_ 1455 A_Hybrid_Kilometers 16777215 "SNA";
VAL_ 1455 A_EV_Miles 16777215 "SNA";
VAL_ 1455 A_EV_Kilometers 16777215 "SNA";
VAL_ 1032 PECP_PumpSpeedActual 127 "SNA";
VAL_ 1032 PE_CoolTempOut 255 "SNA";
VAL_ 1952 SchCond_Time_Till_Dep 127 "SNA";
VAL_ 1952 Sch_PreCondition_Sts 0 "False" 1 "True" 3 "SNA";
VAL_ 1952 HVBatCoolantLevelLow_DPT 0 "False" 1 "True" 3 "SNA";
VAL_ 1952 HTAuxPmpRPMAct 255 "SNA";
VAL_ 1952 HeaterCoreInletTemp 255 "SNA";
VAL_ 1952 ElecCoolantHtrPwr 255 "SNA";
VAL_ 1952 CompressorState 0 "NormalOperation" 1 "DegradedOperation" 2 "Inoperative" 3 "Reserved1" 4 "Reserved2" 5 "Reserved3" 6 "Reserved4" 15 "SNA";
VAL_ 1952 CabinPreconditionReqSts 0 "DEFAULT" 1 "PRE" 2 "SPR" 3 "PRE_OFF" 4 "PRF" 5 "NOT_OK" 6 "BCC" 7 "BCS" 8 "STOPPED_DUE_TO_SOC" 9 "EJECTED_NOT_PLUGGED_IN" 15 "SNA";
VAL_ 1049 RefrigerantPressure 511 "SNA";
VAL_ 1049 HybridMILRequest 0 "Not_Active" 1 "Active";
VAL_ 1027 HVBatteryMILRequest 0 "FALSE" 1 "TRUE";
VAL_ 1036 DefFuelEcon 255 "SNA";
VAL_ 950 SPMControlSts 0 "Not_Active" 1 "Active_ParallelParking" 2 "Active_PerpendicularParking" 3 "Active_OutParking";
VAL_ 950 SDWSts 0 "Not_Active" 1 "Active";
VAL_ 950 SDWFailSts 0 "Fail_Not_Present" 1 "Fail_Present";
VAL_ 950 SDW_Warning_Right_2 0 "NoWarning" 1 "Area1" 2 "Area2" 3 "NotActive";
VAL_ 950 SDW_Warning_Right_1 0 "NoWarning" 1 "Area1" 2 "Area2" 3 "NotActive";
VAL_ 950 SDW_Warning_Left_2 0 "NoWarning" 1 "Area1" 2 "Area2" 3 "NotActive";
VAL_ 950 SDW_Warning_Left_1 0 "NoWarning" 1 "Area1" 2 "Area2" 3 "NotActive";
VAL_ 950 RearSensorSts 0 "Active" 1 "Not_Active_blocked" 2 "Not_Active_failure" 3 "SNA";
VAL_ 950 PAMSystemFault 0 "False" 1 "Temporary_Failure" 2 "External_Failure" 3 "System_Failure";
VAL_ 950 PAM_PopUpRqst 0 "TM0" 1 "TM1" 2 "TM2" 3 "TM3" 4 "TM4" 5 "TM5" 6 "TM6" 7 "TM7" 8 "TM8" 9 "TM9" 10 "TM10" 11 "TM11" 12 "TM12" 13 "TM13" 14 "TM14" 15 "TM15" 16 "TM16" 17 "TM17" 18 "TM18" 19 "TM19" 20 "TM20" 21 "TM21" 22 "TM22" 23 "TM23" 24 "TM24" 25 "TM25" 26 "TM26" 27 "TM27" 28 "TM28" 29 "TM29" 30 "TM30" 31 "TM31" 32 "TM32" 33 "TM33" 34 "TM34" 35 "TM35" 36 "TM36" 37 "TM37" 38 "TM38" 39 "TM39" 40 "TM40" 41 "TM41" 42 "TM42" 43 "TM43" 44 "TM44" 45 "TM45" 46 "TM46" 47 "TM47" 48 "TM48" 49 "TM49" 50 "TM50" 51 "TM51" 52 "TM52" 53 "TM53" 54 "TM54" 55 "TM55" 56 "TM56" 57 "TM57" 58 "TM58" 59 "TM59" 60 "TM60" 61 "TM61" 62 "TM62" 63 "TM63" 64 "TM64" 65 "TM65" 66 "TM66" 67 "TM67" 68 "TM68" 69 "TM69" 70 "TM70" 71 "TM71" 72 "TM72" 73 "TM73" 74 "TM74" 75 "TM75" 76 "TM76" 77 "TM77" 78 "TM78" 79 "TM79" 80 "TM80" 81 "TM81" 82 "TM82" 83 "TM83" 84 "TM84" 85 "TM85" 86 "TM86" 87 "TM87" 88 "TM88" 89 "TM89" 90 "TM90" 91 "TM91" 92 "TM92" 93 "TM93" 94 "TM94" 95 "TM95" 96 "TM96" 97 "TM97" 98 "TM98" 99 "TM99" 100 "TM100" 255 "SNA";
VAL_ 950 PAM_Off_Status 0 "SYSTEM_ON" 1 "SYSTEM_OFF";
VAL_ 950 PAM_LedControlSts 0 "Off" 1 "Continuous light" 2 "Blinking light" 3 "SNA";
VAL_ 950 Graphic_RHR 0 "Slow_flash" 1 "Solid" 2 "None" 3 "SNA";
VAL_ 950 Graphic_RHF 0 "Slow_flash" 1 "Solid" 2 "None" 3 "SNA";
VAL_ 950 Graphic_LHR 0 "Slow_flash" 1 "Solid" 2 "None" 3 "SNA";
VAL_ 950 Graphic_LHF 0 "Slow_flash" 1 "Solid" 2 "None" 3 "SNA";
VAL_ 950 Graphic_CHR 0 "Slow_flash" 1 "Solid" 2 "None" 3 "SNA";
VAL_ 950 Graphic_CHF 0 "Slow_flash" 1 "Solid" 2 "None" 3 "SNA";
VAL_ 950 FrontSensorSts 0 "Active" 1 "Not_Active_blocked" 2 "Not_Active_failure" 3 "SNA";
VAL_ 950 Alert_RHR 0 "No_object_detected" 1 "1_Arc" 2 "2_Arc" 7 "SNA";
VAL_ 950 Alert_RHF 0 "No_object_detected" 1 "1_Arc" 2 "2_Arc" 7 "SNA";
VAL_ 950 Alert_LHR 0 "No_object_detected" 1 "1_Arc" 2 "2_Arc" 7 "SNA";
VAL_ 950 Alert_LHF 0 "No_object_detected" 1 "1_Arc" 2 "2_Arc" 7 "SNA";
VAL_ 950 Alert_CHR 0 "No_object_detected" 1 "1_Arc" 2 "2_Arc" 3 "3_Arc" 4 "4_Arc" 5 "5_Arc" 6 "6_Arc" 7 "SNA";
VAL_ 950 Alert_CHF 0 "No_object_detected" 1 "1_Arc" 2 "2_Arc" 3 "3_Arc" 4 "4_Arc" 5 "5_Arc" 6 "6_Arc" 7 "SNA";
VAL_ 275 RR_PAM_StopControlSts 0 "Off" 1 "On";
VAL_ 275 RR_PAM_Brk_RqSts 0 "Off" 1 "On";
VAL_ 275 RR_PAM_Dist 1023 "SNA";
VAL_ 752 VoltBattFailStatus 0 "Fail_not_present" 1 "Fail_present";
VAL_ 752 RsErrIBS3 0 "NO_ERROR" 1 "ERROR";
VAL_ 752 IBS3_Error_Internal 0 "NO_ERROR" 1 "ERROR";
VAL_ 752 CurrBattFailStatus 0 "Fail_not_present" 1 "Fail_present";
VAL_ 1032 PE_CoolTempIn 255 "SNA";
VAL_ 1036 EngineOilTemperature 255 "SNA";
VAL_ 950 ParkingManeuverActive 0 "Idle" 1 "Enabled_Seeking" 2 "Engaged_Semi" 3 "Engaged_Full" 4 "Not_Used" 5 "Not_Used" 6 "Not_Used" 7 "SNA";
VAL_ 1842 Total_Range 2047 "SNA";
VAL_ 1842 Gas_Range 1023 "SNA";
VAL_ 1952 CabinConditioningSts 0 "Default" 1 "Preconditioning will be rejected-not plugged in" 2 "Preconditioning stopped due to SOC" 3 "Preconditioning" 4 "Cabin set point reached" 5 "Preconditioning off " 6 "Preconditioning failed due to other conditions than HV Battery temperature " 7 "Preconditioning fails due to HV battery temperature" 8 "Battery conditioning complete and the HV battery is ok" 9 "Battery Conditioning stopped before complete and the HV battery is not ok  " 15 "SNA";
VAL_ 1049 Lv2_EstChargeTime 2047 "SNA";
VAL_ 1049 Lv1_EstChargeTime 8191 "SNA";
VAL_ 1049 HCP_EVServiceLampOn 0 "OFF" 1 "ON" 2 "BLINK" 3 "SNA";
VAL_ 1049 ChargingLevelForDisplay 0 "Default_NoLevel" 1 "Level_1_AC" 2 "Level_2_AC" 3 "Level_3_AC" 4 "Level_1_DC" 5 "Level_2_DC" 6 "PlugInNotDet" 7 "PPI_1_No_Drive" 8 "PPI_2_OK_Drive" 15 "SNA";
VAL_ 1049 ChargeSystemSts_DPT 0 "NotCharging" 1 "Charging" 2 "ChargeInterrupted" 3 "ChargeComplete" 7 "SNA";
VAL_ 1049 ChargeSystemFault_DPT 0 "Not_Faulted" 1 "Faulted";
VAL_ 1844 B_Hybrid_Miles 16777215 "SNA";
VAL_ 1844 B_Hybrid_Kilometers 16777215 "SNA";
VAL_ 1844 B_EV_Miles 16777215 "SNA";
VAL_ 1844 B_EV_Kilometers 16777215 "SNA";
VAL_ 1033 HybridEmissionsMalfunction 0 "Not_Active" 1 "Active";
VAL_ 1033 Hybrid_EVT_ModeSts 0 "Hybrid Mode" 1 "EVT Mode";
VAL_ 1049 PopUpMessage9 0 "False" 1 "True";
VAL_ 1049 PopUpMessage7 0 "False" 1 "True";
VAL_ 1049 PopUpMessage6 0 "False" 1 "True";
VAL_ 1049 PopUpMessage5 0 "False" 1 "True";
VAL_ 1049 PopUpMessage4 0 "False" 1 "True";
VAL_ 1049 PopUpMessage3 0 "False" 1 "True";
VAL_ 1049 PopUpMessage2 0 "False" 1 "True";
VAL_ 1049 PopUpMessage10 0 "False" 1 "True";
VAL_ 1049 PopUpMessage1 0 "False" 1 "True";
VAL_ 1049 HybridOutputPowerV 0 "Valid" 1 "Invalid";
VAL_ 1049 HybridEfficiencyCoachV 0 "Valid" 1 "Invalid";
VAL_ 1049 HVBatterySOC_DisplayV 0 "Valid" 1 "Not_Valid";
VAL_ 1049 HVACPowerUse_DisplayV 0 "Valid" 1 "Not_Valid";
VAL_ 1049 EnginePowerUse_DisplayV 0 "Valid" 1 "Not_Valid";
VAL_ 1036 AfterRunCoolantPumpFailSts 0 "Fault_Not_Present" 1 "Fault_Present";
VAL_ 752 IBS3_SOF_V_Accuracy 0 "Inaccurate" 1 "Accurate";
VAL_ 1956 Warning_MotorB_Overtemp 0 "Normal" 1 "Warning";
VAL_ 1956 Warning_MotorA_Overtemp 0 "Normal" 1 "Warning";
VAL_ 1956 Warning_InverterA_Overtemp 0 "Normal" 1 "Warning";
VAL_ 1956 Warning_DCDCTemp_DPT 0 "Normal" 1 "Warning";
VAL_ 1956 Warning_DCDCPerformance_DPT 0 "Normal" 1 "Warning";
VAL_ 1956 MotorB_InverterState 0 "NORMAL_PWR_STAGE_OFF" 1 "NORMAL_PWR_STAGE_ON" 2 "PWR_STAGE_ON_SHUTDWN_PNDING" 3 "ACTIVE_DISCHARGE" 4 "INVERTER_FAULTED";
VAL_ 1956 MotorA_InverterState 0 "NORMAL_PWR_STAGE_OFF" 1 "NORMAL_PWR_STAGE_ON" 2 "PWR_STAGE_ON_SHUTDWN_PNDING" 3 "ACTIVE_DISCHARGE" 4 "INVERTER_FAULTED";
VAL_ 1952 HVBatCritCondT 0 "False" 1 "True";
VAL_ 1952 HTAuxPmpMontrngRPM 0 "TRUE" 1 "FALSE" 3 "SNA";
VAL_ 1952 FRfShVlvSts 0 "Open" 1 "Closed";
VAL_ 1840 Warning_PackTempHigh 0 "Normal" 1 "Warning";
VAL_ 1049 PopUpMessage18 0 "False" 1 "True";
VAL_ 1033 MotorsPowerUse_DisplayV 0 "Valid" 1 "Not_Valid";
VAL_ 1033 Motor2PowerUse_DisplayV 0 "Valid" 1 "Not_Valid";
VAL_ 1033 Motor1PowerUse_DisplayV 0 "Valid" 1 "Not_Valid";
VAL_ 1033 BattPowerUse_DisplayV 0 "Valid" 1 "Not_Valid";
VAL_ 1049 PopUpMessage11 0 "False" 1 "True";
VAL_ 1956 Warning_InverterB_Overtemp 0 "Normal" 1 "Warning";
VAL_ 1049 FOTA_Schedule_Conflict 0 "False" 1 "True";
VAL_ 950 FT_PAM_LedControlSts 0 "Off" 1 "Continuous Light" 2 "2Blinking Light" 3 "SNA";
VAL_ 1033 Hybrid_AGSPosition 127 "SNA";
VAL_ 1033 Hybrid_AGS2Position 127 "SNA";
VAL_ 1049 Regen_Status 0 "unavailable " 1 "Level1" 2 "Level2" 3 "Level3" 4 "Level4" 5 "Level5";
VAL_ 1049 PlugAndChargeSts 0 "Inactive" 1 "Active";
VAL_ 1049 OnePedal_Drive_Sts 0 "Off" 1 "On" 2 "Unavailable";
SIG_GROUP_ 1033 HYBRID_POWERTRAIN5_Pkt 1 : HEV_HybPwrtrnRdcdPerfCmnd MessageCounter_HYBRID_POWERTRAIN5 CRC_HYBRID_POWERTRAIN5 HybridEmissionsMalfunction Hybrid_EVT_ModeSts MotorsPowerUse_DisplayV MotorsPowerUse_Display Motor2PowerUse_DisplayV Motor1PowerUse_DisplayV Motor1PowerUse_Display BattPowerUse_DisplayV BattPowerUse_Display Motor2PowerUse_Display Hybrid_AGSPosition Hybrid_AGS2Position;
SIG_GROUP_ 1049 HYBRID_DISPLAY_Pkt 1 : RefrigerantPressure HybridMILRequest MessageCounter_HYBRID_DISPLAY CRC_HYBRID_DISPLAY HVBatterySOC_Display Lv2_EstChargeTime Lv1_EstChargeTime HybridOutputPower HybridEfficiencyCoach HVACPowerUse_Display HCP_EVServiceLampOn EnginePowerUse_Display ChargingLevelForDisplay ChargeSystemSts_DPT ChargeSystemFault_DPT PopUpMessage9 PopUpMessage7 PopUpMessage6 PopUpMessage5 PopUpMessage4 PopUpMessage3 PopUpMessage2 PopUpMessage10 PopUpMessage1 HybridOutputPowerV HybridEfficiencyCoachV HVBatterySOC_DisplayV HVACPowerUse_DisplayV EnginePowerUse_DisplayV PopUpMessage11 FOTA_Schedule_Conflict Regen_Status PlugAndChargeSts OnePedal_Drive_Sts PopUpMessage18;
SIG_GROUP_ 752 IBS3_DATA_1_Pkt 1 : IBS3_Vbatt IBS3_SOF_VC IBS3_Ibatt VoltBattFailStatus RsErrIBS3 IBS3_Error_Internal CurrBattFailStatus MessageCounter_IBS3DATA1 CRC_IBS3DATA1 IBS3_SOF_V_Accuracy;

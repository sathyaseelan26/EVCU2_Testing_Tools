VERSION ""

NS_ :

BS_:

BU_: SGW RFHM MPAD IPC GNMM EVCU2 ESL ECM DTCM DMSM BSM BCM AGSM ADCAM

BO_ 158 TELEMATIC_VEHICLE_SETUP: 48 SGW
 SG_ FlashLightWLock_Req : 159|1@0+ (1,0) [0|1] "-"  IPC
 SG_ Windows_With_Fob_Req : 179|1@0+ (1,0) [0|1] "-"  IPC
 SG_ TyrePress_Unit_Req : 243|2@0+ (1,0) [0|3] "" IPC
 SG_ Traffic_Sign_Warn_Req : 206|3@0+ (1,0) [0|3] "" IPC
 SG_ Traffic_Sign_Info_Req : 230|1@0+ (1,0) [0|1] "" IPC
 SG_ Torque_Unit_Req : 254|1@0+ (1,0) [0|1] "" IPC
 SG_ Tire_Fill_Alert_Req : 215|1@0+ (1,0) [0|1] "" IPC
 SG_ Tilt_Mirr_Rev_Req : 210|1@0+ (1,0) [0|1] "" IPC
 SG_ Temp_Unit_Req : 239|1@0+ (1,0) [0|1] "" IPC
 SG_ SVC_Guidelines_Req : 193|1@0+ (1,0) [0|1] "" IPC
 SG_ SVC_Delay_Req : 192|1@0+ (1,0) [0|1] "" IPC
 SG_ Steer_Feel_Req : 209|2@0+ (1,0) [0|3] "" IPC
 SG_ SpeedLockDoorEnable_Req : 94|1@0+ (1,0) [0|1] "-"  IPC
 SG_ Speed_Unit_Req : 253|1@0+ (1,0) [0|1] "" IPC
 SG_ SoundHornRemoteStart_Req : 104|1@0+ (1,0) [0|1] "" IPC
 SG_ SoundHornLock_Req : 127|2@0+ (1,0) [0|3] "" IPC
 SG_ Sdw_Req : 125|2@0+ (1,0) [0|3] "" IPC
 SG_ RKEMemoryLinkEnable_Req : 166|1@0+ (1,0) [0|1] "-"  IPC
 SG_ RemStNrmlStEnbl_Req : 178|2@0+ (1,0) [0|3] "-"  IPC
 SG_ RemoteDoorUnlock_Req : 102|1@0+ (1,0) [0|1] "" IPC
 SG_ Rear_Brk_Asst_Req : 190|1@0+ (1,0) [0|1] "" IPC
 SG_ Rdy_To_Drive_Req : 223|1@0+ (1,0) [0|1] "" IPC
 SG_ RainSensorLevel_Req : 93|1@0+ (1,0) [0|1] "-"  IPC
 SG_ Proximity_WU_Req : 6|1@0+ (1,0) [0|1] "-"  IPC
 SG_ PLGAlert_Req : 168|1@0+ (1,0) [0|1] "-"  IPC
 SG_ PhoneRepetition_Req : 114|1@0+ (1,0) [0|1] "" IPC
 SG_ Ped_EM_Brk_Warn_Act_Req : 175|1@0+ (1,0) [0|1] "-"  ADCAM,MPAD,IPC
 SG_ PassiveEntry_Req : 101|1@0+ (1,0) [0|1] "" IPC
 SG_ PamChimeVolumeRear_Req : 111|2@0+ (1,0) [0|3] "" IPC
 SG_ PamChimeVolumeFront_Req : 107|2@0+ (1,0) [0|3] "" IPC
 SG_ Night_Vision_Req : 247|1@0+ (1,0) [0|1] "" IPC
 SG_ New_Spd_Zone_Ind_Req : 227|2@0+ (1,0) [0|3] "" IPC
 SG_ NavigationRepetition_Req : 105|1@0+ (1,0) [0|1] "" IPC
 SG_ LDW_Sensibility_Req : 147|2@0+ (1,0) [0|3] "-"  IPC
 SG_ LDW_Intensity_Req : 154|2@0+ (1,0) [0|3] "-"  IPC
 SG_ LanguageSelection_Req : 135|8@0+ (1,0) [0|255] "-"  IPC
 SG_ Intelligent_Speed_Req : 246|1@0+ (1,0) [0|1] "" IPC
 SG_ Illuminated_Approach_Req : 197|2@0+ (1,0) [0|3] "-"  IPC
 SG_ HP_Unit_Req : 245|2@0+ (1,0) [0|3] "" IPC
 SG_ HourMode_Req : 87|1@0+ (1,0) [0|1] "-"  IPC
 SG_ Hill_Start_Assist_Req : 184|1@0+ (1,0) [0|1] "-"  IPC
 SG_ HeadLightWipers_Req : 167|1@0+ (1,0) [0|1] "-"  IPC
 SG_ HeadlightsOffDelay_Req : 145|2@0+ (1,0) [0|3] "-"  IPC
 SG_ Handsfree_Liftgate_Req : 182|1@0+ (1,0) [0|1] "-"  IPC
 SG_ GreetingLightsEnable_Req : 81|1@0+ (1,0) [0|1] "-"  IPC
 SG_ Fwrd_Cam_Guidelines_Req : 189|1@0+ (1,0) [0|1] "-"  IPC
 SG_ FSFCWPlusSetting_Req : 143|3@0+ (1,0) [0|7] "-"  ADCAM,MPAD,IPC
 SG_ FSFCWPlusActivationMode_Req : 149|2@0+ (1,0) [0|3] "-"  ADCAM,IPC
 SG_ EPB_MaintenanceMode_Req : 155|1@0+ (1,0) [0|1] "-"  BSM
 SG_ Eng_Off_Pwr_Delay_Req : 187|2@0+ (1,0) [0|3] "-"  IPC
 SG_ Easy_Exit_D_Req : 174|1@0+ (1,0) [0|1] "-"  IPC
 SG_ DynamicGrid_Req : 100|1@0+ (1,0) [0|1] "" IPC
 SG_ Drowsy_Driver_Alert_Req : 5|1@0+ (1,0) [0|1] "-"  ADCAM,IPC
 SG_ DRLEnable_Req : 80|1@0+ (1,0) [0|1] "-"  IPC
 SG_ Dist_Unit_Req : 231|1@0+ (1,0) [0|1] "" IPC
 SG_ CorneringEnable_Req : 82|1@0+ (1,0) [0|1] "-"  IPC
 SG_ Consum_Unit_Req : 238|3@0+ (1,0) [0|7] "" IPC
 SG_ BSDEnable_Req : 140|2@0+ (1,0) [0|2] "-"  IPC
 SG_ Backup_Cam_Delay_Req : 173|1@0+ (1,0) [0|1] "-"  IPC
 SG_ AutoUnlockDoorExit_Req : 162|1@0+ (1,0) [0|1] "-"  IPC
 SG_ AutoParkBrake_Req : 103|1@0+ (1,0) [0|1] "" IPC
 SG_ AutoHighBeamEnable_Req : 92|1@0+ (1,0) [0|1] "-"  IPC
 SG_ Auto_Fold_Mirr_Req : 255|1@0+ (1,0) [0|1] "-"  IPC
 SG_ Act_Lane_Mgt_Strength_Req : 1|2@0+ (1,0) [0|2] "-"  IPC
 SG_ Act_Lane_Mgt_Req : 4|2@0+ (1,0) [0|2] "-"  IPC
 SG_ Active_Park_Prox_Chime_Req : 251|1@0+ (1,0) [0|1] "" IPC
 SG_ Active_Park_Mode_Req : 252|1@0+ (1,0) [0|1] "" IPC
 SG_ MessageCounter_TVS1 : 307|4@0+ (1,0) [0|15] "-"  ADCAM
 SG_ CRC_TVS1 : 319|8@0+ (1,0) [0|255] "-"  ADCAM
 SG_ StaticGrid_Req : 99|1@0+ (1,0) [0|1] "" IPC
 SG_ PwrLevReq : 10|3@0+ (1,0) [0|7] "" IPC
 SG_ Adaptive_Front_Lighting_Req : 29|1@0+ (1,0) [0|1] "-"  IPC
 SG_ Spaak_Req : 64|1@0+ (1,0) [0|1] "" IPC
 SG_ FOA_Alert_Type_Req : 283|2@0+ (1,0) [0|3] "" IPC
 SG_ Trailer_detection_blind_spot_Req : 287|1@0+ (1,0) [0|1] "-"  IPC
 SG_ SOC_Max_Lev_Req : 294|1@0+ (1,0) [0|1] "" IPC
 SG_ SpeedLimitAdjust_Req : 290|2@0+ (1,0) [0|3] "" IPC
 SG_ AssistedLaneChange_Req : 292|2@0+ (1,0) [0|3] "" IPC

BO_ 154 TELEMATIC_FD_18: 64 SGW
 SG_ Text_Type_Aud_Ph : 7|8@0+ (1,0) [0|254] "" IPC
 SG_ Text_Characters_Aud_Ph : 23|416@0+ (1,0) [0|0] "" IPC

BO_ 150 TELEMATIC_FD_17: 64 SGW
 SG_ Text_Type_NavTbT : 4|4@0+ (1,0) [0|14] "" IPC
 SG_ NumMultiMessage_NavTbT : 7|3@0+ (1,0) [0|7] "" IPC
 SG_ FirstFrame_NavTbT : 0|1@0+ (1,0) [0|1] "" IPC
 SG_ Text_Characters_NavTbT : 23|416@0+ (1,0) [0|0] "" IPC

BO_ 1466 TELEMATIC_FD_15: 32 SGW
 SG_ Right_Cluster_Button_function : 31|5@0+ (1,0) [0|30] "-"  IPC
 SG_ Left_Cluster_Button_function : 15|5@0+ (1,0) [0|30] "-"  IPC
 SG_ ETM_HUD_Layout : 7|3@0+ (1,0) [0|6] "-"  IPC
 SG_ ETM_HUD_CustomSetting : 4|2@0+ (1,0) [0|3] "-"  IPC
 SG_ Center_Cluster_Button_function : 23|5@0+ (1,0) [0|30] "-"  IPC
 SG_ HUtoIPC_NAV_Sts : 2|3@0+ (1,0) [0|6] "-"  IPC
 SG_ ChargeNow : 89|1@0+ (1,0) [0|1] "-"  EVCU2

BO_ 1465 TELEMATIC_FD_14: 32 SGW
 SG_ Radio_Delete_Request : 183|3@0+ (1,0) [0|6] "" IPC
 SG_ ETM_HUD_Zone5 : 172|3@0+ (1,0) [0|6] "-"  IPC
 SG_ ETM_HUD_Zone4 : 175|3@0+ (1,0) [0|6] "-"  IPC
 SG_ ETM_HUD_Zone3 : 164|3@0+ (1,0) [0|6] "-"  IPC
 SG_ ETM_HUD_Zone2 : 167|3@0+ (1,0) [0|6] "-"  IPC
 SG_ ETM_HUD_Zone1 : 156|3@0+ (1,0) [0|6] "-"  IPC
 SG_ ClusterAudiomode : 127|7@0+ (1,0) [0|126] "-"  IPC
 SG_ Radio_Profile_Request : 82|3@0+ (1,0) [0|6] "-"  IPC

BO_ 608 TELEMATIC_FD_11: 32 SGW
 SG_ SpdUnits : 80|1@0+ (1,0) [0|1] "-"  ADCAM,MPAD
 SG_ MessageCounter_Telematic11 : 179|4@0+ (1,0) [0|15] "-"  ADCAM,MPAD
 SG_ Map_Data_Supplier : 119|3@0+ (1,0) [0|7] "-"  ADCAM
 SG_ DrvSide : 88|1@0+ (1,0) [0|1] "-"  ADCAM,MPAD
 SG_ CRC_Telematic11 : 191|8@0+ (1,0) [0|255] "-"  ADCAM,MPAD
 SG_ PathIdx_CS : 87|6@0+ (1,0) [0|63] "-"  ADCAM,MPAD
 SG_ NUM_OF_LANES_DRV_DIR_CS : 99|3@0+ (1,0) [0|7] "-"  ADCAM
 SG_ NavDataAvailable_CS : 81|1@0+ (1,0) [0|1] "-"  ADCAM,MPAD
 SG_ FuncRoadClass_CS : 95|3@0+ (1,0) [0|7] "-"  ADCAM,MPAD
 SG_ FormOfWay_CS : 103|4@0+ (1,0) [0|15] "-"  ADCAM,MPAD
 SG_ EffSpdLmtType_CS : 116|3@0+ (1,0) [0|7] "-"  ADCAM,MPAD
 SG_ EffSpdLmt_NS : 28|5@0+ (1,0) [0|31] "" ADCAM
 SG_ EffSpdLmt_CS : 111|5@0+ (1,0) [0|31] "-"  ADCAM,MPAD,IPC
 SG_ Divided_Road_CS : 90|2@0+ (1,0) [0|3] "-"  ADCAM
 SG_ BuiltUpArea_CS : 92|2@0+ (1,0) [0|3] "-"  ADCAM,MPAD
 SG_ CountryCode : 113|10@0+ (1,0) [0|1023] "-"  ADCAM,MPAD

BO_ 1429 TBM_FD_1: 32 SGW
 SG_ SOSCallStatus : 75|4@0+ (1,0) [0|15] "-"  IPC
 SG_ U_CONN_REQ_BCM_FOA_ALERT_FB : 2|1@0+ (1,0) [0|1] "" BCM
 SG_ Disarm_Mobile_App_Req : 6|1@0+ (1,0) [0|1] "" BCM

BO_ 612 SCCM_FD_3: 32 BCM
 SG_ WprWashSw_Psd : 85|2@0+ (1,0) [0|2] "-"  ADCAM
 SG_ MessageCounter_SCCM3 : 179|4@0+ (1,0) [0|15] "-"  ADCAM
 SG_ CRC_SCCM3 : 191|8@0+ (1,0) [0|255] "-"  ADCAM

BO_ 160 RFHUB_FD_4: 32 RFHM
 SG_ UConnSeed4 : 111|8@0+ (1,0) [0|255] "" SGW
 SG_ UConnSeed3 : 103|8@0+ (1,0) [0|255] "" SGW
 SG_ UConnSeed2 : 95|8@0+ (1,0) [0|255] "" SGW
 SG_ UConnSeed1 : 87|8@0+ (1,0) [0|255] "" SGW

BO_ 255 PT_TORQUE_FD_1: 48 EVCU2
 SG_ MessageCounter_PT_TORQUE_FD_1 : 307|4@0+ (1,0) [0|15] "-"  ADCAM,MPAD,DTCM
 SG_ CRC_PT_TORQUE_FD_1 : 319|8@0+ (1,0) [0|255] "-"  ADCAM,MPAD,DTCM
 SG_ SSC_TrqEnblRq_Allowed : 22|1@0+ (1,0) [0|1] "-"  BSM
 SG_ PPPA_TrqEnblRq_Allowed : 21|1@0+ (1,0) [0|1] "-"  Vector__XXX
 SG_ ESC_TrqEnblRq_Allowed : 38|1@0+ (1,0) [0|1] "-"  BSM
 SG_ Accel_Pedal_Override : 37|1@0+ (1,0) [0|1] "-"  ADCAM,MPAD,BCM,BSM
 SG_ ACC_NCC_TrqEnblRq_Allowed : 23|1@0+ (1,0) [0|1] "-"  BCM
 SG_ Total_AxleTorque_Static : 151|16@0+ (2,-65534) [-65534|65536] "Nm"  SGW,BCM,BSM,DTCM
 SG_ RRCC_TrqEnblRq_Allowed : 39|1@0+ (1,0) [0|1] "-"  Vector__XXX
 SG_ Rear_AxleTorque_Static : 183|16@0+ (2,-65534) [-65534|65536] "Nm"  SGW,BCM,BSM
 SG_ Front_AxleTorque_Static : 167|16@0+ (2,-65534) [-65534|65536] "Nm"  SGW,BCM,BSM
 SG_ Veh_StandStill_Req_OPD : 36|2@0+ (1,0) [0|3] "" BSM
 SG_ Front_Axle_Target_Torque : 199|16@0+ (2,-65535) [-65535|65535] "Nm"  BSM
 SG_ Rear_Axle_Target_Torque : 215|16@0+ (2,-65535) [-65535|65535] "Nm"  BSM

CM_ SG_ 158 Windows_With_Fob_Req "Windows with Key Fob setting request";
CM_ SG_ 158 TyrePress_Unit_Req "Tyre Pressure setting request";
CM_ SG_ 158 Trailer_detection_blind_spot_Req "Trailer_detection_blind_spot_Req";
CM_ SG_ 158 Traffic_Sign_Warn_Req "Traffic Sign Warning setting request";
CM_ SG_ 158 Traffic_Sign_Info_Req "Traffic Sign Information setting request";
CM_ SG_ 158 Torque_Unit_Req "Torque Unit setting request";
CM_ SG_ 158 Tire_Fill_Alert_Req "Tire Fill Alert setting request";
CM_ SG_ 158 Tilt_Mirr_Rev_Req "Tilt Mirrors in Reverse setting request";
CM_ SG_ 158 Temp_Unit_Req "Temperature Unit setting request";
CM_ SG_ 158 SVC_Guidelines_Req "Surround View Camera Guidelines setting request";
CM_ SG_ 158 SVC_Delay_Req "Surround View Camera Delay setting request";
CM_ SG_ 158 Steer_Feel_Req "Steering Feel setting request";
CM_ SG_ 158 StaticGrid_Req "Rear View Camera Static Gridlines request";
CM_ SG_ 158 SpeedLockDoorEnable_Req "This signal is managed when the driver requests a setting of Auto Door Locks";
CM_ SG_ 158 SpeedLimitAdjust_Req "L2+ Feature for Speed Limit Adjust Request";
CM_ SG_ 158 Speed_Unit_Req "Speed Unit setting request";
CM_ SG_ 158 Spaak_Req "Spaak _Req";
CM_ SG_ 158 SoundHornRemoteStart_Req "This signal is managed when the driver requests a setting of the Sound Horn with Remote Start";
CM_ SG_ 158 SoundHornLock_Req "This signal is managed when the driver requests a setting of the Sound Horn with Unlock";
CM_ SG_ 158 SOC_Max_Lev_Req "Customer top of SOC selection request.";
CM_ SG_ 158 Sdw_Req "This signal is managed when the driver request a  setting of the Sdw";
CM_ SG_ 158 RKEMemoryLinkEnable_Req "To enable or disable RKE linked to memory";
CM_ SG_ 158 RemStNrmlStEnbl_Req "Setting to allow seat heating and venting for all starts, remote starts, or none";
CM_ SG_ 158 RemoteDoorUnlock_Req "This signal is managed when the driver requests a setting of the Remote Door Unlock";
CM_ SG_ 158 Rear_Brk_Asst_Req "Rear Braking Assist setting request";
CM_ SG_ 158 Rdy_To_Drive_Req "Ready to Driver Pop Up setting request";
CM_ SG_ 158 RainSensorLevel_Req "This signal is managed when the driver requests a setting of Rain Sensor Level";
CM_ SG_ 158 PwrLevReq "This signal is managed when the driver requests the Power Level setting";
CM_ SG_ 158 Proximity_WU_Req "Proximity Wakeup setting request";
CM_ SG_ 158 PLGAlert_Req "Setting to turn on/off the power liftgate chime";
CM_ SG_ 158 Ped_EM_Brk_Warn_Act_Req "Pedestrian Emergency Braking Warning & Active Braking setting request";
CM_ SG_ 158 HeadLightWipers_Req "Setting to turn on/off headlights with wipers";
CM_ SG_ 158 AutoParkBrake_Req "This signal is managed when the driver requests a setting of the Auto Park Brake";
CM_ SG_ 158 AutoUnlockDoorExit_Req "This signal is managed when the driver request a setting of  Auto Unlock Door On Exit";
CM_ SG_ 158 Backup_Cam_Delay_Req "Backup Camera Delay setting request";
CM_ SG_ 158 BSDEnable_Req "This signal is managed when the driver requests a setting of Blind Spot Alert";
CM_ SG_ 158 AutoHighBeamEnable_Req "This signal is managed when the driver requests a setting of  the Auto High Beam feature";
CM_ SG_ 158 Auto_Fold_Mirr_Req "Auto Folding Mirror setting request";
CM_ SG_ 158 AssistedLaneChange_Req "L2+ Feature for Assisted Lane Change Request";
CM_ SG_ 158 Adaptive_Front_Lighting_Req "Adaptive_Front_Lighting_Req";
CM_ SG_ 158 Active_Park_Prox_Chime_Req "Active Parksense Proximity Chime setting request";
CM_ SG_ 158 Active_Park_Mode_Req "Active Parksense Mode setting request";
CM_ SG_ 158 Act_Lane_Mgt_Strength_Req "Act Lane Mgt Strength setting request";
CM_ SG_ 158 Act_Lane_Mgt_Req "Act Lane Mgt setting request";
CM_ SG_ 158 Consum_Unit_Req "Consumption Unit setting request";
CM_ SG_ 158 CorneringEnable_Req "This signal is managed when the driver requests a setting of Cornering Lights";
CM_ SG_ 158 CRC_TVS1 "CRC according to SAE J1850 standard at each frame transmission.";
CM_ SG_ 158 Dist_Unit_Req "Distance Unit setting request";
CM_ SG_ 158 DRLEnable_Req "This signal is managed when the driver requests a setting of the DRL feature";
CM_ SG_ 158 Drowsy_Driver_Alert_Req "Drowsy Driver Alert setting request";
CM_ SG_ 158 DynamicGrid_Req "Rear View Camera Dynamic Gridlines request";
CM_ SG_ 158 Easy_Exit_D_Req "Driver Easy Exit Seat setting request";
CM_ SG_ 158 Eng_Off_Pwr_Delay_Req "Engine Off Power Delay setting request";
CM_ SG_ 158 EPB_MaintenanceMode_Req "This signal is managed when the driver request a setting of  Maintenance Mode";
CM_ SG_ 158 FlashLightWLock_Req "This signal is managed when the driver request a setting of  Flash Light With Lock";
CM_ SG_ 158 FOA_Alert_Type_Req "Forgotten Object Alert Type";
CM_ SG_ 158 FSFCWPlusActivationMode_Req "This signal is managed when the driver request a  setting of FSFCW";
CM_ SG_ 158 FSFCWPlusSetting_Req "This signal is managed when the driver request a  setting of FSFCW";
CM_ SG_ 158 Handsfree_Liftgate_Req "Handsfree Liftgate setting request";
CM_ SG_ 158 Fwrd_Cam_Guidelines_Req "Forward Facing Camera Guidelines setting request";
CM_ SG_ 158 HeadlightsOffDelay_Req "This signal is managed when the driver requests a setting of the Headligts Off Delay";
CM_ SG_ 158 PassiveEntry_Req "This signal is managed when the driver requests a setting of the Passive Entry";
CM_ SG_ 158 PamChimeVolumeRear_Req "This signal is managed when the driver request a  setting of the of Chime Volume  of the PAM  8  Channels";
CM_ SG_ 158 PamChimeVolumeFront_Req "This signal is managed when the driver request a  setting of the of Chime Volume  of the PAM";
CM_ SG_ 158 Night_Vision_Req "Night Vision setting request";
CM_ SG_ 158 New_Spd_Zone_Ind_Req "New Speed Zone Indication setting request";
CM_ SG_ 158 MessageCounter_TVS1 "This signal is a counter used for safety checks strategies. This counter is incremented of 1 (one) unit at each frame transmission.";
CM_ SG_ 158 LDW_Sensibility_Req "This signal is managed when the driver requests a setting of  the LDW Sensibility";
CM_ SG_ 158 LDW_Intensity_Req "This signal is managed when the driver requests a setting of the LDW Intensity";
CM_ SG_ 158 LanguageSelection_Req "This signal is managed when the driver requests a setting of Language";
CM_ SG_ 158 Intelligent_Speed_Req "Intelligent Speed setting request";
CM_ SG_ 158 Illuminated_Approach_Req "Illuminated Approach setting request";
CM_ SG_ 158 HP_Unit_Req "Horsepower Unit setting request";
CM_ SG_ 158 HourMode_Req "This signal is managed when the driver requests a setting of Hour Mode";
CM_ SG_ 158 Hill_Start_Assist_Req "Hill Start Assist setting request";
CM_ SG_ 158 GreetingLightsEnable_Req "This signal is managed when the button of block or unblocking of the door is pressed.";
CM_ SG_ 1466 Right_Cluster_Button_function "Value / text to be shown in Right steering wheel button on cluster";
CM_ SG_ 1466 Center_Cluster_Button_function "Value / text to be shown in Center steering wheel button on cluster";
CM_ SG_ 1466 ETM_HUD_CustomSetting "HUD Setting Selection by User";
CM_ SG_ 1466 ChargeNow "Charge Now Signal";
CM_ SG_ 1466 ETM_HUD_Layout "HUD Layout selection";
CM_ SG_ 1466 Left_Cluster_Button_function "Value / text to be shown in left steering wheel button on cluster";
CM_ SG_ 1466 HUtoIPC_NAV_Sts "HU to IPC NAV Sts";
CM_ SG_ 1465 Radio_Profile_Request "Changes the profile based on selection";
CM_ SG_ 1465 Radio_Delete_Request "Updates based on user which profile is deleted";
CM_ SG_ 1465 ETM_HUD_Zone5 "ETM to Cluster HUD Zone 5";
CM_ SG_ 1465 ETM_HUD_Zone4 "ETM to Cluster HUD Zone 4";
CM_ SG_ 1465 ETM_HUD_Zone3 "ETM to Cluster HUD Zone 3";
CM_ SG_ 1465 ETM_HUD_Zone2 "ETM to Cluster HUD Zone 2";
CM_ SG_ 1465 ETM_HUD_Zone1 "ETM to Cluster HUD Zone 1";
CM_ SG_ 1465 ClusterAudiomode "TGW audio mode for Cabin/Driver";
CM_ SG_ 608 SpdUnits "Speed Units";
CM_ SG_ 608 EffSpdLmt_NS "Speed Limit value for the Next Segment";
CM_ SG_ 608 EffSpdLmt_CS "Effective Speed Limit Value";
CM_ SG_ 608 DrvSide "Driving Side";
CM_ SG_ 608 Divided_Road_CS "Provides information on roadway is devided or not. (Reference ADASIS 2.0.2.0)";
CM_ SG_ 608 CRC_Telematic11 "CRC according to SAE J1850 standard at each frame transmission.";
CM_ SG_ 608 CountryCode "Country Code (Coding based on ISO 3166-1 numeric)";
CM_ SG_ 608 BuiltUpArea_CS "Segment built-up area status";
CM_ SG_ 608 NavDataAvailable_CS "Validity of Available Nav Data [1 = Valid Data Available]";
CM_ SG_ 608 MessageCounter_Telematic11 "This signal is a counter used for safety checks strategies. This counter is incremented of 1 (one) unit at each frame transmission.";
CM_ SG_ 608 PathIdx_CS "Path Index";
CM_ SG_ 608 NUM_OF_LANES_DRV_DIR_CS "Number of lanes in driving direction";
CM_ SG_ 608 Map_Data_Supplier "Map Provider of current area (map tile, region, country)";
CM_ SG_ 608 FuncRoadClass_CS "Functional Road Class";
CM_ SG_ 608 FormOfWay_CS "Form of Way";
CM_ SG_ 608 EffSpdLmtType_CS "Effective Speed Limit Type";
CM_ SG_ 1429 Disarm_Mobile_App_Req "Forgotten Object Alert mobile alert request";
CM_ SG_ 1429 SOSCallStatus "SOS call function status";
CM_ SG_ 1429 U_CONN_REQ_BCM_FOA_ALERT_FB "Forgotten Object Alert Uconnect Feedback";
CM_ SG_ 612 WprWashSw_Psd "Front wiper switch pressed";
CM_ SG_ 612 MessageCounter_SCCM3 "This signal is a counter used for safety checks strategies. This counter is incremented of 1 (one) unit at each frame transmission.";
CM_ SG_ 612 CRC_SCCM3 "CRC according to SAE J1850 standard at each frame transmission.";
CM_ SG_ 160 UConnSeed4 "random # for security, Character 4";
CM_ SG_ 160 UConnSeed3 "random # for security, Character 3";
CM_ SG_ 160 UConnSeed2 "random # for security, Character 2";
CM_ SG_ 160 UConnSeed1 "random # for security, Character 1";
CM_ SG_ 255 ACC_NCC_TrqEnblRq_Allowed "ACC/NCC Torque request allowed. True =[1]";
CM_ SG_ 255 CRC_PT_TORQUE_FD_1 "CRC according to SAE J1850 standard at each frame transmission.";
CM_ SG_ 255 Front_AxleTorque_Static "Static Front Axle Torqu";
CM_ SG_ 255 ESC_TrqEnblRq_Allowed "ESC Torque request allowed. True =[1]";
CM_ SG_ 255 Front_Axle_Target_Torque "Front Axle Target Axle Torque Request from EVCU2";
CM_ SG_ 255 MessageCounter_PT_TORQUE_FD_1 "This signal is a counter used for safety checks strategies. This counter is incremented of 1 (one) unit at each frame transmission.";
CM_ SG_ 255 Rear_Axle_Target_Torque "Rear Axle Target Axle Torque Request from EVCU2";
CM_ SG_ 255 PPPA_TrqEnblRq_Allowed "PPPA Torque request allowed. True =[1]";
CM_ SG_ 255 Total_AxleTorque_Static "Static Axle Torque (effective total Axle torque)";
CM_ SG_ 255 SSC_TrqEnblRq_Allowed "SCC Torque request allowed. True =[1]";
CM_ SG_ 255 Veh_StandStill_Req_OPD "Vehicle Stand Still Request from EVCU2 When One Pedal Drive is Active";
CM_ SG_ 255 RRCC_TrqEnblRq_Allowed "RRCC Torque request allowed. True =[1]";
CM_ SG_ 255 Accel_Pedal_Override "Driver Accelerator Pedal Override. True =[1]";
CM_ SG_ 255 Rear_AxleTorque_Static "Static Rear Axle Torque";
BA_DEF_ BO_ "CANFD_BRS" ENUM "0","1";
BA_DEF_ BO_ "VFrameFormat" ENUM "StandardCAN","ExtendedCAN","reserved","reserved","reserved","reserved","reserved","reserved","reserved","reserved","reserved","reserved","reserved","reserved","StandardCAN_FD","ExtendedCAN_FD";
BA_DEF_ BO_ "DiagConnection" HEX 0 65535;
BA_DEF_ BO_ "DiagState" ENUM "No","Yes";
BA_DEF_ BO_ "NmAsrMessage" ENUM "No","Yes";
BA_DEF_ BO_ "GenMsgDelayTime" INT 0 65535;
BA_DEF_ BO_ "GenMsgCycleTime" INT 0 65535;
BA_DEF_ BO_ "GenMsgCycleTimeFast" INT 0 65535;
BA_DEF_ BO_ "GenMsgStartDelayTime" INT 0 65535;
BA_DEF_ BO_ "GenMsgILSupport" ENUM "No","Yes";
BA_DEF_ BO_ "GenMsgNrOfRepetition" INT 0 255;
BA_DEF_ BO_ "GenMsgSendType" ENUM "Cyclic","NotUsed","NotUsed","NotUsed","NotUsed","NotUsed","NotUsed","NotUsed","NoMsgSendType";
BA_DEF_ BO_ "NmMessage" ENUM "No","Yes";
BA_DEF_ BO_ "DiagResponse" ENUM "No","Yes";
BA_DEF_ BO_ "Type" ENUM "P","C","PE","COC","PE_Cntrl","E","E_Cntrl","OC","S","BAF","DC","EM","MM","ISO-TP","-";
BA_DEF_ BO_ "DiagRequest" ENUM "No","Yes";
BA_DEF_ SG_ "GenSigTimeoutTime_SGW" INT 0 65535;
BA_DEF_ SG_ "GenSigTimeoutTime_RFHM" INT 0 65535;
BA_DEF_ SG_ "GenSigTimeoutTime_MPAD" INT 0 65535;
BA_DEF_ SG_ "GenSigTimeoutTime_IPC" INT 0 65535;
BA_DEF_ SG_ "GenSigTimeoutTime_GNMM" INT 0 65535;
BA_DEF_ SG_ "GenSigTimeoutTime_EVCU2" INT 0 65535;
BA_DEF_ SG_ "GenSigTimeoutTime_ESL" INT 0 65535;
BA_DEF_ SG_ "GenSigTimeoutTime_ECM" INT 0 65535;
BA_DEF_ SG_ "GenSigTimeoutTime_DTCM" INT 0 65535;
BA_DEF_ SG_ "GenSigTimeoutTime_DMSM" INT 0 65535;
BA_DEF_ SG_ "GenSigTimeoutTime_BSM" INT 0 65535;
BA_DEF_ SG_ "GenSigTimeoutTime_BCM" INT 0 65535;
BA_DEF_ SG_ "GenSigTimeoutTime_AGSM" INT 0 65535;
BA_DEF_ SG_ "GenSigTimeoutTime_ADCAM" INT 0 65535;
BA_DEF_ SG_ "SystemSignalLongSymbol" STRING ;
BA_DEF_ SG_ "GenSigSendType" ENUM "NotUsed","OnWrite","OnWriteWithRepetition","OnChange","OnChangeWithRepetition","IfActive","IfActiveWithRepetition","NoSigSendType";
BA_DEF_ SG_ "GenSigInactiveValue" INT 0 2147483647;
BA_DEF_ SG_ "GenSigStartValue" INT 0 2147483647;
BA_DEF_DEF_ "CANFD_BRS" "0";
BA_DEF_DEF_ "VFrameFormat" "StandardCAN_FD";
BA_DEF_DEF_ "DiagConnection" 0;
BA_DEF_DEF_ "DiagState" "No";
BA_DEF_DEF_ "NmAsrMessage" "No";
BA_DEF_DEF_ "GenMsgDelayTime" 0;
BA_DEF_DEF_ "GenMsgCycleTime" 0;
BA_DEF_DEF_ "GenMsgCycleTimeFast" 0;
BA_DEF_DEF_ "GenMsgStartDelayTime" 0;
BA_DEF_DEF_ "GenMsgILSupport" "No";
BA_DEF_DEF_ "GenMsgNrOfRepetition" 0;
BA_DEF_DEF_ "GenMsgSendType" "NoMsgSendType";
BA_DEF_DEF_ "NmMessage" "No";
BA_DEF_DEF_ "DiagResponse" "No";
BA_DEF_DEF_ "Type" "-";
BA_DEF_DEF_ "DiagRequest" "No";
BA_DEF_DEF_ "GenSigTimeoutTime_SGW" 2500;
BA_DEF_DEF_ "GenSigTimeoutTime_RFHM" 2500;
BA_DEF_DEF_ "GenSigTimeoutTime_MPAD" 2500;
BA_DEF_DEF_ "GenSigTimeoutTime_IPC" 2500;
BA_DEF_DEF_ "GenSigTimeoutTime_GNMM" 2500;
BA_DEF_DEF_ "GenSigTimeoutTime_EVCU2" 2500;
BA_DEF_DEF_ "GenSigTimeoutTime_ESL" 2500;
BA_DEF_DEF_ "GenSigTimeoutTime_ECM" 2500;
BA_DEF_DEF_ "GenSigTimeoutTime_DTCM" 2500;
BA_DEF_DEF_ "GenSigTimeoutTime_DMSM" 2500;
BA_DEF_DEF_ "GenSigTimeoutTime_BSM" 2500;
BA_DEF_DEF_ "GenSigTimeoutTime_BCM" 2500;
BA_DEF_DEF_ "GenSigTimeoutTime_AGSM" 2500;
BA_DEF_DEF_ "GenSigTimeoutTime_ADCAM" 2500;
BA_DEF_DEF_ "SystemSignalLongSymbol" "";
BA_DEF_DEF_ "GenSigSendType" "NoSigSendType";
BA_DEF_DEF_ "GenSigInactiveValue" 0;
BA_DEF_DEF_ "GenSigStartValue" 0;
BA_ "CANFD_BRS" BO_ 158 1;
BA_ "GenMsgILSupport" BO_ 158 1;
BA_ "Type" BO_ 158 8;
BA_ "CANFD_BRS" BO_ 154 1;
BA_ "GenMsgILSupport" BO_ 154 1;
BA_ "Type" BO_ 154 7;
BA_ "Type" BO_ 150 7;
BA_ "CANFD_BRS" BO_ 150 1;
BA_ "GenMsgILSupport" BO_ 150 1;
BA_ "CANFD_BRS" BO_ 1466 1;
BA_ "GenMsgDelayTime" BO_ 1466 20;
BA_ "GenMsgCycleTime" BO_ 1466 1000;
BA_ "GenMsgCycleTimeFast" BO_ 1466 20;
BA_ "GenMsgILSupport" BO_ 1466 1;
BA_ "GenMsgNrOfRepetition" BO_ 1466 2;
BA_ "GenMsgSendType" BO_ 1466 0;
BA_ "Type" BO_ 1466 3;
BA_ "CANFD_BRS" BO_ 1465 1;
BA_ "GenMsgDelayTime" BO_ 1465 20;
BA_ "GenMsgCycleTime" BO_ 1465 1000;
BA_ "GenMsgCycleTimeFast" BO_ 1465 20;
BA_ "GenMsgILSupport" BO_ 1465 1;
BA_ "GenMsgNrOfRepetition" BO_ 1465 2;
BA_ "GenMsgSendType" BO_ 1465 0;
BA_ "Type" BO_ 1465 3;
BA_ "CANFD_BRS" BO_ 608 1;
BA_ "GenMsgDelayTime" BO_ 608 20;
BA_ "GenMsgCycleTime" BO_ 608 100;
BA_ "GenMsgCycleTimeFast" BO_ 608 20;
BA_ "GenMsgILSupport" BO_ 608 1;
BA_ "GenMsgNrOfRepetition" BO_ 608 2;
BA_ "GenMsgSendType" BO_ 608 0;
BA_ "Type" BO_ 608 3;
BA_ "CANFD_BRS" BO_ 1429 1;
BA_ "GenMsgCycleTime" BO_ 1429 1000;
BA_ "GenMsgILSupport" BO_ 1429 1;
BA_ "GenMsgSendType" BO_ 1429 0;
BA_ "Type" BO_ 1429 3;
BA_ "CANFD_BRS" BO_ 612 1;
BA_ "GenMsgDelayTime" BO_ 612 20;
BA_ "GenMsgCycleTime" BO_ 612 100;
BA_ "GenMsgCycleTimeFast" BO_ 612 20;
BA_ "GenMsgStartDelayTime" BO_ 612 80;
BA_ "GenMsgILSupport" BO_ 612 1;
BA_ "GenMsgNrOfRepetition" BO_ 612 2;
BA_ "GenMsgSendType" BO_ 612 0;
BA_ "Type" BO_ 612 3;
BA_ "CANFD_BRS" BO_ 160 1;
BA_ "GenMsgILSupport" BO_ 160 1;
BA_ "Type" BO_ 160 8;
BA_ "CANFD_BRS" BO_ 255 1;
BA_ "GenMsgCycleTime" BO_ 255 10;
BA_ "GenMsgILSupport" BO_ 255 1;
BA_ "GenMsgSendType" BO_ 255 0;
BA_ "Type" BO_ 255 1;
BA_ "GenSigTimeoutTime_RFHM" SG_ 158 PassiveEntry_Req 0;
BA_ "GenSigTimeoutTime_GNMM" SG_ 158 SpeedLockDoorEnable_Req 0;
BA_ "GenSigTimeoutTime_EVCU2" SG_ 158 SpeedLockDoorEnable_Req 0;
BA_ "GenSigTimeoutTime_ESL" SG_ 158 SpeedLockDoorEnable_Req 0;
BA_ "GenSigTimeoutTime_ECM" SG_ 158 SpeedLockDoorEnable_Req 0;
BA_ "GenSigTimeoutTime_DTCM" SG_ 158 SpeedLockDoorEnable_Req 0;
BA_ "GenSigTimeoutTime_DMSM" SG_ 158 SpeedLockDoorEnable_Req 0;
BA_ "GenSigTimeoutTime_SGW" SG_ 1466 Center_Cluster_Button_function 0;
BA_ "GenSigTimeoutTime_RFHM" SG_ 1466 Center_Cluster_Button_function 0;
BA_ "GenSigTimeoutTime_MPAD" SG_ 1466 Center_Cluster_Button_function 0;
BA_ "GenSigTimeoutTime_GNMM" SG_ 1466 Center_Cluster_Button_function 0;
BA_ "GenSigTimeoutTime_EVCU2" SG_ 1466 Center_Cluster_Button_function 0;
BA_ "GenSigTimeoutTime_ESL" SG_ 1466 Center_Cluster_Button_function 0;
BA_ "GenSigTimeoutTime_ECM" SG_ 1466 Center_Cluster_Button_function 0;
BA_ "GenSigTimeoutTime_DTCM" SG_ 1466 Center_Cluster_Button_function 0;
BA_ "GenSigTimeoutTime_DMSM" SG_ 1466 Center_Cluster_Button_function 0;
BA_ "GenSigTimeoutTime_BSM" SG_ 1466 Center_Cluster_Button_function 0;
BA_ "GenSigTimeoutTime_BCM" SG_ 1466 Center_Cluster_Button_function 0;
BA_ "GenSigTimeoutTime_AGSM" SG_ 1466 Center_Cluster_Button_function 0;
BA_ "GenSigTimeoutTime_ADCAM" SG_ 1466 Center_Cluster_Button_function 0;
BA_ "GenSigSendType" SG_ 1466 Center_Cluster_Button_function 3;
BA_ "GenSigTimeoutTime_SGW" SG_ 1465 ETM_HUD_Zone5 0;
BA_ "GenSigTimeoutTime_RFHM" SG_ 1465 ETM_HUD_Zone5 0;
BA_ "GenSigTimeoutTime_MPAD" SG_ 1465 ETM_HUD_Zone5 0;
BA_ "GenSigTimeoutTime_GNMM" SG_ 1465 ETM_HUD_Zone5 0;
BA_ "GenSigTimeoutTime_EVCU2" SG_ 1465 ETM_HUD_Zone5 0;
BA_ "GenSigTimeoutTime_ESL" SG_ 1465 ETM_HUD_Zone5 0;
BA_ "GenSigTimeoutTime_ECM" SG_ 1465 ETM_HUD_Zone5 0;
BA_ "GenSigTimeoutTime_DTCM" SG_ 1465 ETM_HUD_Zone5 0;
BA_ "GenSigTimeoutTime_DMSM" SG_ 1465 ETM_HUD_Zone5 0;
BA_ "GenSigTimeoutTime_BSM" SG_ 1465 ETM_HUD_Zone5 0;
BA_ "GenSigTimeoutTime_BCM" SG_ 1465 ETM_HUD_Zone5 0;
BA_ "GenSigTimeoutTime_AGSM" SG_ 1465 ETM_HUD_Zone5 0;
BA_ "GenSigTimeoutTime_ADCAM" SG_ 1465 ETM_HUD_Zone5 0;
BA_ "GenSigSendType" SG_ 1465 ETM_HUD_Zone5 3;
BA_ "GenSigTimeoutTime_SGW" SG_ 1465 Radio_Delete_Request 0;
BA_ "GenSigTimeoutTime_RFHM" SG_ 1465 Radio_Delete_Request 0;
BA_ "GenSigTimeoutTime_MPAD" SG_ 1465 Radio_Delete_Request 0;
BA_ "GenSigTimeoutTime_GNMM" SG_ 1465 Radio_Delete_Request 0;
BA_ "GenSigTimeoutTime_EVCU2" SG_ 1465 Radio_Delete_Request 0;
BA_ "GenSigTimeoutTime_ESL" SG_ 1465 Radio_Delete_Request 0;
BA_ "GenSigTimeoutTime_ECM" SG_ 1465 Radio_Delete_Request 0;
BA_ "GenSigTimeoutTime_DTCM" SG_ 1465 Radio_Delete_Request 0;
BA_ "GenSigTimeoutTime_DMSM" SG_ 1465 Radio_Delete_Request 0;
BA_ "GenSigTimeoutTime_BSM" SG_ 1465 Radio_Delete_Request 0;
BA_ "GenSigTimeoutTime_BCM" SG_ 1465 Radio_Delete_Request 0;
BA_ "GenSigTimeoutTime_AGSM" SG_ 1465 Radio_Delete_Request 0;
BA_ "GenSigTimeoutTime_ADCAM" SG_ 1465 Radio_Delete_Request 0;
BA_ "GenSigSendType" SG_ 1465 Radio_Delete_Request 3;
BA_ "GenSigTimeoutTime_SGW" SG_ 1465 ETM_HUD_Zone1 0;
BA_ "GenSigTimeoutTime_RFHM" SG_ 1465 ETM_HUD_Zone1 0;
BA_ "GenSigTimeoutTime_MPAD" SG_ 1465 ETM_HUD_Zone1 0;
BA_ "GenSigTimeoutTime_GNMM" SG_ 1465 ETM_HUD_Zone1 0;
BA_ "GenSigTimeoutTime_EVCU2" SG_ 1465 ETM_HUD_Zone1 0;
BA_ "GenSigTimeoutTime_ESL" SG_ 1465 ETM_HUD_Zone1 0;
BA_ "GenSigTimeoutTime_ECM" SG_ 1465 ETM_HUD_Zone1 0;
BA_ "GenSigTimeoutTime_DTCM" SG_ 1465 ETM_HUD_Zone1 0;
BA_ "GenSigTimeoutTime_DMSM" SG_ 1465 ETM_HUD_Zone1 0;
BA_ "GenSigTimeoutTime_BSM" SG_ 1465 ETM_HUD_Zone1 0;
BA_ "GenSigTimeoutTime_BCM" SG_ 1465 ETM_HUD_Zone1 0;
BA_ "GenSigTimeoutTime_AGSM" SG_ 1465 ETM_HUD_Zone1 0;
BA_ "GenSigTimeoutTime_ADCAM" SG_ 1465 ETM_HUD_Zone1 0;
BA_ "GenSigSendType" SG_ 1465 ETM_HUD_Zone1 3;
BA_ "GenSigTimeoutTime_SGW" SG_ 1465 ETM_HUD_Zone2 0;
BA_ "GenSigTimeoutTime_RFHM" SG_ 1465 ETM_HUD_Zone2 0;
BA_ "GenSigTimeoutTime_MPAD" SG_ 1465 ETM_HUD_Zone2 0;
BA_ "GenSigTimeoutTime_GNMM" SG_ 1465 ETM_HUD_Zone2 0;
BA_ "GenSigTimeoutTime_EVCU2" SG_ 1465 ETM_HUD_Zone2 0;
BA_ "GenSigTimeoutTime_ESL" SG_ 1465 ETM_HUD_Zone2 0;
BA_ "GenSigTimeoutTime_ECM" SG_ 1465 ETM_HUD_Zone2 0;
BA_ "GenSigTimeoutTime_DTCM" SG_ 1465 ETM_HUD_Zone2 0;
BA_ "GenSigTimeoutTime_DMSM" SG_ 1465 ETM_HUD_Zone2 0;
BA_ "GenSigTimeoutTime_BSM" SG_ 1465 ETM_HUD_Zone2 0;
BA_ "GenSigTimeoutTime_BCM" SG_ 1465 ETM_HUD_Zone2 0;
BA_ "GenSigTimeoutTime_AGSM" SG_ 1465 ETM_HUD_Zone2 0;
BA_ "GenSigTimeoutTime_ADCAM" SG_ 1465 ETM_HUD_Zone2 0;
BA_ "GenSigSendType" SG_ 1465 ETM_HUD_Zone2 3;
BA_ "GenSigTimeoutTime_SGW" SG_ 1465 ETM_HUD_Zone3 0;
BA_ "GenSigTimeoutTime_RFHM" SG_ 1465 ETM_HUD_Zone3 0;
BA_ "GenSigTimeoutTime_MPAD" SG_ 1465 ETM_HUD_Zone3 0;
BA_ "GenSigTimeoutTime_GNMM" SG_ 1465 ETM_HUD_Zone3 0;
BA_ "GenSigTimeoutTime_EVCU2" SG_ 1465 ETM_HUD_Zone3 0;
BA_ "GenSigTimeoutTime_ESL" SG_ 1465 ETM_HUD_Zone3 0;
BA_ "GenSigTimeoutTime_ECM" SG_ 1465 ETM_HUD_Zone3 0;
BA_ "GenSigTimeoutTime_DTCM" SG_ 1465 ETM_HUD_Zone3 0;
BA_ "GenSigTimeoutTime_DMSM" SG_ 1465 ETM_HUD_Zone3 0;
BA_ "GenSigTimeoutTime_BSM" SG_ 1465 ETM_HUD_Zone3 0;
BA_ "GenSigTimeoutTime_BCM" SG_ 1465 ETM_HUD_Zone3 0;
BA_ "GenSigTimeoutTime_AGSM" SG_ 1465 ETM_HUD_Zone3 0;
BA_ "GenSigTimeoutTime_ADCAM" SG_ 1465 ETM_HUD_Zone3 0;
BA_ "GenSigSendType" SG_ 1465 ETM_HUD_Zone3 3;
BA_ "GenSigTimeoutTime_SGW" SG_ 1465 ETM_HUD_Zone4 0;
BA_ "GenSigTimeoutTime_RFHM" SG_ 1465 ETM_HUD_Zone4 0;
BA_ "GenSigTimeoutTime_MPAD" SG_ 1465 ETM_HUD_Zone4 0;
BA_ "GenSigTimeoutTime_GNMM" SG_ 1465 ETM_HUD_Zone4 0;
BA_ "GenSigTimeoutTime_EVCU2" SG_ 1465 ETM_HUD_Zone4 0;
BA_ "GenSigTimeoutTime_ESL" SG_ 1465 ETM_HUD_Zone4 0;
BA_ "GenSigTimeoutTime_ECM" SG_ 1465 ETM_HUD_Zone4 0;
BA_ "GenSigTimeoutTime_DTCM" SG_ 1465 ETM_HUD_Zone4 0;
BA_ "GenSigTimeoutTime_DMSM" SG_ 1465 ETM_HUD_Zone4 0;
BA_ "GenSigTimeoutTime_BSM" SG_ 1465 ETM_HUD_Zone4 0;
BA_ "GenSigTimeoutTime_BCM" SG_ 1465 ETM_HUD_Zone4 0;
BA_ "GenSigTimeoutTime_AGSM" SG_ 1465 ETM_HUD_Zone4 0;
BA_ "GenSigTimeoutTime_ADCAM" SG_ 1465 ETM_HUD_Zone4 0;
BA_ "GenSigSendType" SG_ 1465 ETM_HUD_Zone4 3;
BA_ "GenSigTimeoutTime_DTCM" SG_ 608 SpdUnits 0;
BA_ "GenSigTimeoutTime_DMSM" SG_ 608 SpdUnits 0;
BA_ "GenSigTimeoutTime_BSM" SG_ 608 SpdUnits 0;
BA_ "GenSigTimeoutTime_BCM" SG_ 608 SpdUnits 0;
BA_ "GenSigTimeoutTime_AGSM" SG_ 608 SpdUnits 0;
BA_ "GenSigTimeoutTime_SGW" SG_ 608 SpdUnits 0;
BA_ "GenSigTimeoutTime_RFHM" SG_ 608 SpdUnits 0;
BA_ "GenSigTimeoutTime_IPC" SG_ 608 SpdUnits 0;
BA_ "GenSigTimeoutTime_GNMM" SG_ 608 SpdUnits 0;
BA_ "GenSigTimeoutTime_EVCU2" SG_ 608 SpdUnits 0;
BA_ "GenSigTimeoutTime_ESL" SG_ 608 SpdUnits 0;
BA_ "GenSigTimeoutTime_ECM" SG_ 608 SpdUnits 0;
BA_ "GenSigTimeoutTime_SGW" SG_ 1465 ClusterAudiomode 0;
BA_ "GenSigTimeoutTime_RFHM" SG_ 1465 ClusterAudiomode 0;
BA_ "GenSigTimeoutTime_MPAD" SG_ 1465 ClusterAudiomode 0;
BA_ "GenSigTimeoutTime_GNMM" SG_ 1465 ClusterAudiomode 0;
BA_ "GenSigTimeoutTime_EVCU2" SG_ 1465 ClusterAudiomode 0;
BA_ "GenSigTimeoutTime_ESL" SG_ 1465 ClusterAudiomode 0;
BA_ "GenSigTimeoutTime_ECM" SG_ 1465 ClusterAudiomode 0;
BA_ "GenSigTimeoutTime_DTCM" SG_ 1465 ClusterAudiomode 0;
BA_ "GenSigTimeoutTime_DMSM" SG_ 1465 ClusterAudiomode 0;
BA_ "GenSigTimeoutTime_BSM" SG_ 1465 ClusterAudiomode 0;
BA_ "GenSigTimeoutTime_BCM" SG_ 1465 ClusterAudiomode 0;
BA_ "GenSigTimeoutTime_AGSM" SG_ 1465 ClusterAudiomode 0;
BA_ "GenSigTimeoutTime_ADCAM" SG_ 1465 ClusterAudiomode 0;
BA_ "GenSigSendType" SG_ 1465 ClusterAudiomode 3;
BA_ "GenSigTimeoutTime_SGW" SG_ 1465 Radio_Profile_Request 0;
BA_ "GenSigTimeoutTime_RFHM" SG_ 1465 Radio_Profile_Request 0;
BA_ "GenSigTimeoutTime_MPAD" SG_ 1465 Radio_Profile_Request 0;
BA_ "GenSigTimeoutTime_GNMM" SG_ 1465 Radio_Profile_Request 0;
BA_ "GenSigTimeoutTime_EVCU2" SG_ 1465 Radio_Profile_Request 0;
BA_ "GenSigTimeoutTime_ESL" SG_ 1465 Radio_Profile_Request 0;
BA_ "GenSigTimeoutTime_ECM" SG_ 1465 Radio_Profile_Request 0;
BA_ "GenSigTimeoutTime_DTCM" SG_ 1465 Radio_Profile_Request 0;
BA_ "GenSigTimeoutTime_DMSM" SG_ 1465 Radio_Profile_Request 0;
BA_ "GenSigTimeoutTime_BSM" SG_ 1465 Radio_Profile_Request 0;
BA_ "GenSigTimeoutTime_BCM" SG_ 1465 Radio_Profile_Request 0;
BA_ "GenSigTimeoutTime_AGSM" SG_ 1465 Radio_Profile_Request 0;
BA_ "GenSigTimeoutTime_ADCAM" SG_ 1465 Radio_Profile_Request 0;
BA_ "GenSigSendType" SG_ 1465 Radio_Profile_Request 3;
BA_ "GenSigTimeoutTime_SGW" SG_ 158 SpeedLockDoorEnable_Req 0;
BA_ "GenSigTimeoutTime_RFHM" SG_ 158 SpeedLockDoorEnable_Req 0;
BA_ "GenSigTimeoutTime_MPAD" SG_ 158 SpeedLockDoorEnable_Req 0;
BA_ "GenSigTimeoutTime_SGW" SG_ 158 Steer_Feel_Req 0;
BA_ "GenSigTimeoutTime_RFHM" SG_ 158 Steer_Feel_Req 0;
BA_ "GenSigTimeoutTime_MPAD" SG_ 158 Steer_Feel_Req 0;
BA_ "GenSigTimeoutTime_GNMM" SG_ 158 Steer_Feel_Req 0;
BA_ "GenSigTimeoutTime_EVCU2" SG_ 158 Steer_Feel_Req 0;
BA_ "GenSigTimeoutTime_ESL" SG_ 158 Steer_Feel_Req 0;
BA_ "GenSigTimeoutTime_ECM" SG_ 158 Steer_Feel_Req 0;
BA_ "GenSigTimeoutTime_DTCM" SG_ 158 Steer_Feel_Req 0;
BA_ "GenSigTimeoutTime_DMSM" SG_ 158 Steer_Feel_Req 0;
BA_ "GenSigTimeoutTime_BSM" SG_ 158 Steer_Feel_Req 0;
BA_ "GenSigTimeoutTime_BCM" SG_ 158 Steer_Feel_Req 0;
BA_ "GenSigTimeoutTime_AGSM" SG_ 158 Steer_Feel_Req 0;
BA_ "GenSigTimeoutTime_ADCAM" SG_ 158 Steer_Feel_Req 0;
BA_ "GenSigSendType" SG_ 158 Steer_Feel_Req 3;
BA_ "GenSigTimeoutTime_SGW" SG_ 158 SVC_Delay_Req 0;
BA_ "GenSigTimeoutTime_RFHM" SG_ 158 SVC_Delay_Req 0;
BA_ "GenSigTimeoutTime_MPAD" SG_ 158 SVC_Delay_Req 0;
BA_ "GenSigTimeoutTime_GNMM" SG_ 158 SVC_Delay_Req 0;
BA_ "GenSigTimeoutTime_EVCU2" SG_ 158 SVC_Delay_Req 0;
BA_ "GenSigTimeoutTime_ESL" SG_ 158 SVC_Delay_Req 0;
BA_ "GenSigTimeoutTime_ECM" SG_ 158 SVC_Delay_Req 0;
BA_ "GenSigTimeoutTime_DTCM" SG_ 158 SVC_Delay_Req 0;
BA_ "GenSigTimeoutTime_DMSM" SG_ 158 SVC_Delay_Req 0;
BA_ "GenSigTimeoutTime_BSM" SG_ 158 SVC_Delay_Req 0;
BA_ "GenSigTimeoutTime_BCM" SG_ 158 SVC_Delay_Req 0;
BA_ "GenSigTimeoutTime_AGSM" SG_ 158 SVC_Delay_Req 0;
BA_ "GenSigTimeoutTime_ADCAM" SG_ 158 SVC_Delay_Req 0;
BA_ "GenSigSendType" SG_ 158 SVC_Delay_Req 3;
BA_ "GenSigTimeoutTime_SGW" SG_ 158 SVC_Guidelines_Req 0;
BA_ "GenSigTimeoutTime_RFHM" SG_ 158 SVC_Guidelines_Req 0;
BA_ "GenSigTimeoutTime_MPAD" SG_ 158 SVC_Guidelines_Req 0;
BA_ "GenSigTimeoutTime_GNMM" SG_ 158 SVC_Guidelines_Req 0;
BA_ "GenSigTimeoutTime_EVCU2" SG_ 158 SVC_Guidelines_Req 0;
BA_ "GenSigTimeoutTime_ESL" SG_ 158 SVC_Guidelines_Req 0;
BA_ "GenSigTimeoutTime_ECM" SG_ 158 SVC_Guidelines_Req 0;
BA_ "GenSigTimeoutTime_DTCM" SG_ 158 SVC_Guidelines_Req 0;
BA_ "GenSigTimeoutTime_DMSM" SG_ 158 SVC_Guidelines_Req 0;
BA_ "GenSigTimeoutTime_BSM" SG_ 158 SVC_Guidelines_Req 0;
BA_ "GenSigTimeoutTime_BCM" SG_ 158 SVC_Guidelines_Req 0;
BA_ "GenSigTimeoutTime_AGSM" SG_ 158 SVC_Guidelines_Req 0;
BA_ "GenSigTimeoutTime_ADCAM" SG_ 158 SVC_Guidelines_Req 0;
BA_ "GenSigSendType" SG_ 158 SVC_Guidelines_Req 3;
BA_ "GenSigTimeoutTime_SGW" SG_ 158 Temp_Unit_Req 0;
BA_ "GenSigTimeoutTime_RFHM" SG_ 158 Temp_Unit_Req 0;
BA_ "GenSigTimeoutTime_MPAD" SG_ 158 Temp_Unit_Req 0;
BA_ "GenSigTimeoutTime_GNMM" SG_ 158 Temp_Unit_Req 0;
BA_ "GenSigTimeoutTime_EVCU2" SG_ 158 Temp_Unit_Req 0;
BA_ "GenSigTimeoutTime_ESL" SG_ 158 Temp_Unit_Req 0;
BA_ "GenSigTimeoutTime_ECM" SG_ 158 Temp_Unit_Req 0;
BA_ "GenSigTimeoutTime_DTCM" SG_ 158 Temp_Unit_Req 0;
BA_ "GenSigTimeoutTime_DMSM" SG_ 158 Temp_Unit_Req 0;
BA_ "GenSigTimeoutTime_BSM" SG_ 158 Temp_Unit_Req 0;
BA_ "GenSigTimeoutTime_BCM" SG_ 158 Temp_Unit_Req 0;
BA_ "GenSigTimeoutTime_AGSM" SG_ 158 Temp_Unit_Req 0;
BA_ "GenSigTimeoutTime_ADCAM" SG_ 158 Temp_Unit_Req 0;
BA_ "GenSigSendType" SG_ 158 Temp_Unit_Req 3;
BA_ "GenSigTimeoutTime_SGW" SG_ 158 Tilt_Mirr_Rev_Req 0;
BA_ "GenSigTimeoutTime_RFHM" SG_ 158 Tilt_Mirr_Rev_Req 0;
BA_ "GenSigTimeoutTime_MPAD" SG_ 158 Tilt_Mirr_Rev_Req 0;
BA_ "GenSigTimeoutTime_GNMM" SG_ 158 Tilt_Mirr_Rev_Req 0;
BA_ "GenSigTimeoutTime_EVCU2" SG_ 158 Tilt_Mirr_Rev_Req 0;
BA_ "GenSigTimeoutTime_ESL" SG_ 158 Tilt_Mirr_Rev_Req 0;
BA_ "GenSigTimeoutTime_ECM" SG_ 158 Tilt_Mirr_Rev_Req 0;
BA_ "GenSigTimeoutTime_DTCM" SG_ 158 Tilt_Mirr_Rev_Req 0;
BA_ "GenSigTimeoutTime_DMSM" SG_ 158 Tilt_Mirr_Rev_Req 0;
BA_ "GenSigTimeoutTime_BSM" SG_ 158 Tilt_Mirr_Rev_Req 0;
BA_ "GenSigTimeoutTime_BCM" SG_ 158 Tilt_Mirr_Rev_Req 0;
BA_ "GenSigTimeoutTime_AGSM" SG_ 158 Tilt_Mirr_Rev_Req 0;
BA_ "GenSigTimeoutTime_ADCAM" SG_ 158 Tilt_Mirr_Rev_Req 0;
BA_ "GenSigSendType" SG_ 158 Tilt_Mirr_Rev_Req 3;
BA_ "GenSigTimeoutTime_SGW" SG_ 158 Tire_Fill_Alert_Req 0;
BA_ "GenSigTimeoutTime_RFHM" SG_ 158 Tire_Fill_Alert_Req 0;
BA_ "GenSigTimeoutTime_MPAD" SG_ 158 Tire_Fill_Alert_Req 0;
BA_ "GenSigTimeoutTime_GNMM" SG_ 158 Tire_Fill_Alert_Req 0;
BA_ "GenSigTimeoutTime_EVCU2" SG_ 158 Tire_Fill_Alert_Req 0;
BA_ "GenSigTimeoutTime_ESL" SG_ 158 Tire_Fill_Alert_Req 0;
BA_ "GenSigTimeoutTime_ECM" SG_ 158 Tire_Fill_Alert_Req 0;
BA_ "GenSigTimeoutTime_DTCM" SG_ 158 Tire_Fill_Alert_Req 0;
BA_ "GenSigTimeoutTime_DMSM" SG_ 158 Tire_Fill_Alert_Req 0;
BA_ "GenSigTimeoutTime_BSM" SG_ 158 Tire_Fill_Alert_Req 0;
BA_ "GenSigTimeoutTime_BCM" SG_ 158 Tire_Fill_Alert_Req 0;
BA_ "GenSigTimeoutTime_AGSM" SG_ 158 Tire_Fill_Alert_Req 0;
BA_ "GenSigTimeoutTime_ADCAM" SG_ 158 Tire_Fill_Alert_Req 0;
BA_ "GenSigSendType" SG_ 158 Tire_Fill_Alert_Req 3;
BA_ "GenSigTimeoutTime_SGW" SG_ 158 Torque_Unit_Req 0;
BA_ "GenSigTimeoutTime_RFHM" SG_ 158 Torque_Unit_Req 0;
BA_ "GenSigTimeoutTime_MPAD" SG_ 158 Torque_Unit_Req 0;
BA_ "GenSigTimeoutTime_GNMM" SG_ 158 Torque_Unit_Req 0;
BA_ "GenSigTimeoutTime_EVCU2" SG_ 158 Torque_Unit_Req 0;
BA_ "GenSigTimeoutTime_ESL" SG_ 158 Torque_Unit_Req 0;
BA_ "GenSigTimeoutTime_ECM" SG_ 158 Torque_Unit_Req 0;
BA_ "GenSigTimeoutTime_DTCM" SG_ 158 Torque_Unit_Req 0;
BA_ "GenSigTimeoutTime_DMSM" SG_ 158 Torque_Unit_Req 0;
BA_ "GenSigTimeoutTime_BSM" SG_ 158 Torque_Unit_Req 0;
BA_ "GenSigTimeoutTime_BCM" SG_ 158 Torque_Unit_Req 0;
BA_ "GenSigTimeoutTime_AGSM" SG_ 158 Torque_Unit_Req 0;
BA_ "GenSigTimeoutTime_ADCAM" SG_ 158 Torque_Unit_Req 0;
BA_ "GenSigSendType" SG_ 158 Torque_Unit_Req 3;
BA_ "GenSigTimeoutTime_SGW" SG_ 158 Traffic_Sign_Info_Req 0;
BA_ "GenSigTimeoutTime_RFHM" SG_ 158 Traffic_Sign_Info_Req 0;
BA_ "GenSigTimeoutTime_MPAD" SG_ 158 Traffic_Sign_Info_Req 0;
BA_ "GenSigTimeoutTime_GNMM" SG_ 158 Traffic_Sign_Info_Req 0;
BA_ "GenSigTimeoutTime_EVCU2" SG_ 158 Traffic_Sign_Info_Req 0;
BA_ "GenSigTimeoutTime_ESL" SG_ 158 Traffic_Sign_Info_Req 0;
BA_ "GenSigTimeoutTime_ECM" SG_ 158 Traffic_Sign_Info_Req 0;
BA_ "GenSigTimeoutTime_DTCM" SG_ 158 Traffic_Sign_Info_Req 0;
BA_ "GenSigTimeoutTime_DMSM" SG_ 158 Traffic_Sign_Info_Req 0;
BA_ "GenSigTimeoutTime_BSM" SG_ 158 Traffic_Sign_Info_Req 0;
BA_ "GenSigTimeoutTime_BCM" SG_ 158 Traffic_Sign_Info_Req 0;
BA_ "GenSigTimeoutTime_AGSM" SG_ 158 Traffic_Sign_Info_Req 0;
BA_ "GenSigTimeoutTime_ADCAM" SG_ 158 Traffic_Sign_Info_Req 0;
BA_ "GenSigSendType" SG_ 158 Traffic_Sign_Info_Req 3;
BA_ "GenSigTimeoutTime_SGW" SG_ 158 Traffic_Sign_Warn_Req 0;
BA_ "GenSigTimeoutTime_RFHM" SG_ 158 Traffic_Sign_Warn_Req 0;
BA_ "GenSigTimeoutTime_MPAD" SG_ 158 Traffic_Sign_Warn_Req 0;
BA_ "GenSigTimeoutTime_GNMM" SG_ 158 Traffic_Sign_Warn_Req 0;
BA_ "GenSigTimeoutTime_EVCU2" SG_ 158 Traffic_Sign_Warn_Req 0;
BA_ "GenSigTimeoutTime_ESL" SG_ 158 Traffic_Sign_Warn_Req 0;
BA_ "GenSigTimeoutTime_ECM" SG_ 158 Traffic_Sign_Warn_Req 0;
BA_ "GenSigTimeoutTime_DTCM" SG_ 158 Traffic_Sign_Warn_Req 0;
BA_ "GenSigTimeoutTime_DMSM" SG_ 158 Traffic_Sign_Warn_Req 0;
BA_ "GenSigTimeoutTime_BSM" SG_ 158 Traffic_Sign_Warn_Req 0;
BA_ "GenSigTimeoutTime_BCM" SG_ 158 Traffic_Sign_Warn_Req 0;
BA_ "GenSigTimeoutTime_AGSM" SG_ 158 Traffic_Sign_Warn_Req 0;
BA_ "GenSigTimeoutTime_ADCAM" SG_ 158 Traffic_Sign_Warn_Req 0;
BA_ "GenSigSendType" SG_ 158 Traffic_Sign_Warn_Req 3;
BA_ "GenSigTimeoutTime_SGW" SG_ 158 TyrePress_Unit_Req 0;
BA_ "GenSigTimeoutTime_RFHM" SG_ 158 TyrePress_Unit_Req 0;
BA_ "GenSigTimeoutTime_MPAD" SG_ 158 TyrePress_Unit_Req 0;
BA_ "GenSigTimeoutTime_GNMM" SG_ 158 TyrePress_Unit_Req 0;
BA_ "GenSigTimeoutTime_EVCU2" SG_ 158 TyrePress_Unit_Req 0;
BA_ "GenSigTimeoutTime_ESL" SG_ 158 TyrePress_Unit_Req 0;
BA_ "GenSigTimeoutTime_ECM" SG_ 158 TyrePress_Unit_Req 0;
BA_ "GenSigTimeoutTime_DTCM" SG_ 158 TyrePress_Unit_Req 0;
BA_ "GenSigTimeoutTime_DMSM" SG_ 158 TyrePress_Unit_Req 0;
BA_ "GenSigTimeoutTime_BSM" SG_ 158 TyrePress_Unit_Req 0;
BA_ "GenSigTimeoutTime_BCM" SG_ 158 TyrePress_Unit_Req 0;
BA_ "GenSigTimeoutTime_AGSM" SG_ 158 TyrePress_Unit_Req 0;
BA_ "GenSigTimeoutTime_ADCAM" SG_ 158 TyrePress_Unit_Req 0;
BA_ "GenSigSendType" SG_ 158 TyrePress_Unit_Req 3;
BA_ "GenSigTimeoutTime_SGW" SG_ 158 Windows_With_Fob_Req 0;
BA_ "GenSigTimeoutTime_RFHM" SG_ 158 Windows_With_Fob_Req 0;
BA_ "GenSigTimeoutTime_MPAD" SG_ 158 Windows_With_Fob_Req 0;
BA_ "GenSigTimeoutTime_GNMM" SG_ 158 Windows_With_Fob_Req 0;
BA_ "GenSigTimeoutTime_EVCU2" SG_ 158 Windows_With_Fob_Req 0;
BA_ "GenSigTimeoutTime_ESL" SG_ 158 Windows_With_Fob_Req 0;
BA_ "GenSigTimeoutTime_ECM" SG_ 158 Windows_With_Fob_Req 0;
BA_ "GenSigTimeoutTime_DTCM" SG_ 158 Windows_With_Fob_Req 0;
BA_ "GenSigTimeoutTime_DMSM" SG_ 158 Windows_With_Fob_Req 0;
BA_ "GenSigTimeoutTime_BSM" SG_ 158 Windows_With_Fob_Req 0;
BA_ "GenSigTimeoutTime_BCM" SG_ 158 Windows_With_Fob_Req 0;
BA_ "GenSigTimeoutTime_AGSM" SG_ 158 Windows_With_Fob_Req 0;
BA_ "GenSigTimeoutTime_ADCAM" SG_ 158 Windows_With_Fob_Req 0;
BA_ "GenSigSendType" SG_ 158 Windows_With_Fob_Req 3;
BA_ "GenSigTimeoutTime_AGSM" SG_ 255 Veh_StandStill_Req_OPD 0;
BA_ "GenSigTimeoutTime_ADCAM" SG_ 255 Veh_StandStill_Req_OPD 0;
BA_ "GenSigTimeoutTime_SGW" SG_ 255 SSC_TrqEnblRq_Allowed 0;
BA_ "GenSigTimeoutTime_RFHM" SG_ 255 SSC_TrqEnblRq_Allowed 0;
BA_ "GenSigTimeoutTime_MPAD" SG_ 255 SSC_TrqEnblRq_Allowed 0;
BA_ "GenSigTimeoutTime_IPC" SG_ 255 SSC_TrqEnblRq_Allowed 0;
BA_ "GenSigTimeoutTime_GNMM" SG_ 255 SSC_TrqEnblRq_Allowed 0;
BA_ "GenSigTimeoutTime_EVCU2" SG_ 255 SSC_TrqEnblRq_Allowed 0;
BA_ "GenSigTimeoutTime_ESL" SG_ 255 SSC_TrqEnblRq_Allowed 0;
BA_ "GenSigTimeoutTime_RFHM" SG_ 255 Total_AxleTorque_Static 0;
BA_ "GenSigTimeoutTime_MPAD" SG_ 255 Total_AxleTorque_Static 0;
BA_ "GenSigTimeoutTime_IPC" SG_ 255 Total_AxleTorque_Static 0;
BA_ "GenSigTimeoutTime_GNMM" SG_ 255 Total_AxleTorque_Static 0;
BA_ "GenSigTimeoutTime_EVCU2" SG_ 255 Total_AxleTorque_Static 0;
BA_ "GenSigTimeoutTime_ESL" SG_ 255 Total_AxleTorque_Static 0;
BA_ "GenSigTimeoutTime_ECM" SG_ 255 Total_AxleTorque_Static 0;
BA_ "GenSigTimeoutTime_DMSM" SG_ 255 Total_AxleTorque_Static 0;
BA_ "GenSigTimeoutTime_AGSM" SG_ 255 Total_AxleTorque_Static 0;
BA_ "GenSigTimeoutTime_ADCAM" SG_ 255 Total_AxleTorque_Static 0;
BA_ "GenSigStartValue" SG_ 255 Total_AxleTorque_Static 32767;
BA_ "GenSigTimeoutTime_ECM" SG_ 255 SSC_TrqEnblRq_Allowed 0;
BA_ "GenSigTimeoutTime_DTCM" SG_ 255 SSC_TrqEnblRq_Allowed 0;
BA_ "GenSigTimeoutTime_DMSM" SG_ 255 SSC_TrqEnblRq_Allowed 0;
BA_ "GenSigTimeoutTime_BCM" SG_ 255 SSC_TrqEnblRq_Allowed 0;
BA_ "GenSigTimeoutTime_AGSM" SG_ 255 SSC_TrqEnblRq_Allowed 0;
BA_ "GenSigTimeoutTime_ADCAM" SG_ 255 SSC_TrqEnblRq_Allowed 0;
BA_ "GenSigTimeoutTime_RFHM" SG_ 255 Rear_AxleTorque_Static 0;
BA_ "GenSigTimeoutTime_MPAD" SG_ 255 Rear_AxleTorque_Static 0;
BA_ "GenSigTimeoutTime_IPC" SG_ 255 Rear_AxleTorque_Static 0;
BA_ "GenSigTimeoutTime_GNMM" SG_ 255 Rear_AxleTorque_Static 0;
BA_ "GenSigTimeoutTime_EVCU2" SG_ 255 Rear_AxleTorque_Static 0;
BA_ "GenSigTimeoutTime_ESL" SG_ 255 Rear_AxleTorque_Static 0;
BA_ "GenSigTimeoutTime_ECM" SG_ 255 Rear_AxleTorque_Static 0;
BA_ "GenSigTimeoutTime_DTCM" SG_ 255 Rear_AxleTorque_Static 0;
BA_ "GenSigTimeoutTime_DMSM" SG_ 255 Rear_AxleTorque_Static 0;
BA_ "GenSigTimeoutTime_AGSM" SG_ 255 Rear_AxleTorque_Static 0;
BA_ "GenSigTimeoutTime_ADCAM" SG_ 255 Rear_AxleTorque_Static 0;
BA_ "GenSigStartValue" SG_ 255 Rear_AxleTorque_Static 32767;
BA_ "GenSigTimeoutTime_SGW" SG_ 255 RRCC_TrqEnblRq_Allowed 0;
BA_ "GenSigTimeoutTime_RFHM" SG_ 255 RRCC_TrqEnblRq_Allowed 0;
BA_ "GenSigTimeoutTime_MPAD" SG_ 255 RRCC_TrqEnblRq_Allowed 0;
BA_ "GenSigTimeoutTime_IPC" SG_ 255 RRCC_TrqEnblRq_Allowed 0;
BA_ "GenSigTimeoutTime_GNMM" SG_ 255 RRCC_TrqEnblRq_Allowed 0;
BA_ "GenSigTimeoutTime_EVCU2" SG_ 255 RRCC_TrqEnblRq_Allowed 0;
BA_ "GenSigTimeoutTime_ESL" SG_ 255 RRCC_TrqEnblRq_Allowed 0;
BA_ "GenSigTimeoutTime_ECM" SG_ 255 RRCC_TrqEnblRq_Allowed 0;
BA_ "GenSigTimeoutTime_DTCM" SG_ 255 RRCC_TrqEnblRq_Allowed 0;
BA_ "GenSigTimeoutTime_DMSM" SG_ 255 RRCC_TrqEnblRq_Allowed 0;
BA_ "GenSigTimeoutTime_BSM" SG_ 255 RRCC_TrqEnblRq_Allowed 0;
BA_ "GenSigTimeoutTime_BCM" SG_ 255 RRCC_TrqEnblRq_Allowed 0;
BA_ "GenSigTimeoutTime_AGSM" SG_ 255 RRCC_TrqEnblRq_Allowed 0;
BA_ "GenSigTimeoutTime_ADCAM" SG_ 255 RRCC_TrqEnblRq_Allowed 0;
BA_ "GenSigTimeoutTime_SGW" SG_ 255 Rear_Axle_Target_Torque 0;
BA_ "GenSigTimeoutTime_RFHM" SG_ 255 Rear_Axle_Target_Torque 0;
BA_ "GenSigTimeoutTime_MPAD" SG_ 255 Rear_Axle_Target_Torque 0;
BA_ "GenSigTimeoutTime_IPC" SG_ 255 Rear_Axle_Target_Torque 0;
BA_ "GenSigTimeoutTime_BCM" SG_ 158 GreetingLightsEnable_Req 0;
BA_ "GenSigTimeoutTime_SGW" SG_ 158 PwrLevReq 0;
BA_ "GenSigTimeoutTime_RFHM" SG_ 158 PwrLevReq 0;
BA_ "GenSigTimeoutTime_MPAD" SG_ 158 PwrLevReq 0;
BA_ "GenSigTimeoutTime_GNMM" SG_ 158 PwrLevReq 0;
BA_ "GenSigTimeoutTime_EVCU2" SG_ 158 PwrLevReq 0;
BA_ "GenSigTimeoutTime_ESL" SG_ 158 PwrLevReq 0;
BA_ "GenSigTimeoutTime_ECM" SG_ 158 PwrLevReq 0;
BA_ "GenSigTimeoutTime_DTCM" SG_ 158 PwrLevReq 0;
BA_ "GenSigTimeoutTime_DMSM" SG_ 158 PwrLevReq 0;
BA_ "GenSigTimeoutTime_BSM" SG_ 158 PwrLevReq 0;
BA_ "GenSigTimeoutTime_BCM" SG_ 158 PwrLevReq 0;
BA_ "GenSigTimeoutTime_AGSM" SG_ 158 PwrLevReq 0;
BA_ "GenSigTimeoutTime_ADCAM" SG_ 158 PwrLevReq 0;
BA_ "GenSigSendType" SG_ 158 PwrLevReq 1;
BA_ "GenSigStartValue" SG_ 158 PwrLevReq 2;
BA_ "GenSigTimeoutTime_SGW" SG_ 158 SpeedLimitAdjust_Req 0;
BA_ "GenSigTimeoutTime_RFHM" SG_ 158 SpeedLimitAdjust_Req 0;
BA_ "GenSigTimeoutTime_MPAD" SG_ 158 SpeedLimitAdjust_Req 0;
BA_ "GenSigTimeoutTime_GNMM" SG_ 158 SpeedLimitAdjust_Req 0;
BA_ "GenSigTimeoutTime_EVCU2" SG_ 158 SpeedLimitAdjust_Req 0;
BA_ "GenSigTimeoutTime_ESL" SG_ 158 SpeedLimitAdjust_Req 0;
BA_ "GenSigTimeoutTime_ECM" SG_ 158 SpeedLimitAdjust_Req 0;
BA_ "GenSigTimeoutTime_DTCM" SG_ 158 SpeedLimitAdjust_Req 0;
BA_ "GenSigTimeoutTime_DMSM" SG_ 158 SpeedLimitAdjust_Req 0;
BA_ "GenSigTimeoutTime_BSM" SG_ 158 SpeedLimitAdjust_Req 0;
BA_ "GenSigTimeoutTime_BCM" SG_ 158 SpeedLimitAdjust_Req 0;
BA_ "GenSigTimeoutTime_AGSM" SG_ 158 SpeedLimitAdjust_Req 0;
BA_ "GenSigTimeoutTime_ADCAM" SG_ 158 SpeedLimitAdjust_Req 0;
BA_ "GenSigSendType" SG_ 158 SpeedLimitAdjust_Req 3;
BA_ "GenSigStartValue" SG_ 158 SpeedLimitAdjust_Req 2;
BA_ "GenSigTimeoutTime_SGW" SG_ 158 SOC_Max_Lev_Req 0;
BA_ "GenSigTimeoutTime_RFHM" SG_ 158 SOC_Max_Lev_Req 0;
BA_ "GenSigTimeoutTime_MPAD" SG_ 158 SOC_Max_Lev_Req 0;
BA_ "GenSigTimeoutTime_GNMM" SG_ 158 SOC_Max_Lev_Req 0;
BA_ "GenSigTimeoutTime_EVCU2" SG_ 158 SOC_Max_Lev_Req 0;
BA_ "GenSigTimeoutTime_ESL" SG_ 158 SOC_Max_Lev_Req 0;
BA_ "GenSigTimeoutTime_ECM" SG_ 158 SOC_Max_Lev_Req 0;
BA_ "GenSigTimeoutTime_DTCM" SG_ 158 SOC_Max_Lev_Req 0;
BA_ "GenSigTimeoutTime_DMSM" SG_ 158 SOC_Max_Lev_Req 0;
BA_ "GenSigTimeoutTime_BSM" SG_ 158 SOC_Max_Lev_Req 0;
BA_ "GenSigTimeoutTime_BCM" SG_ 158 SOC_Max_Lev_Req 0;
BA_ "GenSigTimeoutTime_AGSM" SG_ 158 SOC_Max_Lev_Req 0;
BA_ "GenSigTimeoutTime_ADCAM" SG_ 158 SOC_Max_Lev_Req 0;
BA_ "GenSigSendType" SG_ 158 SOC_Max_Lev_Req 1;
BA_ "GenSigTimeoutTime_SGW" SG_ 158 Spaak_Req 0;
BA_ "GenSigTimeoutTime_RFHM" SG_ 158 Spaak_Req 0;
BA_ "GenSigTimeoutTime_MPAD" SG_ 158 Spaak_Req 0;
BA_ "GenSigTimeoutTime_GNMM" SG_ 158 Spaak_Req 0;
BA_ "GenSigTimeoutTime_EVCU2" SG_ 158 Spaak_Req 0;
BA_ "GenSigTimeoutTime_ESL" SG_ 158 Spaak_Req 0;
BA_ "GenSigTimeoutTime_ECM" SG_ 158 Spaak_Req 0;
BA_ "GenSigTimeoutTime_DTCM" SG_ 158 Spaak_Req 0;
BA_ "GenSigTimeoutTime_DMSM" SG_ 158 Spaak_Req 0;
BA_ "GenSigTimeoutTime_BSM" SG_ 158 Spaak_Req 0;
BA_ "GenSigTimeoutTime_BCM" SG_ 158 Spaak_Req 0;
BA_ "GenSigTimeoutTime_AGSM" SG_ 158 Spaak_Req 0;
BA_ "GenSigTimeoutTime_ADCAM" SG_ 158 Spaak_Req 0;
BA_ "GenSigSendType" SG_ 158 Spaak_Req 3;
BA_ "GenSigTimeoutTime_SGW" SG_ 608 CountryCode 0;
BA_ "GenSigTimeoutTime_RFHM" SG_ 608 CountryCode 0;
BA_ "GenSigTimeoutTime_IPC" SG_ 608 CountryCode 0;
BA_ "GenSigTimeoutTime_GNMM" SG_ 608 CountryCode 0;
BA_ "GenSigTimeoutTime_EVCU2" SG_ 608 CountryCode 0;
BA_ "GenSigTimeoutTime_ESL" SG_ 608 CountryCode 0;
BA_ "GenSigTimeoutTime_ECM" SG_ 608 CountryCode 0;
BA_ "GenSigTimeoutTime_DTCM" SG_ 608 CountryCode 0;
BA_ "GenSigTimeoutTime_DMSM" SG_ 608 CountryCode 0;
BA_ "GenSigTimeoutTime_BSM" SG_ 608 CountryCode 0;
BA_ "GenSigTimeoutTime_BCM" SG_ 608 CountryCode 0;
BA_ "GenSigTimeoutTime_AGSM" SG_ 608 CountryCode 0;
BA_ "GenSigTimeoutTime_DMSM" SG_ 608 NavDataAvailable_CS 0;
BA_ "GenSigTimeoutTime_BSM" SG_ 608 NavDataAvailable_CS 0;
BA_ "GenSigTimeoutTime_BCM" SG_ 608 NavDataAvailable_CS 0;
BA_ "GenSigTimeoutTime_AGSM" SG_ 608 NavDataAvailable_CS 0;
BA_ "GenSigSendType" SG_ 608 NavDataAvailable_CS 3;
BA_ "GenSigTimeoutTime_SGW" SG_ 608 FuncRoadClass_CS 0;
BA_ "GenSigTimeoutTime_RFHM" SG_ 608 FuncRoadClass_CS 0;
BA_ "GenSigTimeoutTime_IPC" SG_ 608 FuncRoadClass_CS 0;
BA_ "GenSigTimeoutTime_GNMM" SG_ 608 FuncRoadClass_CS 0;
BA_ "GenSigTimeoutTime_EVCU2" SG_ 608 FuncRoadClass_CS 0;
BA_ "GenSigTimeoutTime_ESL" SG_ 608 FuncRoadClass_CS 0;
BA_ "GenSigTimeoutTime_ECM" SG_ 608 FuncRoadClass_CS 0;
BA_ "GenSigTimeoutTime_DTCM" SG_ 608 FuncRoadClass_CS 0;
BA_ "GenSigTimeoutTime_DMSM" SG_ 608 FuncRoadClass_CS 0;
BA_ "GenSigTimeoutTime_BSM" SG_ 608 FuncRoadClass_CS 0;
BA_ "GenSigTimeoutTime_BCM" SG_ 608 FuncRoadClass_CS 0;
BA_ "GenSigTimeoutTime_AGSM" SG_ 608 FuncRoadClass_CS 0;
BA_ "GenSigSendType" SG_ 608 FuncRoadClass_CS 3;
BA_ "GenSigTimeoutTime_SGW" SG_ 608 FormOfWay_CS 0;
BA_ "GenSigTimeoutTime_RFHM" SG_ 608 FormOfWay_CS 0;
BA_ "GenSigTimeoutTime_IPC" SG_ 608 FormOfWay_CS 0;
BA_ "GenSigTimeoutTime_GNMM" SG_ 608 FormOfWay_CS 0;
BA_ "GenSigTimeoutTime_EVCU2" SG_ 608 FormOfWay_CS 0;
BA_ "GenSigTimeoutTime_ESL" SG_ 608 FormOfWay_CS 0;
BA_ "GenSigTimeoutTime_ECM" SG_ 608 FormOfWay_CS 0;
BA_ "GenSigTimeoutTime_DTCM" SG_ 608 FormOfWay_CS 0;
BA_ "GenSigTimeoutTime_DMSM" SG_ 608 FormOfWay_CS 0;
BA_ "GenSigTimeoutTime_BSM" SG_ 608 FormOfWay_CS 0;
BA_ "GenSigTimeoutTime_BCM" SG_ 608 FormOfWay_CS 0;
BA_ "GenSigTimeoutTime_AGSM" SG_ 608 FormOfWay_CS 0;
BA_ "GenSigSendType" SG_ 608 FormOfWay_CS 3;
BA_ "GenSigTimeoutTime_SGW" SG_ 608 EffSpdLmt_NS 0;
BA_ "GenSigTimeoutTime_RFHM" SG_ 608 EffSpdLmt_NS 0;
BA_ "GenSigTimeoutTime_MPAD" SG_ 608 EffSpdLmt_NS 0;
BA_ "GenSigTimeoutTime_IPC" SG_ 608 EffSpdLmt_NS 0;
BA_ "GenSigTimeoutTime_GNMM" SG_ 608 EffSpdLmt_NS 0;
BA_ "GenSigTimeoutTime_EVCU2" SG_ 608 EffSpdLmt_NS 0;
BA_ "GenSigTimeoutTime_ESL" SG_ 608 EffSpdLmt_NS 0;
BA_ "GenSigTimeoutTime_ECM" SG_ 608 EffSpdLmt_NS 0;
BA_ "GenSigTimeoutTime_DTCM" SG_ 608 EffSpdLmt_NS 0;
BA_ "GenSigTimeoutTime_DMSM" SG_ 608 EffSpdLmt_NS 0;
BA_ "GenSigTimeoutTime_BSM" SG_ 608 EffSpdLmt_NS 0;
BA_ "GenSigTimeoutTime_BCM" SG_ 608 EffSpdLmt_NS 0;
BA_ "GenSigTimeoutTime_AGSM" SG_ 608 EffSpdLmt_NS 0;
BA_ "GenSigSendType" SG_ 608 EffSpdLmt_NS 3;
BA_ "GenSigTimeoutTime_SGW" SG_ 608 EffSpdLmtType_CS 0;
BA_ "GenSigTimeoutTime_RFHM" SG_ 608 EffSpdLmtType_CS 0;
BA_ "GenSigTimeoutTime_IPC" SG_ 608 EffSpdLmtType_CS 0;
BA_ "GenSigTimeoutTime_GNMM" SG_ 608 EffSpdLmtType_CS 0;
BA_ "GenSigTimeoutTime_EVCU2" SG_ 608 EffSpdLmtType_CS 0;
BA_ "GenSigTimeoutTime_ESL" SG_ 608 EffSpdLmtType_CS 0;
BA_ "GenSigTimeoutTime_ECM" SG_ 608 EffSpdLmtType_CS 0;
BA_ "GenSigTimeoutTime_DTCM" SG_ 608 EffSpdLmtType_CS 0;
BA_ "GenSigTimeoutTime_DMSM" SG_ 608 EffSpdLmtType_CS 0;
BA_ "GenSigTimeoutTime_BSM" SG_ 608 EffSpdLmtType_CS 0;
BA_ "GenSigTimeoutTime_BCM" SG_ 608 EffSpdLmtType_CS 0;
BA_ "GenSigTimeoutTime_AGSM" SG_ 608 EffSpdLmtType_CS 0;
BA_ "GenSigSendType" SG_ 608 EffSpdLmtType_CS 3;
BA_ "GenSigTimeoutTime_SGW" SG_ 608 Divided_Road_CS 0;
BA_ "GenSigTimeoutTime_RFHM" SG_ 608 Divided_Road_CS 0;
BA_ "GenSigTimeoutTime_MPAD" SG_ 608 Divided_Road_CS 0;
BA_ "GenSigTimeoutTime_IPC" SG_ 608 Divided_Road_CS 0;
BA_ "GenSigTimeoutTime_GNMM" SG_ 608 Divided_Road_CS 0;
BA_ "GenSigTimeoutTime_EVCU2" SG_ 608 Divided_Road_CS 0;
BA_ "GenSigTimeoutTime_ESL" SG_ 608 Divided_Road_CS 0;
BA_ "GenSigTimeoutTime_ECM" SG_ 608 Divided_Road_CS 0;
BA_ "GenSigTimeoutTime_DTCM" SG_ 608 Divided_Road_CS 0;
BA_ "GenSigTimeoutTime_DMSM" SG_ 608 Divided_Road_CS 0;
BA_ "GenSigTimeoutTime_BSM" SG_ 608 Divided_Road_CS 0;
BA_ "GenSigTimeoutTime_BCM" SG_ 608 Divided_Road_CS 0;
BA_ "GenSigTimeoutTime_AGSM" SG_ 608 Divided_Road_CS 0;
BA_ "GenSigSendType" SG_ 608 Divided_Road_CS 3;
BA_ "GenSigTimeoutTime_SGW" SG_ 608 EffSpdLmt_CS 0;
BA_ "GenSigTimeoutTime_RFHM" SG_ 608 EffSpdLmt_CS 0;
BA_ "GenSigTimeoutTime_GNMM" SG_ 608 EffSpdLmt_CS 0;
BA_ "GenSigTimeoutTime_EVCU2" SG_ 608 EffSpdLmt_CS 0;
BA_ "GenSigTimeoutTime_ESL" SG_ 608 EffSpdLmt_CS 0;
BA_ "GenSigTimeoutTime_ECM" SG_ 608 EffSpdLmt_CS 0;
BA_ "GenSigTimeoutTime_DTCM" SG_ 608 EffSpdLmt_CS 0;
BA_ "GenSigTimeoutTime_DMSM" SG_ 608 EffSpdLmt_CS 0;
BA_ "GenSigTimeoutTime_BSM" SG_ 608 EffSpdLmt_CS 0;
BA_ "GenSigTimeoutTime_BCM" SG_ 608 EffSpdLmt_CS 0;
BA_ "GenSigTimeoutTime_AGSM" SG_ 608 EffSpdLmt_CS 0;
BA_ "GenSigSendType" SG_ 608 EffSpdLmt_CS 3;
BA_ "GenSigTimeoutTime_SGW" SG_ 608 BuiltUpArea_CS 0;
BA_ "GenSigTimeoutTime_RFHM" SG_ 608 BuiltUpArea_CS 0;
BA_ "GenSigTimeoutTime_IPC" SG_ 608 BuiltUpArea_CS 0;
BA_ "GenSigTimeoutTime_GNMM" SG_ 608 BuiltUpArea_CS 0;
BA_ "GenSigTimeoutTime_EVCU2" SG_ 608 BuiltUpArea_CS 0;
BA_ "GenSigTimeoutTime_ESL" SG_ 608 BuiltUpArea_CS 0;
BA_ "GenSigTimeoutTime_ECM" SG_ 608 BuiltUpArea_CS 0;
BA_ "GenSigTimeoutTime_DTCM" SG_ 608 BuiltUpArea_CS 0;
BA_ "GenSigTimeoutTime_DMSM" SG_ 608 BuiltUpArea_CS 0;
BA_ "GenSigTimeoutTime_BSM" SG_ 608 BuiltUpArea_CS 0;
BA_ "GenSigTimeoutTime_BCM" SG_ 608 BuiltUpArea_CS 0;
BA_ "GenSigTimeoutTime_AGSM" SG_ 608 BuiltUpArea_CS 0;
BA_ "GenSigSendType" SG_ 608 BuiltUpArea_CS 3;
BA_ "GenSigTimeoutTime_SGW" SG_ 158 GreetingLightsEnable_Req 0;
BA_ "GenSigTimeoutTime_RFHM" SG_ 158 GreetingLightsEnable_Req 0;
BA_ "GenSigTimeoutTime_MPAD" SG_ 158 GreetingLightsEnable_Req 0;
BA_ "GenSigTimeoutTime_GNMM" SG_ 158 GreetingLightsEnable_Req 0;
BA_ "GenSigTimeoutTime_EVCU2" SG_ 158 GreetingLightsEnable_Req 0;
BA_ "GenSigTimeoutTime_ESL" SG_ 158 GreetingLightsEnable_Req 0;
BA_ "GenSigTimeoutTime_ECM" SG_ 158 GreetingLightsEnable_Req 0;
BA_ "GenSigTimeoutTime_DTCM" SG_ 158 GreetingLightsEnable_Req 0;
BA_ "GenSigTimeoutTime_DMSM" SG_ 158 GreetingLightsEnable_Req 0;
BA_ "GenSigTimeoutTime_BSM" SG_ 158 GreetingLightsEnable_Req 0;
BA_ "GenSigTimeoutTime_RFHM" SG_ 158 HeadlightsOffDelay_Req 0;
BA_ "GenSigTimeoutTime_MPAD" SG_ 158 HeadlightsOffDelay_Req 0;
BA_ "GenSigTimeoutTime_GNMM" SG_ 158 HeadlightsOffDelay_Req 0;
BA_ "GenSigTimeoutTime_EVCU2" SG_ 158 HeadlightsOffDelay_Req 0;
BA_ "GenSigTimeoutTime_ESL" SG_ 158 HeadlightsOffDelay_Req 0;
BA_ "GenSigTimeoutTime_ECM" SG_ 158 HeadlightsOffDelay_Req 0;
BA_ "GenSigTimeoutTime_DTCM" SG_ 158 HeadlightsOffDelay_Req 0;
BA_ "GenSigTimeoutTime_DMSM" SG_ 158 HeadlightsOffDelay_Req 0;
BA_ "GenSigTimeoutTime_BSM" SG_ 158 HeadlightsOffDelay_Req 0;
BA_ "GenSigTimeoutTime_BCM" SG_ 158 HeadlightsOffDelay_Req 0;
BA_ "GenSigTimeoutTime_AGSM" SG_ 158 HeadlightsOffDelay_Req 0;
BA_ "GenSigTimeoutTime_ADCAM" SG_ 158 HeadlightsOffDelay_Req 0;
BA_ "GenSigSendType" SG_ 158 HeadlightsOffDelay_Req 1;
BA_ "GenSigTimeoutTime_SGW" SG_ 158 Handsfree_Liftgate_Req 0;
BA_ "GenSigTimeoutTime_RFHM" SG_ 158 Handsfree_Liftgate_Req 0;
BA_ "GenSigTimeoutTime_MPAD" SG_ 158 Handsfree_Liftgate_Req 0;
BA_ "GenSigTimeoutTime_GNMM" SG_ 158 Handsfree_Liftgate_Req 0;
BA_ "GenSigTimeoutTime_EVCU2" SG_ 158 Handsfree_Liftgate_Req 0;
BA_ "GenSigTimeoutTime_ESL" SG_ 158 Handsfree_Liftgate_Req 0;
BA_ "GenSigTimeoutTime_ECM" SG_ 158 Handsfree_Liftgate_Req 0;
BA_ "GenSigTimeoutTime_DTCM" SG_ 158 Handsfree_Liftgate_Req 0;
BA_ "GenSigTimeoutTime_DMSM" SG_ 158 Handsfree_Liftgate_Req 0;
BA_ "GenSigTimeoutTime_BSM" SG_ 158 Handsfree_Liftgate_Req 0;
BA_ "GenSigTimeoutTime_BCM" SG_ 158 Handsfree_Liftgate_Req 0;
BA_ "GenSigTimeoutTime_AGSM" SG_ 158 Handsfree_Liftgate_Req 0;
BA_ "GenSigTimeoutTime_ADCAM" SG_ 158 Handsfree_Liftgate_Req 0;
BA_ "GenSigSendType" SG_ 158 Handsfree_Liftgate_Req 3;
BA_ "GenSigTimeoutTime_DTCM" SG_ 158 AutoParkBrake_Req 0;
BA_ "GenSigTimeoutTime_SGW" SG_ 158 AutoHighBeamEnable_Req 0;
BA_ "GenSigTimeoutTime_RFHM" SG_ 158 AutoHighBeamEnable_Req 0;
BA_ "GenSigTimeoutTime_MPAD" SG_ 158 AutoHighBeamEnable_Req 0;
BA_ "GenSigTimeoutTime_GNMM" SG_ 158 AutoHighBeamEnable_Req 0;
BA_ "GenSigTimeoutTime_EVCU2" SG_ 158 AutoHighBeamEnable_Req 0;
BA_ "GenSigTimeoutTime_ESL" SG_ 158 AutoHighBeamEnable_Req 0;
BA_ "GenSigTimeoutTime_ECM" SG_ 158 AutoHighBeamEnable_Req 0;
BA_ "GenSigTimeoutTime_DTCM" SG_ 158 AutoHighBeamEnable_Req 0;
BA_ "GenSigTimeoutTime_DMSM" SG_ 158 AutoHighBeamEnable_Req 0;
BA_ "GenSigTimeoutTime_BSM" SG_ 158 AutoHighBeamEnable_Req 0;
BA_ "GenSigTimeoutTime_BCM" SG_ 158 AutoHighBeamEnable_Req 0;
BA_ "GenSigTimeoutTime_AGSM" SG_ 158 AutoHighBeamEnable_Req 0;
BA_ "GenSigTimeoutTime_ADCAM" SG_ 158 AutoHighBeamEnable_Req 0;
BA_ "GenSigSendType" SG_ 158 AutoHighBeamEnable_Req 1;
BA_ "GenSigStartValue" SG_ 158 AutoHighBeamEnable_Req 1;
BA_ "GenSigTimeoutTime_SGW" SG_ 158 Act_Lane_Mgt_Req 0;
BA_ "GenSigTimeoutTime_RFHM" SG_ 158 Act_Lane_Mgt_Req 0;
BA_ "GenSigTimeoutTime_MPAD" SG_ 158 Act_Lane_Mgt_Req 0;
BA_ "GenSigTimeoutTime_GNMM" SG_ 158 Act_Lane_Mgt_Req 0;
BA_ "GenSigTimeoutTime_EVCU2" SG_ 158 Act_Lane_Mgt_Req 0;
BA_ "GenSigTimeoutTime_ESL" SG_ 158 Act_Lane_Mgt_Req 0;
BA_ "GenSigTimeoutTime_ECM" SG_ 158 Act_Lane_Mgt_Req 0;
BA_ "GenSigTimeoutTime_DTCM" SG_ 158 Act_Lane_Mgt_Req 0;
BA_ "GenSigTimeoutTime_DMSM" SG_ 158 Act_Lane_Mgt_Req 0;
BA_ "GenSigTimeoutTime_BSM" SG_ 158 Act_Lane_Mgt_Req 0;
BA_ "GenSigTimeoutTime_BCM" SG_ 158 Act_Lane_Mgt_Req 0;
BA_ "GenSigTimeoutTime_AGSM" SG_ 158 Act_Lane_Mgt_Req 0;
BA_ "GenSigTimeoutTime_ADCAM" SG_ 158 Act_Lane_Mgt_Req 0;
BA_ "GenSigSendType" SG_ 158 Act_Lane_Mgt_Req 3;
BA_ "GenSigTimeoutTime_SGW" SG_ 158 Act_Lane_Mgt_Strength_Req 0;
BA_ "GenSigTimeoutTime_RFHM" SG_ 158 Act_Lane_Mgt_Strength_Req 0;
BA_ "GenSigTimeoutTime_MPAD" SG_ 158 Act_Lane_Mgt_Strength_Req 0;
BA_ "GenSigTimeoutTime_GNMM" SG_ 158 Act_Lane_Mgt_Strength_Req 0;
BA_ "GenSigTimeoutTime_EVCU2" SG_ 158 Act_Lane_Mgt_Strength_Req 0;
BA_ "GenSigTimeoutTime_ESL" SG_ 158 Act_Lane_Mgt_Strength_Req 0;
BA_ "GenSigTimeoutTime_ECM" SG_ 158 Act_Lane_Mgt_Strength_Req 0;
BA_ "GenSigTimeoutTime_DTCM" SG_ 158 Act_Lane_Mgt_Strength_Req 0;
BA_ "GenSigTimeoutTime_DMSM" SG_ 158 Act_Lane_Mgt_Strength_Req 0;
BA_ "GenSigTimeoutTime_BSM" SG_ 158 Act_Lane_Mgt_Strength_Req 0;
BA_ "GenSigTimeoutTime_BCM" SG_ 158 Act_Lane_Mgt_Strength_Req 0;
BA_ "GenSigTimeoutTime_AGSM" SG_ 158 Act_Lane_Mgt_Strength_Req 0;
BA_ "GenSigTimeoutTime_ADCAM" SG_ 158 Act_Lane_Mgt_Strength_Req 0;
BA_ "GenSigSendType" SG_ 158 Act_Lane_Mgt_Strength_Req 3;
BA_ "GenSigTimeoutTime_SGW" SG_ 158 Auto_Fold_Mirr_Req 0;
BA_ "GenSigTimeoutTime_RFHM" SG_ 158 Auto_Fold_Mirr_Req 0;
BA_ "GenSigTimeoutTime_MPAD" SG_ 158 Auto_Fold_Mirr_Req 0;
BA_ "GenSigTimeoutTime_GNMM" SG_ 158 Auto_Fold_Mirr_Req 0;
BA_ "GenSigTimeoutTime_EVCU2" SG_ 158 Auto_Fold_Mirr_Req 0;
BA_ "GenSigTimeoutTime_ESL" SG_ 158 Auto_Fold_Mirr_Req 0;
BA_ "GenSigTimeoutTime_ECM" SG_ 158 Auto_Fold_Mirr_Req 0;
BA_ "GenSigTimeoutTime_DTCM" SG_ 158 Auto_Fold_Mirr_Req 0;
BA_ "GenSigTimeoutTime_DMSM" SG_ 158 Auto_Fold_Mirr_Req 0;
BA_ "GenSigTimeoutTime_BSM" SG_ 158 Auto_Fold_Mirr_Req 0;
BA_ "GenSigTimeoutTime_BCM" SG_ 158 Auto_Fold_Mirr_Req 0;
BA_ "GenSigTimeoutTime_AGSM" SG_ 158 Auto_Fold_Mirr_Req 0;
BA_ "GenSigTimeoutTime_ADCAM" SG_ 158 Auto_Fold_Mirr_Req 0;
BA_ "GenSigSendType" SG_ 158 Auto_Fold_Mirr_Req 3;
BA_ "GenSigTimeoutTime_DMSM" SG_ 158 AutoParkBrake_Req 0;
BA_ "GenSigTimeoutTime_BSM" SG_ 158 AutoParkBrake_Req 0;
BA_ "GenSigTimeoutTime_BCM" SG_ 158 AutoParkBrake_Req 0;
BA_ "GenSigTimeoutTime_AGSM" SG_ 158 AutoParkBrake_Req 0;
BA_ "GenSigTimeoutTime_ADCAM" SG_ 158 AutoParkBrake_Req 0;
BA_ "GenSigSendType" SG_ 158 AutoParkBrake_Req 1;
BA_ "GenSigTimeoutTime_SGW" SG_ 1429 SOSCallStatus 0;
BA_ "GenSigTimeoutTime_RFHM" SG_ 1429 SOSCallStatus 0;
BA_ "GenSigTimeoutTime_MPAD" SG_ 1429 SOSCallStatus 0;
BA_ "GenSigTimeoutTime_GNMM" SG_ 1429 SOSCallStatus 0;
BA_ "GenSigTimeoutTime_EVCU2" SG_ 1429 SOSCallStatus 0;
BA_ "GenSigTimeoutTime_ESL" SG_ 1429 SOSCallStatus 0;
BA_ "GenSigTimeoutTime_ECM" SG_ 1429 SOSCallStatus 0;
BA_ "GenSigTimeoutTime_DTCM" SG_ 1429 SOSCallStatus 0;
BA_ "GenSigTimeoutTime_DMSM" SG_ 1429 SOSCallStatus 0;
BA_ "GenSigTimeoutTime_BSM" SG_ 1429 SOSCallStatus 0;
BA_ "GenSigTimeoutTime_BCM" SG_ 1429 SOSCallStatus 0;
BA_ "GenSigTimeoutTime_AGSM" SG_ 1429 SOSCallStatus 0;
BA_ "GenSigTimeoutTime_ADCAM" SG_ 1429 SOSCallStatus 0;
BA_ "GenSigSendType" SG_ 1429 SOSCallStatus 3;
BA_ "GenSigTimeoutTime_SGW" SG_ 158 HeadLightWipers_Req 0;
BA_ "GenSigTimeoutTime_RFHM" SG_ 158 HeadLightWipers_Req 0;
BA_ "GenSigTimeoutTime_MPAD" SG_ 158 HeadLightWipers_Req 0;
BA_ "GenSigTimeoutTime_GNMM" SG_ 158 HeadLightWipers_Req 0;
BA_ "GenSigTimeoutTime_EVCU2" SG_ 158 HeadLightWipers_Req 0;
BA_ "GenSigTimeoutTime_ESL" SG_ 158 HeadLightWipers_Req 0;
BA_ "GenSigTimeoutTime_ECM" SG_ 158 HeadLightWipers_Req 0;
BA_ "GenSigTimeoutTime_DTCM" SG_ 158 HeadLightWipers_Req 0;
BA_ "GenSigTimeoutTime_DMSM" SG_ 158 HeadLightWipers_Req 0;
BA_ "GenSigTimeoutTime_BSM" SG_ 158 HeadLightWipers_Req 0;
BA_ "GenSigTimeoutTime_BCM" SG_ 158 HeadLightWipers_Req 0;
BA_ "GenSigTimeoutTime_AGSM" SG_ 158 HeadLightWipers_Req 0;
BA_ "GenSigTimeoutTime_ADCAM" SG_ 158 HeadLightWipers_Req 0;
BA_ "GenSigSendType" SG_ 158 HeadLightWipers_Req 1;
BA_ "GenSigStartValue" SG_ 158 HeadLightWipers_Req 1;
BA_ "GenSigTimeoutTime_SGW" SG_ 158 Hill_Start_Assist_Req 0;
BA_ "GenSigTimeoutTime_RFHM" SG_ 158 Hill_Start_Assist_Req 0;
BA_ "GenSigTimeoutTime_MPAD" SG_ 158 Hill_Start_Assist_Req 0;
BA_ "GenSigTimeoutTime_GNMM" SG_ 158 Hill_Start_Assist_Req 0;
BA_ "GenSigTimeoutTime_EVCU2" SG_ 158 Hill_Start_Assist_Req 0;
BA_ "GenSigTimeoutTime_ESL" SG_ 158 Hill_Start_Assist_Req 0;
BA_ "GenSigTimeoutTime_ECM" SG_ 158 Hill_Start_Assist_Req 0;
BA_ "GenSigTimeoutTime_DTCM" SG_ 158 Hill_Start_Assist_Req 0;
BA_ "GenSigTimeoutTime_DMSM" SG_ 158 Hill_Start_Assist_Req 0;
BA_ "GenSigTimeoutTime_BSM" SG_ 158 Hill_Start_Assist_Req 0;
BA_ "GenSigTimeoutTime_BCM" SG_ 158 Hill_Start_Assist_Req 0;
BA_ "GenSigTimeoutTime_AGSM" SG_ 158 Hill_Start_Assist_Req 0;
BA_ "GenSigTimeoutTime_ADCAM" SG_ 158 Hill_Start_Assist_Req 0;
BA_ "GenSigSendType" SG_ 158 Hill_Start_Assist_Req 3;
BA_ "GenSigTimeoutTime_SGW" SG_ 158 PamChimeVolumeRear_Req 0;
BA_ "GenSigTimeoutTime_RFHM" SG_ 158 PamChimeVolumeRear_Req 0;
BA_ "GenSigTimeoutTime_MPAD" SG_ 158 PamChimeVolumeRear_Req 0;
BA_ "GenSigTimeoutTime_GNMM" SG_ 158 PamChimeVolumeRear_Req 0;
BA_ "GenSigTimeoutTime_EVCU2" SG_ 158 PamChimeVolumeRear_Req 0;
BA_ "GenSigTimeoutTime_ESL" SG_ 158 PamChimeVolumeRear_Req 0;
BA_ "GenSigTimeoutTime_ECM" SG_ 158 PamChimeVolumeRear_Req 0;
BA_ "GenSigTimeoutTime_DTCM" SG_ 158 PamChimeVolumeRear_Req 0;
BA_ "GenSigTimeoutTime_DMSM" SG_ 158 PamChimeVolumeRear_Req 0;
BA_ "GenSigTimeoutTime_BSM" SG_ 158 PamChimeVolumeRear_Req 0;
BA_ "GenSigTimeoutTime_BCM" SG_ 158 PamChimeVolumeRear_Req 0;
BA_ "GenSigTimeoutTime_AGSM" SG_ 158 PamChimeVolumeRear_Req 0;
BA_ "GenSigTimeoutTime_ADCAM" SG_ 158 PamChimeVolumeRear_Req 0;
BA_ "GenSigSendType" SG_ 158 PamChimeVolumeRear_Req 1;
BA_ "GenSigStartValue" SG_ 158 PamChimeVolumeRear_Req 1;
BA_ "GenSigTimeoutTime_SGW" SG_ 158 PamChimeVolumeFront_Req 0;
BA_ "GenSigTimeoutTime_RFHM" SG_ 158 PamChimeVolumeFront_Req 0;
BA_ "GenSigTimeoutTime_MPAD" SG_ 158 PamChimeVolumeFront_Req 0;
BA_ "GenSigTimeoutTime_GNMM" SG_ 158 PamChimeVolumeFront_Req 0;
BA_ "GenSigTimeoutTime_EVCU2" SG_ 158 PamChimeVolumeFront_Req 0;
BA_ "GenSigTimeoutTime_ESL" SG_ 158 PamChimeVolumeFront_Req 0;
BA_ "GenSigTimeoutTime_ECM" SG_ 158 PamChimeVolumeFront_Req 0;
BA_ "GenSigTimeoutTime_DTCM" SG_ 158 PamChimeVolumeFront_Req 0;
BA_ "GenSigTimeoutTime_DMSM" SG_ 158 PamChimeVolumeFront_Req 0;
BA_ "GenSigTimeoutTime_BSM" SG_ 158 PamChimeVolumeFront_Req 0;
BA_ "GenSigTimeoutTime_BCM" SG_ 158 PamChimeVolumeFront_Req 0;
BA_ "GenSigTimeoutTime_AGSM" SG_ 158 PamChimeVolumeFront_Req 0;
BA_ "GenSigTimeoutTime_ADCAM" SG_ 158 PamChimeVolumeFront_Req 0;
BA_ "GenSigSendType" SG_ 158 PamChimeVolumeFront_Req 1;
BA_ "GenSigStartValue" SG_ 158 PamChimeVolumeFront_Req 1;
BA_ "GenSigTimeoutTime_SGW" SG_ 158 New_Spd_Zone_Ind_Req 0;
BA_ "GenSigTimeoutTime_RFHM" SG_ 158 New_Spd_Zone_Ind_Req 0;
BA_ "GenSigTimeoutTime_MPAD" SG_ 158 New_Spd_Zone_Ind_Req 0;
BA_ "GenSigTimeoutTime_GNMM" SG_ 158 New_Spd_Zone_Ind_Req 0;
BA_ "GenSigTimeoutTime_EVCU2" SG_ 158 New_Spd_Zone_Ind_Req 0;
BA_ "GenSigTimeoutTime_ESL" SG_ 158 New_Spd_Zone_Ind_Req 0;
BA_ "GenSigTimeoutTime_ECM" SG_ 158 New_Spd_Zone_Ind_Req 0;
BA_ "GenSigTimeoutTime_DTCM" SG_ 158 New_Spd_Zone_Ind_Req 0;
BA_ "GenSigTimeoutTime_DMSM" SG_ 158 New_Spd_Zone_Ind_Req 0;
BA_ "GenSigTimeoutTime_BSM" SG_ 158 New_Spd_Zone_Ind_Req 0;
BA_ "GenSigTimeoutTime_BCM" SG_ 158 New_Spd_Zone_Ind_Req 0;
BA_ "GenSigTimeoutTime_AGSM" SG_ 158 New_Spd_Zone_Ind_Req 0;
BA_ "GenSigTimeoutTime_ADCAM" SG_ 158 New_Spd_Zone_Ind_Req 0;
BA_ "GenSigSendType" SG_ 158 New_Spd_Zone_Ind_Req 3;
BA_ "GenSigTimeoutTime_SGW" SG_ 158 Night_Vision_Req 0;
BA_ "GenSigTimeoutTime_RFHM" SG_ 158 Night_Vision_Req 0;
BA_ "GenSigTimeoutTime_MPAD" SG_ 158 Night_Vision_Req 0;
BA_ "GenSigTimeoutTime_GNMM" SG_ 158 Night_Vision_Req 0;
BA_ "GenSigTimeoutTime_EVCU2" SG_ 158 Night_Vision_Req 0;
BA_ "GenSigTimeoutTime_ESL" SG_ 158 Night_Vision_Req 0;
BA_ "GenSigTimeoutTime_ECM" SG_ 158 Night_Vision_Req 0;
BA_ "GenSigTimeoutTime_DTCM" SG_ 158 Night_Vision_Req 0;
BA_ "GenSigTimeoutTime_DMSM" SG_ 158 Night_Vision_Req 0;
BA_ "GenSigTimeoutTime_BSM" SG_ 158 Night_Vision_Req 0;
BA_ "GenSigTimeoutTime_BCM" SG_ 158 Night_Vision_Req 0;
BA_ "GenSigTimeoutTime_AGSM" SG_ 158 Night_Vision_Req 0;
BA_ "GenSigTimeoutTime_ADCAM" SG_ 158 Night_Vision_Req 0;
BA_ "GenSigSendType" SG_ 158 Night_Vision_Req 3;
BA_ "GenSigTimeoutTime_MPAD" SG_ 158 PassiveEntry_Req 0;
BA_ "GenSigTimeoutTime_GNMM" SG_ 158 PassiveEntry_Req 0;
BA_ "GenSigTimeoutTime_EVCU2" SG_ 158 PassiveEntry_Req 0;
BA_ "GenSigTimeoutTime_ESL" SG_ 158 PassiveEntry_Req 0;
BA_ "GenSigTimeoutTime_ECM" SG_ 158 PassiveEntry_Req 0;
BA_ "GenSigTimeoutTime_DTCM" SG_ 158 PassiveEntry_Req 0;
BA_ "GenSigTimeoutTime_DMSM" SG_ 158 PassiveEntry_Req 0;
BA_ "GenSigTimeoutTime_BSM" SG_ 158 PassiveEntry_Req 0;
BA_ "GenSigTimeoutTime_BCM" SG_ 158 PassiveEntry_Req 0;
BA_ "GenSigTimeoutTime_AGSM" SG_ 158 PassiveEntry_Req 0;
BA_ "GenSigTimeoutTime_ADCAM" SG_ 158 PassiveEntry_Req 0;
BA_ "GenSigSendType" SG_ 158 PassiveEntry_Req 1;
BA_ "GenSigTimeoutTime_BSM" SG_ 158 HourMode_Req 0;
BA_ "GenSigTimeoutTime_BCM" SG_ 158 HourMode_Req 0;
BA_ "GenSigTimeoutTime_AGSM" SG_ 158 HourMode_Req 0;
BA_ "GenSigTimeoutTime_ADCAM" SG_ 158 HourMode_Req 0;
BA_ "GenSigSendType" SG_ 158 HourMode_Req 1;
BA_ "GenSigTimeoutTime_SGW" SG_ 158 HourMode_Req 0;
BA_ "GenSigTimeoutTime_RFHM" SG_ 158 HourMode_Req 0;
BA_ "GenSigTimeoutTime_MPAD" SG_ 158 HourMode_Req 0;
BA_ "GenSigTimeoutTime_GNMM" SG_ 158 HourMode_Req 0;
BA_ "GenSigTimeoutTime_EVCU2" SG_ 158 HourMode_Req 0;
BA_ "GenSigTimeoutTime_ESL" SG_ 158 HourMode_Req 0;
BA_ "GenSigTimeoutTime_ECM" SG_ 158 HourMode_Req 0;
BA_ "GenSigTimeoutTime_DTCM" SG_ 158 HourMode_Req 0;
BA_ "GenSigTimeoutTime_DMSM" SG_ 158 HourMode_Req 0;
BA_ "GenSigTimeoutTime_SGW" SG_ 158 HP_Unit_Req 0;
BA_ "GenSigTimeoutTime_RFHM" SG_ 158 HP_Unit_Req 0;
BA_ "GenSigTimeoutTime_MPAD" SG_ 158 HP_Unit_Req 0;
BA_ "GenSigTimeoutTime_GNMM" SG_ 158 HP_Unit_Req 0;
BA_ "GenSigTimeoutTime_EVCU2" SG_ 158 HP_Unit_Req 0;
BA_ "GenSigTimeoutTime_ESL" SG_ 158 HP_Unit_Req 0;
BA_ "GenSigTimeoutTime_ECM" SG_ 158 HP_Unit_Req 0;
BA_ "GenSigTimeoutTime_DTCM" SG_ 158 HP_Unit_Req 0;
BA_ "GenSigTimeoutTime_DMSM" SG_ 158 HP_Unit_Req 0;
BA_ "GenSigTimeoutTime_BSM" SG_ 158 HP_Unit_Req 0;
BA_ "GenSigTimeoutTime_BCM" SG_ 158 HP_Unit_Req 0;
BA_ "GenSigTimeoutTime_AGSM" SG_ 158 HP_Unit_Req 0;
BA_ "GenSigTimeoutTime_ADCAM" SG_ 158 HP_Unit_Req 0;
BA_ "GenSigSendType" SG_ 158 HP_Unit_Req 3;
BA_ "GenSigTimeoutTime_SGW" SG_ 158 Illuminated_Approach_Req 0;
BA_ "GenSigTimeoutTime_RFHM" SG_ 158 Illuminated_Approach_Req 0;
BA_ "GenSigTimeoutTime_MPAD" SG_ 158 Illuminated_Approach_Req 0;
BA_ "GenSigTimeoutTime_GNMM" SG_ 158 Illuminated_Approach_Req 0;
BA_ "GenSigTimeoutTime_EVCU2" SG_ 158 Illuminated_Approach_Req 0;
BA_ "GenSigTimeoutTime_ESL" SG_ 158 Illuminated_Approach_Req 0;
BA_ "GenSigTimeoutTime_ECM" SG_ 158 Illuminated_Approach_Req 0;
BA_ "GenSigTimeoutTime_DTCM" SG_ 158 Illuminated_Approach_Req 0;
BA_ "GenSigTimeoutTime_DMSM" SG_ 158 Illuminated_Approach_Req 0;
BA_ "GenSigTimeoutTime_BSM" SG_ 158 Illuminated_Approach_Req 0;
BA_ "GenSigTimeoutTime_BCM" SG_ 158 Illuminated_Approach_Req 0;
BA_ "GenSigTimeoutTime_AGSM" SG_ 158 Illuminated_Approach_Req 0;
BA_ "GenSigTimeoutTime_ADCAM" SG_ 158 Illuminated_Approach_Req 0;
BA_ "GenSigSendType" SG_ 158 Illuminated_Approach_Req 3;
BA_ "GenSigTimeoutTime_SGW" SG_ 158 Intelligent_Speed_Req 0;
BA_ "GenSigTimeoutTime_RFHM" SG_ 158 Intelligent_Speed_Req 0;
BA_ "GenSigTimeoutTime_MPAD" SG_ 158 Intelligent_Speed_Req 0;
BA_ "GenSigTimeoutTime_GNMM" SG_ 158 Intelligent_Speed_Req 0;
BA_ "GenSigTimeoutTime_EVCU2" SG_ 158 Intelligent_Speed_Req 0;
BA_ "GenSigTimeoutTime_ESL" SG_ 158 Intelligent_Speed_Req 0;
BA_ "GenSigTimeoutTime_ECM" SG_ 158 Intelligent_Speed_Req 0;
BA_ "GenSigTimeoutTime_DTCM" SG_ 158 Intelligent_Speed_Req 0;
BA_ "GenSigTimeoutTime_DMSM" SG_ 158 Intelligent_Speed_Req 0;
BA_ "GenSigTimeoutTime_BSM" SG_ 158 Intelligent_Speed_Req 0;
BA_ "GenSigTimeoutTime_BCM" SG_ 158 Intelligent_Speed_Req 0;
BA_ "GenSigTimeoutTime_AGSM" SG_ 158 Intelligent_Speed_Req 0;
BA_ "GenSigTimeoutTime_ADCAM" SG_ 158 Intelligent_Speed_Req 0;
BA_ "GenSigSendType" SG_ 158 Intelligent_Speed_Req 3;
BA_ "GenSigTimeoutTime_SGW" SG_ 158 LanguageSelection_Req 0;
BA_ "GenSigTimeoutTime_RFHM" SG_ 158 LanguageSelection_Req 0;
BA_ "GenSigTimeoutTime_MPAD" SG_ 158 LanguageSelection_Req 0;
BA_ "GenSigTimeoutTime_GNMM" SG_ 158 LanguageSelection_Req 0;
BA_ "GenSigTimeoutTime_EVCU2" SG_ 158 LanguageSelection_Req 0;
BA_ "GenSigTimeoutTime_ESL" SG_ 158 LanguageSelection_Req 0;
BA_ "GenSigTimeoutTime_ECM" SG_ 158 LanguageSelection_Req 0;
BA_ "GenSigTimeoutTime_DTCM" SG_ 158 LanguageSelection_Req 0;
BA_ "GenSigTimeoutTime_DMSM" SG_ 158 LanguageSelection_Req 0;
BA_ "GenSigTimeoutTime_BSM" SG_ 158 LanguageSelection_Req 0;
BA_ "GenSigTimeoutTime_BCM" SG_ 158 LanguageSelection_Req 0;
BA_ "GenSigTimeoutTime_AGSM" SG_ 158 LanguageSelection_Req 0;
BA_ "GenSigTimeoutTime_ADCAM" SG_ 158 LanguageSelection_Req 0;
BA_ "GenSigSendType" SG_ 158 LanguageSelection_Req 1;
BA_ "GenSigTimeoutTime_SGW" SG_ 158 LDW_Intensity_Req 0;
BA_ "GenSigTimeoutTime_RFHM" SG_ 158 LDW_Intensity_Req 0;
BA_ "GenSigTimeoutTime_MPAD" SG_ 158 LDW_Intensity_Req 0;
BA_ "GenSigTimeoutTime_GNMM" SG_ 158 LDW_Intensity_Req 0;
BA_ "GenSigTimeoutTime_EVCU2" SG_ 158 LDW_Intensity_Req 0;
BA_ "GenSigTimeoutTime_ESL" SG_ 158 LDW_Intensity_Req 0;
BA_ "GenSigTimeoutTime_ECM" SG_ 158 LDW_Intensity_Req 0;
BA_ "GenSigTimeoutTime_DTCM" SG_ 158 LDW_Intensity_Req 0;
BA_ "GenSigTimeoutTime_DMSM" SG_ 158 LDW_Intensity_Req 0;
BA_ "GenSigTimeoutTime_BSM" SG_ 158 LDW_Intensity_Req 0;
BA_ "GenSigTimeoutTime_BCM" SG_ 158 LDW_Intensity_Req 0;
BA_ "GenSigTimeoutTime_AGSM" SG_ 158 LDW_Intensity_Req 0;
BA_ "GenSigTimeoutTime_ADCAM" SG_ 158 LDW_Intensity_Req 0;
BA_ "GenSigSendType" SG_ 158 LDW_Intensity_Req 1;
BA_ "GenSigTimeoutTime_SGW" SG_ 158 LDW_Sensibility_Req 0;
BA_ "GenSigTimeoutTime_RFHM" SG_ 158 LDW_Sensibility_Req 0;
BA_ "GenSigTimeoutTime_MPAD" SG_ 158 LDW_Sensibility_Req 0;
BA_ "GenSigTimeoutTime_GNMM" SG_ 158 LDW_Sensibility_Req 0;
BA_ "GenSigTimeoutTime_EVCU2" SG_ 158 LDW_Sensibility_Req 0;
BA_ "GenSigTimeoutTime_ESL" SG_ 158 LDW_Sensibility_Req 0;
BA_ "GenSigTimeoutTime_ECM" SG_ 158 LDW_Sensibility_Req 0;
BA_ "GenSigTimeoutTime_DTCM" SG_ 158 LDW_Sensibility_Req 0;
BA_ "GenSigTimeoutTime_DMSM" SG_ 158 LDW_Sensibility_Req 0;
BA_ "GenSigTimeoutTime_BSM" SG_ 158 LDW_Sensibility_Req 0;
BA_ "GenSigTimeoutTime_BCM" SG_ 158 LDW_Sensibility_Req 0;
BA_ "GenSigTimeoutTime_AGSM" SG_ 158 LDW_Sensibility_Req 0;
BA_ "GenSigTimeoutTime_ADCAM" SG_ 158 LDW_Sensibility_Req 0;
BA_ "GenSigSendType" SG_ 158 LDW_Sensibility_Req 1;
BA_ "GenSigStartValue" SG_ 158 LDW_Sensibility_Req 3;
BA_ "GenSigTimeoutTime_SGW" SG_ 158 NavigationRepetition_Req 0;
BA_ "GenSigTimeoutTime_RFHM" SG_ 158 NavigationRepetition_Req 0;
BA_ "GenSigTimeoutTime_MPAD" SG_ 158 NavigationRepetition_Req 0;
BA_ "GenSigTimeoutTime_GNMM" SG_ 158 NavigationRepetition_Req 0;
BA_ "GenSigTimeoutTime_EVCU2" SG_ 158 NavigationRepetition_Req 0;
BA_ "GenSigTimeoutTime_ESL" SG_ 158 NavigationRepetition_Req 0;
BA_ "GenSigTimeoutTime_ECM" SG_ 158 NavigationRepetition_Req 0;
BA_ "GenSigTimeoutTime_DTCM" SG_ 158 NavigationRepetition_Req 0;
BA_ "GenSigTimeoutTime_DMSM" SG_ 158 NavigationRepetition_Req 0;
BA_ "GenSigTimeoutTime_BSM" SG_ 158 NavigationRepetition_Req 0;
BA_ "GenSigTimeoutTime_BCM" SG_ 158 NavigationRepetition_Req 0;
BA_ "GenSigTimeoutTime_AGSM" SG_ 158 NavigationRepetition_Req 0;
BA_ "GenSigTimeoutTime_ADCAM" SG_ 158 NavigationRepetition_Req 0;
BA_ "GenSigSendType" SG_ 158 NavigationRepetition_Req 1;
BA_ "GenSigTimeoutTime_SGW" SG_ 158 HeadlightsOffDelay_Req 0;
BA_ "GenSigTimeoutTime_GNMM" SG_ 255 Rear_Axle_Target_Torque 0;
BA_ "GenSigTimeoutTime_SGW" SG_ 158 MessageCounter_TVS1 0;
BA_ "GenSigTimeoutTime_RFHM" SG_ 158 MessageCounter_TVS1 0;
BA_ "GenSigTimeoutTime_MPAD" SG_ 158 MessageCounter_TVS1 0;
BA_ "GenSigTimeoutTime_IPC" SG_ 158 MessageCounter_TVS1 0;
BA_ "GenSigTimeoutTime_GNMM" SG_ 158 MessageCounter_TVS1 0;
BA_ "GenSigTimeoutTime_EVCU2" SG_ 158 MessageCounter_TVS1 0;
BA_ "GenSigTimeoutTime_ESL" SG_ 158 MessageCounter_TVS1 0;
BA_ "GenSigTimeoutTime_ECM" SG_ 158 MessageCounter_TVS1 0;
BA_ "GenSigTimeoutTime_DTCM" SG_ 158 MessageCounter_TVS1 0;
BA_ "GenSigTimeoutTime_DMSM" SG_ 158 MessageCounter_TVS1 0;
BA_ "GenSigTimeoutTime_BSM" SG_ 158 MessageCounter_TVS1 0;
BA_ "GenSigTimeoutTime_BCM" SG_ 158 MessageCounter_TVS1 0;
BA_ "GenSigTimeoutTime_AGSM" SG_ 158 MessageCounter_TVS1 0;
BA_ "GenSigTimeoutTime_SGW" SG_ 150 Text_Characters_NavTbT 0;
BA_ "GenSigTimeoutTime_RFHM" SG_ 150 Text_Characters_NavTbT 0;
BA_ "GenSigTimeoutTime_MPAD" SG_ 150 Text_Characters_NavTbT 0;
BA_ "GenSigTimeoutTime_GNMM" SG_ 150 Text_Characters_NavTbT 0;
BA_ "GenSigTimeoutTime_EVCU2" SG_ 150 Text_Characters_NavTbT 0;
BA_ "GenSigTimeoutTime_ESL" SG_ 150 Text_Characters_NavTbT 0;
BA_ "GenSigTimeoutTime_ECM" SG_ 150 Text_Characters_NavTbT 0;
BA_ "GenSigTimeoutTime_DTCM" SG_ 150 Text_Characters_NavTbT 0;
BA_ "GenSigTimeoutTime_DMSM" SG_ 150 Text_Characters_NavTbT 0;
BA_ "GenSigTimeoutTime_BSM" SG_ 150 Text_Characters_NavTbT 0;
BA_ "GenSigTimeoutTime_BCM" SG_ 150 Text_Characters_NavTbT 0;
BA_ "GenSigTimeoutTime_AGSM" SG_ 150 Text_Characters_NavTbT 0;
BA_ "GenSigTimeoutTime_ADCAM" SG_ 150 Text_Characters_NavTbT 0;
BA_ "GenSigSendType" SG_ 150 Text_Characters_NavTbT 3;
BA_ "GenSigTimeoutTime_SGW" SG_ 154 Text_Characters_Aud_Ph 0;
BA_ "GenSigTimeoutTime_RFHM" SG_ 154 Text_Characters_Aud_Ph 0;
BA_ "GenSigTimeoutTime_MPAD" SG_ 154 Text_Characters_Aud_Ph 0;
BA_ "GenSigTimeoutTime_GNMM" SG_ 154 Text_Characters_Aud_Ph 0;
BA_ "GenSigTimeoutTime_EVCU2" SG_ 154 Text_Characters_Aud_Ph 0;
BA_ "GenSigTimeoutTime_ESL" SG_ 154 Text_Characters_Aud_Ph 0;
BA_ "GenSigTimeoutTime_ECM" SG_ 154 Text_Characters_Aud_Ph 0;
BA_ "GenSigTimeoutTime_DTCM" SG_ 154 Text_Characters_Aud_Ph 0;
BA_ "GenSigTimeoutTime_DMSM" SG_ 154 Text_Characters_Aud_Ph 0;
BA_ "GenSigTimeoutTime_BSM" SG_ 154 Text_Characters_Aud_Ph 0;
BA_ "GenSigTimeoutTime_BCM" SG_ 154 Text_Characters_Aud_Ph 0;
BA_ "GenSigTimeoutTime_AGSM" SG_ 154 Text_Characters_Aud_Ph 0;
BA_ "GenSigTimeoutTime_ADCAM" SG_ 154 Text_Characters_Aud_Ph 0;
BA_ "GenSigSendType" SG_ 154 Text_Characters_Aud_Ph 3;
BA_ "GenSigTimeoutTime_SGW" SG_ 1466 HUtoIPC_NAV_Sts 0;
BA_ "GenSigTimeoutTime_RFHM" SG_ 1466 HUtoIPC_NAV_Sts 0;
BA_ "GenSigTimeoutTime_MPAD" SG_ 1466 HUtoIPC_NAV_Sts 0;
BA_ "GenSigTimeoutTime_GNMM" SG_ 1466 HUtoIPC_NAV_Sts 0;
BA_ "GenSigTimeoutTime_EVCU2" SG_ 1466 HUtoIPC_NAV_Sts 0;
BA_ "GenSigTimeoutTime_ESL" SG_ 1466 HUtoIPC_NAV_Sts 0;
BA_ "GenSigTimeoutTime_ECM" SG_ 1466 HUtoIPC_NAV_Sts 0;
BA_ "GenSigTimeoutTime_DTCM" SG_ 1466 HUtoIPC_NAV_Sts 0;
BA_ "GenSigTimeoutTime_DMSM" SG_ 1466 HUtoIPC_NAV_Sts 0;
BA_ "GenSigTimeoutTime_BSM" SG_ 1466 HUtoIPC_NAV_Sts 0;
BA_ "GenSigTimeoutTime_BCM" SG_ 1466 HUtoIPC_NAV_Sts 0;
BA_ "GenSigTimeoutTime_AGSM" SG_ 1466 HUtoIPC_NAV_Sts 0;
BA_ "GenSigTimeoutTime_ADCAM" SG_ 1466 HUtoIPC_NAV_Sts 0;
BA_ "GenSigSendType" SG_ 1466 HUtoIPC_NAV_Sts 3;
BA_ "GenSigTimeoutTime_SGW" SG_ 1466 ChargeNow 0;
BA_ "GenSigTimeoutTime_RFHM" SG_ 1466 ChargeNow 0;
BA_ "GenSigTimeoutTime_MPAD" SG_ 1466 ChargeNow 0;
BA_ "GenSigTimeoutTime_IPC" SG_ 1466 ChargeNow 0;
BA_ "GenSigTimeoutTime_GNMM" SG_ 1466 ChargeNow 0;
BA_ "GenSigTimeoutTime_ESL" SG_ 1466 ChargeNow 0;
BA_ "GenSigTimeoutTime_SGW" SG_ 612 WprWashSw_Psd 0;
BA_ "GenSigTimeoutTime_RFHM" SG_ 612 WprWashSw_Psd 0;
BA_ "GenSigTimeoutTime_MPAD" SG_ 612 WprWashSw_Psd 0;
BA_ "GenSigTimeoutTime_IPC" SG_ 612 WprWashSw_Psd 0;
BA_ "GenSigTimeoutTime_GNMM" SG_ 612 WprWashSw_Psd 0;
BA_ "GenSigTimeoutTime_EVCU2" SG_ 612 WprWashSw_Psd 0;
BA_ "GenSigTimeoutTime_ESL" SG_ 612 WprWashSw_Psd 0;
BA_ "GenSigTimeoutTime_ECM" SG_ 612 WprWashSw_Psd 0;
BA_ "GenSigTimeoutTime_DTCM" SG_ 612 WprWashSw_Psd 0;
BA_ "GenSigTimeoutTime_DMSM" SG_ 612 WprWashSw_Psd 0;
BA_ "GenSigTimeoutTime_BSM" SG_ 612 WprWashSw_Psd 0;
BA_ "GenSigTimeoutTime_BCM" SG_ 612 WprWashSw_Psd 0;
BA_ "GenSigTimeoutTime_AGSM" SG_ 612 WprWashSw_Psd 0;
BA_ "GenSigSendType" SG_ 612 WprWashSw_Psd 3;
BA_ "GenSigTimeoutTime_SGW" SG_ 612 CRC_SCCM3 0;
BA_ "GenSigTimeoutTime_RFHM" SG_ 612 CRC_SCCM3 0;
BA_ "GenSigTimeoutTime_MPAD" SG_ 612 CRC_SCCM3 0;
BA_ "GenSigTimeoutTime_IPC" SG_ 612 CRC_SCCM3 0;
BA_ "GenSigTimeoutTime_GNMM" SG_ 612 CRC_SCCM3 0;
BA_ "GenSigTimeoutTime_EVCU2" SG_ 612 CRC_SCCM3 0;
BA_ "GenSigTimeoutTime_ESL" SG_ 612 CRC_SCCM3 0;
BA_ "GenSigTimeoutTime_ECM" SG_ 612 CRC_SCCM3 0;
BA_ "GenSigTimeoutTime_DTCM" SG_ 612 CRC_SCCM3 0;
BA_ "GenSigTimeoutTime_DMSM" SG_ 612 CRC_SCCM3 0;
BA_ "GenSigTimeoutTime_BSM" SG_ 612 CRC_SCCM3 0;
BA_ "GenSigTimeoutTime_BCM" SG_ 612 CRC_SCCM3 0;
BA_ "GenSigTimeoutTime_AGSM" SG_ 612 CRC_SCCM3 0;
BA_ "GenSigTimeoutTime_SGW" SG_ 612 MessageCounter_SCCM3 0;
BA_ "GenSigTimeoutTime_RFHM" SG_ 612 MessageCounter_SCCM3 0;
BA_ "GenSigTimeoutTime_MPAD" SG_ 612 MessageCounter_SCCM3 0;
BA_ "GenSigTimeoutTime_IPC" SG_ 612 MessageCounter_SCCM3 0;
BA_ "GenSigTimeoutTime_GNMM" SG_ 612 MessageCounter_SCCM3 0;
BA_ "GenSigTimeoutTime_EVCU2" SG_ 612 MessageCounter_SCCM3 0;
BA_ "GenSigTimeoutTime_ESL" SG_ 612 MessageCounter_SCCM3 0;
BA_ "GenSigTimeoutTime_ECM" SG_ 612 MessageCounter_SCCM3 0;
BA_ "GenSigTimeoutTime_DTCM" SG_ 612 MessageCounter_SCCM3 0;
BA_ "GenSigTimeoutTime_DMSM" SG_ 612 MessageCounter_SCCM3 0;
BA_ "GenSigTimeoutTime_BSM" SG_ 612 MessageCounter_SCCM3 0;
BA_ "GenSigTimeoutTime_BCM" SG_ 612 MessageCounter_SCCM3 0;
BA_ "GenSigTimeoutTime_AGSM" SG_ 612 MessageCounter_SCCM3 0;
BA_ "GenSigTimeoutTime_SGW" SG_ 1466 ETM_HUD_CustomSetting 0;
BA_ "GenSigTimeoutTime_RFHM" SG_ 1466 ETM_HUD_CustomSetting 0;
BA_ "GenSigTimeoutTime_MPAD" SG_ 1466 ETM_HUD_CustomSetting 0;
BA_ "GenSigTimeoutTime_GNMM" SG_ 1466 ETM_HUD_CustomSetting 0;
BA_ "GenSigTimeoutTime_EVCU2" SG_ 1466 ETM_HUD_CustomSetting 0;
BA_ "GenSigTimeoutTime_ESL" SG_ 1466 ETM_HUD_CustomSetting 0;
BA_ "GenSigTimeoutTime_ECM" SG_ 1466 ETM_HUD_CustomSetting 0;
BA_ "GenSigTimeoutTime_DTCM" SG_ 1466 ETM_HUD_CustomSetting 0;
BA_ "GenSigTimeoutTime_DMSM" SG_ 1466 ETM_HUD_CustomSetting 0;
BA_ "GenSigTimeoutTime_BSM" SG_ 1466 ETM_HUD_CustomSetting 0;
BA_ "GenSigTimeoutTime_BCM" SG_ 1466 ETM_HUD_CustomSetting 0;
BA_ "GenSigTimeoutTime_AGSM" SG_ 1466 ETM_HUD_CustomSetting 0;
BA_ "GenSigTimeoutTime_ADCAM" SG_ 1466 ETM_HUD_CustomSetting 0;
BA_ "GenSigSendType" SG_ 1466 ETM_HUD_CustomSetting 3;
BA_ "GenSigTimeoutTime_SGW" SG_ 1466 ETM_HUD_Layout 0;
BA_ "GenSigTimeoutTime_RFHM" SG_ 1466 ETM_HUD_Layout 0;
BA_ "GenSigTimeoutTime_MPAD" SG_ 1466 ETM_HUD_Layout 0;
BA_ "GenSigTimeoutTime_GNMM" SG_ 1466 ETM_HUD_Layout 0;
BA_ "GenSigTimeoutTime_EVCU2" SG_ 1466 ETM_HUD_Layout 0;
BA_ "GenSigTimeoutTime_ESL" SG_ 1466 ETM_HUD_Layout 0;
BA_ "GenSigTimeoutTime_ECM" SG_ 1466 ETM_HUD_Layout 0;
BA_ "GenSigTimeoutTime_DTCM" SG_ 1466 ETM_HUD_Layout 0;
BA_ "GenSigTimeoutTime_DMSM" SG_ 1466 ETM_HUD_Layout 0;
BA_ "GenSigTimeoutTime_BSM" SG_ 1466 ETM_HUD_Layout 0;
BA_ "GenSigTimeoutTime_BCM" SG_ 1466 ETM_HUD_Layout 0;
BA_ "GenSigTimeoutTime_AGSM" SG_ 1466 ETM_HUD_Layout 0;
BA_ "GenSigTimeoutTime_ADCAM" SG_ 1466 ETM_HUD_Layout 0;
BA_ "GenSigSendType" SG_ 1466 ETM_HUD_Layout 3;
BA_ "GenSigTimeoutTime_SGW" SG_ 1466 Left_Cluster_Button_function 0;
BA_ "GenSigTimeoutTime_RFHM" SG_ 1466 Left_Cluster_Button_function 0;
BA_ "GenSigTimeoutTime_MPAD" SG_ 1466 Left_Cluster_Button_function 0;
BA_ "GenSigTimeoutTime_GNMM" SG_ 1466 Left_Cluster_Button_function 0;
BA_ "GenSigTimeoutTime_EVCU2" SG_ 1466 Left_Cluster_Button_function 0;
BA_ "GenSigTimeoutTime_ESL" SG_ 1466 Left_Cluster_Button_function 0;
BA_ "GenSigTimeoutTime_ECM" SG_ 1466 Left_Cluster_Button_function 0;
BA_ "GenSigTimeoutTime_DTCM" SG_ 1466 Left_Cluster_Button_function 0;
BA_ "GenSigTimeoutTime_DMSM" SG_ 1466 Left_Cluster_Button_function 0;
BA_ "GenSigTimeoutTime_BSM" SG_ 1466 Left_Cluster_Button_function 0;
BA_ "GenSigTimeoutTime_BCM" SG_ 1466 Left_Cluster_Button_function 0;
BA_ "GenSigTimeoutTime_AGSM" SG_ 1466 Left_Cluster_Button_function 0;
BA_ "GenSigTimeoutTime_ADCAM" SG_ 1466 Left_Cluster_Button_function 0;
BA_ "GenSigSendType" SG_ 1466 Left_Cluster_Button_function 3;
BA_ "GenSigTimeoutTime_SGW" SG_ 1466 Right_Cluster_Button_function 0;
BA_ "GenSigTimeoutTime_RFHM" SG_ 1466 Right_Cluster_Button_function 0;
BA_ "GenSigTimeoutTime_MPAD" SG_ 1466 Right_Cluster_Button_function 0;
BA_ "GenSigTimeoutTime_GNMM" SG_ 1466 Right_Cluster_Button_function 0;
BA_ "GenSigTimeoutTime_EVCU2" SG_ 1466 Right_Cluster_Button_function 0;
BA_ "GenSigTimeoutTime_ESL" SG_ 1466 Right_Cluster_Button_function 0;
BA_ "GenSigTimeoutTime_ECM" SG_ 1466 Right_Cluster_Button_function 0;
BA_ "GenSigTimeoutTime_DTCM" SG_ 1466 Right_Cluster_Button_function 0;
BA_ "GenSigTimeoutTime_DMSM" SG_ 1466 Right_Cluster_Button_function 0;
BA_ "GenSigTimeoutTime_BSM" SG_ 1466 Right_Cluster_Button_function 0;
BA_ "GenSigTimeoutTime_BCM" SG_ 1466 Right_Cluster_Button_function 0;
BA_ "GenSigTimeoutTime_AGSM" SG_ 1466 Right_Cluster_Button_function 0;
BA_ "GenSigTimeoutTime_ADCAM" SG_ 1466 Right_Cluster_Button_function 0;
BA_ "GenSigSendType" SG_ 1466 Right_Cluster_Button_function 3;
BA_ "GenSigTimeoutTime_SGW" SG_ 150 FirstFrame_NavTbT 0;
BA_ "GenSigTimeoutTime_RFHM" SG_ 150 FirstFrame_NavTbT 0;
BA_ "GenSigTimeoutTime_MPAD" SG_ 150 FirstFrame_NavTbT 0;
BA_ "GenSigTimeoutTime_GNMM" SG_ 150 FirstFrame_NavTbT 0;
BA_ "GenSigTimeoutTime_EVCU2" SG_ 150 FirstFrame_NavTbT 0;
BA_ "GenSigTimeoutTime_ESL" SG_ 150 FirstFrame_NavTbT 0;
BA_ "GenSigTimeoutTime_ECM" SG_ 150 FirstFrame_NavTbT 0;
BA_ "GenSigTimeoutTime_DTCM" SG_ 150 FirstFrame_NavTbT 0;
BA_ "GenSigTimeoutTime_DMSM" SG_ 150 FirstFrame_NavTbT 0;
BA_ "GenSigTimeoutTime_BSM" SG_ 150 FirstFrame_NavTbT 0;
BA_ "GenSigTimeoutTime_BCM" SG_ 150 FirstFrame_NavTbT 0;
BA_ "GenSigTimeoutTime_AGSM" SG_ 150 FirstFrame_NavTbT 0;
BA_ "GenSigTimeoutTime_ADCAM" SG_ 150 FirstFrame_NavTbT 0;
BA_ "GenSigSendType" SG_ 150 FirstFrame_NavTbT 3;
BA_ "GenSigTimeoutTime_SGW" SG_ 150 NumMultiMessage_NavTbT 0;
BA_ "GenSigTimeoutTime_RFHM" SG_ 150 NumMultiMessage_NavTbT 0;
BA_ "GenSigTimeoutTime_MPAD" SG_ 150 NumMultiMessage_NavTbT 0;
BA_ "GenSigTimeoutTime_GNMM" SG_ 150 NumMultiMessage_NavTbT 0;
BA_ "GenSigTimeoutTime_EVCU2" SG_ 150 NumMultiMessage_NavTbT 0;
BA_ "GenSigTimeoutTime_ESL" SG_ 150 NumMultiMessage_NavTbT 0;
BA_ "GenSigTimeoutTime_ECM" SG_ 150 NumMultiMessage_NavTbT 0;
BA_ "GenSigTimeoutTime_DTCM" SG_ 150 NumMultiMessage_NavTbT 0;
BA_ "GenSigTimeoutTime_DMSM" SG_ 150 NumMultiMessage_NavTbT 0;
BA_ "GenSigTimeoutTime_BSM" SG_ 150 NumMultiMessage_NavTbT 0;
BA_ "GenSigTimeoutTime_BCM" SG_ 150 NumMultiMessage_NavTbT 0;
BA_ "GenSigTimeoutTime_AGSM" SG_ 150 NumMultiMessage_NavTbT 0;
BA_ "GenSigTimeoutTime_ADCAM" SG_ 150 NumMultiMessage_NavTbT 0;
BA_ "GenSigSendType" SG_ 150 NumMultiMessage_NavTbT 3;
BA_ "GenSigTimeoutTime_SGW" SG_ 154 Text_Type_Aud_Ph 0;
BA_ "GenSigTimeoutTime_RFHM" SG_ 154 Text_Type_Aud_Ph 0;
BA_ "GenSigTimeoutTime_MPAD" SG_ 154 Text_Type_Aud_Ph 0;
BA_ "GenSigTimeoutTime_GNMM" SG_ 154 Text_Type_Aud_Ph 0;
BA_ "GenSigTimeoutTime_EVCU2" SG_ 154 Text_Type_Aud_Ph 0;
BA_ "GenSigTimeoutTime_ESL" SG_ 154 Text_Type_Aud_Ph 0;
BA_ "GenSigTimeoutTime_ECM" SG_ 154 Text_Type_Aud_Ph 0;
BA_ "GenSigTimeoutTime_DTCM" SG_ 154 Text_Type_Aud_Ph 0;
BA_ "GenSigTimeoutTime_DMSM" SG_ 154 Text_Type_Aud_Ph 0;
BA_ "GenSigTimeoutTime_BSM" SG_ 154 Text_Type_Aud_Ph 0;
BA_ "GenSigTimeoutTime_BCM" SG_ 154 Text_Type_Aud_Ph 0;
BA_ "GenSigTimeoutTime_AGSM" SG_ 154 Text_Type_Aud_Ph 0;
BA_ "GenSigTimeoutTime_ADCAM" SG_ 154 Text_Type_Aud_Ph 0;
BA_ "GenSigSendType" SG_ 154 Text_Type_Aud_Ph 3;
BA_ "GenSigTimeoutTime_SGW" SG_ 150 Text_Type_NavTbT 0;
BA_ "GenSigTimeoutTime_RFHM" SG_ 150 Text_Type_NavTbT 0;
BA_ "GenSigTimeoutTime_MPAD" SG_ 150 Text_Type_NavTbT 0;
BA_ "GenSigTimeoutTime_GNMM" SG_ 150 Text_Type_NavTbT 0;
BA_ "GenSigTimeoutTime_EVCU2" SG_ 150 Text_Type_NavTbT 0;
BA_ "GenSigTimeoutTime_ESL" SG_ 150 Text_Type_NavTbT 0;
BA_ "GenSigTimeoutTime_ECM" SG_ 150 Text_Type_NavTbT 0;
BA_ "GenSigTimeoutTime_DTCM" SG_ 150 Text_Type_NavTbT 0;
BA_ "GenSigTimeoutTime_DMSM" SG_ 150 Text_Type_NavTbT 0;
BA_ "GenSigTimeoutTime_BSM" SG_ 150 Text_Type_NavTbT 0;
BA_ "GenSigTimeoutTime_BCM" SG_ 150 Text_Type_NavTbT 0;
BA_ "GenSigTimeoutTime_AGSM" SG_ 150 Text_Type_NavTbT 0;
BA_ "GenSigTimeoutTime_ADCAM" SG_ 150 Text_Type_NavTbT 0;
BA_ "GenSigSendType" SG_ 150 Text_Type_NavTbT 3;
BA_ "GenSigTimeoutTime_RFHM" SG_ 160 UConnSeed3 0;
BA_ "GenSigTimeoutTime_MPAD" SG_ 160 UConnSeed3 0;
BA_ "GenSigTimeoutTime_IPC" SG_ 160 UConnSeed3 0;
BA_ "GenSigTimeoutTime_GNMM" SG_ 160 UConnSeed3 0;
BA_ "GenSigTimeoutTime_EVCU2" SG_ 160 UConnSeed3 0;
BA_ "GenSigTimeoutTime_ESL" SG_ 160 UConnSeed3 0;
BA_ "GenSigTimeoutTime_ECM" SG_ 160 UConnSeed3 0;
BA_ "GenSigTimeoutTime_DTCM" SG_ 160 UConnSeed3 0;
BA_ "GenSigTimeoutTime_DMSM" SG_ 160 UConnSeed3 0;
BA_ "GenSigTimeoutTime_BSM" SG_ 160 UConnSeed3 0;
BA_ "GenSigTimeoutTime_BCM" SG_ 160 UConnSeed3 0;
BA_ "GenSigTimeoutTime_AGSM" SG_ 160 UConnSeed3 0;
BA_ "GenSigTimeoutTime_ADCAM" SG_ 160 UConnSeed3 0;
BA_ "GenSigSendType" SG_ 160 UConnSeed3 1;
BA_ "GenSigTimeoutTime_RFHM" SG_ 160 UConnSeed4 0;
BA_ "GenSigTimeoutTime_MPAD" SG_ 160 UConnSeed4 0;
BA_ "GenSigTimeoutTime_IPC" SG_ 160 UConnSeed4 0;
BA_ "GenSigTimeoutTime_GNMM" SG_ 160 UConnSeed4 0;
BA_ "GenSigTimeoutTime_EVCU2" SG_ 160 UConnSeed4 0;
BA_ "GenSigTimeoutTime_ESL" SG_ 160 UConnSeed4 0;
BA_ "GenSigTimeoutTime_ECM" SG_ 160 UConnSeed4 0;
BA_ "GenSigTimeoutTime_DTCM" SG_ 160 UConnSeed4 0;
BA_ "GenSigTimeoutTime_DMSM" SG_ 160 UConnSeed4 0;
BA_ "GenSigTimeoutTime_BSM" SG_ 160 UConnSeed4 0;
BA_ "GenSigTimeoutTime_BCM" SG_ 160 UConnSeed4 0;
BA_ "GenSigTimeoutTime_AGSM" SG_ 160 UConnSeed4 0;
BA_ "GenSigTimeoutTime_ADCAM" SG_ 160 UConnSeed4 0;
BA_ "GenSigSendType" SG_ 160 UConnSeed4 1;
BA_ "GenSigTimeoutTime_RFHM" SG_ 160 UConnSeed1 0;
BA_ "GenSigTimeoutTime_MPAD" SG_ 160 UConnSeed1 0;
BA_ "GenSigTimeoutTime_IPC" SG_ 160 UConnSeed1 0;
BA_ "GenSigTimeoutTime_GNMM" SG_ 160 UConnSeed1 0;
BA_ "GenSigTimeoutTime_EVCU2" SG_ 160 UConnSeed1 0;
BA_ "GenSigTimeoutTime_ESL" SG_ 160 UConnSeed1 0;
BA_ "GenSigTimeoutTime_ECM" SG_ 160 UConnSeed1 0;
BA_ "GenSigTimeoutTime_DTCM" SG_ 160 UConnSeed1 0;
BA_ "GenSigTimeoutTime_DMSM" SG_ 160 UConnSeed1 0;
BA_ "GenSigTimeoutTime_BSM" SG_ 160 UConnSeed1 0;
BA_ "GenSigTimeoutTime_BCM" SG_ 160 UConnSeed1 0;
BA_ "GenSigTimeoutTime_AGSM" SG_ 160 UConnSeed1 0;
BA_ "GenSigTimeoutTime_ADCAM" SG_ 160 UConnSeed1 0;
BA_ "GenSigSendType" SG_ 160 UConnSeed1 1;
BA_ "GenSigTimeoutTime_BCM" SG_ 160 UConnSeed2 0;
BA_ "GenSigTimeoutTime_AGSM" SG_ 160 UConnSeed2 0;
BA_ "GenSigTimeoutTime_ADCAM" SG_ 160 UConnSeed2 0;
BA_ "GenSigSendType" SG_ 160 UConnSeed2 1;
BA_ "GenSigTimeoutTime_RFHM" SG_ 160 UConnSeed2 0;
BA_ "GenSigTimeoutTime_MPAD" SG_ 160 UConnSeed2 0;
BA_ "GenSigTimeoutTime_IPC" SG_ 160 UConnSeed2 0;
BA_ "GenSigTimeoutTime_GNMM" SG_ 160 UConnSeed2 0;
BA_ "GenSigTimeoutTime_EVCU2" SG_ 160 UConnSeed2 0;
BA_ "GenSigTimeoutTime_ESL" SG_ 160 UConnSeed2 0;
BA_ "GenSigTimeoutTime_ECM" SG_ 160 UConnSeed2 0;
BA_ "GenSigTimeoutTime_DTCM" SG_ 160 UConnSeed2 0;
BA_ "GenSigTimeoutTime_DMSM" SG_ 160 UConnSeed2 0;
BA_ "GenSigTimeoutTime_BSM" SG_ 160 UConnSeed2 0;
BA_ "GenSigTimeoutTime_ECM" SG_ 1466 ChargeNow 0;
BA_ "GenSigTimeoutTime_DTCM" SG_ 1466 ChargeNow 0;
BA_ "GenSigTimeoutTime_DMSM" SG_ 1466 ChargeNow 0;
BA_ "GenSigTimeoutTime_BSM" SG_ 1466 ChargeNow 0;
BA_ "GenSigTimeoutTime_BCM" SG_ 1466 ChargeNow 0;
BA_ "GenSigTimeoutTime_AGSM" SG_ 1466 ChargeNow 0;
BA_ "GenSigTimeoutTime_ADCAM" SG_ 1466 ChargeNow 0;
BA_ "GenSigSendType" SG_ 1466 ChargeNow 3;
BA_ "GenSigTimeoutTime_SGW" SG_ 608 NUM_OF_LANES_DRV_DIR_CS 0;
BA_ "GenSigTimeoutTime_RFHM" SG_ 608 NUM_OF_LANES_DRV_DIR_CS 0;
BA_ "GenSigTimeoutTime_MPAD" SG_ 608 NUM_OF_LANES_DRV_DIR_CS 0;
BA_ "GenSigTimeoutTime_IPC" SG_ 608 NUM_OF_LANES_DRV_DIR_CS 0;
BA_ "GenSigTimeoutTime_GNMM" SG_ 608 NUM_OF_LANES_DRV_DIR_CS 0;
BA_ "GenSigTimeoutTime_EVCU2" SG_ 608 NUM_OF_LANES_DRV_DIR_CS 0;
BA_ "GenSigTimeoutTime_ESL" SG_ 608 NUM_OF_LANES_DRV_DIR_CS 0;
BA_ "GenSigTimeoutTime_ECM" SG_ 608 NUM_OF_LANES_DRV_DIR_CS 0;
BA_ "GenSigTimeoutTime_DTCM" SG_ 608 NUM_OF_LANES_DRV_DIR_CS 0;
BA_ "GenSigTimeoutTime_DMSM" SG_ 608 NUM_OF_LANES_DRV_DIR_CS 0;
BA_ "GenSigTimeoutTime_BSM" SG_ 608 NUM_OF_LANES_DRV_DIR_CS 0;
BA_ "GenSigTimeoutTime_BCM" SG_ 608 NUM_OF_LANES_DRV_DIR_CS 0;
BA_ "GenSigTimeoutTime_AGSM" SG_ 608 NUM_OF_LANES_DRV_DIR_CS 0;
BA_ "GenSigSendType" SG_ 608 NUM_OF_LANES_DRV_DIR_CS 3;
BA_ "GenSigTimeoutTime_SGW" SG_ 608 PathIdx_CS 0;
BA_ "GenSigTimeoutTime_RFHM" SG_ 608 PathIdx_CS 0;
BA_ "GenSigTimeoutTime_IPC" SG_ 608 PathIdx_CS 0;
BA_ "GenSigTimeoutTime_GNMM" SG_ 608 PathIdx_CS 0;
BA_ "GenSigTimeoutTime_EVCU2" SG_ 608 PathIdx_CS 0;
BA_ "GenSigTimeoutTime_ESL" SG_ 608 PathIdx_CS 0;
BA_ "GenSigTimeoutTime_ECM" SG_ 608 PathIdx_CS 0;
BA_ "GenSigTimeoutTime_DTCM" SG_ 608 PathIdx_CS 0;
BA_ "GenSigTimeoutTime_DMSM" SG_ 608 PathIdx_CS 0;
BA_ "GenSigTimeoutTime_BSM" SG_ 608 PathIdx_CS 0;
BA_ "GenSigTimeoutTime_BCM" SG_ 608 PathIdx_CS 0;
BA_ "GenSigTimeoutTime_AGSM" SG_ 608 PathIdx_CS 0;
BA_ "GenSigSendType" SG_ 608 PathIdx_CS 3;
BA_ "GenSigTimeoutTime_SGW" SG_ 608 NavDataAvailable_CS 0;
BA_ "GenSigTimeoutTime_SGW" SG_ 158 Trailer_detection_blind_spot_Req 0;
BA_ "GenSigTimeoutTime_RFHM" SG_ 158 Trailer_detection_blind_spot_Req 0;
BA_ "GenSigTimeoutTime_MPAD" SG_ 158 Trailer_detection_blind_spot_Req 0;
BA_ "GenSigTimeoutTime_GNMM" SG_ 158 Trailer_detection_blind_spot_Req 0;
BA_ "GenSigTimeoutTime_EVCU2" SG_ 158 Trailer_detection_blind_spot_Req 0;
BA_ "GenSigTimeoutTime_ESL" SG_ 158 Trailer_detection_blind_spot_Req 0;
BA_ "GenSigTimeoutTime_ECM" SG_ 158 Trailer_detection_blind_spot_Req 0;
BA_ "GenSigTimeoutTime_DTCM" SG_ 158 Trailer_detection_blind_spot_Req 0;
BA_ "GenSigTimeoutTime_DMSM" SG_ 158 Trailer_detection_blind_spot_Req 0;
BA_ "GenSigTimeoutTime_BSM" SG_ 158 Trailer_detection_blind_spot_Req 0;
BA_ "GenSigTimeoutTime_BCM" SG_ 158 Trailer_detection_blind_spot_Req 0;
BA_ "GenSigTimeoutTime_AGSM" SG_ 158 Trailer_detection_blind_spot_Req 0;
BA_ "GenSigTimeoutTime_ADCAM" SG_ 158 Trailer_detection_blind_spot_Req 0;
BA_ "GenSigSendType" SG_ 158 Trailer_detection_blind_spot_Req 3;
BA_ "GenSigTimeoutTime_RFHM" SG_ 158 StaticGrid_Req 0;
BA_ "GenSigTimeoutTime_MPAD" SG_ 158 StaticGrid_Req 0;
BA_ "GenSigTimeoutTime_GNMM" SG_ 158 StaticGrid_Req 0;
BA_ "GenSigTimeoutTime_EVCU2" SG_ 158 StaticGrid_Req 0;
BA_ "GenSigTimeoutTime_ESL" SG_ 158 StaticGrid_Req 0;
BA_ "GenSigTimeoutTime_ECM" SG_ 158 StaticGrid_Req 0;
BA_ "GenSigTimeoutTime_DTCM" SG_ 158 StaticGrid_Req 0;
BA_ "GenSigTimeoutTime_DMSM" SG_ 158 StaticGrid_Req 0;
BA_ "GenSigTimeoutTime_BSM" SG_ 158 StaticGrid_Req 0;
BA_ "GenSigTimeoutTime_BCM" SG_ 158 StaticGrid_Req 0;
BA_ "GenSigTimeoutTime_AGSM" SG_ 158 StaticGrid_Req 0;
BA_ "GenSigTimeoutTime_ADCAM" SG_ 158 StaticGrid_Req 0;
BA_ "GenSigSendType" SG_ 158 StaticGrid_Req 1;
BA_ "GenSigTimeoutTime_SGW" SG_ 158 StaticGrid_Req 0;
BA_ "GenSigTimeoutTime_SGW" SG_ 158 FOA_Alert_Type_Req 0;
BA_ "GenSigTimeoutTime_RFHM" SG_ 158 FOA_Alert_Type_Req 0;
BA_ "GenSigTimeoutTime_MPAD" SG_ 158 FOA_Alert_Type_Req 0;
BA_ "GenSigTimeoutTime_GNMM" SG_ 158 FOA_Alert_Type_Req 0;
BA_ "GenSigTimeoutTime_EVCU2" SG_ 158 FOA_Alert_Type_Req 0;
BA_ "GenSigTimeoutTime_ESL" SG_ 158 FOA_Alert_Type_Req 0;
BA_ "GenSigTimeoutTime_ECM" SG_ 158 FOA_Alert_Type_Req 0;
BA_ "GenSigTimeoutTime_DTCM" SG_ 158 FOA_Alert_Type_Req 0;
BA_ "GenSigTimeoutTime_DMSM" SG_ 158 FOA_Alert_Type_Req 0;
BA_ "GenSigTimeoutTime_BSM" SG_ 158 FOA_Alert_Type_Req 0;
BA_ "GenSigTimeoutTime_BCM" SG_ 158 FOA_Alert_Type_Req 0;
BA_ "GenSigTimeoutTime_AGSM" SG_ 158 FOA_Alert_Type_Req 0;
BA_ "GenSigTimeoutTime_ADCAM" SG_ 158 FOA_Alert_Type_Req 0;
BA_ "GenSigSendType" SG_ 158 FOA_Alert_Type_Req 3;
BA_ "GenSigStartValue" SG_ 158 FOA_Alert_Type_Req 1;
BA_ "GenSigTimeoutTime_SGW" SG_ 158 CRC_TVS1 0;
BA_ "GenSigTimeoutTime_RFHM" SG_ 158 CRC_TVS1 0;
BA_ "GenSigTimeoutTime_MPAD" SG_ 158 CRC_TVS1 0;
BA_ "GenSigTimeoutTime_IPC" SG_ 158 CRC_TVS1 0;
BA_ "GenSigTimeoutTime_GNMM" SG_ 158 CRC_TVS1 0;
BA_ "GenSigTimeoutTime_EVCU2" SG_ 158 CRC_TVS1 0;
BA_ "GenSigTimeoutTime_ESL" SG_ 158 CRC_TVS1 0;
BA_ "GenSigTimeoutTime_ECM" SG_ 158 CRC_TVS1 0;
BA_ "GenSigTimeoutTime_DTCM" SG_ 158 CRC_TVS1 0;
BA_ "GenSigTimeoutTime_DMSM" SG_ 158 CRC_TVS1 0;
BA_ "GenSigTimeoutTime_BSM" SG_ 158 CRC_TVS1 0;
BA_ "GenSigTimeoutTime_BCM" SG_ 158 CRC_TVS1 0;
BA_ "GenSigTimeoutTime_AGSM" SG_ 158 CRC_TVS1 0;
BA_ "GenSigTimeoutTime_EVCU2" SG_ 255 Rear_Axle_Target_Torque 0;
BA_ "GenSigTimeoutTime_ESL" SG_ 255 Rear_Axle_Target_Torque 0;
BA_ "GenSigTimeoutTime_ECM" SG_ 255 Rear_Axle_Target_Torque 0;
BA_ "GenSigTimeoutTime_DTCM" SG_ 255 Rear_Axle_Target_Torque 0;
BA_ "GenSigTimeoutTime_DMSM" SG_ 255 Rear_Axle_Target_Torque 0;
BA_ "GenSigTimeoutTime_BCM" SG_ 255 Rear_Axle_Target_Torque 0;
BA_ "GenSigTimeoutTime_AGSM" SG_ 255 Rear_Axle_Target_Torque 0;
BA_ "GenSigTimeoutTime_ADCAM" SG_ 255 Rear_Axle_Target_Torque 0;
BA_ "GenSigStartValue" SG_ 255 Rear_Axle_Target_Torque 32767;
BA_ "GenSigTimeoutTime_SGW" SG_ 255 Front_Axle_Target_Torque 0;
BA_ "GenSigTimeoutTime_RFHM" SG_ 255 Front_Axle_Target_Torque 0;
BA_ "GenSigTimeoutTime_MPAD" SG_ 255 Front_Axle_Target_Torque 0;
BA_ "GenSigTimeoutTime_IPC" SG_ 255 Front_Axle_Target_Torque 0;
BA_ "GenSigTimeoutTime_GNMM" SG_ 255 Front_Axle_Target_Torque 0;
BA_ "GenSigTimeoutTime_EVCU2" SG_ 255 Front_Axle_Target_Torque 0;
BA_ "GenSigTimeoutTime_ESL" SG_ 255 Front_Axle_Target_Torque 0;
BA_ "GenSigTimeoutTime_ECM" SG_ 255 Front_Axle_Target_Torque 0;
BA_ "GenSigTimeoutTime_DTCM" SG_ 255 Front_Axle_Target_Torque 0;
BA_ "GenSigTimeoutTime_DMSM" SG_ 255 Front_Axle_Target_Torque 0;
BA_ "GenSigTimeoutTime_BCM" SG_ 255 Front_Axle_Target_Torque 0;
BA_ "GenSigTimeoutTime_AGSM" SG_ 255 Front_Axle_Target_Torque 0;
BA_ "GenSigTimeoutTime_ADCAM" SG_ 255 Front_Axle_Target_Torque 0;
BA_ "GenSigStartValue" SG_ 255 Front_Axle_Target_Torque 32767;
BA_ "GenSigTimeoutTime_RFHM" SG_ 255 Front_AxleTorque_Static 0;
BA_ "GenSigTimeoutTime_MPAD" SG_ 255 Front_AxleTorque_Static 0;
BA_ "GenSigTimeoutTime_IPC" SG_ 255 Front_AxleTorque_Static 0;
BA_ "GenSigTimeoutTime_GNMM" SG_ 255 Front_AxleTorque_Static 0;
BA_ "GenSigTimeoutTime_EVCU2" SG_ 255 Front_AxleTorque_Static 0;
BA_ "GenSigTimeoutTime_ESL" SG_ 255 Front_AxleTorque_Static 0;
BA_ "GenSigTimeoutTime_ECM" SG_ 255 Front_AxleTorque_Static 0;
BA_ "GenSigTimeoutTime_DTCM" SG_ 255 Front_AxleTorque_Static 0;
BA_ "GenSigTimeoutTime_DMSM" SG_ 255 Front_AxleTorque_Static 0;
BA_ "GenSigTimeoutTime_AGSM" SG_ 255 Front_AxleTorque_Static 0;
BA_ "GenSigTimeoutTime_ADCAM" SG_ 255 Front_AxleTorque_Static 0;
BA_ "GenSigStartValue" SG_ 255 Front_AxleTorque_Static 32767;
BA_ "GenSigTimeoutTime_SGW" SG_ 255 Accel_Pedal_Override 0;
BA_ "GenSigTimeoutTime_RFHM" SG_ 255 Accel_Pedal_Override 0;
BA_ "GenSigTimeoutTime_IPC" SG_ 255 Accel_Pedal_Override 0;
BA_ "GenSigTimeoutTime_GNMM" SG_ 255 Accel_Pedal_Override 0;
BA_ "GenSigTimeoutTime_EVCU2" SG_ 255 Accel_Pedal_Override 0;
BA_ "GenSigTimeoutTime_ESL" SG_ 255 Accel_Pedal_Override 0;
BA_ "GenSigTimeoutTime_ECM" SG_ 255 Accel_Pedal_Override 0;
BA_ "GenSigTimeoutTime_DTCM" SG_ 255 Accel_Pedal_Override 0;
BA_ "GenSigTimeoutTime_DMSM" SG_ 255 Accel_Pedal_Override 0;
BA_ "GenSigTimeoutTime_AGSM" SG_ 255 Accel_Pedal_Override 0;
BA_ "GenSigTimeoutTime_SGW" SG_ 255 PPPA_TrqEnblRq_Allowed 0;
BA_ "GenSigTimeoutTime_RFHM" SG_ 255 PPPA_TrqEnblRq_Allowed 0;
BA_ "GenSigTimeoutTime_MPAD" SG_ 255 PPPA_TrqEnblRq_Allowed 0;
BA_ "GenSigTimeoutTime_IPC" SG_ 255 PPPA_TrqEnblRq_Allowed 0;
BA_ "GenSigTimeoutTime_GNMM" SG_ 255 PPPA_TrqEnblRq_Allowed 0;
BA_ "GenSigTimeoutTime_EVCU2" SG_ 255 PPPA_TrqEnblRq_Allowed 0;
BA_ "GenSigTimeoutTime_ESL" SG_ 255 PPPA_TrqEnblRq_Allowed 0;
BA_ "GenSigTimeoutTime_ECM" SG_ 255 PPPA_TrqEnblRq_Allowed 0;
BA_ "GenSigTimeoutTime_DTCM" SG_ 255 PPPA_TrqEnblRq_Allowed 0;
BA_ "GenSigTimeoutTime_DMSM" SG_ 255 PPPA_TrqEnblRq_Allowed 0;
BA_ "GenSigTimeoutTime_BSM" SG_ 255 PPPA_TrqEnblRq_Allowed 0;
BA_ "GenSigTimeoutTime_BCM" SG_ 255 PPPA_TrqEnblRq_Allowed 0;
BA_ "GenSigTimeoutTime_AGSM" SG_ 255 PPPA_TrqEnblRq_Allowed 0;
BA_ "GenSigTimeoutTime_ADCAM" SG_ 255 PPPA_TrqEnblRq_Allowed 0;
BA_ "GenSigTimeoutTime_SGW" SG_ 255 ESC_TrqEnblRq_Allowed 0;
BA_ "GenSigTimeoutTime_RFHM" SG_ 255 ESC_TrqEnblRq_Allowed 0;
BA_ "GenSigTimeoutTime_MPAD" SG_ 255 ESC_TrqEnblRq_Allowed 0;
BA_ "GenSigTimeoutTime_IPC" SG_ 255 ESC_TrqEnblRq_Allowed 0;
BA_ "GenSigTimeoutTime_GNMM" SG_ 255 ESC_TrqEnblRq_Allowed 0;
BA_ "GenSigTimeoutTime_EVCU2" SG_ 255 ESC_TrqEnblRq_Allowed 0;
BA_ "GenSigTimeoutTime_ESL" SG_ 255 ESC_TrqEnblRq_Allowed 0;
BA_ "GenSigTimeoutTime_ECM" SG_ 255 ESC_TrqEnblRq_Allowed 0;
BA_ "GenSigTimeoutTime_DTCM" SG_ 255 ESC_TrqEnblRq_Allowed 0;
BA_ "GenSigTimeoutTime_DMSM" SG_ 255 ESC_TrqEnblRq_Allowed 0;
BA_ "GenSigTimeoutTime_BCM" SG_ 255 ESC_TrqEnblRq_Allowed 0;
BA_ "GenSigTimeoutTime_AGSM" SG_ 255 ESC_TrqEnblRq_Allowed 0;
BA_ "GenSigTimeoutTime_ADCAM" SG_ 255 ESC_TrqEnblRq_Allowed 0;
BA_ "GenSigTimeoutTime_SGW" SG_ 255 ACC_NCC_TrqEnblRq_Allowed 0;
BA_ "GenSigTimeoutTime_RFHM" SG_ 255 ACC_NCC_TrqEnblRq_Allowed 0;
BA_ "GenSigTimeoutTime_MPAD" SG_ 255 ACC_NCC_TrqEnblRq_Allowed 0;
BA_ "GenSigTimeoutTime_IPC" SG_ 255 ACC_NCC_TrqEnblRq_Allowed 0;
BA_ "GenSigTimeoutTime_GNMM" SG_ 255 ACC_NCC_TrqEnblRq_Allowed 0;
BA_ "GenSigTimeoutTime_EVCU2" SG_ 255 ACC_NCC_TrqEnblRq_Allowed 0;
BA_ "GenSigTimeoutTime_ESL" SG_ 255 ACC_NCC_TrqEnblRq_Allowed 0;
BA_ "GenSigTimeoutTime_ECM" SG_ 255 ACC_NCC_TrqEnblRq_Allowed 0;
BA_ "GenSigTimeoutTime_DTCM" SG_ 255 ACC_NCC_TrqEnblRq_Allowed 0;
BA_ "GenSigTimeoutTime_DMSM" SG_ 255 ACC_NCC_TrqEnblRq_Allowed 0;
BA_ "GenSigTimeoutTime_BSM" SG_ 255 ACC_NCC_TrqEnblRq_Allowed 0;
BA_ "GenSigTimeoutTime_AGSM" SG_ 255 ACC_NCC_TrqEnblRq_Allowed 0;
BA_ "GenSigTimeoutTime_ADCAM" SG_ 255 ACC_NCC_TrqEnblRq_Allowed 0;
BA_ "GenSigTimeoutTime_SGW" SG_ 255 MessageCounter_PT_TORQUE_FD_1 0;
BA_ "GenSigTimeoutTime_RFHM" SG_ 255 MessageCounter_PT_TORQUE_FD_1 0;
BA_ "GenSigTimeoutTime_IPC" SG_ 255 MessageCounter_PT_TORQUE_FD_1 0;
BA_ "GenSigTimeoutTime_GNMM" SG_ 255 MessageCounter_PT_TORQUE_FD_1 0;
BA_ "GenSigTimeoutTime_EVCU2" SG_ 255 MessageCounter_PT_TORQUE_FD_1 0;
BA_ "GenSigTimeoutTime_ESL" SG_ 255 MessageCounter_PT_TORQUE_FD_1 0;
BA_ "GenSigTimeoutTime_ECM" SG_ 255 MessageCounter_PT_TORQUE_FD_1 0;
BA_ "GenSigTimeoutTime_DMSM" SG_ 255 MessageCounter_PT_TORQUE_FD_1 0;
BA_ "GenSigTimeoutTime_BSM" SG_ 255 MessageCounter_PT_TORQUE_FD_1 0;
BA_ "GenSigTimeoutTime_BCM" SG_ 255 MessageCounter_PT_TORQUE_FD_1 0;
BA_ "GenSigTimeoutTime_AGSM" SG_ 255 MessageCounter_PT_TORQUE_FD_1 0;
BA_ "GenSigTimeoutTime_SGW" SG_ 255 CRC_PT_TORQUE_FD_1 0;
BA_ "GenSigTimeoutTime_RFHM" SG_ 255 CRC_PT_TORQUE_FD_1 0;
BA_ "GenSigTimeoutTime_IPC" SG_ 255 CRC_PT_TORQUE_FD_1 0;
BA_ "GenSigTimeoutTime_GNMM" SG_ 255 CRC_PT_TORQUE_FD_1 0;
BA_ "GenSigTimeoutTime_EVCU2" SG_ 255 CRC_PT_TORQUE_FD_1 0;
BA_ "GenSigTimeoutTime_ESL" SG_ 255 CRC_PT_TORQUE_FD_1 0;
BA_ "GenSigTimeoutTime_ECM" SG_ 255 CRC_PT_TORQUE_FD_1 0;
BA_ "GenSigTimeoutTime_DMSM" SG_ 255 CRC_PT_TORQUE_FD_1 0;
BA_ "GenSigTimeoutTime_BSM" SG_ 255 CRC_PT_TORQUE_FD_1 0;
BA_ "GenSigTimeoutTime_BCM" SG_ 255 CRC_PT_TORQUE_FD_1 0;
BA_ "GenSigTimeoutTime_AGSM" SG_ 255 CRC_PT_TORQUE_FD_1 0;
BA_ "GenSigTimeoutTime_BSM" SG_ 158 SpeedLockDoorEnable_Req 0;
BA_ "GenSigTimeoutTime_DTCM" SG_ 608 NavDataAvailable_CS 0;
BA_ "GenSigTimeoutTime_SGW" SG_ 255 Veh_StandStill_Req_OPD 0;
BA_ "GenSigTimeoutTime_RFHM" SG_ 255 Veh_StandStill_Req_OPD 0;
BA_ "GenSigTimeoutTime_MPAD" SG_ 255 Veh_StandStill_Req_OPD 0;
BA_ "GenSigTimeoutTime_IPC" SG_ 255 Veh_StandStill_Req_OPD 0;
BA_ "GenSigTimeoutTime_GNMM" SG_ 255 Veh_StandStill_Req_OPD 0;
BA_ "GenSigTimeoutTime_EVCU2" SG_ 255 Veh_StandStill_Req_OPD 0;
BA_ "GenSigTimeoutTime_ESL" SG_ 255 Veh_StandStill_Req_OPD 0;
BA_ "GenSigTimeoutTime_ECM" SG_ 255 Veh_StandStill_Req_OPD 0;
BA_ "GenSigTimeoutTime_DTCM" SG_ 255 Veh_StandStill_Req_OPD 0;
BA_ "GenSigTimeoutTime_DMSM" SG_ 255 Veh_StandStill_Req_OPD 0;
BA_ "GenSigTimeoutTime_BCM" SG_ 255 Veh_StandStill_Req_OPD 0;
BA_ "GenSigTimeoutTime_SGW" SG_ 158 Ped_EM_Brk_Warn_Act_Req 0;
BA_ "GenSigTimeoutTime_RFHM" SG_ 158 Ped_EM_Brk_Warn_Act_Req 0;
BA_ "GenSigTimeoutTime_GNMM" SG_ 158 Ped_EM_Brk_Warn_Act_Req 0;
BA_ "GenSigTimeoutTime_EVCU2" SG_ 158 Ped_EM_Brk_Warn_Act_Req 0;
BA_ "GenSigTimeoutTime_ESL" SG_ 158 Ped_EM_Brk_Warn_Act_Req 0;
BA_ "GenSigTimeoutTime_ECM" SG_ 158 Ped_EM_Brk_Warn_Act_Req 0;
BA_ "GenSigTimeoutTime_DTCM" SG_ 158 Ped_EM_Brk_Warn_Act_Req 0;
BA_ "GenSigTimeoutTime_DMSM" SG_ 158 Ped_EM_Brk_Warn_Act_Req 0;
BA_ "GenSigTimeoutTime_BSM" SG_ 158 Ped_EM_Brk_Warn_Act_Req 0;
BA_ "GenSigTimeoutTime_BCM" SG_ 158 Ped_EM_Brk_Warn_Act_Req 0;
BA_ "GenSigTimeoutTime_AGSM" SG_ 158 Ped_EM_Brk_Warn_Act_Req 0;
BA_ "GenSigSendType" SG_ 158 Ped_EM_Brk_Warn_Act_Req 3;
BA_ "GenSigTimeoutTime_SGW" SG_ 158 PhoneRepetition_Req 0;
BA_ "GenSigTimeoutTime_RFHM" SG_ 158 PhoneRepetition_Req 0;
BA_ "GenSigTimeoutTime_MPAD" SG_ 158 PhoneRepetition_Req 0;
BA_ "GenSigTimeoutTime_GNMM" SG_ 158 PhoneRepetition_Req 0;
BA_ "GenSigTimeoutTime_EVCU2" SG_ 158 PhoneRepetition_Req 0;
BA_ "GenSigTimeoutTime_ESL" SG_ 158 PhoneRepetition_Req 0;
BA_ "GenSigTimeoutTime_ECM" SG_ 158 PhoneRepetition_Req 0;
BA_ "GenSigTimeoutTime_DTCM" SG_ 158 PhoneRepetition_Req 0;
BA_ "GenSigTimeoutTime_DMSM" SG_ 158 PhoneRepetition_Req 0;
BA_ "GenSigTimeoutTime_BSM" SG_ 158 PhoneRepetition_Req 0;
BA_ "GenSigTimeoutTime_BCM" SG_ 158 PhoneRepetition_Req 0;
BA_ "GenSigTimeoutTime_AGSM" SG_ 158 PhoneRepetition_Req 0;
BA_ "GenSigTimeoutTime_ADCAM" SG_ 158 PhoneRepetition_Req 0;
BA_ "GenSigSendType" SG_ 158 PhoneRepetition_Req 1;
BA_ "GenSigTimeoutTime_DMSM" SG_ 158 PLGAlert_Req 0;
BA_ "GenSigTimeoutTime_BSM" SG_ 158 PLGAlert_Req 0;
BA_ "GenSigTimeoutTime_BCM" SG_ 158 PLGAlert_Req 0;
BA_ "GenSigTimeoutTime_AGSM" SG_ 158 PLGAlert_Req 0;
BA_ "GenSigTimeoutTime_ADCAM" SG_ 158 PLGAlert_Req 0;
BA_ "GenSigSendType" SG_ 158 PLGAlert_Req 1;
BA_ "GenSigStartValue" SG_ 158 PLGAlert_Req 1;
BA_ "GenSigTimeoutTime_SGW" SG_ 158 PLGAlert_Req 0;
BA_ "GenSigTimeoutTime_RFHM" SG_ 158 PLGAlert_Req 0;
BA_ "GenSigTimeoutTime_MPAD" SG_ 158 PLGAlert_Req 0;
BA_ "GenSigTimeoutTime_GNMM" SG_ 158 PLGAlert_Req 0;
BA_ "GenSigTimeoutTime_EVCU2" SG_ 158 PLGAlert_Req 0;
BA_ "GenSigTimeoutTime_ESL" SG_ 158 PLGAlert_Req 0;
BA_ "GenSigTimeoutTime_ECM" SG_ 158 PLGAlert_Req 0;
BA_ "GenSigTimeoutTime_DTCM" SG_ 158 PLGAlert_Req 0;
BA_ "GenSigTimeoutTime_SGW" SG_ 158 Proximity_WU_Req 0;
BA_ "GenSigTimeoutTime_RFHM" SG_ 158 Proximity_WU_Req 0;
BA_ "GenSigTimeoutTime_MPAD" SG_ 158 Proximity_WU_Req 0;
BA_ "GenSigTimeoutTime_GNMM" SG_ 158 Proximity_WU_Req 0;
BA_ "GenSigTimeoutTime_EVCU2" SG_ 158 Proximity_WU_Req 0;
BA_ "GenSigTimeoutTime_ESL" SG_ 158 Proximity_WU_Req 0;
BA_ "GenSigTimeoutTime_ECM" SG_ 158 Proximity_WU_Req 0;
BA_ "GenSigTimeoutTime_DTCM" SG_ 158 Proximity_WU_Req 0;
BA_ "GenSigTimeoutTime_DMSM" SG_ 158 Proximity_WU_Req 0;
BA_ "GenSigTimeoutTime_BSM" SG_ 158 Proximity_WU_Req 0;
BA_ "GenSigTimeoutTime_BCM" SG_ 158 Proximity_WU_Req 0;
BA_ "GenSigTimeoutTime_AGSM" SG_ 158 Proximity_WU_Req 0;
BA_ "GenSigTimeoutTime_ADCAM" SG_ 158 Proximity_WU_Req 0;
BA_ "GenSigSendType" SG_ 158 Proximity_WU_Req 3;
BA_ "GenSigTimeoutTime_BCM" SG_ 158 SpeedLockDoorEnable_Req 0;
BA_ "GenSigTimeoutTime_AGSM" SG_ 158 SpeedLockDoorEnable_Req 0;
BA_ "GenSigTimeoutTime_ADCAM" SG_ 158 SpeedLockDoorEnable_Req 0;
BA_ "GenSigSendType" SG_ 158 SpeedLockDoorEnable_Req 1;
BA_ "GenSigTimeoutTime_SGW" SG_ 158 Speed_Unit_Req 0;
BA_ "GenSigTimeoutTime_RFHM" SG_ 158 Speed_Unit_Req 0;
BA_ "GenSigTimeoutTime_MPAD" SG_ 158 Speed_Unit_Req 0;
BA_ "GenSigTimeoutTime_GNMM" SG_ 158 Speed_Unit_Req 0;
BA_ "GenSigTimeoutTime_EVCU2" SG_ 158 Speed_Unit_Req 0;
BA_ "GenSigTimeoutTime_ESL" SG_ 158 Speed_Unit_Req 0;
BA_ "GenSigTimeoutTime_ECM" SG_ 158 Speed_Unit_Req 0;
BA_ "GenSigTimeoutTime_DTCM" SG_ 158 Speed_Unit_Req 0;
BA_ "GenSigTimeoutTime_DMSM" SG_ 158 Speed_Unit_Req 0;
BA_ "GenSigTimeoutTime_BSM" SG_ 158 Speed_Unit_Req 0;
BA_ "GenSigTimeoutTime_BCM" SG_ 158 Speed_Unit_Req 0;
BA_ "GenSigTimeoutTime_AGSM" SG_ 158 Speed_Unit_Req 0;
BA_ "GenSigTimeoutTime_ADCAM" SG_ 158 Speed_Unit_Req 0;
BA_ "GenSigSendType" SG_ 158 Speed_Unit_Req 3;
BA_ "GenSigTimeoutTime_SGW" SG_ 158 SoundHornRemoteStart_Req 0;
BA_ "GenSigTimeoutTime_RFHM" SG_ 158 SoundHornRemoteStart_Req 0;
BA_ "GenSigTimeoutTime_MPAD" SG_ 158 SoundHornRemoteStart_Req 0;
BA_ "GenSigTimeoutTime_GNMM" SG_ 158 SoundHornRemoteStart_Req 0;
BA_ "GenSigTimeoutTime_EVCU2" SG_ 158 SoundHornRemoteStart_Req 0;
BA_ "GenSigTimeoutTime_ESL" SG_ 158 SoundHornRemoteStart_Req 0;
BA_ "GenSigTimeoutTime_ECM" SG_ 158 SoundHornRemoteStart_Req 0;
BA_ "GenSigTimeoutTime_DTCM" SG_ 158 SoundHornRemoteStart_Req 0;
BA_ "GenSigTimeoutTime_DMSM" SG_ 158 SoundHornRemoteStart_Req 0;
BA_ "GenSigTimeoutTime_BSM" SG_ 158 SoundHornRemoteStart_Req 0;
BA_ "GenSigTimeoutTime_BCM" SG_ 158 SoundHornRemoteStart_Req 0;
BA_ "GenSigTimeoutTime_AGSM" SG_ 158 SoundHornRemoteStart_Req 0;
BA_ "GenSigTimeoutTime_ADCAM" SG_ 158 SoundHornRemoteStart_Req 0;
BA_ "GenSigSendType" SG_ 158 SoundHornRemoteStart_Req 1;
BA_ "GenSigTimeoutTime_SGW" SG_ 158 RainSensorLevel_Req 0;
BA_ "GenSigTimeoutTime_RFHM" SG_ 158 RainSensorLevel_Req 0;
BA_ "GenSigTimeoutTime_MPAD" SG_ 158 RainSensorLevel_Req 0;
BA_ "GenSigTimeoutTime_GNMM" SG_ 158 RainSensorLevel_Req 0;
BA_ "GenSigTimeoutTime_EVCU2" SG_ 158 RainSensorLevel_Req 0;
BA_ "GenSigTimeoutTime_ESL" SG_ 158 RainSensorLevel_Req 0;
BA_ "GenSigTimeoutTime_ECM" SG_ 158 RainSensorLevel_Req 0;
BA_ "GenSigTimeoutTime_DTCM" SG_ 158 RainSensorLevel_Req 0;
BA_ "GenSigTimeoutTime_DMSM" SG_ 158 RainSensorLevel_Req 0;
BA_ "GenSigTimeoutTime_BSM" SG_ 158 RainSensorLevel_Req 0;
BA_ "GenSigTimeoutTime_BCM" SG_ 158 RainSensorLevel_Req 0;
BA_ "GenSigTimeoutTime_AGSM" SG_ 158 RainSensorLevel_Req 0;
BA_ "GenSigTimeoutTime_ADCAM" SG_ 158 RainSensorLevel_Req 0;
BA_ "GenSigSendType" SG_ 158 RainSensorLevel_Req 1;
BA_ "GenSigStartValue" SG_ 158 RainSensorLevel_Req 1;
BA_ "GenSigTimeoutTime_SGW" SG_ 158 Rdy_To_Drive_Req 0;
BA_ "GenSigTimeoutTime_RFHM" SG_ 158 Rdy_To_Drive_Req 0;
BA_ "GenSigTimeoutTime_MPAD" SG_ 158 Rdy_To_Drive_Req 0;
BA_ "GenSigTimeoutTime_GNMM" SG_ 158 Rdy_To_Drive_Req 0;
BA_ "GenSigTimeoutTime_EVCU2" SG_ 158 Rdy_To_Drive_Req 0;
BA_ "GenSigTimeoutTime_ESL" SG_ 158 Rdy_To_Drive_Req 0;
BA_ "GenSigTimeoutTime_ECM" SG_ 158 Rdy_To_Drive_Req 0;
BA_ "GenSigTimeoutTime_DTCM" SG_ 158 Rdy_To_Drive_Req 0;
BA_ "GenSigTimeoutTime_DMSM" SG_ 158 Rdy_To_Drive_Req 0;
BA_ "GenSigTimeoutTime_BSM" SG_ 158 Rdy_To_Drive_Req 0;
BA_ "GenSigTimeoutTime_BCM" SG_ 158 Rdy_To_Drive_Req 0;
BA_ "GenSigTimeoutTime_AGSM" SG_ 158 Rdy_To_Drive_Req 0;
BA_ "GenSigTimeoutTime_ADCAM" SG_ 158 Rdy_To_Drive_Req 0;
BA_ "GenSigSendType" SG_ 158 Rdy_To_Drive_Req 3;
BA_ "GenSigTimeoutTime_SGW" SG_ 158 Rear_Brk_Asst_Req 0;
BA_ "GenSigTimeoutTime_RFHM" SG_ 158 Rear_Brk_Asst_Req 0;
BA_ "GenSigTimeoutTime_MPAD" SG_ 158 Rear_Brk_Asst_Req 0;
BA_ "GenSigTimeoutTime_GNMM" SG_ 158 Rear_Brk_Asst_Req 0;
BA_ "GenSigTimeoutTime_EVCU2" SG_ 158 Rear_Brk_Asst_Req 0;
BA_ "GenSigTimeoutTime_ESL" SG_ 158 Rear_Brk_Asst_Req 0;
BA_ "GenSigTimeoutTime_ECM" SG_ 158 Rear_Brk_Asst_Req 0;
BA_ "GenSigTimeoutTime_DTCM" SG_ 158 Rear_Brk_Asst_Req 0;
BA_ "GenSigTimeoutTime_DMSM" SG_ 158 Rear_Brk_Asst_Req 0;
BA_ "GenSigTimeoutTime_BSM" SG_ 158 Rear_Brk_Asst_Req 0;
BA_ "GenSigTimeoutTime_BCM" SG_ 158 Rear_Brk_Asst_Req 0;
BA_ "GenSigTimeoutTime_AGSM" SG_ 158 Rear_Brk_Asst_Req 0;
BA_ "GenSigTimeoutTime_ADCAM" SG_ 158 Rear_Brk_Asst_Req 0;
BA_ "GenSigSendType" SG_ 158 Rear_Brk_Asst_Req 3;
BA_ "GenSigTimeoutTime_SGW" SG_ 158 RemoteDoorUnlock_Req 0;
BA_ "GenSigTimeoutTime_RFHM" SG_ 158 RemoteDoorUnlock_Req 0;
BA_ "GenSigTimeoutTime_MPAD" SG_ 158 RemoteDoorUnlock_Req 0;
BA_ "GenSigTimeoutTime_GNMM" SG_ 158 RemoteDoorUnlock_Req 0;
BA_ "GenSigTimeoutTime_EVCU2" SG_ 158 RemoteDoorUnlock_Req 0;
BA_ "GenSigTimeoutTime_ESL" SG_ 158 RemoteDoorUnlock_Req 0;
BA_ "GenSigTimeoutTime_ECM" SG_ 158 RemoteDoorUnlock_Req 0;
BA_ "GenSigTimeoutTime_DTCM" SG_ 158 RemoteDoorUnlock_Req 0;
BA_ "GenSigTimeoutTime_DMSM" SG_ 158 RemoteDoorUnlock_Req 0;
BA_ "GenSigTimeoutTime_BSM" SG_ 158 RemoteDoorUnlock_Req 0;
BA_ "GenSigTimeoutTime_BCM" SG_ 158 RemoteDoorUnlock_Req 0;
BA_ "GenSigTimeoutTime_AGSM" SG_ 158 RemoteDoorUnlock_Req 0;
BA_ "GenSigTimeoutTime_ADCAM" SG_ 158 RemoteDoorUnlock_Req 0;
BA_ "GenSigSendType" SG_ 158 RemoteDoorUnlock_Req 1;
BA_ "GenSigStartValue" SG_ 158 RemoteDoorUnlock_Req 1;
BA_ "GenSigTimeoutTime_SGW" SG_ 158 RemStNrmlStEnbl_Req 0;
BA_ "GenSigTimeoutTime_RFHM" SG_ 158 RemStNrmlStEnbl_Req 0;
BA_ "GenSigTimeoutTime_MPAD" SG_ 158 RemStNrmlStEnbl_Req 0;
BA_ "GenSigTimeoutTime_GNMM" SG_ 158 RemStNrmlStEnbl_Req 0;
BA_ "GenSigTimeoutTime_EVCU2" SG_ 158 RemStNrmlStEnbl_Req 0;
BA_ "GenSigTimeoutTime_ESL" SG_ 158 RemStNrmlStEnbl_Req 0;
BA_ "GenSigTimeoutTime_ECM" SG_ 158 RemStNrmlStEnbl_Req 0;
BA_ "GenSigTimeoutTime_DTCM" SG_ 158 RemStNrmlStEnbl_Req 0;
BA_ "GenSigTimeoutTime_DMSM" SG_ 158 RemStNrmlStEnbl_Req 0;
BA_ "GenSigTimeoutTime_BSM" SG_ 158 RemStNrmlStEnbl_Req 0;
BA_ "GenSigTimeoutTime_BCM" SG_ 158 RemStNrmlStEnbl_Req 0;
BA_ "GenSigTimeoutTime_AGSM" SG_ 158 RemStNrmlStEnbl_Req 0;
BA_ "GenSigTimeoutTime_ADCAM" SG_ 158 RemStNrmlStEnbl_Req 0;
BA_ "GenSigSendType" SG_ 158 RemStNrmlStEnbl_Req 1;
BA_ "GenSigStartValue" SG_ 158 RemStNrmlStEnbl_Req 2;
BA_ "GenSigTimeoutTime_SGW" SG_ 158 RKEMemoryLinkEnable_Req 0;
BA_ "GenSigTimeoutTime_RFHM" SG_ 158 RKEMemoryLinkEnable_Req 0;
BA_ "GenSigTimeoutTime_MPAD" SG_ 158 RKEMemoryLinkEnable_Req 0;
BA_ "GenSigTimeoutTime_GNMM" SG_ 158 RKEMemoryLinkEnable_Req 0;
BA_ "GenSigTimeoutTime_EVCU2" SG_ 158 RKEMemoryLinkEnable_Req 0;
BA_ "GenSigTimeoutTime_ESL" SG_ 158 RKEMemoryLinkEnable_Req 0;
BA_ "GenSigTimeoutTime_ECM" SG_ 158 RKEMemoryLinkEnable_Req 0;
BA_ "GenSigTimeoutTime_DTCM" SG_ 158 RKEMemoryLinkEnable_Req 0;
BA_ "GenSigTimeoutTime_DMSM" SG_ 158 RKEMemoryLinkEnable_Req 0;
BA_ "GenSigTimeoutTime_BSM" SG_ 158 RKEMemoryLinkEnable_Req 0;
BA_ "GenSigTimeoutTime_BCM" SG_ 158 RKEMemoryLinkEnable_Req 0;
BA_ "GenSigTimeoutTime_AGSM" SG_ 158 RKEMemoryLinkEnable_Req 0;
BA_ "GenSigTimeoutTime_ADCAM" SG_ 158 RKEMemoryLinkEnable_Req 0;
BA_ "GenSigSendType" SG_ 158 RKEMemoryLinkEnable_Req 1;
BA_ "GenSigStartValue" SG_ 158 RKEMemoryLinkEnable_Req 1;
BA_ "GenSigTimeoutTime_SGW" SG_ 158 Sdw_Req 0;
BA_ "GenSigTimeoutTime_RFHM" SG_ 158 Sdw_Req 0;
BA_ "GenSigTimeoutTime_MPAD" SG_ 158 Sdw_Req 0;
BA_ "GenSigTimeoutTime_GNMM" SG_ 158 Sdw_Req 0;
BA_ "GenSigTimeoutTime_EVCU2" SG_ 158 Sdw_Req 0;
BA_ "GenSigTimeoutTime_ESL" SG_ 158 Sdw_Req 0;
BA_ "GenSigTimeoutTime_ECM" SG_ 158 Sdw_Req 0;
BA_ "GenSigTimeoutTime_DTCM" SG_ 158 Sdw_Req 0;
BA_ "GenSigTimeoutTime_DMSM" SG_ 158 Sdw_Req 0;
BA_ "GenSigTimeoutTime_BSM" SG_ 158 Sdw_Req 0;
BA_ "GenSigTimeoutTime_BCM" SG_ 158 Sdw_Req 0;
BA_ "GenSigTimeoutTime_AGSM" SG_ 158 Sdw_Req 0;
BA_ "GenSigTimeoutTime_ADCAM" SG_ 158 Sdw_Req 0;
BA_ "GenSigSendType" SG_ 158 Sdw_Req 1;
BA_ "GenSigStartValue" SG_ 158 Sdw_Req 2;
BA_ "GenSigTimeoutTime_SGW" SG_ 158 SoundHornLock_Req 0;
BA_ "GenSigTimeoutTime_RFHM" SG_ 158 SoundHornLock_Req 0;
BA_ "GenSigTimeoutTime_MPAD" SG_ 158 SoundHornLock_Req 0;
BA_ "GenSigTimeoutTime_GNMM" SG_ 158 SoundHornLock_Req 0;
BA_ "GenSigTimeoutTime_EVCU2" SG_ 158 SoundHornLock_Req 0;
BA_ "GenSigTimeoutTime_ESL" SG_ 158 SoundHornLock_Req 0;
BA_ "GenSigTimeoutTime_ECM" SG_ 158 SoundHornLock_Req 0;
BA_ "GenSigTimeoutTime_DTCM" SG_ 158 SoundHornLock_Req 0;
BA_ "GenSigTimeoutTime_DMSM" SG_ 158 SoundHornLock_Req 0;
BA_ "GenSigTimeoutTime_BSM" SG_ 158 SoundHornLock_Req 0;
BA_ "GenSigTimeoutTime_BCM" SG_ 158 SoundHornLock_Req 0;
BA_ "GenSigTimeoutTime_AGSM" SG_ 158 SoundHornLock_Req 0;
BA_ "GenSigTimeoutTime_ADCAM" SG_ 158 SoundHornLock_Req 0;
BA_ "GenSigSendType" SG_ 158 SoundHornLock_Req 1;
BA_ "GenSigStartValue" SG_ 158 SoundHornLock_Req 1;
BA_ "GenSigTimeoutTime_SGW" SG_ 608 CRC_Telematic11 0;
BA_ "GenSigTimeoutTime_RFHM" SG_ 608 CRC_Telematic11 0;
BA_ "GenSigTimeoutTime_IPC" SG_ 608 CRC_Telematic11 0;
BA_ "GenSigTimeoutTime_GNMM" SG_ 608 CRC_Telematic11 0;
BA_ "GenSigTimeoutTime_EVCU2" SG_ 608 CRC_Telematic11 0;
BA_ "GenSigTimeoutTime_ESL" SG_ 608 CRC_Telematic11 0;
BA_ "GenSigTimeoutTime_ECM" SG_ 608 CRC_Telematic11 0;
BA_ "GenSigTimeoutTime_DTCM" SG_ 608 CRC_Telematic11 0;
BA_ "GenSigTimeoutTime_DMSM" SG_ 608 CRC_Telematic11 0;
BA_ "GenSigTimeoutTime_BSM" SG_ 608 CRC_Telematic11 0;
BA_ "GenSigTimeoutTime_BCM" SG_ 608 CRC_Telematic11 0;
BA_ "GenSigTimeoutTime_AGSM" SG_ 608 CRC_Telematic11 0;
BA_ "GenSigTimeoutTime_SGW" SG_ 158 PassiveEntry_Req 0;
BA_ "GenSigTimeoutTime_SGW" SG_ 608 MessageCounter_Telematic11 0;
BA_ "GenSigTimeoutTime_RFHM" SG_ 608 MessageCounter_Telematic11 0;
BA_ "GenSigTimeoutTime_IPC" SG_ 608 MessageCounter_Telematic11 0;
BA_ "GenSigTimeoutTime_GNMM" SG_ 608 MessageCounter_Telematic11 0;
BA_ "GenSigTimeoutTime_EVCU2" SG_ 608 MessageCounter_Telematic11 0;
BA_ "GenSigTimeoutTime_ESL" SG_ 608 MessageCounter_Telematic11 0;
BA_ "GenSigTimeoutTime_ECM" SG_ 608 MessageCounter_Telematic11 0;
BA_ "GenSigTimeoutTime_DTCM" SG_ 608 MessageCounter_Telematic11 0;
BA_ "GenSigTimeoutTime_DMSM" SG_ 608 MessageCounter_Telematic11 0;
BA_ "GenSigTimeoutTime_BSM" SG_ 608 MessageCounter_Telematic11 0;
BA_ "GenSigTimeoutTime_BCM" SG_ 608 MessageCounter_Telematic11 0;
BA_ "GenSigTimeoutTime_AGSM" SG_ 608 MessageCounter_Telematic11 0;
BA_ "GenSigTimeoutTime_SGW" SG_ 608 DrvSide 0;
BA_ "GenSigTimeoutTime_RFHM" SG_ 608 DrvSide 0;
BA_ "GenSigTimeoutTime_IPC" SG_ 608 DrvSide 0;
BA_ "GenSigTimeoutTime_GNMM" SG_ 608 DrvSide 0;
BA_ "GenSigTimeoutTime_EVCU2" SG_ 608 DrvSide 0;
BA_ "GenSigTimeoutTime_ESL" SG_ 608 DrvSide 0;
BA_ "GenSigTimeoutTime_ECM" SG_ 608 DrvSide 0;
BA_ "GenSigTimeoutTime_DTCM" SG_ 608 DrvSide 0;
BA_ "GenSigTimeoutTime_DMSM" SG_ 608 DrvSide 0;
BA_ "GenSigTimeoutTime_BSM" SG_ 608 DrvSide 0;
BA_ "GenSigTimeoutTime_BCM" SG_ 608 DrvSide 0;
BA_ "GenSigTimeoutTime_AGSM" SG_ 608 DrvSide 0;
BA_ "GenSigTimeoutTime_SGW" SG_ 608 Map_Data_Supplier 0;
BA_ "GenSigTimeoutTime_RFHM" SG_ 608 Map_Data_Supplier 0;
BA_ "GenSigTimeoutTime_MPAD" SG_ 608 Map_Data_Supplier 0;
BA_ "GenSigTimeoutTime_IPC" SG_ 608 Map_Data_Supplier 0;
BA_ "GenSigTimeoutTime_GNMM" SG_ 608 Map_Data_Supplier 0;
BA_ "GenSigTimeoutTime_EVCU2" SG_ 608 Map_Data_Supplier 0;
BA_ "GenSigTimeoutTime_ESL" SG_ 608 Map_Data_Supplier 0;
BA_ "GenSigTimeoutTime_ECM" SG_ 608 Map_Data_Supplier 0;
BA_ "GenSigTimeoutTime_DTCM" SG_ 608 Map_Data_Supplier 0;
BA_ "GenSigTimeoutTime_DMSM" SG_ 608 Map_Data_Supplier 0;
BA_ "GenSigTimeoutTime_BSM" SG_ 608 Map_Data_Supplier 0;
BA_ "GenSigTimeoutTime_BCM" SG_ 608 Map_Data_Supplier 0;
BA_ "GenSigTimeoutTime_AGSM" SG_ 608 Map_Data_Supplier 0;
BA_ "GenSigTimeoutTime_AGSM" SG_ 158 GreetingLightsEnable_Req 0;
BA_ "GenSigTimeoutTime_ADCAM" SG_ 158 GreetingLightsEnable_Req 0;
BA_ "GenSigSendType" SG_ 158 GreetingLightsEnable_Req 1;
BA_ "GenSigTimeoutTime_SGW" SG_ 158 Backup_Cam_Delay_Req 0;
BA_ "GenSigTimeoutTime_RFHM" SG_ 158 Backup_Cam_Delay_Req 0;
BA_ "GenSigTimeoutTime_MPAD" SG_ 158 Backup_Cam_Delay_Req 0;
BA_ "GenSigTimeoutTime_GNMM" SG_ 158 Backup_Cam_Delay_Req 0;
BA_ "GenSigTimeoutTime_EVCU2" SG_ 158 Backup_Cam_Delay_Req 0;
BA_ "GenSigTimeoutTime_ESL" SG_ 158 Backup_Cam_Delay_Req 0;
BA_ "GenSigTimeoutTime_ECM" SG_ 158 Backup_Cam_Delay_Req 0;
BA_ "GenSigTimeoutTime_DTCM" SG_ 158 Backup_Cam_Delay_Req 0;
BA_ "GenSigTimeoutTime_DMSM" SG_ 158 Backup_Cam_Delay_Req 0;
BA_ "GenSigTimeoutTime_BSM" SG_ 158 Backup_Cam_Delay_Req 0;
BA_ "GenSigTimeoutTime_BCM" SG_ 158 Backup_Cam_Delay_Req 0;
BA_ "GenSigTimeoutTime_AGSM" SG_ 158 Backup_Cam_Delay_Req 0;
BA_ "GenSigTimeoutTime_ADCAM" SG_ 158 Backup_Cam_Delay_Req 0;
BA_ "GenSigSendType" SG_ 158 Backup_Cam_Delay_Req 3;
BA_ "GenSigTimeoutTime_SGW" SG_ 158 AutoUnlockDoorExit_Req 0;
BA_ "GenSigTimeoutTime_RFHM" SG_ 158 AutoUnlockDoorExit_Req 0;
BA_ "GenSigTimeoutTime_MPAD" SG_ 158 AutoUnlockDoorExit_Req 0;
BA_ "GenSigTimeoutTime_GNMM" SG_ 158 AutoUnlockDoorExit_Req 0;
BA_ "GenSigTimeoutTime_EVCU2" SG_ 158 AutoUnlockDoorExit_Req 0;
BA_ "GenSigTimeoutTime_ESL" SG_ 158 AutoUnlockDoorExit_Req 0;
BA_ "GenSigTimeoutTime_ECM" SG_ 158 AutoUnlockDoorExit_Req 0;
BA_ "GenSigTimeoutTime_DTCM" SG_ 158 AutoUnlockDoorExit_Req 0;
BA_ "GenSigTimeoutTime_DMSM" SG_ 158 AutoUnlockDoorExit_Req 0;
BA_ "GenSigTimeoutTime_BSM" SG_ 158 AutoUnlockDoorExit_Req 0;
BA_ "GenSigTimeoutTime_BCM" SG_ 158 AutoUnlockDoorExit_Req 0;
BA_ "GenSigTimeoutTime_AGSM" SG_ 158 AutoUnlockDoorExit_Req 0;
BA_ "GenSigTimeoutTime_ADCAM" SG_ 158 AutoUnlockDoorExit_Req 0;
BA_ "GenSigSendType" SG_ 158 AutoUnlockDoorExit_Req 1;
BA_ "GenSigStartValue" SG_ 158 AutoUnlockDoorExit_Req 1;
BA_ "GenSigTimeoutTime_SGW" SG_ 158 FSFCWPlusSetting_Req 0;
BA_ "GenSigTimeoutTime_RFHM" SG_ 158 FSFCWPlusSetting_Req 0;
BA_ "GenSigTimeoutTime_GNMM" SG_ 158 FSFCWPlusSetting_Req 0;
BA_ "GenSigTimeoutTime_EVCU2" SG_ 158 FSFCWPlusSetting_Req 0;
BA_ "GenSigTimeoutTime_ESL" SG_ 158 FSFCWPlusSetting_Req 0;
BA_ "GenSigTimeoutTime_ECM" SG_ 158 FSFCWPlusSetting_Req 0;
BA_ "GenSigTimeoutTime_DTCM" SG_ 158 FSFCWPlusSetting_Req 0;
BA_ "GenSigTimeoutTime_DMSM" SG_ 158 FSFCWPlusSetting_Req 0;
BA_ "GenSigTimeoutTime_BSM" SG_ 158 FSFCWPlusSetting_Req 0;
BA_ "GenSigTimeoutTime_BCM" SG_ 158 FSFCWPlusSetting_Req 0;
BA_ "GenSigTimeoutTime_AGSM" SG_ 158 FSFCWPlusSetting_Req 0;
BA_ "GenSigSendType" SG_ 158 FSFCWPlusSetting_Req 1;
BA_ "GenSigStartValue" SG_ 158 FSFCWPlusSetting_Req 3;
BA_ "GenSigTimeoutTime_SGW" SG_ 158 AutoParkBrake_Req 0;
BA_ "GenSigTimeoutTime_RFHM" SG_ 158 AutoParkBrake_Req 0;
BA_ "GenSigTimeoutTime_MPAD" SG_ 158 AutoParkBrake_Req 0;
BA_ "GenSigTimeoutTime_GNMM" SG_ 158 AutoParkBrake_Req 0;
BA_ "GenSigTimeoutTime_EVCU2" SG_ 158 AutoParkBrake_Req 0;
BA_ "GenSigTimeoutTime_ESL" SG_ 158 AutoParkBrake_Req 0;
BA_ "GenSigTimeoutTime_ECM" SG_ 158 AutoParkBrake_Req 0;
BA_ "GenSigTimeoutTime_SGW" SG_ 158 Fwrd_Cam_Guidelines_Req 0;
BA_ "GenSigTimeoutTime_RFHM" SG_ 158 Fwrd_Cam_Guidelines_Req 0;
BA_ "GenSigTimeoutTime_MPAD" SG_ 158 Fwrd_Cam_Guidelines_Req 0;
BA_ "GenSigTimeoutTime_GNMM" SG_ 158 Fwrd_Cam_Guidelines_Req 0;
BA_ "GenSigTimeoutTime_EVCU2" SG_ 158 Fwrd_Cam_Guidelines_Req 0;
BA_ "GenSigTimeoutTime_ESL" SG_ 158 Fwrd_Cam_Guidelines_Req 0;
BA_ "GenSigTimeoutTime_ECM" SG_ 158 Fwrd_Cam_Guidelines_Req 0;
BA_ "GenSigTimeoutTime_DTCM" SG_ 158 Fwrd_Cam_Guidelines_Req 0;
BA_ "GenSigTimeoutTime_DMSM" SG_ 158 Fwrd_Cam_Guidelines_Req 0;
BA_ "GenSigTimeoutTime_BSM" SG_ 158 Fwrd_Cam_Guidelines_Req 0;
BA_ "GenSigTimeoutTime_BCM" SG_ 158 Fwrd_Cam_Guidelines_Req 0;
BA_ "GenSigTimeoutTime_AGSM" SG_ 158 Fwrd_Cam_Guidelines_Req 0;
BA_ "GenSigTimeoutTime_ADCAM" SG_ 158 Fwrd_Cam_Guidelines_Req 0;
BA_ "GenSigSendType" SG_ 158 Fwrd_Cam_Guidelines_Req 3;
BA_ "GenSigTimeoutTime_SGW" SG_ 158 FSFCWPlusActivationMode_Req 0;
BA_ "GenSigTimeoutTime_RFHM" SG_ 158 FSFCWPlusActivationMode_Req 0;
BA_ "GenSigTimeoutTime_MPAD" SG_ 158 FSFCWPlusActivationMode_Req 0;
BA_ "GenSigTimeoutTime_GNMM" SG_ 158 FSFCWPlusActivationMode_Req 0;
BA_ "GenSigTimeoutTime_EVCU2" SG_ 158 FSFCWPlusActivationMode_Req 0;
BA_ "GenSigTimeoutTime_ESL" SG_ 158 FSFCWPlusActivationMode_Req 0;
BA_ "GenSigTimeoutTime_ECM" SG_ 158 FSFCWPlusActivationMode_Req 0;
BA_ "GenSigTimeoutTime_DTCM" SG_ 158 FSFCWPlusActivationMode_Req 0;
BA_ "GenSigTimeoutTime_DMSM" SG_ 158 FSFCWPlusActivationMode_Req 0;
BA_ "GenSigTimeoutTime_BSM" SG_ 158 FSFCWPlusActivationMode_Req 0;
BA_ "GenSigTimeoutTime_BCM" SG_ 158 FSFCWPlusActivationMode_Req 0;
BA_ "GenSigTimeoutTime_AGSM" SG_ 158 FSFCWPlusActivationMode_Req 0;
BA_ "GenSigSendType" SG_ 158 FSFCWPlusActivationMode_Req 1;
BA_ "GenSigStartValue" SG_ 158 FSFCWPlusActivationMode_Req 1;
BA_ "GenSigTimeoutTime_SGW" SG_ 158 EPB_MaintenanceMode_Req 0;
BA_ "GenSigTimeoutTime_RFHM" SG_ 158 EPB_MaintenanceMode_Req 0;
BA_ "GenSigTimeoutTime_MPAD" SG_ 158 EPB_MaintenanceMode_Req 0;
BA_ "GenSigTimeoutTime_IPC" SG_ 158 EPB_MaintenanceMode_Req 0;
BA_ "GenSigTimeoutTime_GNMM" SG_ 158 EPB_MaintenanceMode_Req 0;
BA_ "GenSigTimeoutTime_EVCU2" SG_ 158 EPB_MaintenanceMode_Req 0;
BA_ "GenSigTimeoutTime_ESL" SG_ 158 EPB_MaintenanceMode_Req 0;
BA_ "GenSigTimeoutTime_ECM" SG_ 158 EPB_MaintenanceMode_Req 0;
BA_ "GenSigTimeoutTime_DTCM" SG_ 158 EPB_MaintenanceMode_Req 0;
BA_ "GenSigTimeoutTime_DMSM" SG_ 158 EPB_MaintenanceMode_Req 0;
BA_ "GenSigTimeoutTime_BCM" SG_ 158 EPB_MaintenanceMode_Req 0;
BA_ "GenSigTimeoutTime_AGSM" SG_ 158 EPB_MaintenanceMode_Req 0;
BA_ "GenSigTimeoutTime_ADCAM" SG_ 158 EPB_MaintenanceMode_Req 0;
BA_ "GenSigSendType" SG_ 158 EPB_MaintenanceMode_Req 1;
BA_ "GenSigTimeoutTime_SGW" SG_ 158 Eng_Off_Pwr_Delay_Req 0;
BA_ "GenSigTimeoutTime_RFHM" SG_ 158 Eng_Off_Pwr_Delay_Req 0;
BA_ "GenSigTimeoutTime_MPAD" SG_ 158 Eng_Off_Pwr_Delay_Req 0;
BA_ "GenSigTimeoutTime_GNMM" SG_ 158 Eng_Off_Pwr_Delay_Req 0;
BA_ "GenSigTimeoutTime_EVCU2" SG_ 158 Eng_Off_Pwr_Delay_Req 0;
BA_ "GenSigTimeoutTime_ESL" SG_ 158 Eng_Off_Pwr_Delay_Req 0;
BA_ "GenSigTimeoutTime_ECM" SG_ 158 Eng_Off_Pwr_Delay_Req 0;
BA_ "GenSigTimeoutTime_DTCM" SG_ 158 Eng_Off_Pwr_Delay_Req 0;
BA_ "GenSigTimeoutTime_DMSM" SG_ 158 Eng_Off_Pwr_Delay_Req 0;
BA_ "GenSigTimeoutTime_BSM" SG_ 158 Eng_Off_Pwr_Delay_Req 0;
BA_ "GenSigTimeoutTime_BCM" SG_ 158 Eng_Off_Pwr_Delay_Req 0;
BA_ "GenSigTimeoutTime_AGSM" SG_ 158 Eng_Off_Pwr_Delay_Req 0;
BA_ "GenSigTimeoutTime_ADCAM" SG_ 158 Eng_Off_Pwr_Delay_Req 0;
BA_ "GenSigSendType" SG_ 158 Eng_Off_Pwr_Delay_Req 3;
BA_ "GenSigTimeoutTime_SGW" SG_ 158 Easy_Exit_D_Req 0;
BA_ "GenSigTimeoutTime_RFHM" SG_ 158 Easy_Exit_D_Req 0;
BA_ "GenSigTimeoutTime_MPAD" SG_ 158 Easy_Exit_D_Req 0;
BA_ "GenSigTimeoutTime_GNMM" SG_ 158 Easy_Exit_D_Req 0;
BA_ "GenSigTimeoutTime_EVCU2" SG_ 158 Easy_Exit_D_Req 0;
BA_ "GenSigTimeoutTime_ESL" SG_ 158 Easy_Exit_D_Req 0;
BA_ "GenSigTimeoutTime_ECM" SG_ 158 Easy_Exit_D_Req 0;
BA_ "GenSigTimeoutTime_DTCM" SG_ 158 Easy_Exit_D_Req 0;
BA_ "GenSigTimeoutTime_DMSM" SG_ 158 Easy_Exit_D_Req 0;
BA_ "GenSigTimeoutTime_BSM" SG_ 158 Easy_Exit_D_Req 0;
BA_ "GenSigTimeoutTime_BCM" SG_ 158 Easy_Exit_D_Req 0;
BA_ "GenSigTimeoutTime_AGSM" SG_ 158 Easy_Exit_D_Req 0;
BA_ "GenSigTimeoutTime_ADCAM" SG_ 158 Easy_Exit_D_Req 0;
BA_ "GenSigSendType" SG_ 158 Easy_Exit_D_Req 3;
BA_ "GenSigTimeoutTime_SGW" SG_ 158 DynamicGrid_Req 0;
BA_ "GenSigTimeoutTime_RFHM" SG_ 158 DynamicGrid_Req 0;
BA_ "GenSigTimeoutTime_MPAD" SG_ 158 DynamicGrid_Req 0;
BA_ "GenSigTimeoutTime_GNMM" SG_ 158 DynamicGrid_Req 0;
BA_ "GenSigTimeoutTime_EVCU2" SG_ 158 DynamicGrid_Req 0;
BA_ "GenSigTimeoutTime_ESL" SG_ 158 DynamicGrid_Req 0;
BA_ "GenSigTimeoutTime_ECM" SG_ 158 DynamicGrid_Req 0;
BA_ "GenSigTimeoutTime_DTCM" SG_ 158 DynamicGrid_Req 0;
BA_ "GenSigTimeoutTime_DMSM" SG_ 158 DynamicGrid_Req 0;
BA_ "GenSigTimeoutTime_BSM" SG_ 158 DynamicGrid_Req 0;
BA_ "GenSigTimeoutTime_BCM" SG_ 158 DynamicGrid_Req 0;
BA_ "GenSigTimeoutTime_AGSM" SG_ 158 DynamicGrid_Req 0;
BA_ "GenSigTimeoutTime_ADCAM" SG_ 158 DynamicGrid_Req 0;
BA_ "GenSigSendType" SG_ 158 DynamicGrid_Req 1;
BA_ "GenSigStartValue" SG_ 158 DynamicGrid_Req 1;
BA_ "GenSigTimeoutTime_SGW" SG_ 158 Drowsy_Driver_Alert_Req 0;
BA_ "GenSigTimeoutTime_RFHM" SG_ 158 Drowsy_Driver_Alert_Req 0;
BA_ "GenSigTimeoutTime_MPAD" SG_ 158 Drowsy_Driver_Alert_Req 0;
BA_ "GenSigTimeoutTime_GNMM" SG_ 158 Drowsy_Driver_Alert_Req 0;
BA_ "GenSigTimeoutTime_EVCU2" SG_ 158 Drowsy_Driver_Alert_Req 0;
BA_ "GenSigTimeoutTime_ESL" SG_ 158 Drowsy_Driver_Alert_Req 0;
BA_ "GenSigTimeoutTime_ECM" SG_ 158 Drowsy_Driver_Alert_Req 0;
BA_ "GenSigTimeoutTime_DTCM" SG_ 158 Drowsy_Driver_Alert_Req 0;
BA_ "GenSigTimeoutTime_DMSM" SG_ 158 Drowsy_Driver_Alert_Req 0;
BA_ "GenSigTimeoutTime_BSM" SG_ 158 Drowsy_Driver_Alert_Req 0;
BA_ "GenSigTimeoutTime_BCM" SG_ 158 Drowsy_Driver_Alert_Req 0;
BA_ "GenSigTimeoutTime_AGSM" SG_ 158 Drowsy_Driver_Alert_Req 0;
BA_ "GenSigSendType" SG_ 158 Drowsy_Driver_Alert_Req 3;
BA_ "GenSigTimeoutTime_SGW" SG_ 158 DRLEnable_Req 0;
BA_ "GenSigTimeoutTime_RFHM" SG_ 158 DRLEnable_Req 0;
BA_ "GenSigTimeoutTime_MPAD" SG_ 158 DRLEnable_Req 0;
BA_ "GenSigTimeoutTime_GNMM" SG_ 158 DRLEnable_Req 0;
BA_ "GenSigTimeoutTime_EVCU2" SG_ 158 DRLEnable_Req 0;
BA_ "GenSigTimeoutTime_ESL" SG_ 158 DRLEnable_Req 0;
BA_ "GenSigTimeoutTime_ECM" SG_ 158 DRLEnable_Req 0;
BA_ "GenSigTimeoutTime_DTCM" SG_ 158 DRLEnable_Req 0;
BA_ "GenSigTimeoutTime_DMSM" SG_ 158 DRLEnable_Req 0;
BA_ "GenSigTimeoutTime_BSM" SG_ 158 DRLEnable_Req 0;
BA_ "GenSigTimeoutTime_BCM" SG_ 158 DRLEnable_Req 0;
BA_ "GenSigTimeoutTime_AGSM" SG_ 158 DRLEnable_Req 0;
BA_ "GenSigTimeoutTime_ADCAM" SG_ 158 DRLEnable_Req 0;
BA_ "GenSigSendType" SG_ 158 DRLEnable_Req 1;
BA_ "GenSigTimeoutTime_SGW" SG_ 158 Dist_Unit_Req 0;
BA_ "GenSigTimeoutTime_RFHM" SG_ 158 Dist_Unit_Req 0;
BA_ "GenSigTimeoutTime_MPAD" SG_ 158 Dist_Unit_Req 0;
BA_ "GenSigTimeoutTime_GNMM" SG_ 158 Dist_Unit_Req 0;
BA_ "GenSigTimeoutTime_EVCU2" SG_ 158 Dist_Unit_Req 0;
BA_ "GenSigTimeoutTime_ESL" SG_ 158 Dist_Unit_Req 0;
BA_ "GenSigTimeoutTime_ECM" SG_ 158 Dist_Unit_Req 0;
BA_ "GenSigTimeoutTime_DTCM" SG_ 158 Dist_Unit_Req 0;
BA_ "GenSigTimeoutTime_DMSM" SG_ 158 Dist_Unit_Req 0;
BA_ "GenSigTimeoutTime_BSM" SG_ 158 Dist_Unit_Req 0;
BA_ "GenSigTimeoutTime_BCM" SG_ 158 Dist_Unit_Req 0;
BA_ "GenSigTimeoutTime_AGSM" SG_ 158 Dist_Unit_Req 0;
BA_ "GenSigTimeoutTime_ADCAM" SG_ 158 Dist_Unit_Req 0;
BA_ "GenSigSendType" SG_ 158 Dist_Unit_Req 3;
BA_ "GenSigTimeoutTime_SGW" SG_ 158 CorneringEnable_Req 0;
BA_ "GenSigTimeoutTime_RFHM" SG_ 158 CorneringEnable_Req 0;
BA_ "GenSigTimeoutTime_MPAD" SG_ 158 CorneringEnable_Req 0;
BA_ "GenSigTimeoutTime_GNMM" SG_ 158 CorneringEnable_Req 0;
BA_ "GenSigTimeoutTime_EVCU2" SG_ 158 CorneringEnable_Req 0;
BA_ "GenSigTimeoutTime_ESL" SG_ 158 CorneringEnable_Req 0;
BA_ "GenSigTimeoutTime_ECM" SG_ 158 CorneringEnable_Req 0;
BA_ "GenSigTimeoutTime_DTCM" SG_ 158 CorneringEnable_Req 0;
BA_ "GenSigTimeoutTime_DMSM" SG_ 158 CorneringEnable_Req 0;
BA_ "GenSigTimeoutTime_BSM" SG_ 158 CorneringEnable_Req 0;
BA_ "GenSigTimeoutTime_BCM" SG_ 158 CorneringEnable_Req 0;
BA_ "GenSigTimeoutTime_AGSM" SG_ 158 CorneringEnable_Req 0;
BA_ "GenSigTimeoutTime_ADCAM" SG_ 158 CorneringEnable_Req 0;
BA_ "GenSigSendType" SG_ 158 CorneringEnable_Req 1;
BA_ "GenSigTimeoutTime_SGW" SG_ 158 Consum_Unit_Req 0;
BA_ "GenSigTimeoutTime_RFHM" SG_ 158 Consum_Unit_Req 0;
BA_ "GenSigTimeoutTime_MPAD" SG_ 158 Consum_Unit_Req 0;
BA_ "GenSigTimeoutTime_GNMM" SG_ 158 Consum_Unit_Req 0;
BA_ "GenSigTimeoutTime_EVCU2" SG_ 158 Consum_Unit_Req 0;
BA_ "GenSigTimeoutTime_ESL" SG_ 158 Consum_Unit_Req 0;
BA_ "GenSigTimeoutTime_ECM" SG_ 158 Consum_Unit_Req 0;
BA_ "GenSigTimeoutTime_DTCM" SG_ 158 Consum_Unit_Req 0;
BA_ "GenSigTimeoutTime_DMSM" SG_ 158 Consum_Unit_Req 0;
BA_ "GenSigTimeoutTime_BSM" SG_ 158 Consum_Unit_Req 0;
BA_ "GenSigTimeoutTime_BCM" SG_ 158 Consum_Unit_Req 0;
BA_ "GenSigTimeoutTime_AGSM" SG_ 158 Consum_Unit_Req 0;
BA_ "GenSigTimeoutTime_ADCAM" SG_ 158 Consum_Unit_Req 0;
BA_ "GenSigSendType" SG_ 158 Consum_Unit_Req 3;
BA_ "GenSigStartValue" SG_ 158 BSDEnable_Req 2;
BA_ "GenSigTimeoutTime_SGW" SG_ 158 BSDEnable_Req 0;
BA_ "GenSigTimeoutTime_RFHM" SG_ 158 BSDEnable_Req 0;
BA_ "GenSigTimeoutTime_MPAD" SG_ 158 BSDEnable_Req 0;
BA_ "GenSigTimeoutTime_GNMM" SG_ 158 BSDEnable_Req 0;
BA_ "GenSigTimeoutTime_EVCU2" SG_ 158 BSDEnable_Req 0;
BA_ "GenSigTimeoutTime_ESL" SG_ 158 BSDEnable_Req 0;
BA_ "GenSigTimeoutTime_ECM" SG_ 158 BSDEnable_Req 0;
BA_ "GenSigTimeoutTime_DTCM" SG_ 158 BSDEnable_Req 0;
BA_ "GenSigTimeoutTime_DMSM" SG_ 158 BSDEnable_Req 0;
BA_ "GenSigTimeoutTime_BSM" SG_ 158 BSDEnable_Req 0;
BA_ "GenSigTimeoutTime_BCM" SG_ 158 BSDEnable_Req 0;
BA_ "GenSigTimeoutTime_AGSM" SG_ 158 BSDEnable_Req 0;
BA_ "GenSigTimeoutTime_ADCAM" SG_ 158 BSDEnable_Req 0;
BA_ "GenSigSendType" SG_ 158 BSDEnable_Req 1;
BA_ "GenSigTimeoutTime_SGW" SG_ 158 FlashLightWLock_Req 0;
BA_ "GenSigTimeoutTime_RFHM" SG_ 158 FlashLightWLock_Req 0;
BA_ "GenSigTimeoutTime_MPAD" SG_ 158 FlashLightWLock_Req 0;
BA_ "GenSigTimeoutTime_GNMM" SG_ 158 FlashLightWLock_Req 0;
BA_ "GenSigTimeoutTime_EVCU2" SG_ 158 FlashLightWLock_Req 0;
BA_ "GenSigTimeoutTime_ESL" SG_ 158 FlashLightWLock_Req 0;
BA_ "GenSigTimeoutTime_ECM" SG_ 158 FlashLightWLock_Req 0;
BA_ "GenSigTimeoutTime_DTCM" SG_ 158 FlashLightWLock_Req 0;
BA_ "GenSigTimeoutTime_DMSM" SG_ 158 FlashLightWLock_Req 0;
BA_ "GenSigTimeoutTime_BSM" SG_ 158 FlashLightWLock_Req 0;
BA_ "GenSigTimeoutTime_BCM" SG_ 158 FlashLightWLock_Req 0;
BA_ "GenSigTimeoutTime_AGSM" SG_ 158 FlashLightWLock_Req 0;
BA_ "GenSigTimeoutTime_ADCAM" SG_ 158 FlashLightWLock_Req 0;
BA_ "GenSigSendType" SG_ 158 FlashLightWLock_Req 1;
BA_ "GenSigStartValue" SG_ 158 FlashLightWLock_Req 1;
BA_ "GenSigTimeoutTime_SGW" SG_ 158 Adaptive_Front_Lighting_Req 0;
BA_ "GenSigTimeoutTime_RFHM" SG_ 158 Adaptive_Front_Lighting_Req 0;
BA_ "GenSigTimeoutTime_MPAD" SG_ 158 Adaptive_Front_Lighting_Req 0;
BA_ "GenSigTimeoutTime_GNMM" SG_ 158 Adaptive_Front_Lighting_Req 0;
BA_ "GenSigTimeoutTime_EVCU2" SG_ 158 Adaptive_Front_Lighting_Req 0;
BA_ "GenSigTimeoutTime_ESL" SG_ 158 Adaptive_Front_Lighting_Req 0;
BA_ "GenSigTimeoutTime_ECM" SG_ 158 Adaptive_Front_Lighting_Req 0;
BA_ "GenSigTimeoutTime_DTCM" SG_ 158 Adaptive_Front_Lighting_Req 0;
BA_ "GenSigTimeoutTime_DMSM" SG_ 158 Adaptive_Front_Lighting_Req 0;
BA_ "GenSigTimeoutTime_BSM" SG_ 158 Adaptive_Front_Lighting_Req 0;
BA_ "GenSigTimeoutTime_BCM" SG_ 158 Adaptive_Front_Lighting_Req 0;
BA_ "GenSigTimeoutTime_AGSM" SG_ 158 Adaptive_Front_Lighting_Req 0;
BA_ "GenSigTimeoutTime_ADCAM" SG_ 158 Adaptive_Front_Lighting_Req 0;
BA_ "GenSigSendType" SG_ 158 Adaptive_Front_Lighting_Req 1;
BA_ "GenSigTimeoutTime_SGW" SG_ 158 AssistedLaneChange_Req 0;
BA_ "GenSigTimeoutTime_RFHM" SG_ 158 AssistedLaneChange_Req 0;
BA_ "GenSigTimeoutTime_MPAD" SG_ 158 AssistedLaneChange_Req 0;
BA_ "GenSigTimeoutTime_GNMM" SG_ 158 AssistedLaneChange_Req 0;
BA_ "GenSigTimeoutTime_EVCU2" SG_ 158 AssistedLaneChange_Req 0;
BA_ "GenSigTimeoutTime_ESL" SG_ 158 AssistedLaneChange_Req 0;
BA_ "GenSigTimeoutTime_ECM" SG_ 158 AssistedLaneChange_Req 0;
BA_ "GenSigTimeoutTime_DTCM" SG_ 158 AssistedLaneChange_Req 0;
BA_ "GenSigTimeoutTime_DMSM" SG_ 158 AssistedLaneChange_Req 0;
BA_ "GenSigTimeoutTime_BSM" SG_ 158 AssistedLaneChange_Req 0;
BA_ "GenSigTimeoutTime_BCM" SG_ 158 AssistedLaneChange_Req 0;
BA_ "GenSigTimeoutTime_AGSM" SG_ 158 AssistedLaneChange_Req 0;
BA_ "GenSigTimeoutTime_ADCAM" SG_ 158 AssistedLaneChange_Req 0;
BA_ "GenSigSendType" SG_ 158 AssistedLaneChange_Req 3;
BA_ "GenSigStartValue" SG_ 158 AssistedLaneChange_Req 1;
BA_ "GenSigTimeoutTime_SGW" SG_ 158 Active_Park_Mode_Req 0;
BA_ "GenSigTimeoutTime_RFHM" SG_ 158 Active_Park_Mode_Req 0;
BA_ "GenSigTimeoutTime_MPAD" SG_ 158 Active_Park_Mode_Req 0;
BA_ "GenSigTimeoutTime_GNMM" SG_ 158 Active_Park_Mode_Req 0;
BA_ "GenSigTimeoutTime_EVCU2" SG_ 158 Active_Park_Mode_Req 0;
BA_ "GenSigTimeoutTime_ESL" SG_ 158 Active_Park_Mode_Req 0;
BA_ "GenSigTimeoutTime_ECM" SG_ 158 Active_Park_Mode_Req 0;
BA_ "GenSigTimeoutTime_DTCM" SG_ 158 Active_Park_Mode_Req 0;
BA_ "GenSigTimeoutTime_DMSM" SG_ 158 Active_Park_Mode_Req 0;
BA_ "GenSigTimeoutTime_BSM" SG_ 158 Active_Park_Mode_Req 0;
BA_ "GenSigTimeoutTime_BCM" SG_ 158 Active_Park_Mode_Req 0;
BA_ "GenSigTimeoutTime_AGSM" SG_ 158 Active_Park_Mode_Req 0;
BA_ "GenSigTimeoutTime_ADCAM" SG_ 158 Active_Park_Mode_Req 0;
BA_ "GenSigSendType" SG_ 158 Active_Park_Mode_Req 3;
BA_ "GenSigTimeoutTime_SGW" SG_ 158 Active_Park_Prox_Chime_Req 0;
BA_ "GenSigTimeoutTime_RFHM" SG_ 158 Active_Park_Prox_Chime_Req 0;
BA_ "GenSigTimeoutTime_MPAD" SG_ 158 Active_Park_Prox_Chime_Req 0;
BA_ "GenSigTimeoutTime_GNMM" SG_ 158 Active_Park_Prox_Chime_Req 0;
BA_ "GenSigTimeoutTime_EVCU2" SG_ 158 Active_Park_Prox_Chime_Req 0;
BA_ "GenSigTimeoutTime_ESL" SG_ 158 Active_Park_Prox_Chime_Req 0;
BA_ "GenSigTimeoutTime_ECM" SG_ 158 Active_Park_Prox_Chime_Req 0;
BA_ "GenSigTimeoutTime_DTCM" SG_ 158 Active_Park_Prox_Chime_Req 0;
BA_ "GenSigTimeoutTime_DMSM" SG_ 158 Active_Park_Prox_Chime_Req 0;
BA_ "GenSigTimeoutTime_BSM" SG_ 158 Active_Park_Prox_Chime_Req 0;
BA_ "GenSigTimeoutTime_BCM" SG_ 158 Active_Park_Prox_Chime_Req 0;
BA_ "GenSigTimeoutTime_AGSM" SG_ 158 Active_Park_Prox_Chime_Req 0;
BA_ "GenSigTimeoutTime_ADCAM" SG_ 158 Active_Park_Prox_Chime_Req 0;
BA_ "GenSigSendType" SG_ 158 Active_Park_Prox_Chime_Req 3;
BA_ "GenSigTimeoutTime_SGW" SG_ 1429 U_CONN_REQ_BCM_FOA_ALERT_FB 0;
BA_ "GenSigTimeoutTime_RFHM" SG_ 1429 U_CONN_REQ_BCM_FOA_ALERT_FB 0;
BA_ "GenSigTimeoutTime_MPAD" SG_ 1429 U_CONN_REQ_BCM_FOA_ALERT_FB 0;
BA_ "GenSigTimeoutTime_IPC" SG_ 1429 U_CONN_REQ_BCM_FOA_ALERT_FB 0;
BA_ "GenSigTimeoutTime_GNMM" SG_ 1429 U_CONN_REQ_BCM_FOA_ALERT_FB 0;
BA_ "GenSigTimeoutTime_EVCU2" SG_ 1429 U_CONN_REQ_BCM_FOA_ALERT_FB 0;
BA_ "GenSigTimeoutTime_ESL" SG_ 1429 U_CONN_REQ_BCM_FOA_ALERT_FB 0;
BA_ "GenSigTimeoutTime_ECM" SG_ 1429 U_CONN_REQ_BCM_FOA_ALERT_FB 0;
BA_ "GenSigTimeoutTime_DTCM" SG_ 1429 U_CONN_REQ_BCM_FOA_ALERT_FB 0;
BA_ "GenSigTimeoutTime_DMSM" SG_ 1429 U_CONN_REQ_BCM_FOA_ALERT_FB 0;
BA_ "GenSigTimeoutTime_BSM" SG_ 1429 U_CONN_REQ_BCM_FOA_ALERT_FB 0;
BA_ "GenSigTimeoutTime_AGSM" SG_ 1429 U_CONN_REQ_BCM_FOA_ALERT_FB 0;
BA_ "GenSigTimeoutTime_ADCAM" SG_ 1429 U_CONN_REQ_BCM_FOA_ALERT_FB 0;
BA_ "GenSigSendType" SG_ 1429 U_CONN_REQ_BCM_FOA_ALERT_FB 3;
BA_ "GenSigTimeoutTime_SGW" SG_ 1429 Disarm_Mobile_App_Req 0;
BA_ "GenSigTimeoutTime_RFHM" SG_ 1429 Disarm_Mobile_App_Req 0;
BA_ "GenSigTimeoutTime_MPAD" SG_ 1429 Disarm_Mobile_App_Req 0;
BA_ "GenSigTimeoutTime_IPC" SG_ 1429 Disarm_Mobile_App_Req 0;
BA_ "GenSigTimeoutTime_GNMM" SG_ 1429 Disarm_Mobile_App_Req 0;
BA_ "GenSigTimeoutTime_EVCU2" SG_ 1429 Disarm_Mobile_App_Req 0;
BA_ "GenSigTimeoutTime_ESL" SG_ 1429 Disarm_Mobile_App_Req 0;
BA_ "GenSigTimeoutTime_ECM" SG_ 1429 Disarm_Mobile_App_Req 0;
BA_ "GenSigTimeoutTime_DTCM" SG_ 1429 Disarm_Mobile_App_Req 0;
BA_ "GenSigTimeoutTime_DMSM" SG_ 1429 Disarm_Mobile_App_Req 0;
BA_ "GenSigTimeoutTime_BSM" SG_ 1429 Disarm_Mobile_App_Req 0;
BA_ "GenSigTimeoutTime_AGSM" SG_ 1429 Disarm_Mobile_App_Req 0;
BA_ "GenSigTimeoutTime_ADCAM" SG_ 1429 Disarm_Mobile_App_Req 0;
BA_ "GenSigSendType" SG_ 1429 Disarm_Mobile_App_Req 3;
BA_ "GenSigTimeoutTime_RFHM" SG_ 608 NavDataAvailable_CS 0;
BA_ "GenSigTimeoutTime_IPC" SG_ 608 NavDataAvailable_CS 0;
BA_ "GenSigTimeoutTime_GNMM" SG_ 608 NavDataAvailable_CS 0;
BA_ "GenSigTimeoutTime_EVCU2" SG_ 608 NavDataAvailable_CS 0;
BA_ "GenSigTimeoutTime_ESL" SG_ 608 NavDataAvailable_CS 0;
BA_ "GenSigTimeoutTime_ECM" SG_ 608 NavDataAvailable_CS 0;
VAL_ 158 FlashLightWLock_Req 0 "Off" 1 "On";
VAL_ 158 Windows_With_Fob_Req 0 "Off" 1 "On";
VAL_ 158 TyrePress_Unit_Req 0 "KPa" 1 "psi" 2 "bar";
VAL_ 158 Traffic_Sign_Warn_Req 0 "Off" 1 "Visual" 2 "Visual_Chime";
VAL_ 158 Traffic_Sign_Info_Req 0 "Off" 1 "On";
VAL_ 158 Torque_Unit_Req 0 "Nm" 1 "lb_ft";
VAL_ 158 Tire_Fill_Alert_Req 0 "Off" 1 "On";
VAL_ 158 Tilt_Mirr_Rev_Req 0 "Off" 1 "On";
VAL_ 158 Temp_Unit_Req 0 "°C" 1 "°F";
VAL_ 158 SVC_Guidelines_Req 0 "Off" 1 "On";
VAL_ 158 SVC_Delay_Req 0 "Off" 1 "On";
VAL_ 158 Steer_Feel_Req 0 "Normal" 1 "Sport" 2 "Comfort";
VAL_ 158 SpeedLockDoorEnable_Req 0 "Not_Enable" 1 "Enable";
VAL_ 158 Speed_Unit_Req 0 "mph" 1 "kph";
VAL_ 158 SoundHornRemoteStart_Req 0 "On" 1 "Off";
VAL_ 158 SoundHornLock_Req 0 "Off" 1 "1st Press" 2 "2nd Press";
VAL_ 158 Sdw_Req 0 "Off" 1 "Sound" 2 "Sound_Display";
VAL_ 158 RKEMemoryLinkEnable_Req 0 "Off" 1 "On";
VAL_ 158 RemStNrmlStEnbl_Req 0 "Off" 1 "Remote_Start_Only" 2 "Remote_And_Normal_Start " 3 "Normal_Start_Only";
VAL_ 158 RemoteDoorUnlock_Req 0 "Driver" 1 "All";
VAL_ 158 Rear_Brk_Asst_Req 0 "Warn" 1 "Warn_Braking";
VAL_ 158 Rdy_To_Drive_Req 0 "Off" 1 "On";
VAL_ 158 RainSensorLevel_Req 0 "Not_Enable" 1 "Enable";
VAL_ 158 Proximity_WU_Req 0 "Off" 1 "On";
VAL_ 158 PLGAlert_Req 0 "Off" 1 "On";
VAL_ 158 PhoneRepetition_Req 0 "On" 1 "Off";
VAL_ 158 Ped_EM_Brk_Warn_Act_Req 0 "Off" 1 "On";
VAL_ 158 PassiveEntry_Req 0 "On" 1 "Off";
VAL_ 158 PamChimeVolumeRear_Req 0 "Low" 1 "Medium" 2 "High";
VAL_ 158 PamChimeVolumeFront_Req 0 "Low" 1 "Medium" 2 "High";
VAL_ 158 Night_Vision_Req 0 "Off" 1 "On";
VAL_ 158 New_Spd_Zone_Ind_Req 0 "Off" 1 "Visual" 2 "Chime" 3 "Visual_Chime";
VAL_ 158 NavigationRepetition_Req 0 "On" 1 "Off";
VAL_ 158 LDW_Sensibility_Req 0 "Early" 1 "Med" 2 "Late";
VAL_ 158 LDW_Intensity_Req 0 "Low" 1 "Med" 2 "High";
VAL_ 158 LanguageSelection_Req 0 "Italian" 1 "Deutsch" 2 "English" 3 "Espanol" 4 "Francais" 5 "Portugues" 6 "Polish" 7 "Dutch" 8 "Brazilian" 9 "Turkish" 10 "Mexican" 11 "English_US" 12 "Canadian" 13 "Russian" 14 "Chinese" 15 "Japanese" 16 "Korean" 17 "Arabic" 18 "Czech" 19 "Slovakian" 20 "Hungarian" 21 "Hindi";
VAL_ 158 Intelligent_Speed_Req 0 "Off" 1 "On";
VAL_ 158 Illuminated_Approach_Req 0 "Zero" 1 "Thirty" 2 "Sixty" 3 "Ninety";
VAL_ 158 HP_Unit_Req 0 "HP" 1 "kW" 2 "PS";
VAL_ 158 HourMode_Req 0 "0_24_h" 1 "0_12_h";
VAL_ 158 Hill_Start_Assist_Req 0 "Off" 1 "On";
VAL_ 158 HeadLightWipers_Req 0 "Off" 1 "On";
VAL_ 158 HeadlightsOffDelay_Req 0 "0sec" 1 "30sec" 2 "60sec" 3 "90sec";
VAL_ 158 Handsfree_Liftgate_Req 0 "Off" 1 "On";
VAL_ 158 GreetingLightsEnable_Req 0 "True" 1 "False";
VAL_ 158 Fwrd_Cam_Guidelines_Req 0 "Off" 1 "On";
VAL_ 158 FSFCWPlusSetting_Req 0 "Off" 1 "Audio" 2 "Brake" 3 "Audio_Brake" 4 "Not_Request";
VAL_ 158 FSFCWPlusActivationMode_Req 0 "Near" 1 "Med" 2 "Far";
VAL_ 158 EPB_MaintenanceMode_Req 0 "Off" 1 "On";
VAL_ 158 Eng_Off_Pwr_Delay_Req 0 "Zero" 1 "Fourty_Five_Sec" 2 "Five_Min" 3 "Ten_Min";
VAL_ 158 Easy_Exit_D_Req 0 "Off" 1 "On";
VAL_ 158 DynamicGrid_Req 0 "Dynamic Gridlines OFF" 1 "Dynamic Gridlines ON";
VAL_ 158 Drowsy_Driver_Alert_Req 0 "Off" 1 "On";
VAL_ 158 DRLEnable_Req 0 "True" 1 "False";
VAL_ 158 Dist_Unit_Req 0 "km" 1 "miles";
VAL_ 158 CorneringEnable_Req 0 "True" 1 "False";
VAL_ 158 Consum_Unit_Req 0 "Km_Per_Litre" 1 "Litres_Per_100Km" 2 "Miles_Per_Gallon_UK" 3 "Miles_Per_Gallon_US" 4 "km/kWh" 5 "kWh/100km" 6 "mi/kWh" 7 "kWh/mi";
VAL_ 158 BSDEnable_Req 0 "Not_Enable" 1 "Enable_LED" 2 "Enable_ LED_Chime";
VAL_ 158 Backup_Cam_Delay_Req 0 "Off" 1 "On";
VAL_ 158 AutoUnlockDoorExit_Req 0 "Not_Enable" 1 "Enable";
VAL_ 158 AutoParkBrake_Req 0 "On" 1 "Off";
VAL_ 158 AutoHighBeamEnable_Req 0 "Not_Enable" 1 "Enable";
VAL_ 158 Auto_Fold_Mirr_Req 0 "Off" 1 "On";
VAL_ 158 Act_Lane_Mgt_Strength_Req 0 "Low" 1 "Medium" 2 "High";
VAL_ 158 Act_Lane_Mgt_Req 0 "Vib_Only" 1 "Steer_Asst_Only" 2 "Vib_Steer_Asst";
VAL_ 154 Text_Type_Aud_Ph 0 "No_Text" 1 "First_Line_Audio_Info" 2 "Second_Line_Audio_Info" 3 "Third_Line_Audio_Info" 4 "Fourth_Line_Audio_Info" 7 "Incoming_Call" 8 "Call_Active_OR_Calling" 9 "Phone_Name" 10 "Contact_Name_OR_Phone_Number" 11 "Second_Phone_Incoming_Call" 12 "Wechat_incoming_call" 13 "Wechat_call_active" 14 "Wechat_calling" 255 "SNA";
VAL_ 150 Text_Type_NavTbT 0 "No_Text" 1 "Nav_Turn_By_Turn_Info" 2 "Current_Road" 4 "Lane_Guidance_Info" 15 "SNA";
VAL_ 150 FirstFrame_NavTbT 0 "Not_First_Frame" 1 "First_Frame";
VAL_ 1466 Right_Cluster_Button_function 0 "Blank" 1 "Previous" 2 "Next" 3 "Pause/Play" 4 "Tune -" 5 "Tune +" 6 "Mute" 7 "Tag Song" 8 "Tag Artist" 9 "Unmute" 10 "Transfer Call to Device" 11 "Preset -" 12 "Preset +" 13 "Seek Up" 14 "Seek Down" 15 "Next Mode" 16 "Volume -" 17 "Volume +" 31 "SNA";
VAL_ 1466 Left_Cluster_Button_function 0 "Blank" 1 "Previous" 2 "Next" 3 "Pause/Play" 4 "Tune -" 5 "Tune +" 6 "Mute" 7 "Tag Song" 8 "Tag Artist" 9 "Unmute" 10 "Transfer Call to Device" 11 "Preset -" 12 "Preset +" 13 "Seek Up" 14 "Seek Down" 15 "Next Mode" 16 "Volume -" 17 "Volume +" 31 "SNA";
VAL_ 1466 ETM_HUD_Layout 0 "Default" 1 "Layout 1 Selected" 2 "Layout 2 Selected" 3 "Layout 3 Selected" 4 "Layout 4 Selected" 5 "Not Utilized " 6 "Not Utilized" 7 "SNA";
VAL_ 1466 ETM_HUD_CustomSetting 0 "Default" 1 "ETM Settings Being Active work by User" 2 "ETM Settings Saved by Cutomer" 3 "ETM Settings Cancelled by User";
VAL_ 1466 Center_Cluster_Button_function 0 "Blank" 1 "Previous" 2 "Next" 3 "Pause/Play" 4 "Tune -" 5 "Tune +" 6 "Mute" 7 "Tag Song" 8 "Tag Artist" 9 "Unmute" 10 "Transfer Call to Device" 11 "Preset -" 12 "Preset +" 13 "Seek Up" 14 "Seek Down" 15 "Next Mode" 16 "Volume -" 17 "Volume +" 31 "SNA";
VAL_ 1465 Radio_Delete_Request 0 "No_Action" 1 "Delete_Profile_1" 2 "Delete_Profile_2" 3 "Delete_Profile_3" 4 "Delete_Profile_4" 5 "Delete_Profile_5" 6 "Delete_All" 7 "SNA";
VAL_ 1465 ETM_HUD_Zone5 0 "Blank Zone" 1 "Speedometer" 2 "Speed Limit Sign" 3 "Turn By Turn" 4 "Gear Display" 5 "ACC/Cruise Control" 6 "Phone" 7 "SNA";
VAL_ 1465 ETM_HUD_Zone4 0 "Blank Zone" 1 "Speedometer" 2 "Speed Limit Sign" 3 "Turn By Turn" 4 "Gear Display" 5 "ACC/Cruise Control" 6 "Phone" 7 "SNA";
VAL_ 1465 ETM_HUD_Zone3 0 "Blank Zone" 1 "Speedometer" 2 "Speed Limit Sign" 3 "Turn By Turn" 4 "Gear Display" 5 "ACC/Cruise Control" 6 "Phone" 7 "SNA";
VAL_ 1465 ETM_HUD_Zone2 0 "Blank Zone" 1 "Speedometer" 2 "Speed Limit Sign" 3 "Turn By Turn" 4 "Gear Display" 5 "ACC/Cruise Control" 6 "Phone" 7 "SNA";
VAL_ 1465 ETM_HUD_Zone1 0 "Blank Zone" 1 "Speedometer" 2 "Speed Limit Sign" 3 "Turn By Turn" 4 "Gear Display" 5 "ACC/Cruise Control" 6 "Phone" 7 "SNA";
VAL_ 1465 ClusterAudiomode 0 "AM" 1 "FM" 2 "Apple_CarPlay" 3 "Android_Auto" 4 "CD" 5 "HDD" 6 "AUX" 7 "SD_Card" 8 "Baidu_Car_Life" 9 "SXM" 10 "Not_Used1" 11 "RSE_Listen_In_DVD" 12 "USB3" 13 "RSE1_AUX" 14 "RSE1_HDMI" 15 "RSE_USB" 16 "Alexa" 18 "DAB/DMB" 19 "USB1" 20 "VES_Rear_Source" 21 "RSE2_AUX" 22 "RSE_HDMI" 23 "Bluetooth" 24 "DTV" 25 "USB2" 26 "APPS" 27 "Audio_Muted" 28 "Not_Used2" 29 "Power_Off" 30 "Anti-Theft_Lock" 127 "SNA";
VAL_ 608 SpdUnits 0 "km_h" 1 "mph";
VAL_ 608 Map_Data_Supplier 0 "Unknown" 1 "NAVTEQ" 2 "TomTom" 3 "Zenrin" 4 "IPC" 5 "NavInfo" 6 "Other" 7 "NA";
VAL_ 608 DrvSide 0 "Left" 1 "Right";
VAL_ 1429 SOSCallStatus 0 "No_Indication" 1 "Sos_Battery_Fail" 2 "Sos_Fail" 3 "Sos_Call_Ended" 4 "Sos_Call_Establish" 5 "Starting_SOS_Fail" 6 "Incoming_SOS_Call" 7 "Starting_SOS_1_Phase" 8 "Starting_SOS_2_Phase" 9 "Starting_SOS_Auto";
VAL_ 1465 Radio_Profile_Request 0 "No_Action" 1 "Profile_1" 2 "Profile_2" 3 "Profile_3" 4 "Profile_4" 5 "Profile_5" 6 "Profile_6" 7 "SNA";
VAL_ 1466 HUtoIPC_NAV_Sts 0 "Active" 1 "Not_Active" 2 "Map_Not_Available" 3 "Initialization" 4 "AppleCarPlay_projection_Active" 5 "AndroidAuto_projection_Active" 6 "BaiduCarLife_projection_Active" 7 "SNA";
VAL_ 608 PathIdx_CS 0 "Map_data_not_valid_1" 1 "Map_data_not_valid_2" 2 "Map_data_not_valid_3" 3 "Map_data_not_valid_4" 4 "Map_data_valid" 5 "Map_data_not_valid_5" 6 "Map_data_not_valid_6" 7 "Map_data_not_valid_7" 8 "Map_data_not_valid_8" 9 "Map_data_not_valid_9" 10 "Map_data_not_valid_10" 11 "Map_data_not_valid_11" 12 "Map_data_not_valid_12" 13 "Map_data_not_valid_13" 14 "Map_data_not_valid_14" 15 "Map_data_not_valid_15" 16 "Map_data_not_valid_16" 17 "Map_data_not_valid_17" 18 "Map_data_not_valid_18" 19 "Map_data_not_valid_19" 20 "Map_data_not_valid_20" 21 "Map_data_not_valid_21" 22 "Map_data_not_valid_22" 23 "Map_data_not_valid_23" 24 "Map_data_not_valid_24" 25 "Map_data_not_valid_25" 26 "Map_data_not_valid_26" 27 "Map_data_not_valid_27" 28 "Map_data_not_valid_28" 29 "Map_data_not_valid_29" 30 "Map_data_not_valid_30" 31 "Map_data_not_valid_31" 32 "Map_data_not_valid_32" 33 "Map_data_not_valid_33" 34 "Map_data_not_valid_34" 35 "Map_data_not_valid_35" 36 "Map_data_not_valid_36" 37 "Map_data_not_valid_37" 38 "Map_data_not_valid_38" 39 "Map_data_not_valid_39" 40 "Map_data_not_valid_40" 41 "Map_data_not_valid_41" 42 "Map_data_not_valid_42" 43 "Map_data_not_valid_43" 44 "Map_data_not_valid_44" 45 "Map_data_not_valid_45" 46 "Map_data_not_valid_46" 47 "Map_data_not_valid_47" 48 "Map_data_not_valid_48" 49 "Map_data_not_valid_49" 50 "Map_data_not_valid_50" 51 "Map_data_not_valid_51" 52 "Map_data_not_valid_52" 53 "Map_data_not_valid_53" 54 "Map_data_not_valid_54" 55 "Map_data_not_valid_55" 56 "Map_data_not_valid_56" 57 "Map_data_not_valid_57" 58 "Map_data_not_valid_58" 59 "Map_data_not_valid_59" 60 "Map_data_not_valid_60" 61 "Map_data_not_valid_61" 62 "Map_data_not_valid_62" 63 "Map_data_not_valid_63";
VAL_ 608 NUM_OF_LANES_DRV_DIR_CS 0 "Wrong_Direction" 1 "Nmbr_Lanes_1" 2 "Nmbr_Lanes_2" 3 "Nmbr_Lanes_3" 4 "Nmbr_Lanes_4" 5 "Nmbr_Lanes_5" 6 "Nmbr_Lanes_6_or_more" 7 "NA";
VAL_ 608 NavDataAvailable_CS 0 "Valid_Data_Not_Available" 1 "Valid_Data_Available";
VAL_ 608 FuncRoadClass_CS 0 "Unknown" 1 "Priority_1" 2 "Priority_2" 3 "Priority_3" 4 "Priority_4" 5 "Priority_5" 6 "Priority_6" 7 "NA";
VAL_ 608 FormOfWay_CS 0 "TYPE_0" 1 "TYPE_1" 2 "TYPE_2" 3 "TYPE_3" 4 "TYPE_4" 5 "TYPE_5" 6 "TYPE_6" 7 "TYPE_7" 8 "TYPE_8" 9 "TYPE_9" 10 "TYPE_10" 11 "TYPE_11" 12 "TYPE_12" 13 "TYPE_13" 14 "TYPE_14" 15 "SNA";
VAL_ 608 EffSpdLmtType_CS 0 "Implicit" 1 "Explicit_On_Traffic_Sign" 2 "Explicit_Night" 3 "Explicit_Day" 4 "Explicit_Time_of_day" 5 "Explicit_Rain" 6 "Explicit_Snow" 7 "Unknown";
VAL_ 608 EffSpdLmt_NS 0 "Unknown" 1 "Less_Equal_5kmh" 2 "7_kmh_mph" 3 "10_kmh_mph" 4 "15_kmh_mph" 5 "20_kmh_mph" 6 "25_kmh_mph" 7 "30_kmh_mph" 8 "35_kmh_mph" 9 "40_kmh_mph" 10 "45_kmh_mph" 11 "50_kmh_mph" 12 "55_kmh_mph" 13 "60_kmh_mph" 14 "65_kmh_mph" 15 "70_kmh_mph" 16 "75_kmh_mph" 17 "80_kmh_mph" 18 "85_kmh_mph" 19 "90_kmh_mph" 20 "95_kmh_mph" 21 "100_kmh_mph" 22 "105_kmh_mph" 23 "110_kmh_mph" 24 "115_kmh_mph" 25 "120_kmh_mph" 26 "130_kmh_mph" 27 "140_kmh_mph" 28 "150_kmh_mph" 29 "160_kmh_mph" 30 "Unlimited" 31 "Invalid";
VAL_ 608 EffSpdLmt_CS 0 "Unknown" 1 "Less_Equal_5kmh" 2 "7_kmh_mph" 3 "10_kmh_mph" 4 "15_kmh_mph" 5 "20_kmh_mph" 6 "25_kmh_mph" 7 "30_kmh_mph" 8 "35_kmh_mph" 9 "40_kmh_mph" 10 "45_kmh_mph" 11 "50_kmh_mph" 12 "55_kmh_mph" 13 "60_kmh_mph" 14 "65_kmh_mph" 15 "70_kmh_mph" 16 "75_kmh_mph" 17 "80_kmh_mph" 18 "85_kmh_mph" 19 "90_kmh_mph" 20 "95_kmh_mph" 21 "100_kmh_mph" 22 "105_kmh_mph" 23 "110_kmh_mph" 24 "115_kmh_mph" 25 "120_kmh_mph" 26 "130_kmh_mph" 27 "140_kmh_mph" 28 "150_kmh_mph" 29 "160_kmh_mph" 30 "Unlimited" 31 "Invalid";
VAL_ 608 Divided_Road_CS 0 "Sgmnt_Not_Dvded_Rd_or_Dual_crrig" 1 "Sgmnt_Prt_Dvded_Rd_or_Dual_crrig" 2 "Unknown" 3 "NA";
VAL_ 608 BuiltUpArea_CS 0 "No_built_up_area" 1 "Built_up_area" 2 "Unknown" 3 "NA";
VAL_ 612 WprWashSw_Psd 0 "NPSD" 1 "MIST" 2 "WASH";
VAL_ 158 Active_Park_Prox_Chime_Req 0 "Off" 1 "On";
VAL_ 158 Active_Park_Mode_Req 0 "Full_Auto" 1 "Steering_Only";
VAL_ 158 StaticGrid_Req 0 "Static Gridlines OFF" 1 "Static Gridlines ON";
VAL_ 158 PwrLevReq 0 "Level1" 1 "Level2" 2 "Level3" 3 "Level4" 4 "Level5";
VAL_ 158 Adaptive_Front_Lighting_Req 0 "Disable" 1 "Enable";
VAL_ 1466 ChargeNow 0 "No_Charge" 1 "Charge_Now";
VAL_ 255 Veh_StandStill_Req_OPD 0 "Not_Active" 1 "Active" 3 "SNA";
VAL_ 255 Front_Axle_Target_Torque 65535 "SNA";
VAL_ 255 Rear_Axle_Target_Torque 65535 "SNA";
VAL_ 158 Spaak_Req 0 "Off" 1 "On";
VAL_ 158 FOA_Alert_Type_Req 0 "Off" 1 "Cluster_Warning" 2 "Cluster_SMS_Warning";
VAL_ 1429 U_CONN_REQ_BCM_FOA_ALERT_FB 0 "Not_Active" 1 "Active";
VAL_ 1429 Disarm_Mobile_App_Req 0 "Not_Active" 1 "Active";
VAL_ 158 Trailer_detection_blind_spot_Req 0 "Auto" 1 "Max";
VAL_ 158 SOC_Max_Lev_Req 0 "Level1" 1 "Level2";
VAL_ 255 SSC_TrqEnblRq_Allowed 0 "FALSE" 1 "TRUE";
VAL_ 255 PPPA_TrqEnblRq_Allowed 0 "FALSE" 1 "TRUE";
VAL_ 255 ESC_TrqEnblRq_Allowed 0 "FALSE" 1 "TRUE";
VAL_ 255 Accel_Pedal_Override 0 "FALSE" 1 "TRUE";
VAL_ 255 ACC_NCC_TrqEnblRq_Allowed 0 "FALSE" 1 "TRUE";
VAL_ 255 Total_AxleTorque_Static 65535 "SNA";
VAL_ 255 RRCC_TrqEnblRq_Allowed 0 "FALSE" 1 "TRUE";
VAL_ 255 Rear_AxleTorque_Static 65535 "SNA";
VAL_ 255 Front_AxleTorque_Static 65535 "SNA";
VAL_ 158 SpeedLimitAdjust_Req 0 "Off" 1 "Manual" 2 "Automatic";
VAL_ 158 AssistedLaneChange_Req 0 "Off" 1 "Driver_Initiated" 2 "System_Driver_Initiated" 3 "Not_Used";
SIG_GROUP_ 255 PT_TORQUE_FD_1_Pkt 1 : MessageCounter_PT_TORQUE_FD_1 CRC_PT_TORQUE_FD_1 SSC_TrqEnblRq_Allowed PPPA_TrqEnblRq_Allowed ESC_TrqEnblRq_Allowed Accel_Pedal_Override ACC_NCC_TrqEnblRq_Allowed Total_AxleTorque_Static RRCC_TrqEnblRq_Allowed Rear_AxleTorque_Static Front_AxleTorque_Static Veh_StandStill_Req_OPD Front_Axle_Target_Torque Rear_Axle_Target_Torque;

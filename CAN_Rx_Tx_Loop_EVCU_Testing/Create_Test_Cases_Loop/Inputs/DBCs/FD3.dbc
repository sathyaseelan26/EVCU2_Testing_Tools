VERSION ""

NS_ :

BS_:

BU_: SGW RFHM MPAD IPC GNMM EVCU2 ESL ECM DTCM DMSM BSM BCM AGSM ADCAM

BO_ 2654339184 PDC_INFO_FD_SGW: 64 SGW
 SG_ GenericFailSts_FD11_SGW : 269|1@0+ (1,0) [0|1] "" Vector__XXX
 SG_ GenericFailSts_FD08_SGW : 357|1@0+ (1,0) [0|1] "" Vector__XXX
 SG_ GenericFailSts_FD03_SGW : 181|1@0+ (1,0) [0|1] "" BCM
 SG_ GenericFailSts_FD02_SGW : 93|1@0+ (1,0) [0|1] "" Vector__XXX
 SG_ GenericFailSts_FD01_SGW : 5|1@0+ (1,0) [0|1] "" Vector__XXX
 SG_ EOL_FD11_SGW : 271|1@0+ (1,0) [0|1] "-"  Vector__XXX
 SG_ EOL_FD08_SGW : 359|1@0+ (1,0) [0|1] "-"  Vector__XXX
 SG_ EOL_FD03_SGW : 183|1@0+ (1,0) [0|1] "-"  BCM
 SG_ EOL_FD02_SGW : 95|1@0+ (1,0) [0|1] "-"  Vector__XXX
 SG_ EOL_FD01_SGW : 7|1@0+ (1,0) [0|1] "-"  Vector__XXX
 SG_ CurrentFailSts_FD11_SGW : 270|1@0+ (1,0) [0|1] "" Vector__XXX
 SG_ CurrentFailSts_FD08_SGW : 358|1@0+ (1,0) [0|1] "" Vector__XXX
 SG_ CurrentFailSts_FD03_SGW : 182|1@0+ (1,0) [0|1] "" BCM
 SG_ CurrentFailSts_FD02_SGW : 94|1@0+ (1,0) [0|1] "" Vector__XXX
 SG_ CurrentFailSts_FD01_SGW : 6|1@0+ (1,0) [0|1] "" Vector__XXX
 SG_ WakeupSource_FD11_SGW : 287|8@0+ (1,0) [0|255] "" Vector__XXX
 SG_ WakeupSource_FD08_SGW : 375|8@0+ (1,0) [0|255] "" Vector__XXX
 SG_ WakeupSource_FD03_SGW : 199|8@0+ (1,0) [0|255] "" Vector__XXX
 SG_ WakeupSource_FD02_SGW : 111|8@0+ (1,0) [0|255] "" Vector__XXX
 SG_ WakeupSource_FD01_SGW : 23|8@0+ (1,0) [0|255] "" Vector__XXX
 SG_ PreviousCanNMState_FD11_SGW : 275|4@0+ (1,0) [0|15] "" Vector__XXX
 SG_ PreviousCanNMState_FD08_SGW : 363|4@0+ (1,0) [0|15] "" Vector__XXX
 SG_ PreviousCanNMState_FD03_SGW : 187|4@0+ (1,0) [0|15] "" Vector__XXX
 SG_ PreviousCanNMState_FD02_SGW : 99|4@0+ (1,0) [0|15] "" Vector__XXX
 SG_ PreviousCanNMState_FD01_SGW : 11|4@0+ (1,0) [0|15] "" Vector__XXX
 SG_ DES_FD11_SGW : 268|2@0+ (1,0) [0|3] "" Vector__XXX
 SG_ DES_FD08_SGW : 356|2@0+ (1,0) [0|3] "" Vector__XXX
 SG_ DES_FD03_SGW : 180|2@0+ (1,0) [0|3] "" Vector__XXX
 SG_ DES_FD02_SGW : 92|2@0+ (1,0) [0|3] "" Vector__XXX
 SG_ DES_FD01_SGW : 4|2@0+ (1,0) [0|3] "" Vector__XXX
 SG_ CurrentCanNMState_FD11_SGW : 279|4@0+ (1,0) [0|15] "" Vector__XXX
 SG_ CurrentCanNMState_FD08_SGW : 367|4@0+ (1,0) [0|15] "" Vector__XXX
 SG_ CurrentCanNMState_FD03_SGW : 191|4@0+ (1,0) [0|15] "" Vector__XXX
 SG_ CurrentCanNMState_FD02_SGW : 103|4@0+ (1,0) [0|15] "" Vector__XXX
 SG_ CurrentCanNMState_FD01_SGW : 15|4@0+ (1,0) [0|15] "" Vector__XXX
 SG_ StayActiveSource_FD11_SGW : 295|64@0+ (1,0) [0|18446744073709551615] "" Vector__XXX
 SG_ StayActiveSource_FD08_SGW : 383|64@0+ (1,0) [0|18446744073709551615] "" Vector__XXX
 SG_ StayActiveSource_FD03_SGW : 207|64@0+ (1,0) [0|18446744073709551615] "" Vector__XXX
 SG_ StayActiveSource_FD02_SGW : 119|64@0+ (1,0) [0|18446744073709551615] "" Vector__XXX
 SG_ StayActiveSource_FD01_SGW : 31|64@0+ (1,0) [0|18446744073709551615] "" Vector__XXX

BO_ 2654339072 PDC_INFO_FD_BCM: 48 BCM
 SG_ GenericFailSts_FD04_BCM : 269|1@0+ (1,0) [0|1] "" Vector__XXX
 SG_ GenericFailSts_FD03_BCM : 181|1@0+ (1,0) [0|1] "" Vector__XXX
 SG_ GenericFailSts_FD02_BCM : 93|1@0+ (1,0) [0|1] "" Vector__XXX
 SG_ GenericFailSts_FD01_BCM : 5|1@0+ (1,0) [0|1] "" Vector__XXX
 SG_ EOL_FD04_BCM : 271|1@0+ (1,0) [0|1] "-"  Vector__XXX
 SG_ EOL_FD03_BCM : 183|1@0+ (1,0) [0|1] "-"  Vector__XXX
 SG_ EOL_FD02_BCM : 95|1@0+ (1,0) [0|1] "-"  Vector__XXX
 SG_ EOL_FD01_BCM : 7|1@0+ (1,0) [0|1] "-"  Vector__XXX
 SG_ CurrentFailSts_FD04_BCM : 270|1@0+ (1,0) [0|1] "" Vector__XXX
 SG_ CurrentFailSts_FD03_BCM : 182|1@0+ (1,0) [0|1] "" Vector__XXX
 SG_ CurrentFailSts_FD02_BCM : 94|1@0+ (1,0) [0|1] "" Vector__XXX
 SG_ CurrentFailSts_FD01_BCM : 6|1@0+ (1,0) [0|1] "" Vector__XXX
 SG_ WakeupSource_FD04_BCM : 287|8@0+ (1,0) [0|255] "" Vector__XXX
 SG_ WakeupSource_FD03_BCM : 199|8@0+ (1,0) [0|255] "" Vector__XXX
 SG_ WakeupSource_FD02_BCM : 111|8@0+ (1,0) [0|255] "" Vector__XXX
 SG_ WakeupSource_FD01_BCM : 23|8@0+ (1,0) [0|255] "" Vector__XXX
 SG_ PreviousCanNMState_FD04_BCM : 275|4@0+ (1,0) [0|15] "" Vector__XXX
 SG_ PreviousCanNMState_FD03_BCM : 187|4@0+ (1,0) [0|15] "" Vector__XXX
 SG_ PreviousCanNMState_FD02_BCM : 99|4@0+ (1,0) [0|15] "" Vector__XXX
 SG_ PreviousCanNMState_FD01_BCM : 11|4@0+ (1,0) [0|15] "" Vector__XXX
 SG_ DES_FD04_BCM : 268|2@0+ (1,0) [0|3] "" Vector__XXX
 SG_ DES_FD03_BCM : 180|2@0+ (1,0) [0|3] "" Vector__XXX
 SG_ DES_FD02_BCM : 92|2@0+ (1,0) [0|3] "" Vector__XXX
 SG_ DES_FD01_BCM : 4|2@0+ (1,0) [0|3] "" Vector__XXX
 SG_ CurrentCanNMState_FD04_BCM : 279|4@0+ (1,0) [0|15] "" Vector__XXX
 SG_ CurrentCanNMState_FD03_BCM : 191|4@0+ (1,0) [0|15] "" Vector__XXX
 SG_ CurrentCanNMState_FD02_BCM : 103|4@0+ (1,0) [0|15] "" Vector__XXX
 SG_ CurrentCanNMState_FD01_BCM : 15|4@0+ (1,0) [0|15] "" Vector__XXX
 SG_ StayActiveSource_FD04_BCM : 295|64@0+ (1,0) [0|18446744073709551615] "" Vector__XXX
 SG_ StayActiveSource_FD03_BCM : 207|64@0+ (1,0) [0|18446744073709551615] "" Vector__XXX
 SG_ StayActiveSource_FD02_BCM : 119|64@0+ (1,0) [0|18446744073709551615] "" Vector__XXX
 SG_ StayActiveSource_FD01_BCM : 31|64@0+ (1,0) [0|18446744073709551615] "" Vector__XXX

BO_ 1443 IPC_VEHICLE_SETUP: 48 IPC
 SG_ FlashLightWLock : 159|1@0+ (1,0) [0|1] "-"  SGW,BCM
 SG_ Windows_With_Fob : 179|1@0+ (1,0) [0|1] "-"  SGW,BCM
 SG_ TyrePress_Unit : 243|2@0+ (1,0) [0|3] "" SGW,BCM
 SG_ Traffic_Sign_Warn : 171|3@0+ (1,0) [0|3] "" SGW,BCM
 SG_ Traffic_Sign_Info : 230|1@0+ (1,0) [0|1] "" ADCAM,MPAD,EVCU2,SGW,BCM
 SG_ Torque_Unit : 254|1@0+ (1,0) [0|1] "" SGW,BCM
 SG_ Tire_Fill_Alert : 215|1@0+ (1,0) [0|1] "" SGW,BCM,RFHM
 SG_ Tilt_Mirr_Rev : 210|1@0+ (1,0) [0|1] "" SGW,BCM
 SG_ Temp_Unit : 239|1@0+ (1,0) [0|1] "" SGW,BCM
 SG_ TelematicSetupACK : 97|2@0+ (1,0) [0|3] "-"  SGW,BCM
 SG_ SVC_Guidelines : 193|1@0+ (1,0) [0|1] "" SGW,BCM
 SG_ SVC_Delay : 192|1@0+ (1,0) [0|1] "" SGW,BCM
 SG_ Steer_Feel : 209|2@0+ (1,0) [0|3] "" SGW,BCM
 SG_ SpeedLockDoorEnable : 94|1@0+ (1,0) [0|1] "-"  SGW,BCM
 SG_ Speed_Unit : 253|1@0+ (1,0) [0|1] "" ADCAM,MPAD,EVCU2,SGW,BCM
 SG_ SoundHornRemoteStart : 104|1@0+ (1,0) [0|1] "" SGW,BCM
 SG_ SoundHornLock : 127|2@0+ (1,0) [0|3] "" SGW,BCM
 SG_ Sdw : 125|2@0+ (1,0) [0|3] "" SGW,BCM
 SG_ RKEMemoryLinkEnable : 166|1@0+ (1,0) [0|1] "-"  SGW,BCM
 SG_ RemStNrmlStEnbl : 178|2@0+ (1,0) [0|3] "-"  SGW,BCM
 SG_ RemoteDoorUnlock : 102|1@0+ (1,0) [0|1] "" SGW,BCM
 SG_ Rear_Brk_Asst : 190|1@0+ (1,0) [0|1] "" SGW,BCM
 SG_ Rdy_To_Drive : 223|1@0+ (1,0) [0|1] "" SGW,BCM
 SG_ RainSensorLevel : 93|1@0+ (1,0) [0|1] "-"  SGW,BCM
 SG_ PLGAlert : 168|1@0+ (1,0) [0|1] "-"  SGW,BCM
 SG_ PhoneRepetition : 114|1@0+ (1,0) [0|1] "" SGW,BCM
 SG_ Ped_EM_Brk_Warn_Act : 175|1@0+ (1,0) [0|1] "-"  SGW,BCM
 SG_ PassiveEntry : 101|1@0+ (1,0) [0|1] "" SGW,BCM,RFHM
 SG_ PamChimeVolumeRear : 111|2@0+ (1,0) [0|3] "" SGW,BCM
 SG_ PamChimeVolumeFront : 107|2@0+ (1,0) [0|3] "" SGW,BCM
 SG_ Night_Vision : 70|1@0+ (1,0) [0|1] "" SGW,BCM
 SG_ New_Spd_Zone_Ind : 247|2@0+ (1,0) [0|3] "" EVCU2,SGW,BCM
 SG_ NavRepetition : 105|1@0+ (1,0) [0|1] "" SGW,BCM
 SG_ LDW_Sensibility : 147|2@0+ (1,0) [0|3] "-"  ADCAM,SGW,BCM
 SG_ LDW_Intensity : 154|2@0+ (1,0) [0|3] "-"  ADCAM,SGW,BCM
 SG_ LanguageSelection : 135|8@0+ (1,0) [0|255] "-"  SGW,BCM
 SG_ IPCProgrammed : 40|1@0+ (1,0) [0|1] "-"  SGW,BCM
 SG_ Intelligent_Speed : 69|1@0+ (1,0) [0|1] "" EVCU2,SGW,BCM
 SG_ Illuminated_Approach : 68|2@0+ (1,0) [0|3] "-"  SGW,BCM
 SG_ HP_Unit : 245|2@0+ (1,0) [0|3] "" SGW,BCM
 SG_ HourMode : 87|1@0+ (1,0) [0|1] "-"  SGW,BCM
 SG_ Hill_Start_Assist : 184|1@0+ (1,0) [0|1] "-"  SGW,BCM,BSM
 SG_ HeadLightWipers : 167|1@0+ (1,0) [0|1] "-"  SGW,BCM
 SG_ HeadlightsOffDelay : 145|2@0+ (1,0) [0|3] "-"  SGW,BCM
 SG_ Handsfree_Liftgate : 182|1@0+ (1,0) [0|1] "-"  SGW,BCM
 SG_ GreetingLightsEnable : 81|1@0+ (1,0) [0|1] "-"  SGW,BCM
 SG_ Fwrd_Cam_Guidelines : 189|1@0+ (1,0) [0|1] "-"  SGW,BCM
 SG_ FSFCWPlusSetting : 143|3@0+ (1,0) [0|7] "-"  ADCAM,MPAD,SGW,BCM
 SG_ FSFCWPlusActivationMode : 149|2@0+ (1,0) [0|3] "-"  ADCAM,SGW,BCM
 SG_ EPB_MaintenanceMode : 155|1@0+ (1,0) [0|1] "-"  SGW
 SG_ Eng_Off_Pwr_Delay : 187|2@0+ (1,0) [0|3] "-"  SGW,BCM
 SG_ Easy_Exit_D : 174|1@0+ (1,0) [0|1] "-"  SGW,BCM
 SG_ DynamicGrid : 100|1@0+ (1,0) [0|1] "" SGW,BCM
 SG_ DRLEnable : 80|1@0+ (1,0) [0|1] "-"  SGW,BCM
 SG_ Dist_Unit : 231|1@0+ (1,0) [0|1] "" MPAD,SGW,BCM
 SG_ CorneringEnable : 82|1@0+ (1,0) [0|1] "-"  SGW,BCM
 SG_ Consum_Unit : 238|3@0+ (1,0) [0|7] "" SGW,BCM
 SG_ BSDEnable : 140|2@0+ (1,0) [0|3] "" ADCAM,SGW,BCM
 SG_ Backup_Cam_Delay : 173|1@0+ (1,0) [0|1] "-"  SGW,BCM
 SG_ AutoUnlockDoorExit : 162|1@0+ (1,0) [0|1] "-"  SGW,BCM
 SG_ AutoParkBrake : 103|1@0+ (1,0) [0|1] "" SGW,BCM,BSM
 SG_ AutoHighBeamEnable : 92|1@0+ (1,0) [0|1] "-"  SGW,BCM
 SG_ Auto_Fold_Mirr : 255|1@0+ (1,0) [0|1] "-"  SGW,BCM
 SG_ AmbientLightingLevel : 118|4@0+ (1,0) [0|15] "" SGW
 SG_ Proximity_WU : 121|1@0+ (1,0) [0|1] "-"  SGW,BCM,RFHM
 SG_ Drowsy_Driver_Alert : 120|1@0+ (1,0) [0|1] "-"  ADCAM,SGW,BCM
 SG_ Active_Park_Prox_Chime : 218|1@0+ (1,0) [0|1] "" SGW,BCM
 SG_ Active_Park_Mode : 219|1@0+ (1,0) [0|1] "" SGW,BCM,BSM
 SG_ MessageCounter_IPCVS1 : 307|4@0+ (1,0) [0|15] "-"  ADCAM,MPAD,BCM,EVCU2
 SG_ CRC_IPCVS1 : 319|8@0+ (1,0) [0|255] "-"  ADCAM,MPAD,BCM,EVCU2
 SG_ Act_Lane_Mgt_Strength : 123|2@0+ (1,0) [0|3] "-"  ADCAM,MPAD,SGW,BCM
 SG_ Act_Lane_Mgt : 91|2@0+ (1,0) [0|3] "-"  ADCAM,MPAD,SGW,BCM
 SG_ StaticGrid : 99|1@0+ (1,0) [0|1] "" SGW,BCM
 SG_ PwrLev : 7|3@0+ (1,0) [0|7] "" EVCU2,SGW,BCM
 SG_ Adaptive_Front_Lighting : 18|1@0+ (1,0) [0|1] "-"  SGW,BCM
 SG_ FOA_AppAlert_Disable_UserReq : 290|1@0+ (1,0) [0|1] "" BCM
 SG_ Spaak : 289|1@0+ (1,0) [0|1] "-"  SGW,BCM,RFHM
 SG_ Trailer_detection_blind_spot : 310|1@0+ (1,0) [0|1] "-"  ADCAM,SGW,BCM
 SG_ SOC_Max_Lev : 308|1@0+ (1,0) [0|1] "" EVCU2,SGW,BCM

CM_ SG_ 2654339184 CurrentCanNMState_FD01_SGW "Indicates that CanNM state the ECU is currently executing";
CM_ SG_ 2654339184 CurrentCanNMState_FD02_SGW "Indicates that CanNM state the ECU is currently executing";
CM_ SG_ 2654339184 CurrentCanNMState_FD03_SGW "Indicates that CanNM state the ECU is currently executing";
CM_ SG_ 2654339184 CurrentCanNMState_FD08_SGW "Indicates that CanNM state the ECU is currently executing";
CM_ SG_ 2654339184 CurrentCanNMState_FD11_SGW "Indicates that CanNM state the ECU is currently executing";
CM_ SG_ 2654339184 CurrentFailSts_FD01_SGW "Indicates the presence/absence of at least one DTC with DTCStatus = present in the System Memory";
CM_ SG_ 2654339184 DES_FD11_SGW "Indicates whether the ECU?s CAN cell is in either ErrorActive, or ErrorPassive state OR has just now recovered from a BusOff condition";
CM_ SG_ 2654339184 StayActiveSource_FD02_SGW "Indicates the source that requests the ECU to stay active";
CM_ SG_ 2654339184 StayActiveSource_FD03_SGW "Indicates the source that requests the ECU to stay active";
CM_ SG_ 2654339184 StayActiveSource_FD08_SGW "Indicates the source that requests the ECU to stay active";
CM_ SG_ 2654339184 StayActiveSource_FD11_SGW "Indicates the source that requests the ECU to stay active";
CM_ SG_ 2654339184 WakeupSource_FD01_SGW "Indicates the reason the ECU was most recently awakened";
CM_ SG_ 2654339184 WakeupSource_FD02_SGW "Indicates the reason the ECU was most recently awakened";
CM_ SG_ 2654339184 WakeupSource_FD03_SGW "Indicates the reason the ECU was most recently awakened";
CM_ SG_ 2654339184 WakeupSource_FD08_SGW "Indicates the reason the ECU was most recently awakened";
CM_ SG_ 2654339184 WakeupSource_FD11_SGW "Indicates the reason the ECU was most recently awakened";
CM_ SG_ 2654339184 PreviousCanNMState_FD03_SGW "Indicates the last CanNM state that the ECU existed in";
CM_ SG_ 2654339184 PreviousCanNMState_FD08_SGW "Indicates the last CanNM state that the ECU existed in";
CM_ SG_ 2654339184 PreviousCanNMState_FD11_SGW "Indicates the last CanNM state that the ECU existed in";
CM_ SG_ 2654339184 StayActiveSource_FD01_SGW "Indicates the source that requests the ECU to stay active";
CM_ SG_ 2654339184 PreviousCanNMState_FD02_SGW "Indicates the last CanNM state that the ECU existed in";
CM_ SG_ 2654339184 PreviousCanNMState_FD01_SGW "Indicates the last CanNM state that the ECU existed in";
CM_ SG_ 2654339184 GenericFailSts_FD11_SGW "Indicates the presence/absent of at least one DTC in the System Memory";
CM_ SG_ 2654339184 GenericFailSts_FD08_SGW "Indicates the presence/absent of at least one DTC in the System Memory";
CM_ SG_ 2654339184 EOL_FD01_SGW "Indicates if the ECU requires configuration data at the assembly plant End Of Line";
CM_ SG_ 2654339184 EOL_FD02_SGW "Indicates if the ECU requires configuration data at the assembly plant End Of Line";
CM_ SG_ 2654339184 EOL_FD08_SGW "Indicates if the ECU requires configuration data at the assembly plant End Of Line";
CM_ SG_ 2654339184 EOL_FD03_SGW "Indicates if the ECU requires configuration data at the assembly plant End Of Line";
CM_ SG_ 2654339184 GenericFailSts_FD03_SGW "Indicates the presence/absent of at least one DTC in the System Memory";
CM_ SG_ 2654339184 GenericFailSts_FD02_SGW "Indicates the presence/absent of at least one DTC in the System Memory";
CM_ SG_ 2654339184 GenericFailSts_FD01_SGW "Indicates the presence/absent of at least one DTC in the System Memory";
CM_ SG_ 2654339184 EOL_FD11_SGW "Indicates if the ECU requires configuration data at the assembly plant End Of Line";
CM_ SG_ 2654339184 DES_FD03_SGW "Indicates whether the ECU?s CAN cell is in either ErrorActive, or ErrorPassive state OR has just now recovered from a BusOff condition";
CM_ SG_ 2654339184 DES_FD08_SGW "Indicates whether the ECU?s CAN cell is in either ErrorActive, or ErrorPassive state OR has just now recovered from a BusOff condition";
CM_ SG_ 2654339184 DES_FD02_SGW "Indicates whether the ECU?s CAN cell is in either ErrorActive, or ErrorPassive state OR has just now recovered from a BusOff condition";
CM_ SG_ 2654339184 DES_FD01_SGW "Indicates whether the ECU?s CAN cell is in either ErrorActive, or ErrorPassive state OR has just now recovered from a BusOff condition";
CM_ SG_ 2654339184 CurrentFailSts_FD02_SGW "Indicates the presence/absence of at least one DTC with DTCStatus = present in the System Memory";
CM_ SG_ 2654339184 CurrentFailSts_FD03_SGW "Indicates the presence/absence of at least one DTC with DTCStatus = present in the System Memory";
CM_ SG_ 2654339184 CurrentFailSts_FD08_SGW "Indicates the presence/absence of at least one DTC with DTCStatus = present in the System Memory";
CM_ SG_ 2654339184 CurrentFailSts_FD11_SGW "Indicates the presence/absence of at least one DTC with DTCStatus = present in the System Memory";
CM_ SG_ 2654339072 WakeupSource_FD01_BCM "Indicates the reason the ECU was most recently awakened";
CM_ SG_ 2654339072 WakeupSource_FD02_BCM "Indicates the reason the ECU was most recently awakened";
CM_ SG_ 2654339072 WakeupSource_FD03_BCM "Indicates the reason the ECU was most recently awakened";
CM_ SG_ 2654339072 WakeupSource_FD04_BCM "Indicates the reason the ECU was most recently awakened";
CM_ SG_ 2654339072 PreviousCanNMState_FD01_BCM "Indicates the last CanNM state that the ECU existed in";
CM_ SG_ 2654339072 PreviousCanNMState_FD02_BCM "Indicates the last CanNM state that the ECU existed in";
CM_ SG_ 2654339072 PreviousCanNMState_FD03_BCM "Indicates the last CanNM state that the ECU existed in";
CM_ SG_ 2654339072 PreviousCanNMState_FD04_BCM "Indicates the last CanNM state that the ECU existed in";
CM_ SG_ 2654339072 StayActiveSource_FD01_BCM "Indicates the source that requests the ECU to stay active";
CM_ SG_ 2654339072 StayActiveSource_FD02_BCM "Indicates the source that requests the ECU to stay active";
CM_ SG_ 2654339072 StayActiveSource_FD03_BCM "Indicates the source that requests the ECU to stay active";
CM_ SG_ 2654339072 StayActiveSource_FD04_BCM "Indicates the source that requests the ECU to stay active";
CM_ SG_ 2654339072 GenericFailSts_FD01_BCM "Indicates the presence/absent of at least one DTC in the System Memory";
CM_ SG_ 2654339072 GenericFailSts_FD02_BCM "Indicates the presence/absent of at least one DTC in the System Memory";
CM_ SG_ 2654339072 GenericFailSts_FD03_BCM "Indicates the presence/absent of at least one DTC in the System Memory";
CM_ SG_ 2654339072 GenericFailSts_FD04_BCM "Indicates the presence/absent of at least one DTC in the System Memory";
CM_ SG_ 2654339072 EOL_FD04_BCM "Indicates if the ECU requires configuration data at the assembly plant End Of Line";
CM_ SG_ 2654339072 EOL_FD03_BCM "Indicates if the ECU requires configuration data at the assembly plant End Of Line";
CM_ SG_ 2654339072 EOL_FD01_BCM "Indicates if the ECU requires configuration data at the assembly plant End Of Line";
CM_ SG_ 2654339072 EOL_FD02_BCM "Indicates if the ECU requires configuration data at the assembly plant End Of Line";
CM_ SG_ 2654339072 CurrentCanNMState_FD01_BCM "Indicates that CanNM state the ECU is currently executing";
CM_ SG_ 2654339072 CurrentCanNMState_FD02_BCM "Indicates that CanNM state the ECU is currently executing";
CM_ SG_ 2654339072 CurrentCanNMState_FD03_BCM "Indicates that CanNM state the ECU is currently executing";
CM_ SG_ 2654339072 CurrentCanNMState_FD04_BCM "Indicates that CanNM state the ECU is currently executing";
CM_ SG_ 2654339072 CurrentFailSts_FD01_BCM "Indicates the presence/absence of at least one DTC with DTCStatus = present in the System Memory";
CM_ SG_ 2654339072 CurrentFailSts_FD02_BCM "Indicates the presence/absence of at least one DTC with DTCStatus = present in the System Memory";
CM_ SG_ 2654339072 CurrentFailSts_FD03_BCM "Indicates the presence/absence of at least one DTC with DTCStatus = present in the System Memory";
CM_ SG_ 2654339072 CurrentFailSts_FD04_BCM "Indicates the presence/absence of at least one DTC with DTCStatus = present in the System Memory";
CM_ SG_ 2654339072 DES_FD01_BCM "Indicates whether the ECU?s CAN cell is in either ErrorActive, or ErrorPassive state OR has just now recovered from a BusOff condition";
CM_ SG_ 2654339072 DES_FD02_BCM "Indicates whether the ECU?s CAN cell is in either ErrorActive, or ErrorPassive state OR has just now recovered from a BusOff condition";
CM_ SG_ 2654339072 DES_FD03_BCM "Indicates whether the ECU?s CAN cell is in either ErrorActive, or ErrorPassive state OR has just now recovered from a BusOff condition";
CM_ SG_ 2654339072 DES_FD04_BCM "Indicates whether the ECU?s CAN cell is in either ErrorActive, or ErrorPassive state OR has just now recovered from a BusOff condition";
CM_ SG_ 1443 TyrePress_Unit "Tyre Pressure setting";
CM_ SG_ 1443 Traffic_Sign_Warn "Traffic Sign Warning setting";
CM_ SG_ 1443 Windows_With_Fob "Windows with Key Fob setting";
CM_ SG_ 1443 Trailer_detection_blind_spot "Trailer_detection_blind_spot";
CM_ SG_ 1443 Act_Lane_Mgt "Act Lane Mgt setting";
CM_ SG_ 1443 Act_Lane_Mgt_Strength "Act Lane Mgt Strength setting";
CM_ SG_ 1443 AutoHighBeamEnable "This signal is used to give information about the Auto High Beam feature selected";
CM_ SG_ 1443 Active_Park_Mode "Active Parksense Mode setting";
CM_ SG_ 1443 Active_Park_Prox_Chime "Active Parksense Proximity Chime setting";
CM_ SG_ 1443 Adaptive_Front_Lighting "HUD_Display";
CM_ SG_ 1443 AmbientLightingLevel "This signal is used to give information about the Ambient Lighting Level selected";
CM_ SG_ 1443 Auto_Fold_Mirr "Auto Folding Mirror setting";
CM_ SG_ 1443 AutoParkBrake "This signal is used to give information about the Auto Park Brake selected";
CM_ SG_ 1443 AutoUnlockDoorExit "This signal is used to give information about the Auto Unlock Door on Exit feature selected";
CM_ SG_ 1443 Backup_Cam_Delay "Backup Camera Delay setting";
CM_ SG_ 1443 CorneringEnable "This signal is used to give information about the Cornering Lights selected";
CM_ SG_ 1443 BSDEnable "This signal is used to give information about the Blind Spot Alert feature selected";
CM_ SG_ 1443 Consum_Unit "Consumption Unit setting";
CM_ SG_ 1443 CRC_IPCVS1 "CRC according to SAE J1850 standard at each frame transmission.";
CM_ SG_ 1443 DRLEnable "This signal is used to give information about the DRL feature selected";
CM_ SG_ 1443 Dist_Unit "Distance Unit setting";
CM_ SG_ 1443 Drowsy_Driver_Alert "Drowsy Driver Alert setting";
CM_ SG_ 1443 DynamicGrid "Rear View Camera Dynamic Gridlines request";
CM_ SG_ 1443 Easy_Exit_D "Driver Easy Exit Seat setting";
CM_ SG_ 1443 Eng_Off_Pwr_Delay "Engine Off Power Delay setting";
CM_ SG_ 1443 EPB_MaintenanceMode "This signal is used to give information about the Maintenance Mode feature selected";
CM_ SG_ 1443 FlashLightWLock "This signal is used to give information about the Flash Light With Lock selected";
CM_ SG_ 1443 FOA_AppAlert_Disable_UserReq "Forgotten Object Alert IPC disable request";
CM_ SG_ 1443 FSFCWPlusActivationMode "This signal is used to give information about the FSFCW Activation Mode setting";
CM_ SG_ 1443 FSFCWPlusSetting "This signal is used to give information about the FSFCW setting";
CM_ SG_ 1443 Fwrd_Cam_Guidelines "Forward Facing Camera Guidelines setting";
CM_ SG_ 1443 GreetingLightsEnable "This signal is used to give information about the Greeting Lights selected";
CM_ SG_ 1443 Handsfree_Liftgate "Handsfree Liftgate setting";
CM_ SG_ 1443 HeadlightsOffDelay "This signal is used to give information about the Headlights Off Delay selected";
CM_ SG_ 1443 HeadLightWipers "Setting to turn on/off headlights with wipers";
CM_ SG_ 1443 Illuminated_Approach "Illuminated Approach setting";
CM_ SG_ 1443 Hill_Start_Assist "Hill Start Assist setting";
CM_ SG_ 1443 HourMode "This signal is used to give information about the Hour Mode selected.";
CM_ SG_ 1443 HP_Unit "Horsepower Unit setting";
CM_ SG_ 1443 Intelligent_Speed "Intelligent Speed setting";
CM_ SG_ 1443 PassiveEntry "This signal is used to give information about the Passive Entry selected";
CM_ SG_ 1443 Ped_EM_Brk_Warn_Act "Pedestrian Emergency Braking Warning & Active Braking setting";
CM_ SG_ 1443 PhoneRepetition "This signal is used to give information about the Phone Repetition selected";
CM_ SG_ 1443 Proximity_WU "Proximity Wakeup setting";
CM_ SG_ 1443 Sdw "This signal is used to give information about the Side Distance Warning feature selected";
CM_ SG_ 1443 PwrLev "This signal is used to give information about the Power Level selected.";
CM_ SG_ 1443 RainSensorLevel "This signal is used to give information about the Rain Sensor Level selected";
CM_ SG_ 1443 Rdy_To_Drive "Ready to Driver Pop Up setting";
CM_ SG_ 1443 Rear_Brk_Asst "Rear Braking Assist setting";
CM_ SG_ 1443 IPCProgrammed "IPC Settings Defaults Programmed Status";
CM_ SG_ 1443 LanguageSelection "This signal is used to give information about the Language selected";
CM_ SG_ 1443 LDW_Intensity "This signal is used to give information about the LDW Intensity selected";
CM_ SG_ 1443 LDW_Sensibility "This signal is used to give information about the LDW Sensibility selected";
CM_ SG_ 1443 NavRepetition "This signal is used to give information about the Navigation Repetition selected";
CM_ SG_ 1443 MessageCounter_IPCVS1 "This signal is a counter used for safety checks strategies. This counter is incremented of 1 (one) unit at each frame transmission.";
CM_ SG_ 1443 New_Spd_Zone_Ind "New Speed Zone Indication setting";
CM_ SG_ 1443 Night_Vision "Night Vision setting";
CM_ SG_ 1443 PamChimeVolumeFront "This signal is used to give information about the PAM  Chime Volume selected";
CM_ SG_ 1443 PamChimeVolumeRear "This signal is used to give information about the PAM 8Ch Chime Volume selected";
CM_ SG_ 1443 PLGAlert "Setting to turn on/off the power liftgate chime";
CM_ SG_ 1443 Tilt_Mirr_Rev "Tilt Mirrors in Reverse setting";
CM_ SG_ 1443 Torque_Unit "Torque Unit setting";
CM_ SG_ 1443 Tire_Fill_Alert "Tire Fill Alert setting";
CM_ SG_ 1443 Temp_Unit "Temperature Unit setting";
CM_ SG_ 1443 TelematicSetupACK "Used to give information about the acknowledge of the requested setup changes by telematic module.";
CM_ SG_ 1443 StaticGrid "Rear View Camera Static Gridlines request";
CM_ SG_ 1443 Steer_Feel "Steering Feel setting";
CM_ SG_ 1443 SVC_Delay "Surround View Camera Delay setting";
CM_ SG_ 1443 SVC_Guidelines "Surround View Camera Guidelines setting";
CM_ SG_ 1443 RemoteDoorUnlock "This signal is used to give information about the Remote Door Unlock selected";
CM_ SG_ 1443 RemStNrmlStEnbl "Setting to allow seat heating and venting for all starts, remote starts, or none";
CM_ SG_ 1443 RKEMemoryLinkEnable "To enable or disable RKE linked to memory";
CM_ SG_ 1443 SOC_Max_Lev "Customer top of SOC selection.";
CM_ SG_ 1443 SoundHornLock "This signal is used to give information about the Sound Horn with Lock selected";
CM_ SG_ 1443 SoundHornRemoteStart "This signal is used to give information about the Sound Horn with Remote Start selected";
CM_ SG_ 1443 Spaak "Spaak";
CM_ SG_ 1443 Speed_Unit "Speed Unit setting";
CM_ SG_ 1443 SpeedLockDoorEnable "This signal is used to give information about the Autoclose feature selected";
CM_ SG_ 1443 Traffic_Sign_Info "Traffic Sign Information setting";
BA_DEF_ BO_ "CANFD_BRS" ENUM "0","1";
BA_DEF_ BO_ "VFrameFormat" ENUM "StandardCAN","ExtendedCAN","reserved","reserved","reserved","reserved","reserved","reserved","reserved","reserved","reserved","reserved","reserved","reserved","StandardCAN_FD","ExtendedCAN_FD";
BA_DEF_ BO_ "DiagConnection" HEX 0 65535;
BA_DEF_ BO_ "DiagState" ENUM "No","Yes";
BA_DEF_ BO_ "NmAsrMessage" ENUM "No","Yes";
BA_DEF_ BO_ "GenMsgDelayTime" INT 0 65535;
BA_DEF_ BO_ "GenMsgCycleTime" INT 0 65535;
BA_DEF_ BO_ "GenMsgCycleTimeFast" INT 0 65535;
BA_DEF_ BO_ "GenMsgStartDelayTime" INT 0 65535;
BA_DEF_ BO_ "GenMsgILSupport" ENUM "No","Yes";
BA_DEF_ BO_ "GenMsgNrOfRepetition" INT 0 255;
BA_DEF_ BO_ "GenMsgSendType" ENUM "Cyclic","NotUsed","NotUsed","NotUsed","NotUsed","NotUsed","NotUsed","NotUsed","NoMsgSendType";
BA_DEF_ BO_ "NmMessage" ENUM "No","Yes";
BA_DEF_ BO_ "DiagResponse" ENUM "No","Yes";
BA_DEF_ BO_ "Type" ENUM "P","C","PE","COC","PE_Cntrl","E","E_Cntrl","OC","S","BAF","DC","EM","MM","ISO-TP","-";
BA_DEF_ BO_ "DiagRequest" ENUM "No","Yes";
BA_DEF_ SG_ "GenSigTimeoutTime_SGW" INT 0 65535;
BA_DEF_ SG_ "GenSigTimeoutTime_RFHM" INT 0 65535;
BA_DEF_ SG_ "GenSigTimeoutTime_MPAD" INT 0 65535;
BA_DEF_ SG_ "GenSigTimeoutTime_IPC" INT 0 65535;
BA_DEF_ SG_ "GenSigTimeoutTime_GNMM" INT 0 65535;
BA_DEF_ SG_ "GenSigTimeoutTime_EVCU2" INT 0 65535;
BA_DEF_ SG_ "GenSigTimeoutTime_ESL" INT 0 65535;
BA_DEF_ SG_ "GenSigTimeoutTime_ECM" INT 0 65535;
BA_DEF_ SG_ "GenSigTimeoutTime_DTCM" INT 0 65535;
BA_DEF_ SG_ "GenSigTimeoutTime_DMSM" INT 0 65535;
BA_DEF_ SG_ "GenSigTimeoutTime_BSM" INT 0 65535;
BA_DEF_ SG_ "GenSigTimeoutTime_BCM" INT 0 65535;
BA_DEF_ SG_ "GenSigTimeoutTime_AGSM" INT 0 65535;
BA_DEF_ SG_ "GenSigTimeoutTime_ADCAM" INT 0 65535;
BA_DEF_ SG_ "SystemSignalLongSymbol" STRING ;
BA_DEF_ SG_ "GenSigSendType" ENUM "NotUsed","OnWrite","OnWriteWithRepetition","OnChange","OnChangeWithRepetition","IfActive","IfActiveWithRepetition","NoSigSendType";
BA_DEF_ SG_ "GenSigInactiveValue" INT 0 2147483647;
BA_DEF_ SG_ "GenSigStartValue" INT 0 2147483647;
BA_DEF_DEF_ "CANFD_BRS" "0";
BA_DEF_DEF_ "VFrameFormat" "StandardCAN_FD";
BA_DEF_DEF_ "DiagConnection" 0;
BA_DEF_DEF_ "DiagState" "No";
BA_DEF_DEF_ "NmAsrMessage" "No";
BA_DEF_DEF_ "GenMsgDelayTime" 0;
BA_DEF_DEF_ "GenMsgCycleTime" 0;
BA_DEF_DEF_ "GenMsgCycleTimeFast" 0;
BA_DEF_DEF_ "GenMsgStartDelayTime" 0;
BA_DEF_DEF_ "GenMsgILSupport" "No";
BA_DEF_DEF_ "GenMsgNrOfRepetition" 0;
BA_DEF_DEF_ "GenMsgSendType" "NoMsgSendType";
BA_DEF_DEF_ "NmMessage" "No";
BA_DEF_DEF_ "DiagResponse" "No";
BA_DEF_DEF_ "Type" "-";
BA_DEF_DEF_ "DiagRequest" "No";
BA_DEF_DEF_ "GenSigTimeoutTime_SGW" 2500;
BA_DEF_DEF_ "GenSigTimeoutTime_RFHM" 2500;
BA_DEF_DEF_ "GenSigTimeoutTime_MPAD" 2500;
BA_DEF_DEF_ "GenSigTimeoutTime_IPC" 2500;
BA_DEF_DEF_ "GenSigTimeoutTime_GNMM" 2500;
BA_DEF_DEF_ "GenSigTimeoutTime_EVCU2" 2500;
BA_DEF_DEF_ "GenSigTimeoutTime_ESL" 2500;
BA_DEF_DEF_ "GenSigTimeoutTime_ECM" 2500;
BA_DEF_DEF_ "GenSigTimeoutTime_DTCM" 2500;
BA_DEF_DEF_ "GenSigTimeoutTime_DMSM" 2500;
BA_DEF_DEF_ "GenSigTimeoutTime_BSM" 2500;
BA_DEF_DEF_ "GenSigTimeoutTime_BCM" 2500;
BA_DEF_DEF_ "GenSigTimeoutTime_AGSM" 2500;
BA_DEF_DEF_ "GenSigTimeoutTime_ADCAM" 2500;
BA_DEF_DEF_ "SystemSignalLongSymbol" "";
BA_DEF_DEF_ "GenSigSendType" "NoSigSendType";
BA_DEF_DEF_ "GenSigInactiveValue" 0;
BA_DEF_DEF_ "GenSigStartValue" 0;
BA_ "CANFD_BRS" BO_ 2654339184 1;
BA_ "VFrameFormat" BO_ 2654339184 15;
BA_ "GenMsgCycleTime" BO_ 2654339184 1000;
BA_ "GenMsgILSupport" BO_ 2654339184 1;
BA_ "GenMsgSendType" BO_ 2654339184 0;
BA_ "Type" BO_ 2654339184 1;
BA_ "CANFD_BRS" BO_ 2654339072 1;
BA_ "VFrameFormat" BO_ 2654339072 15;
BA_ "GenMsgCycleTime" BO_ 2654339072 1000;
BA_ "GenMsgStartDelayTime" BO_ 2654339072 440;
BA_ "GenMsgILSupport" BO_ 2654339072 1;
BA_ "GenMsgSendType" BO_ 2654339072 0;
BA_ "Type" BO_ 2654339072 1;
BA_ "CANFD_BRS" BO_ 1443 1;
BA_ "GenMsgDelayTime" BO_ 1443 20;
BA_ "GenMsgCycleTime" BO_ 1443 1000;
BA_ "GenMsgCycleTimeFast" BO_ 1443 20;
BA_ "GenMsgILSupport" BO_ 1443 1;
BA_ "GenMsgNrOfRepetition" BO_ 1443 2;
BA_ "GenMsgSendType" BO_ 1443 0;
BA_ "Type" BO_ 1443 3;
BA_ "GenSigTimeoutTime_SGW" SG_ 2654339072 CurrentFailSts_FD01_BCM 0;
BA_ "GenSigTimeoutTime_RFHM" SG_ 2654339072 CurrentFailSts_FD01_BCM 0;
BA_ "GenSigTimeoutTime_MPAD" SG_ 2654339072 CurrentFailSts_FD01_BCM 0;
BA_ "GenSigTimeoutTime_IPC" SG_ 2654339072 CurrentFailSts_FD01_BCM 0;
BA_ "GenSigTimeoutTime_GNMM" SG_ 2654339072 CurrentFailSts_FD01_BCM 0;
BA_ "GenSigTimeoutTime_EVCU2" SG_ 2654339072 CurrentFailSts_FD01_BCM 0;
BA_ "GenSigTimeoutTime_ESL" SG_ 2654339072 CurrentFailSts_FD01_BCM 0;
BA_ "GenSigTimeoutTime_ECM" SG_ 2654339072 CurrentFailSts_FD01_BCM 0;
BA_ "GenSigTimeoutTime_DTCM" SG_ 2654339072 CurrentFailSts_FD01_BCM 0;
BA_ "GenSigTimeoutTime_DMSM" SG_ 2654339072 CurrentFailSts_FD01_BCM 0;
BA_ "GenSigTimeoutTime_BSM" SG_ 2654339072 CurrentFailSts_FD01_BCM 0;
BA_ "GenSigTimeoutTime_BCM" SG_ 2654339072 CurrentFailSts_FD01_BCM 0;
BA_ "GenSigTimeoutTime_AGSM" SG_ 2654339072 CurrentFailSts_FD01_BCM 0;
BA_ "GenSigTimeoutTime_ADCAM" SG_ 2654339072 CurrentFailSts_FD01_BCM 0;
BA_ "GenSigTimeoutTime_SGW" SG_ 2654339072 StayActiveSource_FD04_BCM 0;
BA_ "GenSigTimeoutTime_RFHM" SG_ 2654339072 StayActiveSource_FD04_BCM 0;
BA_ "GenSigTimeoutTime_MPAD" SG_ 2654339072 StayActiveSource_FD04_BCM 0;
BA_ "GenSigTimeoutTime_IPC" SG_ 2654339072 StayActiveSource_FD04_BCM 0;
BA_ "GenSigTimeoutTime_GNMM" SG_ 2654339072 StayActiveSource_FD04_BCM 0;
BA_ "GenSigTimeoutTime_EVCU2" SG_ 2654339072 StayActiveSource_FD04_BCM 0;
BA_ "GenSigTimeoutTime_ESL" SG_ 2654339072 StayActiveSource_FD04_BCM 0;
BA_ "GenSigTimeoutTime_ECM" SG_ 2654339072 StayActiveSource_FD04_BCM 0;
BA_ "GenSigTimeoutTime_DTCM" SG_ 2654339072 StayActiveSource_FD04_BCM 0;
BA_ "GenSigTimeoutTime_DMSM" SG_ 2654339072 StayActiveSource_FD04_BCM 0;
BA_ "GenSigTimeoutTime_BSM" SG_ 2654339072 StayActiveSource_FD04_BCM 0;
BA_ "GenSigTimeoutTime_BCM" SG_ 2654339072 StayActiveSource_FD04_BCM 0;
BA_ "GenSigTimeoutTime_AGSM" SG_ 2654339072 StayActiveSource_FD04_BCM 0;
BA_ "GenSigTimeoutTime_ADCAM" SG_ 2654339072 StayActiveSource_FD04_BCM 0;
BA_ "GenSigTimeoutTime_SGW" SG_ 2654339072 StayActiveSource_FD03_BCM 0;
BA_ "GenSigTimeoutTime_RFHM" SG_ 2654339072 StayActiveSource_FD03_BCM 0;
BA_ "GenSigTimeoutTime_MPAD" SG_ 2654339072 StayActiveSource_FD03_BCM 0;
BA_ "GenSigTimeoutTime_IPC" SG_ 2654339072 StayActiveSource_FD03_BCM 0;
BA_ "GenSigTimeoutTime_GNMM" SG_ 2654339072 StayActiveSource_FD03_BCM 0;
BA_ "GenSigTimeoutTime_EVCU2" SG_ 2654339072 StayActiveSource_FD03_BCM 0;
BA_ "GenSigTimeoutTime_ESL" SG_ 2654339072 StayActiveSource_FD03_BCM 0;
BA_ "GenSigTimeoutTime_ECM" SG_ 2654339072 StayActiveSource_FD03_BCM 0;
BA_ "GenSigTimeoutTime_DTCM" SG_ 2654339072 StayActiveSource_FD03_BCM 0;
BA_ "GenSigTimeoutTime_DMSM" SG_ 2654339072 StayActiveSource_FD03_BCM 0;
BA_ "GenSigTimeoutTime_BSM" SG_ 2654339072 StayActiveSource_FD03_BCM 0;
BA_ "GenSigTimeoutTime_BCM" SG_ 2654339072 StayActiveSource_FD03_BCM 0;
BA_ "GenSigTimeoutTime_AGSM" SG_ 2654339072 StayActiveSource_FD03_BCM 0;
BA_ "GenSigTimeoutTime_ADCAM" SG_ 2654339072 StayActiveSource_FD03_BCM 0;
BA_ "GenSigTimeoutTime_SGW" SG_ 2654339072 StayActiveSource_FD02_BCM 0;
BA_ "GenSigTimeoutTime_RFHM" SG_ 2654339072 StayActiveSource_FD02_BCM 0;
BA_ "GenSigTimeoutTime_MPAD" SG_ 2654339072 StayActiveSource_FD02_BCM 0;
BA_ "GenSigTimeoutTime_IPC" SG_ 2654339072 StayActiveSource_FD02_BCM 0;
BA_ "GenSigTimeoutTime_GNMM" SG_ 2654339072 StayActiveSource_FD02_BCM 0;
BA_ "GenSigTimeoutTime_EVCU2" SG_ 2654339072 StayActiveSource_FD02_BCM 0;
BA_ "GenSigTimeoutTime_ESL" SG_ 2654339072 StayActiveSource_FD02_BCM 0;
BA_ "GenSigTimeoutTime_ECM" SG_ 2654339072 StayActiveSource_FD02_BCM 0;
BA_ "GenSigTimeoutTime_DTCM" SG_ 2654339072 StayActiveSource_FD02_BCM 0;
BA_ "GenSigTimeoutTime_DMSM" SG_ 2654339072 StayActiveSource_FD02_BCM 0;
BA_ "GenSigTimeoutTime_BSM" SG_ 2654339072 StayActiveSource_FD02_BCM 0;
BA_ "GenSigTimeoutTime_BCM" SG_ 2654339072 StayActiveSource_FD02_BCM 0;
BA_ "GenSigTimeoutTime_AGSM" SG_ 2654339072 StayActiveSource_FD02_BCM 0;
BA_ "GenSigTimeoutTime_ADCAM" SG_ 2654339072 StayActiveSource_FD02_BCM 0;
BA_ "GenSigTimeoutTime_SGW" SG_ 2654339072 StayActiveSource_FD01_BCM 0;
BA_ "GenSigTimeoutTime_RFHM" SG_ 2654339072 StayActiveSource_FD01_BCM 0;
BA_ "GenSigTimeoutTime_MPAD" SG_ 2654339072 StayActiveSource_FD01_BCM 0;
BA_ "GenSigTimeoutTime_IPC" SG_ 2654339072 StayActiveSource_FD01_BCM 0;
BA_ "GenSigTimeoutTime_GNMM" SG_ 2654339072 StayActiveSource_FD01_BCM 0;
BA_ "GenSigTimeoutTime_EVCU2" SG_ 2654339072 StayActiveSource_FD01_BCM 0;
BA_ "GenSigTimeoutTime_ESL" SG_ 2654339072 StayActiveSource_FD01_BCM 0;
BA_ "GenSigTimeoutTime_ECM" SG_ 2654339072 StayActiveSource_FD01_BCM 0;
BA_ "GenSigTimeoutTime_DTCM" SG_ 2654339072 StayActiveSource_FD01_BCM 0;
BA_ "GenSigTimeoutTime_DMSM" SG_ 2654339072 StayActiveSource_FD01_BCM 0;
BA_ "GenSigTimeoutTime_BSM" SG_ 2654339072 StayActiveSource_FD01_BCM 0;
BA_ "GenSigTimeoutTime_BCM" SG_ 2654339072 StayActiveSource_FD01_BCM 0;
BA_ "GenSigTimeoutTime_AGSM" SG_ 2654339072 StayActiveSource_FD01_BCM 0;
BA_ "GenSigTimeoutTime_ADCAM" SG_ 2654339072 StayActiveSource_FD01_BCM 0;
BA_ "GenSigTimeoutTime_SGW" SG_ 2654339072 WakeupSource_FD04_BCM 0;
BA_ "GenSigTimeoutTime_RFHM" SG_ 2654339072 WakeupSource_FD04_BCM 0;
BA_ "GenSigTimeoutTime_MPAD" SG_ 2654339072 WakeupSource_FD04_BCM 0;
BA_ "GenSigTimeoutTime_IPC" SG_ 2654339072 WakeupSource_FD04_BCM 0;
BA_ "GenSigTimeoutTime_GNMM" SG_ 2654339072 WakeupSource_FD04_BCM 0;
BA_ "GenSigTimeoutTime_EVCU2" SG_ 2654339072 WakeupSource_FD04_BCM 0;
BA_ "GenSigTimeoutTime_ESL" SG_ 2654339072 WakeupSource_FD04_BCM 0;
BA_ "GenSigTimeoutTime_ECM" SG_ 2654339072 WakeupSource_FD04_BCM 0;
BA_ "GenSigTimeoutTime_DTCM" SG_ 2654339072 WakeupSource_FD04_BCM 0;
BA_ "GenSigTimeoutTime_DMSM" SG_ 2654339072 WakeupSource_FD04_BCM 0;
BA_ "GenSigTimeoutTime_BSM" SG_ 2654339072 WakeupSource_FD04_BCM 0;
BA_ "GenSigTimeoutTime_BCM" SG_ 2654339072 WakeupSource_FD04_BCM 0;
BA_ "GenSigTimeoutTime_AGSM" SG_ 2654339072 WakeupSource_FD04_BCM 0;
BA_ "GenSigTimeoutTime_ADCAM" SG_ 2654339072 WakeupSource_FD04_BCM 0;
BA_ "GenSigTimeoutTime_SGW" SG_ 2654339072 WakeupSource_FD03_BCM 0;
BA_ "GenSigTimeoutTime_RFHM" SG_ 2654339072 WakeupSource_FD03_BCM 0;
BA_ "GenSigTimeoutTime_MPAD" SG_ 2654339072 WakeupSource_FD03_BCM 0;
BA_ "GenSigTimeoutTime_IPC" SG_ 2654339072 WakeupSource_FD03_BCM 0;
BA_ "GenSigTimeoutTime_GNMM" SG_ 2654339072 WakeupSource_FD03_BCM 0;
BA_ "GenSigTimeoutTime_EVCU2" SG_ 2654339072 WakeupSource_FD03_BCM 0;
BA_ "GenSigTimeoutTime_ESL" SG_ 2654339072 WakeupSource_FD03_BCM 0;
BA_ "GenSigTimeoutTime_ECM" SG_ 2654339072 WakeupSource_FD03_BCM 0;
BA_ "GenSigTimeoutTime_DTCM" SG_ 2654339072 WakeupSource_FD03_BCM 0;
BA_ "GenSigTimeoutTime_DMSM" SG_ 2654339072 WakeupSource_FD03_BCM 0;
BA_ "GenSigTimeoutTime_BSM" SG_ 2654339072 WakeupSource_FD03_BCM 0;
BA_ "GenSigTimeoutTime_BCM" SG_ 2654339072 WakeupSource_FD03_BCM 0;
BA_ "GenSigTimeoutTime_AGSM" SG_ 2654339072 WakeupSource_FD03_BCM 0;
BA_ "GenSigTimeoutTime_ADCAM" SG_ 2654339072 WakeupSource_FD03_BCM 0;
BA_ "GenSigTimeoutTime_SGW" SG_ 2654339072 PreviousCanNMState_FD02_BCM 0;
BA_ "GenSigTimeoutTime_RFHM" SG_ 2654339072 PreviousCanNMState_FD02_BCM 0;
BA_ "GenSigTimeoutTime_MPAD" SG_ 2654339072 PreviousCanNMState_FD02_BCM 0;
BA_ "GenSigTimeoutTime_IPC" SG_ 2654339072 PreviousCanNMState_FD02_BCM 0;
BA_ "GenSigTimeoutTime_GNMM" SG_ 2654339072 PreviousCanNMState_FD02_BCM 0;
BA_ "GenSigTimeoutTime_EVCU2" SG_ 2654339072 PreviousCanNMState_FD02_BCM 0;
BA_ "GenSigTimeoutTime_ESL" SG_ 2654339072 PreviousCanNMState_FD02_BCM 0;
BA_ "GenSigTimeoutTime_ECM" SG_ 2654339072 PreviousCanNMState_FD02_BCM 0;
BA_ "GenSigTimeoutTime_DTCM" SG_ 2654339072 PreviousCanNMState_FD02_BCM 0;
BA_ "GenSigTimeoutTime_DMSM" SG_ 2654339072 PreviousCanNMState_FD02_BCM 0;
BA_ "GenSigTimeoutTime_BSM" SG_ 2654339072 PreviousCanNMState_FD02_BCM 0;
BA_ "GenSigTimeoutTime_BCM" SG_ 2654339072 PreviousCanNMState_FD02_BCM 0;
BA_ "GenSigTimeoutTime_AGSM" SG_ 2654339072 PreviousCanNMState_FD02_BCM 0;
BA_ "GenSigTimeoutTime_ADCAM" SG_ 2654339072 PreviousCanNMState_FD02_BCM 0;
BA_ "GenSigTimeoutTime_SGW" SG_ 2654339072 PreviousCanNMState_FD01_BCM 0;
BA_ "GenSigTimeoutTime_RFHM" SG_ 2654339072 PreviousCanNMState_FD01_BCM 0;
BA_ "GenSigTimeoutTime_MPAD" SG_ 2654339072 PreviousCanNMState_FD01_BCM 0;
BA_ "GenSigTimeoutTime_IPC" SG_ 2654339072 PreviousCanNMState_FD01_BCM 0;
BA_ "GenSigTimeoutTime_GNMM" SG_ 2654339072 PreviousCanNMState_FD01_BCM 0;
BA_ "GenSigTimeoutTime_EVCU2" SG_ 2654339072 PreviousCanNMState_FD01_BCM 0;
BA_ "GenSigTimeoutTime_ESL" SG_ 2654339072 PreviousCanNMState_FD01_BCM 0;
BA_ "GenSigTimeoutTime_ECM" SG_ 2654339072 PreviousCanNMState_FD01_BCM 0;
BA_ "GenSigTimeoutTime_DTCM" SG_ 2654339072 PreviousCanNMState_FD01_BCM 0;
BA_ "GenSigTimeoutTime_DMSM" SG_ 2654339072 PreviousCanNMState_FD01_BCM 0;
BA_ "GenSigTimeoutTime_BSM" SG_ 2654339072 PreviousCanNMState_FD01_BCM 0;
BA_ "GenSigTimeoutTime_BCM" SG_ 2654339072 PreviousCanNMState_FD01_BCM 0;
BA_ "GenSigTimeoutTime_AGSM" SG_ 2654339072 PreviousCanNMState_FD01_BCM 0;
BA_ "GenSigTimeoutTime_ADCAM" SG_ 2654339072 PreviousCanNMState_FD01_BCM 0;
BA_ "GenSigTimeoutTime_SGW" SG_ 2654339072 WakeupSource_FD02_BCM 0;
BA_ "GenSigTimeoutTime_RFHM" SG_ 2654339072 WakeupSource_FD02_BCM 0;
BA_ "GenSigTimeoutTime_MPAD" SG_ 2654339072 WakeupSource_FD02_BCM 0;
BA_ "GenSigTimeoutTime_IPC" SG_ 2654339072 WakeupSource_FD02_BCM 0;
BA_ "GenSigTimeoutTime_GNMM" SG_ 2654339072 WakeupSource_FD02_BCM 0;
BA_ "GenSigTimeoutTime_EVCU2" SG_ 2654339072 WakeupSource_FD02_BCM 0;
BA_ "GenSigTimeoutTime_ESL" SG_ 2654339072 WakeupSource_FD02_BCM 0;
BA_ "GenSigTimeoutTime_ECM" SG_ 2654339072 WakeupSource_FD02_BCM 0;
BA_ "GenSigTimeoutTime_DTCM" SG_ 2654339072 WakeupSource_FD02_BCM 0;
BA_ "GenSigTimeoutTime_DMSM" SG_ 2654339072 WakeupSource_FD02_BCM 0;
BA_ "GenSigTimeoutTime_BSM" SG_ 2654339072 WakeupSource_FD02_BCM 0;
BA_ "GenSigTimeoutTime_BCM" SG_ 2654339072 WakeupSource_FD02_BCM 0;
BA_ "GenSigTimeoutTime_AGSM" SG_ 2654339072 WakeupSource_FD02_BCM 0;
BA_ "GenSigTimeoutTime_ADCAM" SG_ 2654339072 WakeupSource_FD02_BCM 0;
BA_ "GenSigTimeoutTime_SGW" SG_ 2654339072 WakeupSource_FD01_BCM 0;
BA_ "GenSigTimeoutTime_RFHM" SG_ 2654339072 WakeupSource_FD01_BCM 0;
BA_ "GenSigTimeoutTime_MPAD" SG_ 2654339072 WakeupSource_FD01_BCM 0;
BA_ "GenSigTimeoutTime_IPC" SG_ 2654339072 WakeupSource_FD01_BCM 0;
BA_ "GenSigTimeoutTime_GNMM" SG_ 2654339072 WakeupSource_FD01_BCM 0;
BA_ "GenSigTimeoutTime_EVCU2" SG_ 2654339072 WakeupSource_FD01_BCM 0;
BA_ "GenSigTimeoutTime_ESL" SG_ 2654339072 WakeupSource_FD01_BCM 0;
BA_ "GenSigTimeoutTime_ECM" SG_ 2654339072 WakeupSource_FD01_BCM 0;
BA_ "GenSigTimeoutTime_DTCM" SG_ 2654339072 WakeupSource_FD01_BCM 0;
BA_ "GenSigTimeoutTime_DMSM" SG_ 2654339072 WakeupSource_FD01_BCM 0;
BA_ "GenSigTimeoutTime_BSM" SG_ 2654339072 WakeupSource_FD01_BCM 0;
BA_ "GenSigTimeoutTime_BCM" SG_ 2654339072 WakeupSource_FD01_BCM 0;
BA_ "GenSigTimeoutTime_AGSM" SG_ 2654339072 WakeupSource_FD01_BCM 0;
BA_ "GenSigTimeoutTime_ADCAM" SG_ 2654339072 WakeupSource_FD01_BCM 0;
BA_ "GenSigTimeoutTime_SGW" SG_ 2654339072 PreviousCanNMState_FD04_BCM 0;
BA_ "GenSigTimeoutTime_RFHM" SG_ 2654339072 PreviousCanNMState_FD04_BCM 0;
BA_ "GenSigTimeoutTime_MPAD" SG_ 2654339072 PreviousCanNMState_FD04_BCM 0;
BA_ "GenSigTimeoutTime_IPC" SG_ 2654339072 PreviousCanNMState_FD04_BCM 0;
BA_ "GenSigTimeoutTime_GNMM" SG_ 2654339072 PreviousCanNMState_FD04_BCM 0;
BA_ "GenSigTimeoutTime_EVCU2" SG_ 2654339072 PreviousCanNMState_FD04_BCM 0;
BA_ "GenSigTimeoutTime_ESL" SG_ 2654339072 PreviousCanNMState_FD04_BCM 0;
BA_ "GenSigTimeoutTime_ECM" SG_ 2654339072 PreviousCanNMState_FD04_BCM 0;
BA_ "GenSigTimeoutTime_DTCM" SG_ 2654339072 PreviousCanNMState_FD04_BCM 0;
BA_ "GenSigTimeoutTime_DMSM" SG_ 2654339072 PreviousCanNMState_FD04_BCM 0;
BA_ "GenSigTimeoutTime_BSM" SG_ 2654339072 PreviousCanNMState_FD04_BCM 0;
BA_ "GenSigTimeoutTime_BCM" SG_ 2654339072 PreviousCanNMState_FD04_BCM 0;
BA_ "GenSigTimeoutTime_AGSM" SG_ 2654339072 PreviousCanNMState_FD04_BCM 0;
BA_ "GenSigTimeoutTime_ADCAM" SG_ 2654339072 PreviousCanNMState_FD04_BCM 0;
BA_ "GenSigTimeoutTime_RFHM" SG_ 1443 Trailer_detection_blind_spot 0;
BA_ "GenSigTimeoutTime_MPAD" SG_ 1443 Trailer_detection_blind_spot 0;
BA_ "GenSigTimeoutTime_IPC" SG_ 1443 Trailer_detection_blind_spot 0;
BA_ "GenSigTimeoutTime_GNMM" SG_ 1443 Trailer_detection_blind_spot 0;
BA_ "GenSigTimeoutTime_EVCU2" SG_ 1443 Trailer_detection_blind_spot 0;
BA_ "GenSigTimeoutTime_ESL" SG_ 1443 Trailer_detection_blind_spot 0;
BA_ "GenSigTimeoutTime_ECM" SG_ 1443 Trailer_detection_blind_spot 0;
BA_ "GenSigTimeoutTime_DTCM" SG_ 1443 Trailer_detection_blind_spot 0;
BA_ "GenSigTimeoutTime_DMSM" SG_ 1443 Trailer_detection_blind_spot 0;
BA_ "GenSigTimeoutTime_BSM" SG_ 1443 Trailer_detection_blind_spot 0;
BA_ "GenSigTimeoutTime_AGSM" SG_ 1443 Trailer_detection_blind_spot 0;
BA_ "GenSigSendType" SG_ 1443 Trailer_detection_blind_spot 3;
BA_ "GenSigTimeoutTime_SGW" SG_ 1443 MessageCounter_IPCVS1 0;
BA_ "GenSigTimeoutTime_RFHM" SG_ 1443 MessageCounter_IPCVS1 0;
BA_ "GenSigTimeoutTime_IPC" SG_ 1443 MessageCounter_IPCVS1 0;
BA_ "GenSigTimeoutTime_GNMM" SG_ 1443 MessageCounter_IPCVS1 0;
BA_ "GenSigTimeoutTime_EVCU2" SG_ 1443 MessageCounter_IPCVS1 0;
BA_ "GenSigTimeoutTime_ESL" SG_ 1443 MessageCounter_IPCVS1 0;
BA_ "GenSigTimeoutTime_ECM" SG_ 1443 MessageCounter_IPCVS1 0;
BA_ "GenSigTimeoutTime_DTCM" SG_ 1443 MessageCounter_IPCVS1 0;
BA_ "GenSigTimeoutTime_DMSM" SG_ 1443 MessageCounter_IPCVS1 0;
BA_ "GenSigTimeoutTime_BSM" SG_ 1443 MessageCounter_IPCVS1 0;
BA_ "GenSigTimeoutTime_AGSM" SG_ 1443 MessageCounter_IPCVS1 0;
BA_ "GenSigTimeoutTime_SGW" SG_ 1443 CRC_IPCVS1 0;
BA_ "GenSigTimeoutTime_RFHM" SG_ 1443 CRC_IPCVS1 0;
BA_ "GenSigTimeoutTime_IPC" SG_ 1443 CRC_IPCVS1 0;
BA_ "GenSigTimeoutTime_GNMM" SG_ 1443 CRC_IPCVS1 0;
BA_ "GenSigTimeoutTime_EVCU2" SG_ 1443 CRC_IPCVS1 0;
BA_ "GenSigTimeoutTime_ESL" SG_ 1443 CRC_IPCVS1 0;
BA_ "GenSigTimeoutTime_ECM" SG_ 1443 CRC_IPCVS1 0;
BA_ "GenSigTimeoutTime_DTCM" SG_ 1443 CRC_IPCVS1 0;
BA_ "GenSigTimeoutTime_DMSM" SG_ 1443 CRC_IPCVS1 0;
BA_ "GenSigTimeoutTime_BSM" SG_ 1443 CRC_IPCVS1 0;
BA_ "GenSigTimeoutTime_AGSM" SG_ 1443 CRC_IPCVS1 0;
BA_ "GenSigTimeoutTime_SGW" SG_ 1443 FOA_AppAlert_Disable_UserReq 0;
BA_ "GenSigTimeoutTime_RFHM" SG_ 1443 FOA_AppAlert_Disable_UserReq 0;
BA_ "GenSigTimeoutTime_MPAD" SG_ 1443 FOA_AppAlert_Disable_UserReq 0;
BA_ "GenSigTimeoutTime_IPC" SG_ 1443 FOA_AppAlert_Disable_UserReq 0;
BA_ "GenSigTimeoutTime_GNMM" SG_ 1443 FOA_AppAlert_Disable_UserReq 0;
BA_ "GenSigTimeoutTime_EVCU2" SG_ 1443 FOA_AppAlert_Disable_UserReq 0;
BA_ "GenSigTimeoutTime_ESL" SG_ 1443 FOA_AppAlert_Disable_UserReq 0;
BA_ "GenSigTimeoutTime_ECM" SG_ 1443 FOA_AppAlert_Disable_UserReq 0;
BA_ "GenSigTimeoutTime_DTCM" SG_ 1443 FOA_AppAlert_Disable_UserReq 0;
BA_ "GenSigTimeoutTime_DMSM" SG_ 1443 FOA_AppAlert_Disable_UserReq 0;
BA_ "GenSigTimeoutTime_BSM" SG_ 1443 FOA_AppAlert_Disable_UserReq 0;
BA_ "GenSigTimeoutTime_AGSM" SG_ 1443 FOA_AppAlert_Disable_UserReq 0;
BA_ "GenSigTimeoutTime_ADCAM" SG_ 1443 FOA_AppAlert_Disable_UserReq 0;
BA_ "GenSigSendType" SG_ 1443 FOA_AppAlert_Disable_UserReq 3;
BA_ "GenSigTimeoutTime_RFHM" SG_ 1443 Drowsy_Driver_Alert 0;
BA_ "GenSigTimeoutTime_MPAD" SG_ 1443 Drowsy_Driver_Alert 0;
BA_ "GenSigTimeoutTime_IPC" SG_ 1443 Drowsy_Driver_Alert 0;
BA_ "GenSigTimeoutTime_GNMM" SG_ 1443 Drowsy_Driver_Alert 0;
BA_ "GenSigTimeoutTime_EVCU2" SG_ 1443 Drowsy_Driver_Alert 0;
BA_ "GenSigTimeoutTime_ESL" SG_ 1443 Drowsy_Driver_Alert 0;
BA_ "GenSigTimeoutTime_ECM" SG_ 1443 Drowsy_Driver_Alert 0;
BA_ "GenSigTimeoutTime_DTCM" SG_ 1443 Drowsy_Driver_Alert 0;
BA_ "GenSigTimeoutTime_DMSM" SG_ 1443 Drowsy_Driver_Alert 0;
BA_ "GenSigTimeoutTime_BSM" SG_ 1443 Drowsy_Driver_Alert 0;
BA_ "GenSigTimeoutTime_AGSM" SG_ 1443 Drowsy_Driver_Alert 0;
BA_ "GenSigSendType" SG_ 1443 Drowsy_Driver_Alert 3;
BA_ "GenSigTimeoutTime_RFHM" SG_ 1443 Active_Park_Prox_Chime 0;
BA_ "GenSigTimeoutTime_MPAD" SG_ 1443 Active_Park_Prox_Chime 0;
BA_ "GenSigTimeoutTime_IPC" SG_ 1443 Active_Park_Prox_Chime 0;
BA_ "GenSigTimeoutTime_GNMM" SG_ 1443 Active_Park_Prox_Chime 0;
BA_ "GenSigTimeoutTime_EVCU2" SG_ 1443 Active_Park_Prox_Chime 0;
BA_ "GenSigTimeoutTime_ESL" SG_ 1443 Active_Park_Prox_Chime 0;
BA_ "GenSigTimeoutTime_ECM" SG_ 1443 Active_Park_Prox_Chime 0;
BA_ "GenSigTimeoutTime_DTCM" SG_ 1443 Active_Park_Prox_Chime 0;
BA_ "GenSigTimeoutTime_DMSM" SG_ 1443 Active_Park_Prox_Chime 0;
BA_ "GenSigTimeoutTime_BSM" SG_ 1443 Active_Park_Prox_Chime 0;
BA_ "GenSigTimeoutTime_DMSM" SG_ 2654339184 PreviousCanNMState_FD02_SGW 0;
BA_ "GenSigTimeoutTime_BSM" SG_ 2654339184 PreviousCanNMState_FD02_SGW 0;
BA_ "GenSigTimeoutTime_BCM" SG_ 2654339184 PreviousCanNMState_FD02_SGW 0;
BA_ "GenSigTimeoutTime_AGSM" SG_ 2654339184 PreviousCanNMState_FD02_SGW 0;
BA_ "GenSigTimeoutTime_ADCAM" SG_ 2654339184 PreviousCanNMState_FD02_SGW 0;
BA_ "GenSigTimeoutTime_SGW" SG_ 2654339184 PreviousCanNMState_FD01_SGW 0;
BA_ "GenSigTimeoutTime_RFHM" SG_ 2654339184 PreviousCanNMState_FD01_SGW 0;
BA_ "GenSigTimeoutTime_MPAD" SG_ 2654339184 PreviousCanNMState_FD01_SGW 0;
BA_ "GenSigTimeoutTime_IPC" SG_ 2654339184 PreviousCanNMState_FD01_SGW 0;
BA_ "GenSigTimeoutTime_GNMM" SG_ 2654339184 PreviousCanNMState_FD01_SGW 0;
BA_ "GenSigTimeoutTime_EVCU2" SG_ 2654339184 PreviousCanNMState_FD01_SGW 0;
BA_ "GenSigTimeoutTime_ESL" SG_ 2654339184 PreviousCanNMState_FD01_SGW 0;
BA_ "GenSigTimeoutTime_ECM" SG_ 2654339184 PreviousCanNMState_FD01_SGW 0;
BA_ "GenSigTimeoutTime_DTCM" SG_ 2654339184 PreviousCanNMState_FD01_SGW 0;
BA_ "GenSigTimeoutTime_DMSM" SG_ 2654339184 PreviousCanNMState_FD01_SGW 0;
BA_ "GenSigTimeoutTime_BSM" SG_ 2654339184 PreviousCanNMState_FD01_SGW 0;
BA_ "GenSigTimeoutTime_BCM" SG_ 2654339184 PreviousCanNMState_FD01_SGW 0;
BA_ "GenSigTimeoutTime_AGSM" SG_ 2654339184 PreviousCanNMState_FD01_SGW 0;
BA_ "GenSigTimeoutTime_ADCAM" SG_ 2654339184 PreviousCanNMState_FD01_SGW 0;
BA_ "GenSigTimeoutTime_SGW" SG_ 2654339184 DES_FD11_SGW 0;
BA_ "GenSigTimeoutTime_RFHM" SG_ 2654339184 DES_FD11_SGW 0;
BA_ "GenSigTimeoutTime_MPAD" SG_ 2654339184 DES_FD11_SGW 0;
BA_ "GenSigTimeoutTime_IPC" SG_ 2654339184 DES_FD11_SGW 0;
BA_ "GenSigTimeoutTime_GNMM" SG_ 2654339184 DES_FD11_SGW 0;
BA_ "GenSigTimeoutTime_EVCU2" SG_ 2654339184 DES_FD11_SGW 0;
BA_ "GenSigTimeoutTime_ESL" SG_ 2654339184 DES_FD11_SGW 0;
BA_ "GenSigTimeoutTime_ECM" SG_ 2654339184 DES_FD11_SGW 0;
BA_ "GenSigTimeoutTime_DTCM" SG_ 2654339184 DES_FD11_SGW 0;
BA_ "GenSigTimeoutTime_DMSM" SG_ 2654339184 DES_FD11_SGW 0;
BA_ "GenSigTimeoutTime_BSM" SG_ 2654339184 DES_FD11_SGW 0;
BA_ "GenSigTimeoutTime_BCM" SG_ 2654339184 DES_FD11_SGW 0;
BA_ "GenSigTimeoutTime_AGSM" SG_ 2654339184 DES_FD11_SGW 0;
BA_ "GenSigTimeoutTime_ADCAM" SG_ 2654339184 DES_FD11_SGW 0;
BA_ "GenSigTimeoutTime_MPAD" SG_ 1443 Proximity_WU 0;
BA_ "GenSigTimeoutTime_IPC" SG_ 1443 Proximity_WU 0;
BA_ "GenSigTimeoutTime_GNMM" SG_ 1443 Proximity_WU 0;
BA_ "GenSigTimeoutTime_EVCU2" SG_ 1443 Proximity_WU 0;
BA_ "GenSigTimeoutTime_ESL" SG_ 1443 Proximity_WU 0;
BA_ "GenSigTimeoutTime_ECM" SG_ 1443 Proximity_WU 0;
BA_ "GenSigTimeoutTime_DTCM" SG_ 1443 Proximity_WU 0;
BA_ "GenSigTimeoutTime_DMSM" SG_ 1443 Proximity_WU 0;
BA_ "GenSigTimeoutTime_BSM" SG_ 1443 Proximity_WU 0;
BA_ "GenSigTimeoutTime_AGSM" SG_ 1443 Proximity_WU 0;
BA_ "GenSigTimeoutTime_ADCAM" SG_ 1443 Proximity_WU 0;
BA_ "GenSigSendType" SG_ 1443 Proximity_WU 3;
BA_ "GenSigTimeoutTime_MPAD" SG_ 1443 Spaak 0;
BA_ "GenSigTimeoutTime_IPC" SG_ 1443 Spaak 0;
BA_ "GenSigTimeoutTime_GNMM" SG_ 1443 Spaak 0;
BA_ "GenSigTimeoutTime_EVCU2" SG_ 1443 Spaak 0;
BA_ "GenSigTimeoutTime_ESL" SG_ 1443 Spaak 0;
BA_ "GenSigTimeoutTime_ECM" SG_ 1443 Spaak 0;
BA_ "GenSigTimeoutTime_DTCM" SG_ 1443 Spaak 0;
BA_ "GenSigTimeoutTime_DMSM" SG_ 1443 Spaak 0;
BA_ "GenSigTimeoutTime_BSM" SG_ 1443 Spaak 0;
BA_ "GenSigTimeoutTime_AGSM" SG_ 1443 Spaak 0;
BA_ "GenSigTimeoutTime_ADCAM" SG_ 1443 Spaak 0;
BA_ "GenSigSendType" SG_ 1443 Spaak 3;
BA_ "GenSigTimeoutTime_RFHM" SG_ 1443 SOC_Max_Lev 0;
BA_ "GenSigTimeoutTime_MPAD" SG_ 1443 SOC_Max_Lev 0;
BA_ "GenSigTimeoutTime_IPC" SG_ 1443 SOC_Max_Lev 0;
BA_ "GenSigTimeoutTime_GNMM" SG_ 1443 SOC_Max_Lev 0;
BA_ "GenSigTimeoutTime_ESL" SG_ 1443 SOC_Max_Lev 0;
BA_ "GenSigTimeoutTime_ECM" SG_ 1443 SOC_Max_Lev 0;
BA_ "GenSigTimeoutTime_DTCM" SG_ 1443 SOC_Max_Lev 0;
BA_ "GenSigTimeoutTime_DMSM" SG_ 1443 SOC_Max_Lev 0;
BA_ "GenSigTimeoutTime_BSM" SG_ 1443 SOC_Max_Lev 0;
BA_ "GenSigTimeoutTime_AGSM" SG_ 1443 SOC_Max_Lev 0;
BA_ "GenSigTimeoutTime_ADCAM" SG_ 1443 SOC_Max_Lev 0;
BA_ "GenSigSendType" SG_ 1443 SOC_Max_Lev 3;
BA_ "GenSigTimeoutTime_RFHM" SG_ 1443 StaticGrid 0;
BA_ "GenSigTimeoutTime_MPAD" SG_ 1443 StaticGrid 0;
BA_ "GenSigTimeoutTime_IPC" SG_ 1443 StaticGrid 0;
BA_ "GenSigTimeoutTime_GNMM" SG_ 1443 StaticGrid 0;
BA_ "GenSigTimeoutTime_EVCU2" SG_ 1443 StaticGrid 0;
BA_ "GenSigTimeoutTime_ESL" SG_ 1443 StaticGrid 0;
BA_ "GenSigTimeoutTime_ECM" SG_ 1443 StaticGrid 0;
BA_ "GenSigTimeoutTime_DTCM" SG_ 1443 StaticGrid 0;
BA_ "GenSigTimeoutTime_DMSM" SG_ 1443 StaticGrid 0;
BA_ "GenSigTimeoutTime_BSM" SG_ 1443 StaticGrid 0;
BA_ "GenSigTimeoutTime_AGSM" SG_ 1443 StaticGrid 0;
BA_ "GenSigTimeoutTime_ADCAM" SG_ 1443 StaticGrid 0;
BA_ "GenSigSendType" SG_ 1443 StaticGrid 1;
BA_ "GenSigTimeoutTime_RFHM" SG_ 1443 PwrLev 0;
BA_ "GenSigTimeoutTime_MPAD" SG_ 1443 PwrLev 0;
BA_ "GenSigTimeoutTime_IPC" SG_ 1443 PwrLev 0;
BA_ "GenSigTimeoutTime_GNMM" SG_ 1443 PwrLev 0;
BA_ "GenSigTimeoutTime_ESL" SG_ 1443 PwrLev 0;
BA_ "GenSigTimeoutTime_ECM" SG_ 1443 PwrLev 0;
BA_ "GenSigTimeoutTime_DTCM" SG_ 1443 PwrLev 0;
BA_ "GenSigTimeoutTime_DMSM" SG_ 1443 PwrLev 0;
BA_ "GenSigTimeoutTime_BSM" SG_ 1443 PwrLev 0;
BA_ "GenSigTimeoutTime_AGSM" SG_ 1443 PwrLev 0;
BA_ "GenSigTimeoutTime_ADCAM" SG_ 1443 PwrLev 0;
BA_ "GenSigSendType" SG_ 1443 PwrLev 3;
BA_ "GenSigStartValue" SG_ 1443 PwrLev 2;
BA_ "GenSigTimeoutTime_SGW" SG_ 2654339072 GenericFailSts_FD04_BCM 0;
BA_ "GenSigTimeoutTime_RFHM" SG_ 2654339072 GenericFailSts_FD04_BCM 0;
BA_ "GenSigTimeoutTime_MPAD" SG_ 2654339072 GenericFailSts_FD04_BCM 0;
BA_ "GenSigTimeoutTime_IPC" SG_ 2654339072 GenericFailSts_FD04_BCM 0;
BA_ "GenSigTimeoutTime_GNMM" SG_ 2654339072 GenericFailSts_FD04_BCM 0;
BA_ "GenSigTimeoutTime_EVCU2" SG_ 2654339072 GenericFailSts_FD04_BCM 0;
BA_ "GenSigTimeoutTime_ESL" SG_ 2654339072 GenericFailSts_FD04_BCM 0;
BA_ "GenSigTimeoutTime_ECM" SG_ 2654339072 GenericFailSts_FD04_BCM 0;
BA_ "GenSigTimeoutTime_DTCM" SG_ 2654339072 GenericFailSts_FD04_BCM 0;
BA_ "GenSigTimeoutTime_DMSM" SG_ 2654339072 GenericFailSts_FD04_BCM 0;
BA_ "GenSigTimeoutTime_BSM" SG_ 2654339072 GenericFailSts_FD04_BCM 0;
BA_ "GenSigTimeoutTime_BCM" SG_ 2654339072 GenericFailSts_FD04_BCM 0;
BA_ "GenSigTimeoutTime_AGSM" SG_ 2654339072 GenericFailSts_FD04_BCM 0;
BA_ "GenSigTimeoutTime_ADCAM" SG_ 2654339072 GenericFailSts_FD04_BCM 0;
BA_ "GenSigTimeoutTime_SGW" SG_ 2654339072 GenericFailSts_FD03_BCM 0;
BA_ "GenSigTimeoutTime_RFHM" SG_ 2654339072 GenericFailSts_FD03_BCM 0;
BA_ "GenSigTimeoutTime_MPAD" SG_ 2654339072 GenericFailSts_FD03_BCM 0;
BA_ "GenSigTimeoutTime_IPC" SG_ 2654339072 GenericFailSts_FD03_BCM 0;
BA_ "GenSigTimeoutTime_GNMM" SG_ 2654339072 GenericFailSts_FD03_BCM 0;
BA_ "GenSigTimeoutTime_EVCU2" SG_ 2654339072 GenericFailSts_FD03_BCM 0;
BA_ "GenSigTimeoutTime_ESL" SG_ 2654339072 GenericFailSts_FD03_BCM 0;
BA_ "GenSigTimeoutTime_ECM" SG_ 2654339072 GenericFailSts_FD03_BCM 0;
BA_ "GenSigTimeoutTime_DTCM" SG_ 2654339072 GenericFailSts_FD03_BCM 0;
BA_ "GenSigTimeoutTime_DMSM" SG_ 2654339072 GenericFailSts_FD03_BCM 0;
BA_ "GenSigTimeoutTime_BSM" SG_ 2654339072 GenericFailSts_FD03_BCM 0;
BA_ "GenSigTimeoutTime_BCM" SG_ 2654339072 GenericFailSts_FD03_BCM 0;
BA_ "GenSigTimeoutTime_AGSM" SG_ 2654339072 GenericFailSts_FD03_BCM 0;
BA_ "GenSigTimeoutTime_ADCAM" SG_ 2654339072 GenericFailSts_FD03_BCM 0;
BA_ "GenSigTimeoutTime_SGW" SG_ 2654339072 EOL_FD04_BCM 0;
BA_ "GenSigTimeoutTime_RFHM" SG_ 2654339072 EOL_FD04_BCM 0;
BA_ "GenSigTimeoutTime_MPAD" SG_ 2654339072 EOL_FD04_BCM 0;
BA_ "GenSigTimeoutTime_IPC" SG_ 2654339072 EOL_FD04_BCM 0;
BA_ "GenSigTimeoutTime_GNMM" SG_ 2654339072 EOL_FD04_BCM 0;
BA_ "GenSigTimeoutTime_EVCU2" SG_ 2654339072 EOL_FD04_BCM 0;
BA_ "GenSigTimeoutTime_ESL" SG_ 2654339072 EOL_FD04_BCM 0;
BA_ "GenSigTimeoutTime_ECM" SG_ 2654339072 EOL_FD04_BCM 0;
BA_ "GenSigTimeoutTime_DTCM" SG_ 2654339072 EOL_FD04_BCM 0;
BA_ "GenSigTimeoutTime_DMSM" SG_ 2654339072 EOL_FD04_BCM 0;
BA_ "GenSigTimeoutTime_GNMM" SG_ 2654339072 GenericFailSts_FD02_BCM 0;
BA_ "GenSigTimeoutTime_EVCU2" SG_ 2654339072 GenericFailSts_FD02_BCM 0;
BA_ "GenSigTimeoutTime_ESL" SG_ 2654339072 GenericFailSts_FD02_BCM 0;
BA_ "GenSigTimeoutTime_ECM" SG_ 2654339072 GenericFailSts_FD02_BCM 0;
BA_ "GenSigTimeoutTime_DTCM" SG_ 2654339072 GenericFailSts_FD02_BCM 0;
BA_ "GenSigTimeoutTime_DMSM" SG_ 2654339072 GenericFailSts_FD02_BCM 0;
BA_ "GenSigTimeoutTime_BSM" SG_ 2654339072 GenericFailSts_FD02_BCM 0;
BA_ "GenSigTimeoutTime_BCM" SG_ 2654339072 GenericFailSts_FD02_BCM 0;
BA_ "GenSigTimeoutTime_AGSM" SG_ 2654339072 GenericFailSts_FD02_BCM 0;
BA_ "GenSigTimeoutTime_ADCAM" SG_ 2654339072 GenericFailSts_FD02_BCM 0;
BA_ "GenSigTimeoutTime_SGW" SG_ 2654339072 GenericFailSts_FD02_BCM 0;
BA_ "GenSigTimeoutTime_RFHM" SG_ 2654339072 GenericFailSts_FD02_BCM 0;
BA_ "GenSigTimeoutTime_MPAD" SG_ 2654339072 GenericFailSts_FD02_BCM 0;
BA_ "GenSigTimeoutTime_IPC" SG_ 2654339072 GenericFailSts_FD02_BCM 0;
BA_ "GenSigTimeoutTime_SGW" SG_ 2654339072 GenericFailSts_FD01_BCM 0;
BA_ "GenSigTimeoutTime_RFHM" SG_ 2654339072 GenericFailSts_FD01_BCM 0;
BA_ "GenSigTimeoutTime_MPAD" SG_ 2654339072 GenericFailSts_FD01_BCM 0;
BA_ "GenSigTimeoutTime_IPC" SG_ 2654339072 GenericFailSts_FD01_BCM 0;
BA_ "GenSigTimeoutTime_GNMM" SG_ 2654339072 GenericFailSts_FD01_BCM 0;
BA_ "GenSigTimeoutTime_EVCU2" SG_ 2654339072 GenericFailSts_FD01_BCM 0;
BA_ "GenSigTimeoutTime_ESL" SG_ 2654339072 GenericFailSts_FD01_BCM 0;
BA_ "GenSigTimeoutTime_ECM" SG_ 2654339072 GenericFailSts_FD01_BCM 0;
BA_ "GenSigTimeoutTime_DTCM" SG_ 2654339072 GenericFailSts_FD01_BCM 0;
BA_ "GenSigTimeoutTime_DMSM" SG_ 2654339072 GenericFailSts_FD01_BCM 0;
BA_ "GenSigTimeoutTime_BSM" SG_ 2654339072 GenericFailSts_FD01_BCM 0;
BA_ "GenSigTimeoutTime_BCM" SG_ 2654339072 GenericFailSts_FD01_BCM 0;
BA_ "GenSigTimeoutTime_AGSM" SG_ 2654339072 GenericFailSts_FD01_BCM 0;
BA_ "GenSigTimeoutTime_ADCAM" SG_ 2654339072 GenericFailSts_FD01_BCM 0;
BA_ "GenSigTimeoutTime_RFHM" SG_ 1443 Windows_With_Fob 0;
BA_ "GenSigTimeoutTime_MPAD" SG_ 1443 Windows_With_Fob 0;
BA_ "GenSigTimeoutTime_IPC" SG_ 1443 Windows_With_Fob 0;
BA_ "GenSigTimeoutTime_GNMM" SG_ 1443 Windows_With_Fob 0;
BA_ "GenSigTimeoutTime_EVCU2" SG_ 1443 Windows_With_Fob 0;
BA_ "GenSigTimeoutTime_ESL" SG_ 1443 Windows_With_Fob 0;
BA_ "GenSigTimeoutTime_ECM" SG_ 1443 Windows_With_Fob 0;
BA_ "GenSigTimeoutTime_DTCM" SG_ 1443 Windows_With_Fob 0;
BA_ "GenSigTimeoutTime_DMSM" SG_ 1443 Windows_With_Fob 0;
BA_ "GenSigTimeoutTime_BSM" SG_ 1443 Windows_With_Fob 0;
BA_ "GenSigTimeoutTime_AGSM" SG_ 1443 Windows_With_Fob 0;
BA_ "GenSigTimeoutTime_ADCAM" SG_ 1443 Windows_With_Fob 0;
BA_ "GenSigSendType" SG_ 1443 Windows_With_Fob 3;
BA_ "GenSigTimeoutTime_RFHM" SG_ 1443 TyrePress_Unit 0;
BA_ "GenSigTimeoutTime_MPAD" SG_ 1443 TyrePress_Unit 0;
BA_ "GenSigTimeoutTime_IPC" SG_ 1443 TyrePress_Unit 0;
BA_ "GenSigTimeoutTime_GNMM" SG_ 1443 TyrePress_Unit 0;
BA_ "GenSigTimeoutTime_EVCU2" SG_ 1443 TyrePress_Unit 0;
BA_ "GenSigTimeoutTime_ESL" SG_ 1443 TyrePress_Unit 0;
BA_ "GenSigTimeoutTime_ECM" SG_ 1443 TyrePress_Unit 0;
BA_ "GenSigTimeoutTime_DTCM" SG_ 1443 TyrePress_Unit 0;
BA_ "GenSigTimeoutTime_DMSM" SG_ 1443 TyrePress_Unit 0;
BA_ "GenSigTimeoutTime_BSM" SG_ 1443 TyrePress_Unit 0;
BA_ "GenSigTimeoutTime_AGSM" SG_ 1443 TyrePress_Unit 0;
BA_ "GenSigTimeoutTime_ADCAM" SG_ 1443 TyrePress_Unit 0;
BA_ "GenSigSendType" SG_ 1443 TyrePress_Unit 3;
BA_ "GenSigTimeoutTime_RFHM" SG_ 1443 Traffic_Sign_Warn 0;
BA_ "GenSigTimeoutTime_MPAD" SG_ 1443 Traffic_Sign_Warn 0;
BA_ "GenSigTimeoutTime_IPC" SG_ 1443 Traffic_Sign_Warn 0;
BA_ "GenSigTimeoutTime_GNMM" SG_ 1443 Traffic_Sign_Warn 0;
BA_ "GenSigTimeoutTime_EVCU2" SG_ 1443 Traffic_Sign_Warn 0;
BA_ "GenSigTimeoutTime_ESL" SG_ 1443 Traffic_Sign_Warn 0;
BA_ "GenSigTimeoutTime_ECM" SG_ 1443 Traffic_Sign_Warn 0;
BA_ "GenSigTimeoutTime_DTCM" SG_ 1443 Traffic_Sign_Warn 0;
BA_ "GenSigTimeoutTime_DMSM" SG_ 1443 Traffic_Sign_Warn 0;
BA_ "GenSigTimeoutTime_BSM" SG_ 1443 Traffic_Sign_Warn 0;
BA_ "GenSigTimeoutTime_AGSM" SG_ 1443 Traffic_Sign_Warn 0;
BA_ "GenSigTimeoutTime_ADCAM" SG_ 1443 Traffic_Sign_Warn 0;
BA_ "GenSigSendType" SG_ 1443 Traffic_Sign_Warn 3;
BA_ "GenSigTimeoutTime_RFHM" SG_ 1443 Temp_Unit 0;
BA_ "GenSigTimeoutTime_MPAD" SG_ 1443 Temp_Unit 0;
BA_ "GenSigTimeoutTime_IPC" SG_ 1443 Temp_Unit 0;
BA_ "GenSigTimeoutTime_GNMM" SG_ 1443 Temp_Unit 0;
BA_ "GenSigTimeoutTime_EVCU2" SG_ 1443 Temp_Unit 0;
BA_ "GenSigTimeoutTime_ESL" SG_ 1443 Temp_Unit 0;
BA_ "GenSigTimeoutTime_ECM" SG_ 1443 Temp_Unit 0;
BA_ "GenSigTimeoutTime_DTCM" SG_ 1443 Temp_Unit 0;
BA_ "GenSigTimeoutTime_DMSM" SG_ 1443 Temp_Unit 0;
BA_ "GenSigTimeoutTime_BSM" SG_ 1443 Temp_Unit 0;
BA_ "GenSigTimeoutTime_AGSM" SG_ 1443 Temp_Unit 0;
BA_ "GenSigTimeoutTime_ADCAM" SG_ 1443 Temp_Unit 0;
BA_ "GenSigSendType" SG_ 1443 Temp_Unit 3;
BA_ "GenSigTimeoutTime_RFHM" SG_ 1443 Tilt_Mirr_Rev 0;
BA_ "GenSigTimeoutTime_MPAD" SG_ 1443 Tilt_Mirr_Rev 0;
BA_ "GenSigTimeoutTime_IPC" SG_ 1443 Tilt_Mirr_Rev 0;
BA_ "GenSigTimeoutTime_GNMM" SG_ 1443 Tilt_Mirr_Rev 0;
BA_ "GenSigTimeoutTime_EVCU2" SG_ 1443 Tilt_Mirr_Rev 0;
BA_ "GenSigTimeoutTime_ESL" SG_ 1443 Tilt_Mirr_Rev 0;
BA_ "GenSigTimeoutTime_ECM" SG_ 1443 Tilt_Mirr_Rev 0;
BA_ "GenSigTimeoutTime_DTCM" SG_ 1443 Tilt_Mirr_Rev 0;
BA_ "GenSigTimeoutTime_DMSM" SG_ 1443 Tilt_Mirr_Rev 0;
BA_ "GenSigTimeoutTime_BSM" SG_ 1443 Tilt_Mirr_Rev 0;
BA_ "GenSigTimeoutTime_AGSM" SG_ 1443 Tilt_Mirr_Rev 0;
BA_ "GenSigTimeoutTime_ADCAM" SG_ 1443 Tilt_Mirr_Rev 0;
BA_ "GenSigSendType" SG_ 1443 Tilt_Mirr_Rev 3;
BA_ "GenSigTimeoutTime_RFHM" SG_ 1443 Torque_Unit 0;
BA_ "GenSigTimeoutTime_MPAD" SG_ 1443 Torque_Unit 0;
BA_ "GenSigTimeoutTime_IPC" SG_ 1443 Torque_Unit 0;
BA_ "GenSigTimeoutTime_GNMM" SG_ 1443 Torque_Unit 0;
BA_ "GenSigTimeoutTime_EVCU2" SG_ 1443 Torque_Unit 0;
BA_ "GenSigTimeoutTime_ESL" SG_ 1443 Torque_Unit 0;
BA_ "GenSigTimeoutTime_ECM" SG_ 1443 Torque_Unit 0;
BA_ "GenSigTimeoutTime_DTCM" SG_ 1443 Torque_Unit 0;
BA_ "GenSigTimeoutTime_DMSM" SG_ 1443 Torque_Unit 0;
BA_ "GenSigTimeoutTime_BSM" SG_ 1443 Torque_Unit 0;
BA_ "GenSigTimeoutTime_AGSM" SG_ 1443 Torque_Unit 0;
BA_ "GenSigTimeoutTime_ADCAM" SG_ 1443 Torque_Unit 0;
BA_ "GenSigSendType" SG_ 1443 Torque_Unit 3;
BA_ "GenSigTimeoutTime_RFHM" SG_ 1443 Traffic_Sign_Info 0;
BA_ "GenSigTimeoutTime_IPC" SG_ 1443 Traffic_Sign_Info 0;
BA_ "GenSigTimeoutTime_GNMM" SG_ 1443 Traffic_Sign_Info 0;
BA_ "GenSigTimeoutTime_ESL" SG_ 1443 Traffic_Sign_Info 0;
BA_ "GenSigTimeoutTime_ECM" SG_ 1443 Traffic_Sign_Info 0;
BA_ "GenSigTimeoutTime_DTCM" SG_ 1443 Traffic_Sign_Info 0;
BA_ "GenSigTimeoutTime_DMSM" SG_ 1443 Traffic_Sign_Info 0;
BA_ "GenSigTimeoutTime_BSM" SG_ 1443 Traffic_Sign_Info 0;
BA_ "GenSigTimeoutTime_AGSM" SG_ 1443 Traffic_Sign_Info 0;
BA_ "GenSigSendType" SG_ 1443 Traffic_Sign_Info 3;
BA_ "GenSigTimeoutTime_GNMM" SG_ 1443 Tire_Fill_Alert 0;
BA_ "GenSigTimeoutTime_EVCU2" SG_ 1443 Tire_Fill_Alert 0;
BA_ "GenSigTimeoutTime_ESL" SG_ 1443 Tire_Fill_Alert 0;
BA_ "GenSigTimeoutTime_ECM" SG_ 1443 Tire_Fill_Alert 0;
BA_ "GenSigTimeoutTime_DTCM" SG_ 1443 Tire_Fill_Alert 0;
BA_ "GenSigTimeoutTime_DMSM" SG_ 1443 Tire_Fill_Alert 0;
BA_ "GenSigTimeoutTime_BSM" SG_ 1443 Tire_Fill_Alert 0;
BA_ "GenSigTimeoutTime_AGSM" SG_ 1443 Tire_Fill_Alert 0;
BA_ "GenSigTimeoutTime_ADCAM" SG_ 1443 Tire_Fill_Alert 0;
BA_ "GenSigSendType" SG_ 1443 Tire_Fill_Alert 3;
BA_ "GenSigTimeoutTime_MPAD" SG_ 1443 Tire_Fill_Alert 0;
BA_ "GenSigTimeoutTime_IPC" SG_ 1443 Tire_Fill_Alert 0;
BA_ "GenSigTimeoutTime_MPAD" SG_ 1443 PassiveEntry 0;
BA_ "GenSigTimeoutTime_IPC" SG_ 1443 PassiveEntry 0;
BA_ "GenSigTimeoutTime_GNMM" SG_ 1443 PassiveEntry 0;
BA_ "GenSigTimeoutTime_EVCU2" SG_ 1443 PassiveEntry 0;
BA_ "GenSigTimeoutTime_ESL" SG_ 1443 PassiveEntry 0;
BA_ "GenSigTimeoutTime_ECM" SG_ 1443 PassiveEntry 0;
BA_ "GenSigTimeoutTime_DTCM" SG_ 1443 PassiveEntry 0;
BA_ "GenSigTimeoutTime_DMSM" SG_ 1443 PassiveEntry 0;
BA_ "GenSigTimeoutTime_BSM" SG_ 1443 PassiveEntry 0;
BA_ "GenSigTimeoutTime_AGSM" SG_ 1443 PassiveEntry 0;
BA_ "GenSigTimeoutTime_ADCAM" SG_ 1443 PassiveEntry 0;
BA_ "GenSigSendType" SG_ 1443 PassiveEntry 3;
BA_ "GenSigTimeoutTime_RFHM" SG_ 1443 Ped_EM_Brk_Warn_Act 0;
BA_ "GenSigTimeoutTime_MPAD" SG_ 1443 Ped_EM_Brk_Warn_Act 0;
BA_ "GenSigTimeoutTime_IPC" SG_ 1443 Ped_EM_Brk_Warn_Act 0;
BA_ "GenSigTimeoutTime_GNMM" SG_ 1443 Ped_EM_Brk_Warn_Act 0;
BA_ "GenSigTimeoutTime_EVCU2" SG_ 1443 Ped_EM_Brk_Warn_Act 0;
BA_ "GenSigTimeoutTime_ESL" SG_ 1443 Ped_EM_Brk_Warn_Act 0;
BA_ "GenSigTimeoutTime_ECM" SG_ 1443 Ped_EM_Brk_Warn_Act 0;
BA_ "GenSigTimeoutTime_DTCM" SG_ 1443 Ped_EM_Brk_Warn_Act 0;
BA_ "GenSigTimeoutTime_DMSM" SG_ 1443 Ped_EM_Brk_Warn_Act 0;
BA_ "GenSigTimeoutTime_BSM" SG_ 1443 Ped_EM_Brk_Warn_Act 0;
BA_ "GenSigTimeoutTime_AGSM" SG_ 1443 Ped_EM_Brk_Warn_Act 0;
BA_ "GenSigTimeoutTime_ADCAM" SG_ 1443 Ped_EM_Brk_Warn_Act 0;
BA_ "GenSigSendType" SG_ 1443 Ped_EM_Brk_Warn_Act 3;
BA_ "GenSigTimeoutTime_RFHM" SG_ 1443 PamChimeVolumeRear 0;
BA_ "GenSigTimeoutTime_MPAD" SG_ 1443 PamChimeVolumeRear 0;
BA_ "GenSigTimeoutTime_IPC" SG_ 1443 PamChimeVolumeRear 0;
BA_ "GenSigTimeoutTime_GNMM" SG_ 1443 PamChimeVolumeRear 0;
BA_ "GenSigTimeoutTime_EVCU2" SG_ 1443 PamChimeVolumeRear 0;
BA_ "GenSigTimeoutTime_ESL" SG_ 1443 PamChimeVolumeRear 0;
BA_ "GenSigTimeoutTime_ECM" SG_ 1443 PamChimeVolumeRear 0;
BA_ "GenSigTimeoutTime_DTCM" SG_ 1443 PamChimeVolumeRear 0;
BA_ "GenSigTimeoutTime_DMSM" SG_ 1443 PamChimeVolumeRear 0;
BA_ "GenSigTimeoutTime_BSM" SG_ 1443 PamChimeVolumeRear 0;
BA_ "GenSigTimeoutTime_AGSM" SG_ 1443 PamChimeVolumeRear 0;
BA_ "GenSigTimeoutTime_ADCAM" SG_ 1443 PamChimeVolumeRear 0;
BA_ "GenSigSendType" SG_ 1443 PamChimeVolumeRear 3;
BA_ "GenSigStartValue" SG_ 1443 PamChimeVolumeRear 1;
BA_ "GenSigTimeoutTime_RFHM" SG_ 1443 PamChimeVolumeFront 0;
BA_ "GenSigTimeoutTime_MPAD" SG_ 1443 PamChimeVolumeFront 0;
BA_ "GenSigTimeoutTime_IPC" SG_ 1443 PamChimeVolumeFront 0;
BA_ "GenSigTimeoutTime_GNMM" SG_ 1443 PamChimeVolumeFront 0;
BA_ "GenSigTimeoutTime_EVCU2" SG_ 1443 PamChimeVolumeFront 0;
BA_ "GenSigTimeoutTime_ESL" SG_ 1443 PamChimeVolumeFront 0;
BA_ "GenSigTimeoutTime_ECM" SG_ 1443 PamChimeVolumeFront 0;
BA_ "GenSigTimeoutTime_DTCM" SG_ 1443 PamChimeVolumeFront 0;
BA_ "GenSigTimeoutTime_DMSM" SG_ 1443 PamChimeVolumeFront 0;
BA_ "GenSigTimeoutTime_BSM" SG_ 1443 PamChimeVolumeFront 0;
BA_ "GenSigTimeoutTime_AGSM" SG_ 1443 PamChimeVolumeFront 0;
BA_ "GenSigTimeoutTime_ADCAM" SG_ 1443 PamChimeVolumeFront 0;
BA_ "GenSigSendType" SG_ 1443 PamChimeVolumeFront 3;
BA_ "GenSigStartValue" SG_ 1443 PamChimeVolumeFront 1;
BA_ "GenSigTimeoutTime_MPAD" SG_ 1443 PLGAlert 0;
BA_ "GenSigTimeoutTime_IPC" SG_ 1443 PLGAlert 0;
BA_ "GenSigTimeoutTime_GNMM" SG_ 1443 PLGAlert 0;
BA_ "GenSigTimeoutTime_EVCU2" SG_ 1443 PLGAlert 0;
BA_ "GenSigTimeoutTime_ESL" SG_ 1443 PLGAlert 0;
BA_ "GenSigTimeoutTime_ECM" SG_ 1443 PLGAlert 0;
BA_ "GenSigTimeoutTime_DTCM" SG_ 1443 PLGAlert 0;
BA_ "GenSigTimeoutTime_DMSM" SG_ 1443 PLGAlert 0;
BA_ "GenSigTimeoutTime_BSM" SG_ 1443 PLGAlert 0;
BA_ "GenSigTimeoutTime_AGSM" SG_ 1443 PLGAlert 0;
BA_ "GenSigTimeoutTime_ADCAM" SG_ 1443 PLGAlert 0;
BA_ "GenSigSendType" SG_ 1443 PLGAlert 3;
BA_ "GenSigStartValue" SG_ 1443 PLGAlert 1;
BA_ "GenSigTimeoutTime_RFHM" SG_ 1443 PhoneRepetition 0;
BA_ "GenSigTimeoutTime_MPAD" SG_ 1443 PhoneRepetition 0;
BA_ "GenSigTimeoutTime_IPC" SG_ 1443 PhoneRepetition 0;
BA_ "GenSigTimeoutTime_GNMM" SG_ 1443 PhoneRepetition 0;
BA_ "GenSigTimeoutTime_EVCU2" SG_ 1443 PhoneRepetition 0;
BA_ "GenSigTimeoutTime_ESL" SG_ 1443 PhoneRepetition 0;
BA_ "GenSigTimeoutTime_ECM" SG_ 1443 PhoneRepetition 0;
BA_ "GenSigTimeoutTime_DTCM" SG_ 1443 PhoneRepetition 0;
BA_ "GenSigTimeoutTime_DMSM" SG_ 1443 PhoneRepetition 0;
BA_ "GenSigTimeoutTime_BSM" SG_ 1443 PhoneRepetition 0;
BA_ "GenSigTimeoutTime_AGSM" SG_ 1443 PhoneRepetition 0;
BA_ "GenSigTimeoutTime_ADCAM" SG_ 1443 PhoneRepetition 0;
BA_ "GenSigSendType" SG_ 1443 PhoneRepetition 3;
BA_ "GenSigTimeoutTime_RFHM" SG_ 1443 Night_Vision 0;
BA_ "GenSigTimeoutTime_MPAD" SG_ 1443 Night_Vision 0;
BA_ "GenSigTimeoutTime_IPC" SG_ 1443 Night_Vision 0;
BA_ "GenSigTimeoutTime_GNMM" SG_ 1443 Night_Vision 0;
BA_ "GenSigTimeoutTime_EVCU2" SG_ 1443 Night_Vision 0;
BA_ "GenSigTimeoutTime_ESL" SG_ 1443 Night_Vision 0;
BA_ "GenSigTimeoutTime_ECM" SG_ 1443 Night_Vision 0;
BA_ "GenSigTimeoutTime_DTCM" SG_ 1443 Night_Vision 0;
BA_ "GenSigTimeoutTime_DMSM" SG_ 1443 Night_Vision 0;
BA_ "GenSigTimeoutTime_BSM" SG_ 1443 Night_Vision 0;
BA_ "GenSigTimeoutTime_AGSM" SG_ 1443 Night_Vision 0;
BA_ "GenSigTimeoutTime_ADCAM" SG_ 1443 Night_Vision 0;
BA_ "GenSigSendType" SG_ 1443 Night_Vision 3;
BA_ "GenSigTimeoutTime_RFHM" SG_ 1443 NavRepetition 0;
BA_ "GenSigTimeoutTime_MPAD" SG_ 1443 NavRepetition 0;
BA_ "GenSigTimeoutTime_IPC" SG_ 1443 NavRepetition 0;
BA_ "GenSigTimeoutTime_GNMM" SG_ 1443 NavRepetition 0;
BA_ "GenSigTimeoutTime_EVCU2" SG_ 1443 NavRepetition 0;
BA_ "GenSigTimeoutTime_ESL" SG_ 1443 NavRepetition 0;
BA_ "GenSigTimeoutTime_ECM" SG_ 1443 NavRepetition 0;
BA_ "GenSigTimeoutTime_DTCM" SG_ 1443 NavRepetition 0;
BA_ "GenSigTimeoutTime_DMSM" SG_ 1443 NavRepetition 0;
BA_ "GenSigTimeoutTime_BSM" SG_ 1443 NavRepetition 0;
BA_ "GenSigTimeoutTime_AGSM" SG_ 1443 NavRepetition 0;
BA_ "GenSigTimeoutTime_ADCAM" SG_ 1443 NavRepetition 0;
BA_ "GenSigSendType" SG_ 1443 NavRepetition 3;
BA_ "GenSigTimeoutTime_RFHM" SG_ 1443 New_Spd_Zone_Ind 0;
BA_ "GenSigTimeoutTime_MPAD" SG_ 1443 New_Spd_Zone_Ind 0;
BA_ "GenSigTimeoutTime_IPC" SG_ 1443 New_Spd_Zone_Ind 0;
BA_ "GenSigTimeoutTime_GNMM" SG_ 1443 New_Spd_Zone_Ind 0;
BA_ "GenSigTimeoutTime_ESL" SG_ 1443 New_Spd_Zone_Ind 0;
BA_ "GenSigTimeoutTime_ECM" SG_ 1443 New_Spd_Zone_Ind 0;
BA_ "GenSigTimeoutTime_DTCM" SG_ 1443 New_Spd_Zone_Ind 0;
BA_ "GenSigTimeoutTime_DMSM" SG_ 1443 New_Spd_Zone_Ind 0;
BA_ "GenSigTimeoutTime_BSM" SG_ 1443 New_Spd_Zone_Ind 0;
BA_ "GenSigTimeoutTime_AGSM" SG_ 1443 New_Spd_Zone_Ind 0;
BA_ "GenSigTimeoutTime_ADCAM" SG_ 1443 New_Spd_Zone_Ind 0;
BA_ "GenSigSendType" SG_ 1443 New_Spd_Zone_Ind 3;
BA_ "GenSigTimeoutTime_RFHM" SG_ 1443 LDW_Sensibility 0;
BA_ "GenSigTimeoutTime_MPAD" SG_ 1443 LDW_Sensibility 0;
BA_ "GenSigTimeoutTime_IPC" SG_ 1443 LDW_Sensibility 0;
BA_ "GenSigTimeoutTime_GNMM" SG_ 1443 LDW_Sensibility 0;
BA_ "GenSigTimeoutTime_EVCU2" SG_ 1443 LDW_Sensibility 0;
BA_ "GenSigTimeoutTime_ESL" SG_ 1443 LDW_Sensibility 0;
BA_ "GenSigTimeoutTime_ECM" SG_ 1443 LDW_Sensibility 0;
BA_ "GenSigTimeoutTime_DTCM" SG_ 1443 LDW_Sensibility 0;
BA_ "GenSigTimeoutTime_DMSM" SG_ 1443 LDW_Sensibility 0;
BA_ "GenSigTimeoutTime_BSM" SG_ 1443 LDW_Sensibility 0;
BA_ "GenSigTimeoutTime_AGSM" SG_ 1443 LDW_Sensibility 0;
BA_ "GenSigSendType" SG_ 1443 LDW_Sensibility 3;
BA_ "GenSigStartValue" SG_ 1443 LDW_Sensibility 2;
BA_ "GenSigTimeoutTime_RFHM" SG_ 1443 LanguageSelection 0;
BA_ "GenSigTimeoutTime_MPAD" SG_ 1443 LanguageSelection 0;
BA_ "GenSigTimeoutTime_IPC" SG_ 1443 LanguageSelection 0;
BA_ "GenSigTimeoutTime_GNMM" SG_ 1443 LanguageSelection 0;
BA_ "GenSigTimeoutTime_EVCU2" SG_ 1443 LanguageSelection 0;
BA_ "GenSigTimeoutTime_ESL" SG_ 1443 LanguageSelection 0;
BA_ "GenSigTimeoutTime_ECM" SG_ 1443 LanguageSelection 0;
BA_ "GenSigTimeoutTime_DTCM" SG_ 1443 LanguageSelection 0;
BA_ "GenSigTimeoutTime_DMSM" SG_ 1443 LanguageSelection 0;
BA_ "GenSigTimeoutTime_BSM" SG_ 1443 LanguageSelection 0;
BA_ "GenSigTimeoutTime_AGSM" SG_ 1443 LanguageSelection 0;
BA_ "GenSigTimeoutTime_ADCAM" SG_ 1443 LanguageSelection 0;
BA_ "GenSigSendType" SG_ 1443 LanguageSelection 3;
BA_ "GenSigTimeoutTime_RFHM" SG_ 1443 IPCProgrammed 0;
BA_ "GenSigTimeoutTime_MPAD" SG_ 1443 IPCProgrammed 0;
BA_ "GenSigTimeoutTime_IPC" SG_ 1443 IPCProgrammed 0;
BA_ "GenSigTimeoutTime_GNMM" SG_ 1443 IPCProgrammed 0;
BA_ "GenSigTimeoutTime_EVCU2" SG_ 1443 IPCProgrammed 0;
BA_ "GenSigTimeoutTime_ESL" SG_ 1443 IPCProgrammed 0;
BA_ "GenSigTimeoutTime_ECM" SG_ 1443 IPCProgrammed 0;
BA_ "GenSigTimeoutTime_DTCM" SG_ 1443 IPCProgrammed 0;
BA_ "GenSigTimeoutTime_DMSM" SG_ 1443 IPCProgrammed 0;
BA_ "GenSigTimeoutTime_BSM" SG_ 1443 IPCProgrammed 0;
BA_ "GenSigTimeoutTime_AGSM" SG_ 1443 IPCProgrammed 0;
BA_ "GenSigTimeoutTime_ADCAM" SG_ 1443 IPCProgrammed 0;
BA_ "GenSigSendType" SG_ 1443 IPCProgrammed 3;
BA_ "GenSigTimeoutTime_RFHM" SG_ 1443 LDW_Intensity 0;
BA_ "GenSigTimeoutTime_MPAD" SG_ 1443 LDW_Intensity 0;
BA_ "GenSigTimeoutTime_IPC" SG_ 1443 LDW_Intensity 0;
BA_ "GenSigTimeoutTime_GNMM" SG_ 1443 LDW_Intensity 0;
BA_ "GenSigTimeoutTime_EVCU2" SG_ 1443 LDW_Intensity 0;
BA_ "GenSigTimeoutTime_ESL" SG_ 1443 LDW_Intensity 0;
BA_ "GenSigTimeoutTime_ECM" SG_ 1443 LDW_Intensity 0;
BA_ "GenSigTimeoutTime_DTCM" SG_ 1443 LDW_Intensity 0;
BA_ "GenSigTimeoutTime_DMSM" SG_ 1443 LDW_Intensity 0;
BA_ "GenSigTimeoutTime_BSM" SG_ 1443 LDW_Intensity 0;
BA_ "GenSigTimeoutTime_AGSM" SG_ 1443 LDW_Intensity 0;
BA_ "GenSigSendType" SG_ 1443 LDW_Intensity 3;
BA_ "GenSigStartValue" SG_ 1443 LDW_Intensity 2;
BA_ "GenSigTimeoutTime_RFHM" SG_ 1443 Intelligent_Speed 0;
BA_ "GenSigTimeoutTime_MPAD" SG_ 1443 Intelligent_Speed 0;
BA_ "GenSigTimeoutTime_IPC" SG_ 1443 Intelligent_Speed 0;
BA_ "GenSigTimeoutTime_GNMM" SG_ 1443 Intelligent_Speed 0;
BA_ "GenSigTimeoutTime_ESL" SG_ 1443 Intelligent_Speed 0;
BA_ "GenSigTimeoutTime_ECM" SG_ 1443 Intelligent_Speed 0;
BA_ "GenSigTimeoutTime_DTCM" SG_ 1443 Intelligent_Speed 0;
BA_ "GenSigTimeoutTime_DMSM" SG_ 1443 Intelligent_Speed 0;
BA_ "GenSigTimeoutTime_BSM" SG_ 1443 Intelligent_Speed 0;
BA_ "GenSigTimeoutTime_AGSM" SG_ 1443 Intelligent_Speed 0;
BA_ "GenSigTimeoutTime_ADCAM" SG_ 1443 Intelligent_Speed 0;
BA_ "GenSigSendType" SG_ 1443 Intelligent_Speed 3;
BA_ "GenSigTimeoutTime_RFHM" SG_ 1443 Illuminated_Approach 0;
BA_ "GenSigTimeoutTime_MPAD" SG_ 1443 Illuminated_Approach 0;
BA_ "GenSigTimeoutTime_IPC" SG_ 1443 Illuminated_Approach 0;
BA_ "GenSigTimeoutTime_GNMM" SG_ 1443 Illuminated_Approach 0;
BA_ "GenSigTimeoutTime_EVCU2" SG_ 1443 Illuminated_Approach 0;
BA_ "GenSigTimeoutTime_ESL" SG_ 1443 Illuminated_Approach 0;
BA_ "GenSigTimeoutTime_ECM" SG_ 1443 Illuminated_Approach 0;
BA_ "GenSigTimeoutTime_DTCM" SG_ 1443 Illuminated_Approach 0;
BA_ "GenSigTimeoutTime_DMSM" SG_ 1443 Illuminated_Approach 0;
BA_ "GenSigTimeoutTime_BSM" SG_ 1443 Illuminated_Approach 0;
BA_ "GenSigTimeoutTime_AGSM" SG_ 1443 Illuminated_Approach 0;
BA_ "GenSigTimeoutTime_ADCAM" SG_ 1443 Illuminated_Approach 0;
BA_ "GenSigSendType" SG_ 1443 Illuminated_Approach 3;
BA_ "GenSigTimeoutTime_RFHM" SG_ 1443 HP_Unit 0;
BA_ "GenSigTimeoutTime_MPAD" SG_ 1443 HP_Unit 0;
BA_ "GenSigTimeoutTime_IPC" SG_ 1443 HP_Unit 0;
BA_ "GenSigTimeoutTime_GNMM" SG_ 1443 HP_Unit 0;
BA_ "GenSigTimeoutTime_EVCU2" SG_ 1443 HP_Unit 0;
BA_ "GenSigTimeoutTime_ESL" SG_ 1443 HP_Unit 0;
BA_ "GenSigTimeoutTime_ECM" SG_ 1443 HP_Unit 0;
BA_ "GenSigTimeoutTime_DTCM" SG_ 1443 HP_Unit 0;
BA_ "GenSigTimeoutTime_DMSM" SG_ 1443 HP_Unit 0;
BA_ "GenSigTimeoutTime_BSM" SG_ 1443 HP_Unit 0;
BA_ "GenSigTimeoutTime_AGSM" SG_ 1443 HP_Unit 0;
BA_ "GenSigTimeoutTime_ADCAM" SG_ 1443 HP_Unit 0;
BA_ "GenSigSendType" SG_ 1443 HP_Unit 3;
BA_ "GenSigTimeoutTime_DMSM" SG_ 1443 HourMode 0;
BA_ "GenSigTimeoutTime_BSM" SG_ 1443 HourMode 0;
BA_ "GenSigTimeoutTime_AGSM" SG_ 1443 HourMode 0;
BA_ "GenSigTimeoutTime_ADCAM" SG_ 1443 HourMode 0;
BA_ "GenSigSendType" SG_ 1443 HourMode 3;
BA_ "GenSigTimeoutTime_RFHM" SG_ 1443 HourMode 0;
BA_ "GenSigTimeoutTime_MPAD" SG_ 1443 HourMode 0;
BA_ "GenSigTimeoutTime_IPC" SG_ 1443 HourMode 0;
BA_ "GenSigTimeoutTime_GNMM" SG_ 1443 HourMode 0;
BA_ "GenSigTimeoutTime_EVCU2" SG_ 1443 HourMode 0;
BA_ "GenSigTimeoutTime_ESL" SG_ 1443 HourMode 0;
BA_ "GenSigTimeoutTime_ECM" SG_ 1443 HourMode 0;
BA_ "GenSigTimeoutTime_DTCM" SG_ 1443 HourMode 0;
BA_ "GenSigTimeoutTime_RFHM" SG_ 1443 HeadLightWipers 0;
BA_ "GenSigTimeoutTime_MPAD" SG_ 1443 HeadLightWipers 0;
BA_ "GenSigTimeoutTime_IPC" SG_ 1443 HeadLightWipers 0;
BA_ "GenSigTimeoutTime_GNMM" SG_ 1443 HeadLightWipers 0;
BA_ "GenSigTimeoutTime_EVCU2" SG_ 1443 HeadLightWipers 0;
BA_ "GenSigTimeoutTime_ESL" SG_ 1443 HeadLightWipers 0;
BA_ "GenSigTimeoutTime_ECM" SG_ 1443 HeadLightWipers 0;
BA_ "GenSigTimeoutTime_DTCM" SG_ 1443 HeadLightWipers 0;
BA_ "GenSigTimeoutTime_DMSM" SG_ 1443 HeadLightWipers 0;
BA_ "GenSigTimeoutTime_BSM" SG_ 1443 HeadLightWipers 0;
BA_ "GenSigTimeoutTime_AGSM" SG_ 1443 HeadLightWipers 0;
BA_ "GenSigTimeoutTime_ADCAM" SG_ 1443 HeadLightWipers 0;
BA_ "GenSigSendType" SG_ 1443 HeadLightWipers 3;
BA_ "GenSigStartValue" SG_ 1443 HeadLightWipers 1;
BA_ "GenSigTimeoutTime_RFHM" SG_ 1443 HeadlightsOffDelay 0;
BA_ "GenSigTimeoutTime_MPAD" SG_ 1443 HeadlightsOffDelay 0;
BA_ "GenSigTimeoutTime_IPC" SG_ 1443 HeadlightsOffDelay 0;
BA_ "GenSigTimeoutTime_GNMM" SG_ 1443 HeadlightsOffDelay 0;
BA_ "GenSigTimeoutTime_RFHM" SG_ 1443 Hill_Start_Assist 0;
BA_ "GenSigTimeoutTime_MPAD" SG_ 1443 Hill_Start_Assist 0;
BA_ "GenSigTimeoutTime_IPC" SG_ 1443 Hill_Start_Assist 0;
BA_ "GenSigTimeoutTime_GNMM" SG_ 1443 Hill_Start_Assist 0;
BA_ "GenSigTimeoutTime_EVCU2" SG_ 1443 Hill_Start_Assist 0;
BA_ "GenSigTimeoutTime_ESL" SG_ 1443 Hill_Start_Assist 0;
BA_ "GenSigTimeoutTime_ECM" SG_ 1443 Hill_Start_Assist 0;
BA_ "GenSigTimeoutTime_DTCM" SG_ 1443 Hill_Start_Assist 0;
BA_ "GenSigTimeoutTime_DMSM" SG_ 1443 Hill_Start_Assist 0;
BA_ "GenSigTimeoutTime_AGSM" SG_ 1443 Hill_Start_Assist 0;
BA_ "GenSigTimeoutTime_ADCAM" SG_ 1443 Hill_Start_Assist 0;
BA_ "GenSigSendType" SG_ 1443 Hill_Start_Assist 3;
BA_ "GenSigTimeoutTime_RFHM" SG_ 1443 FSFCWPlusSetting 0;
BA_ "GenSigTimeoutTime_IPC" SG_ 1443 FSFCWPlusSetting 0;
BA_ "GenSigTimeoutTime_GNMM" SG_ 1443 FSFCWPlusSetting 0;
BA_ "GenSigTimeoutTime_EVCU2" SG_ 1443 FSFCWPlusSetting 0;
BA_ "GenSigTimeoutTime_ESL" SG_ 1443 FSFCWPlusSetting 0;
BA_ "GenSigTimeoutTime_ECM" SG_ 1443 FSFCWPlusSetting 0;
BA_ "GenSigTimeoutTime_DTCM" SG_ 1443 FSFCWPlusSetting 0;
BA_ "GenSigTimeoutTime_DMSM" SG_ 1443 FSFCWPlusSetting 0;
BA_ "GenSigTimeoutTime_BSM" SG_ 1443 FSFCWPlusSetting 0;
BA_ "GenSigTimeoutTime_AGSM" SG_ 1443 FSFCWPlusSetting 0;
BA_ "GenSigSendType" SG_ 1443 FSFCWPlusSetting 3;
BA_ "GenSigStartValue" SG_ 1443 FSFCWPlusSetting 3;
BA_ "GenSigTimeoutTime_RFHM" SG_ 1443 EPB_MaintenanceMode 0;
BA_ "GenSigTimeoutTime_MPAD" SG_ 1443 EPB_MaintenanceMode 0;
BA_ "GenSigTimeoutTime_IPC" SG_ 1443 EPB_MaintenanceMode 0;
BA_ "GenSigTimeoutTime_GNMM" SG_ 1443 EPB_MaintenanceMode 0;
BA_ "GenSigTimeoutTime_EVCU2" SG_ 1443 EPB_MaintenanceMode 0;
BA_ "GenSigTimeoutTime_ESL" SG_ 1443 EPB_MaintenanceMode 0;
BA_ "GenSigTimeoutTime_ECM" SG_ 1443 EPB_MaintenanceMode 0;
BA_ "GenSigTimeoutTime_DTCM" SG_ 1443 EPB_MaintenanceMode 0;
BA_ "GenSigTimeoutTime_DMSM" SG_ 1443 EPB_MaintenanceMode 0;
BA_ "GenSigTimeoutTime_BSM" SG_ 1443 EPB_MaintenanceMode 0;
BA_ "GenSigTimeoutTime_BCM" SG_ 1443 EPB_MaintenanceMode 0;
BA_ "GenSigTimeoutTime_AGSM" SG_ 1443 EPB_MaintenanceMode 0;
BA_ "GenSigTimeoutTime_ADCAM" SG_ 1443 EPB_MaintenanceMode 0;
BA_ "GenSigSendType" SG_ 1443 EPB_MaintenanceMode 3;
BA_ "GenSigTimeoutTime_RFHM" SG_ 1443 GreetingLightsEnable 0;
BA_ "GenSigTimeoutTime_MPAD" SG_ 1443 GreetingLightsEnable 0;
BA_ "GenSigTimeoutTime_IPC" SG_ 1443 GreetingLightsEnable 0;
BA_ "GenSigTimeoutTime_GNMM" SG_ 1443 GreetingLightsEnable 0;
BA_ "GenSigTimeoutTime_EVCU2" SG_ 1443 GreetingLightsEnable 0;
BA_ "GenSigTimeoutTime_ESL" SG_ 1443 GreetingLightsEnable 0;
BA_ "GenSigTimeoutTime_ECM" SG_ 1443 GreetingLightsEnable 0;
BA_ "GenSigTimeoutTime_DTCM" SG_ 1443 GreetingLightsEnable 0;
BA_ "GenSigTimeoutTime_DMSM" SG_ 1443 GreetingLightsEnable 0;
BA_ "GenSigTimeoutTime_BSM" SG_ 1443 GreetingLightsEnable 0;
BA_ "GenSigTimeoutTime_AGSM" SG_ 1443 GreetingLightsEnable 0;
BA_ "GenSigTimeoutTime_ADCAM" SG_ 1443 GreetingLightsEnable 0;
BA_ "GenSigSendType" SG_ 1443 GreetingLightsEnable 3;
BA_ "GenSigTimeoutTime_RFHM" SG_ 1443 Fwrd_Cam_Guidelines 0;
BA_ "GenSigTimeoutTime_MPAD" SG_ 1443 Fwrd_Cam_Guidelines 0;
BA_ "GenSigTimeoutTime_IPC" SG_ 1443 Fwrd_Cam_Guidelines 0;
BA_ "GenSigTimeoutTime_GNMM" SG_ 1443 Fwrd_Cam_Guidelines 0;
BA_ "GenSigTimeoutTime_EVCU2" SG_ 1443 Fwrd_Cam_Guidelines 0;
BA_ "GenSigTimeoutTime_ESL" SG_ 1443 Fwrd_Cam_Guidelines 0;
BA_ "GenSigTimeoutTime_ECM" SG_ 1443 Fwrd_Cam_Guidelines 0;
BA_ "GenSigTimeoutTime_DTCM" SG_ 1443 Fwrd_Cam_Guidelines 0;
BA_ "GenSigTimeoutTime_DMSM" SG_ 1443 Fwrd_Cam_Guidelines 0;
BA_ "GenSigTimeoutTime_BSM" SG_ 1443 Fwrd_Cam_Guidelines 0;
BA_ "GenSigTimeoutTime_AGSM" SG_ 1443 Fwrd_Cam_Guidelines 0;
BA_ "GenSigTimeoutTime_ADCAM" SG_ 1443 Fwrd_Cam_Guidelines 0;
BA_ "GenSigSendType" SG_ 1443 Fwrd_Cam_Guidelines 3;
BA_ "GenSigTimeoutTime_EVCU2" SG_ 1443 HeadlightsOffDelay 0;
BA_ "GenSigTimeoutTime_ESL" SG_ 1443 HeadlightsOffDelay 0;
BA_ "GenSigTimeoutTime_ECM" SG_ 1443 HeadlightsOffDelay 0;
BA_ "GenSigTimeoutTime_DTCM" SG_ 1443 HeadlightsOffDelay 0;
BA_ "GenSigTimeoutTime_DMSM" SG_ 1443 HeadlightsOffDelay 0;
BA_ "GenSigTimeoutTime_BSM" SG_ 1443 HeadlightsOffDelay 0;
BA_ "GenSigTimeoutTime_AGSM" SG_ 1443 HeadlightsOffDelay 0;
BA_ "GenSigTimeoutTime_ADCAM" SG_ 1443 HeadlightsOffDelay 0;
BA_ "GenSigSendType" SG_ 1443 HeadlightsOffDelay 3;
BA_ "GenSigTimeoutTime_RFHM" SG_ 1443 Handsfree_Liftgate 0;
BA_ "GenSigTimeoutTime_MPAD" SG_ 1443 Handsfree_Liftgate 0;
BA_ "GenSigTimeoutTime_IPC" SG_ 1443 Handsfree_Liftgate 0;
BA_ "GenSigTimeoutTime_GNMM" SG_ 1443 Handsfree_Liftgate 0;
BA_ "GenSigTimeoutTime_EVCU2" SG_ 1443 Handsfree_Liftgate 0;
BA_ "GenSigTimeoutTime_ESL" SG_ 1443 Handsfree_Liftgate 0;
BA_ "GenSigTimeoutTime_ECM" SG_ 1443 Handsfree_Liftgate 0;
BA_ "GenSigTimeoutTime_DTCM" SG_ 1443 Handsfree_Liftgate 0;
BA_ "GenSigTimeoutTime_DMSM" SG_ 1443 Handsfree_Liftgate 0;
BA_ "GenSigTimeoutTime_BSM" SG_ 1443 Handsfree_Liftgate 0;
BA_ "GenSigTimeoutTime_AGSM" SG_ 1443 Handsfree_Liftgate 0;
BA_ "GenSigTimeoutTime_ADCAM" SG_ 1443 Handsfree_Liftgate 0;
BA_ "GenSigSendType" SG_ 1443 Handsfree_Liftgate 3;
BA_ "GenSigTimeoutTime_RFHM" SG_ 1443 Eng_Off_Pwr_Delay 0;
BA_ "GenSigTimeoutTime_MPAD" SG_ 1443 Eng_Off_Pwr_Delay 0;
BA_ "GenSigTimeoutTime_IPC" SG_ 1443 Eng_Off_Pwr_Delay 0;
BA_ "GenSigTimeoutTime_GNMM" SG_ 1443 Eng_Off_Pwr_Delay 0;
BA_ "GenSigTimeoutTime_EVCU2" SG_ 1443 Eng_Off_Pwr_Delay 0;
BA_ "GenSigTimeoutTime_ESL" SG_ 1443 Eng_Off_Pwr_Delay 0;
BA_ "GenSigTimeoutTime_ECM" SG_ 1443 Eng_Off_Pwr_Delay 0;
BA_ "GenSigTimeoutTime_DTCM" SG_ 1443 Eng_Off_Pwr_Delay 0;
BA_ "GenSigTimeoutTime_DMSM" SG_ 1443 Eng_Off_Pwr_Delay 0;
BA_ "GenSigTimeoutTime_BSM" SG_ 1443 Eng_Off_Pwr_Delay 0;
BA_ "GenSigTimeoutTime_AGSM" SG_ 1443 Eng_Off_Pwr_Delay 0;
BA_ "GenSigTimeoutTime_ADCAM" SG_ 1443 Eng_Off_Pwr_Delay 0;
BA_ "GenSigSendType" SG_ 1443 Eng_Off_Pwr_Delay 3;
BA_ "GenSigTimeoutTime_RFHM" SG_ 1443 Easy_Exit_D 0;
BA_ "GenSigTimeoutTime_MPAD" SG_ 1443 Easy_Exit_D 0;
BA_ "GenSigTimeoutTime_IPC" SG_ 1443 Easy_Exit_D 0;
BA_ "GenSigTimeoutTime_GNMM" SG_ 1443 Easy_Exit_D 0;
BA_ "GenSigTimeoutTime_EVCU2" SG_ 1443 Easy_Exit_D 0;
BA_ "GenSigTimeoutTime_ESL" SG_ 1443 Easy_Exit_D 0;
BA_ "GenSigTimeoutTime_ECM" SG_ 1443 Easy_Exit_D 0;
BA_ "GenSigTimeoutTime_DTCM" SG_ 1443 Easy_Exit_D 0;
BA_ "GenSigTimeoutTime_DMSM" SG_ 1443 Easy_Exit_D 0;
BA_ "GenSigTimeoutTime_BSM" SG_ 1443 Easy_Exit_D 0;
BA_ "GenSigTimeoutTime_AGSM" SG_ 1443 Easy_Exit_D 0;
BA_ "GenSigTimeoutTime_ADCAM" SG_ 1443 Easy_Exit_D 0;
BA_ "GenSigSendType" SG_ 1443 Easy_Exit_D 3;
BA_ "GenSigTimeoutTime_RFHM" SG_ 1443 DynamicGrid 0;
BA_ "GenSigTimeoutTime_MPAD" SG_ 1443 DynamicGrid 0;
BA_ "GenSigTimeoutTime_IPC" SG_ 1443 DynamicGrid 0;
BA_ "GenSigTimeoutTime_GNMM" SG_ 1443 DynamicGrid 0;
BA_ "GenSigTimeoutTime_EVCU2" SG_ 1443 DynamicGrid 0;
BA_ "GenSigTimeoutTime_ESL" SG_ 1443 DynamicGrid 0;
BA_ "GenSigTimeoutTime_ECM" SG_ 1443 DynamicGrid 0;
BA_ "GenSigTimeoutTime_DTCM" SG_ 1443 DynamicGrid 0;
BA_ "GenSigTimeoutTime_DMSM" SG_ 1443 DynamicGrid 0;
BA_ "GenSigTimeoutTime_BSM" SG_ 1443 DynamicGrid 0;
BA_ "GenSigTimeoutTime_AGSM" SG_ 1443 DynamicGrid 0;
BA_ "GenSigTimeoutTime_ADCAM" SG_ 1443 DynamicGrid 0;
BA_ "GenSigSendType" SG_ 1443 DynamicGrid 1;
BA_ "GenSigStartValue" SG_ 1443 DynamicGrid 1;
BA_ "GenSigTimeoutTime_RFHM" SG_ 1443 DRLEnable 0;
BA_ "GenSigTimeoutTime_MPAD" SG_ 1443 DRLEnable 0;
BA_ "GenSigTimeoutTime_IPC" SG_ 1443 DRLEnable 0;
BA_ "GenSigTimeoutTime_GNMM" SG_ 1443 DRLEnable 0;
BA_ "GenSigTimeoutTime_EVCU2" SG_ 1443 DRLEnable 0;
BA_ "GenSigTimeoutTime_ESL" SG_ 1443 DRLEnable 0;
BA_ "GenSigTimeoutTime_ECM" SG_ 1443 DRLEnable 0;
BA_ "GenSigTimeoutTime_DTCM" SG_ 1443 DRLEnable 0;
BA_ "GenSigTimeoutTime_DMSM" SG_ 1443 DRLEnable 0;
BA_ "GenSigTimeoutTime_BSM" SG_ 1443 DRLEnable 0;
BA_ "GenSigTimeoutTime_AGSM" SG_ 1443 DRLEnable 0;
BA_ "GenSigTimeoutTime_ADCAM" SG_ 1443 DRLEnable 0;
BA_ "GenSigSendType" SG_ 1443 DRLEnable 3;
BA_ "GenSigTimeoutTime_RFHM" SG_ 1443 FSFCWPlusActivationMode 0;
BA_ "GenSigTimeoutTime_MPAD" SG_ 1443 FSFCWPlusActivationMode 0;
BA_ "GenSigTimeoutTime_IPC" SG_ 1443 FSFCWPlusActivationMode 0;
BA_ "GenSigTimeoutTime_GNMM" SG_ 1443 FSFCWPlusActivationMode 0;
BA_ "GenSigTimeoutTime_EVCU2" SG_ 1443 FSFCWPlusActivationMode 0;
BA_ "GenSigTimeoutTime_ESL" SG_ 1443 FSFCWPlusActivationMode 0;
BA_ "GenSigTimeoutTime_ECM" SG_ 1443 FSFCWPlusActivationMode 0;
BA_ "GenSigTimeoutTime_DTCM" SG_ 1443 FSFCWPlusActivationMode 0;
BA_ "GenSigTimeoutTime_DMSM" SG_ 1443 FSFCWPlusActivationMode 0;
BA_ "GenSigTimeoutTime_BSM" SG_ 1443 FSFCWPlusActivationMode 0;
BA_ "GenSigTimeoutTime_AGSM" SG_ 1443 FSFCWPlusActivationMode 0;
BA_ "GenSigSendType" SG_ 1443 FSFCWPlusActivationMode 3;
BA_ "GenSigStartValue" SG_ 1443 FSFCWPlusActivationMode 1;
BA_ "GenSigTimeoutTime_RFHM" SG_ 1443 Dist_Unit 0;
BA_ "GenSigTimeoutTime_IPC" SG_ 1443 Dist_Unit 0;
BA_ "GenSigTimeoutTime_GNMM" SG_ 1443 Dist_Unit 0;
BA_ "GenSigTimeoutTime_EVCU2" SG_ 1443 Dist_Unit 0;
BA_ "GenSigTimeoutTime_ESL" SG_ 1443 Dist_Unit 0;
BA_ "GenSigTimeoutTime_ECM" SG_ 1443 Dist_Unit 0;
BA_ "GenSigTimeoutTime_DTCM" SG_ 1443 Dist_Unit 0;
BA_ "GenSigTimeoutTime_DMSM" SG_ 1443 Dist_Unit 0;
BA_ "GenSigTimeoutTime_BSM" SG_ 1443 Dist_Unit 0;
BA_ "GenSigTimeoutTime_AGSM" SG_ 1443 Dist_Unit 0;
BA_ "GenSigTimeoutTime_ADCAM" SG_ 1443 Dist_Unit 0;
BA_ "GenSigSendType" SG_ 1443 Dist_Unit 3;
BA_ "GenSigTimeoutTime_RFHM" SG_ 1443 CorneringEnable 0;
BA_ "GenSigTimeoutTime_MPAD" SG_ 1443 CorneringEnable 0;
BA_ "GenSigTimeoutTime_IPC" SG_ 1443 CorneringEnable 0;
BA_ "GenSigTimeoutTime_GNMM" SG_ 1443 CorneringEnable 0;
BA_ "GenSigTimeoutTime_EVCU2" SG_ 1443 CorneringEnable 0;
BA_ "GenSigTimeoutTime_ESL" SG_ 1443 CorneringEnable 0;
BA_ "GenSigTimeoutTime_ECM" SG_ 1443 CorneringEnable 0;
BA_ "GenSigTimeoutTime_DTCM" SG_ 1443 CorneringEnable 0;
BA_ "GenSigTimeoutTime_DMSM" SG_ 1443 CorneringEnable 0;
BA_ "GenSigTimeoutTime_BSM" SG_ 1443 CorneringEnable 0;
BA_ "GenSigTimeoutTime_AGSM" SG_ 1443 CorneringEnable 0;
BA_ "GenSigTimeoutTime_ADCAM" SG_ 1443 CorneringEnable 0;
BA_ "GenSigSendType" SG_ 1443 CorneringEnable 3;
BA_ "GenSigTimeoutTime_BSM" SG_ 1443 Consum_Unit 0;
BA_ "GenSigTimeoutTime_AGSM" SG_ 1443 Consum_Unit 0;
BA_ "GenSigTimeoutTime_ADCAM" SG_ 1443 Consum_Unit 0;
BA_ "GenSigSendType" SG_ 1443 Consum_Unit 3;
BA_ "GenSigTimeoutTime_RFHM" SG_ 1443 Consum_Unit 0;
BA_ "GenSigTimeoutTime_MPAD" SG_ 1443 Consum_Unit 0;
BA_ "GenSigTimeoutTime_IPC" SG_ 1443 Consum_Unit 0;
BA_ "GenSigTimeoutTime_GNMM" SG_ 1443 Consum_Unit 0;
BA_ "GenSigTimeoutTime_EVCU2" SG_ 1443 Consum_Unit 0;
BA_ "GenSigTimeoutTime_ESL" SG_ 1443 Consum_Unit 0;
BA_ "GenSigTimeoutTime_ECM" SG_ 1443 Consum_Unit 0;
BA_ "GenSigTimeoutTime_DTCM" SG_ 1443 Consum_Unit 0;
BA_ "GenSigTimeoutTime_DMSM" SG_ 1443 Consum_Unit 0;
BA_ "GenSigTimeoutTime_RFHM" SG_ 1443 Backup_Cam_Delay 0;
BA_ "GenSigTimeoutTime_MPAD" SG_ 1443 Backup_Cam_Delay 0;
BA_ "GenSigTimeoutTime_IPC" SG_ 1443 Backup_Cam_Delay 0;
BA_ "GenSigTimeoutTime_GNMM" SG_ 1443 Backup_Cam_Delay 0;
BA_ "GenSigTimeoutTime_EVCU2" SG_ 1443 Backup_Cam_Delay 0;
BA_ "GenSigTimeoutTime_ESL" SG_ 1443 Backup_Cam_Delay 0;
BA_ "GenSigTimeoutTime_ECM" SG_ 1443 Backup_Cam_Delay 0;
BA_ "GenSigTimeoutTime_DTCM" SG_ 1443 Backup_Cam_Delay 0;
BA_ "GenSigTimeoutTime_DMSM" SG_ 1443 Backup_Cam_Delay 0;
BA_ "GenSigTimeoutTime_BSM" SG_ 1443 Backup_Cam_Delay 0;
BA_ "GenSigTimeoutTime_AGSM" SG_ 1443 Backup_Cam_Delay 0;
BA_ "GenSigTimeoutTime_ADCAM" SG_ 1443 Backup_Cam_Delay 0;
BA_ "GenSigSendType" SG_ 1443 Backup_Cam_Delay 3;
BA_ "GenSigTimeoutTime_RFHM" SG_ 1443 AutoUnlockDoorExit 0;
BA_ "GenSigTimeoutTime_MPAD" SG_ 1443 AutoUnlockDoorExit 0;
BA_ "GenSigTimeoutTime_IPC" SG_ 1443 AutoUnlockDoorExit 0;
BA_ "GenSigTimeoutTime_GNMM" SG_ 1443 AutoUnlockDoorExit 0;
BA_ "GenSigTimeoutTime_EVCU2" SG_ 1443 AutoUnlockDoorExit 0;
BA_ "GenSigTimeoutTime_RFHM" SG_ 1443 BSDEnable 0;
BA_ "GenSigTimeoutTime_MPAD" SG_ 1443 BSDEnable 0;
BA_ "GenSigTimeoutTime_IPC" SG_ 1443 BSDEnable 0;
BA_ "GenSigTimeoutTime_GNMM" SG_ 1443 BSDEnable 0;
BA_ "GenSigTimeoutTime_EVCU2" SG_ 1443 BSDEnable 0;
BA_ "GenSigTimeoutTime_ESL" SG_ 1443 BSDEnable 0;
BA_ "GenSigTimeoutTime_ECM" SG_ 1443 BSDEnable 0;
BA_ "GenSigTimeoutTime_DTCM" SG_ 1443 BSDEnable 0;
BA_ "GenSigTimeoutTime_DMSM" SG_ 1443 BSDEnable 0;
BA_ "GenSigTimeoutTime_BSM" SG_ 1443 BSDEnable 0;
BA_ "GenSigTimeoutTime_AGSM" SG_ 1443 BSDEnable 0;
BA_ "GenSigSendType" SG_ 1443 BSDEnable 3;
BA_ "GenSigStartValue" SG_ 1443 BSDEnable 2;
BA_ "GenSigTimeoutTime_RFHM" SG_ 1443 FlashLightWLock 0;
BA_ "GenSigTimeoutTime_MPAD" SG_ 1443 FlashLightWLock 0;
BA_ "GenSigTimeoutTime_IPC" SG_ 1443 FlashLightWLock 0;
BA_ "GenSigTimeoutTime_GNMM" SG_ 1443 FlashLightWLock 0;
BA_ "GenSigTimeoutTime_EVCU2" SG_ 1443 FlashLightWLock 0;
BA_ "GenSigTimeoutTime_ESL" SG_ 1443 FlashLightWLock 0;
BA_ "GenSigTimeoutTime_ECM" SG_ 1443 FlashLightWLock 0;
BA_ "GenSigTimeoutTime_DTCM" SG_ 1443 FlashLightWLock 0;
BA_ "GenSigTimeoutTime_DMSM" SG_ 1443 FlashLightWLock 0;
BA_ "GenSigTimeoutTime_BSM" SG_ 1443 FlashLightWLock 0;
BA_ "GenSigTimeoutTime_AGSM" SG_ 1443 FlashLightWLock 0;
BA_ "GenSigTimeoutTime_ADCAM" SG_ 1443 FlashLightWLock 0;
BA_ "GenSigSendType" SG_ 1443 FlashLightWLock 3;
BA_ "GenSigStartValue" SG_ 1443 FlashLightWLock 1;
BA_ "GenSigTimeoutTime_SGW" SG_ 2654339072 PreviousCanNMState_FD03_BCM 0;
BA_ "GenSigTimeoutTime_RFHM" SG_ 2654339072 PreviousCanNMState_FD03_BCM 0;
BA_ "GenSigTimeoutTime_MPAD" SG_ 2654339072 PreviousCanNMState_FD03_BCM 0;
BA_ "GenSigTimeoutTime_IPC" SG_ 2654339072 PreviousCanNMState_FD03_BCM 0;
BA_ "GenSigTimeoutTime_GNMM" SG_ 2654339072 PreviousCanNMState_FD03_BCM 0;
BA_ "GenSigTimeoutTime_EVCU2" SG_ 2654339072 PreviousCanNMState_FD03_BCM 0;
BA_ "GenSigTimeoutTime_ESL" SG_ 2654339072 PreviousCanNMState_FD03_BCM 0;
BA_ "GenSigTimeoutTime_ECM" SG_ 2654339072 PreviousCanNMState_FD03_BCM 0;
BA_ "GenSigTimeoutTime_DTCM" SG_ 2654339072 PreviousCanNMState_FD03_BCM 0;
BA_ "GenSigTimeoutTime_DMSM" SG_ 2654339072 PreviousCanNMState_FD03_BCM 0;
BA_ "GenSigTimeoutTime_BSM" SG_ 2654339072 PreviousCanNMState_FD03_BCM 0;
BA_ "GenSigTimeoutTime_BCM" SG_ 2654339072 PreviousCanNMState_FD03_BCM 0;
BA_ "GenSigTimeoutTime_AGSM" SG_ 2654339072 PreviousCanNMState_FD03_BCM 0;
BA_ "GenSigTimeoutTime_ADCAM" SG_ 2654339072 PreviousCanNMState_FD03_BCM 0;
BA_ "GenSigTimeoutTime_SGW" SG_ 2654339184 DES_FD02_SGW 0;
BA_ "GenSigTimeoutTime_RFHM" SG_ 2654339184 DES_FD02_SGW 0;
BA_ "GenSigTimeoutTime_MPAD" SG_ 2654339184 DES_FD02_SGW 0;
BA_ "GenSigTimeoutTime_IPC" SG_ 2654339184 DES_FD02_SGW 0;
BA_ "GenSigTimeoutTime_GNMM" SG_ 2654339184 DES_FD02_SGW 0;
BA_ "GenSigTimeoutTime_EVCU2" SG_ 2654339184 DES_FD02_SGW 0;
BA_ "GenSigTimeoutTime_ESL" SG_ 2654339184 DES_FD02_SGW 0;
BA_ "GenSigTimeoutTime_SGW" SG_ 2654339184 DES_FD03_SGW 0;
BA_ "GenSigTimeoutTime_RFHM" SG_ 2654339184 DES_FD03_SGW 0;
BA_ "GenSigTimeoutTime_MPAD" SG_ 2654339184 DES_FD03_SGW 0;
BA_ "GenSigTimeoutTime_IPC" SG_ 2654339184 DES_FD03_SGW 0;
BA_ "GenSigTimeoutTime_GNMM" SG_ 2654339184 DES_FD03_SGW 0;
BA_ "GenSigTimeoutTime_EVCU2" SG_ 2654339184 DES_FD03_SGW 0;
BA_ "GenSigTimeoutTime_ESL" SG_ 2654339184 DES_FD03_SGW 0;
BA_ "GenSigTimeoutTime_ECM" SG_ 2654339184 DES_FD03_SGW 0;
BA_ "GenSigTimeoutTime_DTCM" SG_ 2654339184 DES_FD03_SGW 0;
BA_ "GenSigTimeoutTime_DMSM" SG_ 2654339184 DES_FD03_SGW 0;
BA_ "GenSigTimeoutTime_BSM" SG_ 2654339184 DES_FD03_SGW 0;
BA_ "GenSigTimeoutTime_BCM" SG_ 2654339184 DES_FD03_SGW 0;
BA_ "GenSigTimeoutTime_AGSM" SG_ 2654339184 DES_FD03_SGW 0;
BA_ "GenSigTimeoutTime_ADCAM" SG_ 2654339184 DES_FD03_SGW 0;
BA_ "GenSigTimeoutTime_MPAD" SG_ 2654339184 PreviousCanNMState_FD02_SGW 0;
BA_ "GenSigTimeoutTime_IPC" SG_ 2654339184 PreviousCanNMState_FD02_SGW 0;
BA_ "GenSigTimeoutTime_GNMM" SG_ 2654339184 PreviousCanNMState_FD02_SGW 0;
BA_ "GenSigTimeoutTime_EVCU2" SG_ 2654339184 PreviousCanNMState_FD02_SGW 0;
BA_ "GenSigTimeoutTime_ESL" SG_ 2654339184 PreviousCanNMState_FD02_SGW 0;
BA_ "GenSigTimeoutTime_ECM" SG_ 2654339184 PreviousCanNMState_FD02_SGW 0;
BA_ "GenSigTimeoutTime_SGW" SG_ 2654339184 DES_FD08_SGW 0;
BA_ "GenSigTimeoutTime_RFHM" SG_ 2654339184 DES_FD08_SGW 0;
BA_ "GenSigTimeoutTime_MPAD" SG_ 2654339184 DES_FD08_SGW 0;
BA_ "GenSigTimeoutTime_IPC" SG_ 2654339184 DES_FD08_SGW 0;
BA_ "GenSigTimeoutTime_GNMM" SG_ 2654339184 DES_FD08_SGW 0;
BA_ "GenSigTimeoutTime_EVCU2" SG_ 2654339184 DES_FD08_SGW 0;
BA_ "GenSigTimeoutTime_ESL" SG_ 2654339184 DES_FD08_SGW 0;
BA_ "GenSigTimeoutTime_ECM" SG_ 2654339184 DES_FD08_SGW 0;
BA_ "GenSigTimeoutTime_DTCM" SG_ 2654339184 DES_FD08_SGW 0;
BA_ "GenSigTimeoutTime_DMSM" SG_ 2654339184 DES_FD08_SGW 0;
BA_ "GenSigTimeoutTime_BSM" SG_ 2654339184 DES_FD08_SGW 0;
BA_ "GenSigTimeoutTime_BCM" SG_ 2654339184 DES_FD08_SGW 0;
BA_ "GenSigTimeoutTime_AGSM" SG_ 2654339184 DES_FD08_SGW 0;
BA_ "GenSigTimeoutTime_ADCAM" SG_ 2654339184 DES_FD08_SGW 0;
BA_ "GenSigTimeoutTime_ECM" SG_ 2654339184 DES_FD02_SGW 0;
BA_ "GenSigTimeoutTime_AGSM" SG_ 1443 Active_Park_Prox_Chime 0;
BA_ "GenSigTimeoutTime_ADCAM" SG_ 1443 Active_Park_Prox_Chime 0;
BA_ "GenSigSendType" SG_ 1443 Active_Park_Prox_Chime 3;
BA_ "GenSigTimeoutTime_RFHM" SG_ 1443 Active_Park_Mode 0;
BA_ "GenSigTimeoutTime_MPAD" SG_ 1443 Active_Park_Mode 0;
BA_ "GenSigTimeoutTime_IPC" SG_ 1443 Active_Park_Mode 0;
BA_ "GenSigTimeoutTime_GNMM" SG_ 1443 Active_Park_Mode 0;
BA_ "GenSigTimeoutTime_EVCU2" SG_ 1443 Active_Park_Mode 0;
BA_ "GenSigTimeoutTime_ESL" SG_ 1443 Active_Park_Mode 0;
BA_ "GenSigTimeoutTime_ECM" SG_ 1443 Active_Park_Mode 0;
BA_ "GenSigTimeoutTime_DTCM" SG_ 1443 Active_Park_Mode 0;
BA_ "GenSigTimeoutTime_DMSM" SG_ 1443 Active_Park_Mode 0;
BA_ "GenSigTimeoutTime_AGSM" SG_ 1443 Active_Park_Mode 0;
BA_ "GenSigTimeoutTime_ADCAM" SG_ 1443 Active_Park_Mode 0;
BA_ "GenSigSendType" SG_ 1443 Active_Park_Mode 3;
BA_ "GenSigTimeoutTime_RFHM" SG_ 1443 Act_Lane_Mgt_Strength 0;
BA_ "GenSigTimeoutTime_IPC" SG_ 1443 Act_Lane_Mgt_Strength 0;
BA_ "GenSigTimeoutTime_GNMM" SG_ 1443 Act_Lane_Mgt_Strength 0;
BA_ "GenSigTimeoutTime_EVCU2" SG_ 1443 Act_Lane_Mgt_Strength 0;
BA_ "GenSigTimeoutTime_ESL" SG_ 1443 Act_Lane_Mgt_Strength 0;
BA_ "GenSigTimeoutTime_ECM" SG_ 1443 Act_Lane_Mgt_Strength 0;
BA_ "GenSigTimeoutTime_DTCM" SG_ 1443 Act_Lane_Mgt_Strength 0;
BA_ "GenSigTimeoutTime_DMSM" SG_ 1443 Act_Lane_Mgt_Strength 0;
BA_ "GenSigTimeoutTime_BSM" SG_ 1443 Act_Lane_Mgt_Strength 0;
BA_ "GenSigTimeoutTime_AGSM" SG_ 1443 Act_Lane_Mgt_Strength 0;
BA_ "GenSigSendType" SG_ 1443 Act_Lane_Mgt_Strength 3;
BA_ "GenSigTimeoutTime_RFHM" SG_ 1443 Act_Lane_Mgt 0;
BA_ "GenSigTimeoutTime_IPC" SG_ 1443 Act_Lane_Mgt 0;
BA_ "GenSigTimeoutTime_GNMM" SG_ 1443 Act_Lane_Mgt 0;
BA_ "GenSigTimeoutTime_EVCU2" SG_ 1443 Act_Lane_Mgt 0;
BA_ "GenSigTimeoutTime_ESL" SG_ 1443 Act_Lane_Mgt 0;
BA_ "GenSigTimeoutTime_ECM" SG_ 1443 Act_Lane_Mgt 0;
BA_ "GenSigTimeoutTime_DTCM" SG_ 1443 Act_Lane_Mgt 0;
BA_ "GenSigTimeoutTime_DMSM" SG_ 1443 Act_Lane_Mgt 0;
BA_ "GenSigTimeoutTime_BSM" SG_ 1443 Act_Lane_Mgt 0;
BA_ "GenSigTimeoutTime_AGSM" SG_ 1443 Act_Lane_Mgt 0;
BA_ "GenSigSendType" SG_ 1443 Act_Lane_Mgt 3;
BA_ "GenSigTimeoutTime_RFHM" SG_ 1443 Adaptive_Front_Lighting 0;
BA_ "GenSigTimeoutTime_MPAD" SG_ 1443 Adaptive_Front_Lighting 0;
BA_ "GenSigTimeoutTime_IPC" SG_ 1443 Adaptive_Front_Lighting 0;
BA_ "GenSigTimeoutTime_GNMM" SG_ 1443 Adaptive_Front_Lighting 0;
BA_ "GenSigTimeoutTime_EVCU2" SG_ 1443 Adaptive_Front_Lighting 0;
BA_ "GenSigTimeoutTime_ESL" SG_ 1443 Adaptive_Front_Lighting 0;
BA_ "GenSigTimeoutTime_ECM" SG_ 1443 Adaptive_Front_Lighting 0;
BA_ "GenSigTimeoutTime_DTCM" SG_ 1443 Adaptive_Front_Lighting 0;
BA_ "GenSigTimeoutTime_DMSM" SG_ 1443 Adaptive_Front_Lighting 0;
BA_ "GenSigTimeoutTime_BSM" SG_ 1443 Adaptive_Front_Lighting 0;
BA_ "GenSigTimeoutTime_AGSM" SG_ 1443 Adaptive_Front_Lighting 0;
BA_ "GenSigTimeoutTime_ADCAM" SG_ 1443 Adaptive_Front_Lighting 0;
BA_ "GenSigSendType" SG_ 1443 Adaptive_Front_Lighting 3;
BA_ "GenSigTimeoutTime_SGW" SG_ 2654339184 StayActiveSource_FD11_SGW 0;
BA_ "GenSigTimeoutTime_RFHM" SG_ 2654339184 StayActiveSource_FD11_SGW 0;
BA_ "GenSigTimeoutTime_MPAD" SG_ 2654339184 StayActiveSource_FD11_SGW 0;
BA_ "GenSigTimeoutTime_IPC" SG_ 2654339184 StayActiveSource_FD11_SGW 0;
BA_ "GenSigTimeoutTime_GNMM" SG_ 2654339184 StayActiveSource_FD11_SGW 0;
BA_ "GenSigTimeoutTime_EVCU2" SG_ 2654339184 StayActiveSource_FD11_SGW 0;
BA_ "GenSigTimeoutTime_ESL" SG_ 2654339184 StayActiveSource_FD11_SGW 0;
BA_ "GenSigTimeoutTime_ECM" SG_ 2654339184 StayActiveSource_FD11_SGW 0;
BA_ "GenSigTimeoutTime_DTCM" SG_ 2654339184 StayActiveSource_FD11_SGW 0;
BA_ "GenSigTimeoutTime_DMSM" SG_ 2654339184 StayActiveSource_FD11_SGW 0;
BA_ "GenSigTimeoutTime_BSM" SG_ 2654339184 StayActiveSource_FD11_SGW 0;
BA_ "GenSigTimeoutTime_BCM" SG_ 2654339184 StayActiveSource_FD11_SGW 0;
BA_ "GenSigTimeoutTime_AGSM" SG_ 2654339184 StayActiveSource_FD11_SGW 0;
BA_ "GenSigTimeoutTime_ADCAM" SG_ 2654339184 StayActiveSource_FD11_SGW 0;
BA_ "GenSigTimeoutTime_SGW" SG_ 2654339184 StayActiveSource_FD08_SGW 0;
BA_ "GenSigTimeoutTime_RFHM" SG_ 2654339184 StayActiveSource_FD08_SGW 0;
BA_ "GenSigTimeoutTime_MPAD" SG_ 2654339184 StayActiveSource_FD08_SGW 0;
BA_ "GenSigTimeoutTime_IPC" SG_ 2654339184 StayActiveSource_FD08_SGW 0;
BA_ "GenSigTimeoutTime_GNMM" SG_ 2654339184 StayActiveSource_FD08_SGW 0;
BA_ "GenSigTimeoutTime_EVCU2" SG_ 2654339184 StayActiveSource_FD08_SGW 0;
BA_ "GenSigTimeoutTime_ESL" SG_ 2654339184 StayActiveSource_FD08_SGW 0;
BA_ "GenSigTimeoutTime_ECM" SG_ 2654339184 StayActiveSource_FD08_SGW 0;
BA_ "GenSigTimeoutTime_DTCM" SG_ 2654339184 StayActiveSource_FD08_SGW 0;
BA_ "GenSigTimeoutTime_DMSM" SG_ 2654339184 StayActiveSource_FD08_SGW 0;
BA_ "GenSigTimeoutTime_BSM" SG_ 2654339184 StayActiveSource_FD08_SGW 0;
BA_ "GenSigTimeoutTime_BCM" SG_ 2654339184 StayActiveSource_FD08_SGW 0;
BA_ "GenSigTimeoutTime_AGSM" SG_ 2654339184 StayActiveSource_FD08_SGW 0;
BA_ "GenSigTimeoutTime_ADCAM" SG_ 2654339184 StayActiveSource_FD08_SGW 0;
BA_ "GenSigTimeoutTime_SGW" SG_ 2654339184 StayActiveSource_FD03_SGW 0;
BA_ "GenSigTimeoutTime_RFHM" SG_ 2654339184 StayActiveSource_FD03_SGW 0;
BA_ "GenSigTimeoutTime_MPAD" SG_ 2654339184 StayActiveSource_FD03_SGW 0;
BA_ "GenSigTimeoutTime_IPC" SG_ 2654339184 StayActiveSource_FD03_SGW 0;
BA_ "GenSigTimeoutTime_GNMM" SG_ 2654339184 StayActiveSource_FD03_SGW 0;
BA_ "GenSigTimeoutTime_EVCU2" SG_ 2654339184 StayActiveSource_FD03_SGW 0;
BA_ "GenSigTimeoutTime_ESL" SG_ 2654339184 StayActiveSource_FD03_SGW 0;
BA_ "GenSigTimeoutTime_ECM" SG_ 2654339184 StayActiveSource_FD03_SGW 0;
BA_ "GenSigTimeoutTime_DTCM" SG_ 2654339184 StayActiveSource_FD03_SGW 0;
BA_ "GenSigTimeoutTime_DMSM" SG_ 2654339184 StayActiveSource_FD03_SGW 0;
BA_ "GenSigTimeoutTime_BSM" SG_ 2654339184 StayActiveSource_FD03_SGW 0;
BA_ "GenSigTimeoutTime_BCM" SG_ 2654339184 StayActiveSource_FD03_SGW 0;
BA_ "GenSigTimeoutTime_AGSM" SG_ 2654339184 StayActiveSource_FD03_SGW 0;
BA_ "GenSigTimeoutTime_ADCAM" SG_ 2654339184 StayActiveSource_FD03_SGW 0;
BA_ "GenSigTimeoutTime_SGW" SG_ 2654339184 StayActiveSource_FD02_SGW 0;
BA_ "GenSigTimeoutTime_RFHM" SG_ 2654339184 StayActiveSource_FD02_SGW 0;
BA_ "GenSigTimeoutTime_MPAD" SG_ 2654339184 StayActiveSource_FD02_SGW 0;
BA_ "GenSigTimeoutTime_IPC" SG_ 2654339184 StayActiveSource_FD02_SGW 0;
BA_ "GenSigTimeoutTime_GNMM" SG_ 2654339184 StayActiveSource_FD02_SGW 0;
BA_ "GenSigTimeoutTime_EVCU2" SG_ 2654339184 StayActiveSource_FD02_SGW 0;
BA_ "GenSigTimeoutTime_ESL" SG_ 2654339184 StayActiveSource_FD02_SGW 0;
BA_ "GenSigTimeoutTime_ECM" SG_ 2654339184 StayActiveSource_FD02_SGW 0;
BA_ "GenSigTimeoutTime_DTCM" SG_ 2654339184 StayActiveSource_FD02_SGW 0;
BA_ "GenSigTimeoutTime_DMSM" SG_ 2654339184 StayActiveSource_FD02_SGW 0;
BA_ "GenSigTimeoutTime_BSM" SG_ 2654339184 StayActiveSource_FD02_SGW 0;
BA_ "GenSigTimeoutTime_BCM" SG_ 2654339184 StayActiveSource_FD02_SGW 0;
BA_ "GenSigTimeoutTime_AGSM" SG_ 2654339184 StayActiveSource_FD02_SGW 0;
BA_ "GenSigTimeoutTime_ADCAM" SG_ 2654339184 StayActiveSource_FD02_SGW 0;
BA_ "GenSigTimeoutTime_SGW" SG_ 2654339184 StayActiveSource_FD01_SGW 0;
BA_ "GenSigTimeoutTime_RFHM" SG_ 2654339184 StayActiveSource_FD01_SGW 0;
BA_ "GenSigTimeoutTime_MPAD" SG_ 2654339184 StayActiveSource_FD01_SGW 0;
BA_ "GenSigTimeoutTime_IPC" SG_ 2654339184 StayActiveSource_FD01_SGW 0;
BA_ "GenSigTimeoutTime_GNMM" SG_ 2654339184 StayActiveSource_FD01_SGW 0;
BA_ "GenSigTimeoutTime_EVCU2" SG_ 2654339184 StayActiveSource_FD01_SGW 0;
BA_ "GenSigTimeoutTime_ESL" SG_ 2654339184 StayActiveSource_FD01_SGW 0;
BA_ "GenSigTimeoutTime_ECM" SG_ 2654339184 StayActiveSource_FD01_SGW 0;
BA_ "GenSigTimeoutTime_DTCM" SG_ 2654339184 StayActiveSource_FD01_SGW 0;
BA_ "GenSigTimeoutTime_DMSM" SG_ 2654339184 StayActiveSource_FD01_SGW 0;
BA_ "GenSigTimeoutTime_BSM" SG_ 2654339184 StayActiveSource_FD01_SGW 0;
BA_ "GenSigTimeoutTime_BCM" SG_ 2654339184 StayActiveSource_FD01_SGW 0;
BA_ "GenSigTimeoutTime_AGSM" SG_ 2654339184 StayActiveSource_FD01_SGW 0;
BA_ "GenSigTimeoutTime_ADCAM" SG_ 2654339184 StayActiveSource_FD01_SGW 0;
BA_ "GenSigTimeoutTime_SGW" SG_ 2654339184 WakeupSource_FD11_SGW 0;
BA_ "GenSigTimeoutTime_RFHM" SG_ 2654339184 WakeupSource_FD11_SGW 0;
BA_ "GenSigTimeoutTime_MPAD" SG_ 2654339184 WakeupSource_FD11_SGW 0;
BA_ "GenSigTimeoutTime_IPC" SG_ 2654339184 WakeupSource_FD11_SGW 0;
BA_ "GenSigTimeoutTime_GNMM" SG_ 2654339184 WakeupSource_FD11_SGW 0;
BA_ "GenSigTimeoutTime_EVCU2" SG_ 2654339184 WakeupSource_FD11_SGW 0;
BA_ "GenSigTimeoutTime_ESL" SG_ 2654339184 WakeupSource_FD11_SGW 0;
BA_ "GenSigTimeoutTime_ECM" SG_ 2654339184 WakeupSource_FD11_SGW 0;
BA_ "GenSigTimeoutTime_DTCM" SG_ 2654339184 WakeupSource_FD11_SGW 0;
BA_ "GenSigTimeoutTime_DMSM" SG_ 2654339184 WakeupSource_FD11_SGW 0;
BA_ "GenSigTimeoutTime_BSM" SG_ 2654339184 WakeupSource_FD11_SGW 0;
BA_ "GenSigTimeoutTime_BCM" SG_ 2654339184 WakeupSource_FD11_SGW 0;
BA_ "GenSigTimeoutTime_AGSM" SG_ 2654339184 WakeupSource_FD11_SGW 0;
BA_ "GenSigTimeoutTime_ADCAM" SG_ 2654339184 WakeupSource_FD11_SGW 0;
BA_ "GenSigTimeoutTime_SGW" SG_ 2654339184 WakeupSource_FD08_SGW 0;
BA_ "GenSigTimeoutTime_RFHM" SG_ 2654339184 WakeupSource_FD08_SGW 0;
BA_ "GenSigTimeoutTime_MPAD" SG_ 2654339184 WakeupSource_FD08_SGW 0;
BA_ "GenSigTimeoutTime_IPC" SG_ 2654339184 WakeupSource_FD08_SGW 0;
BA_ "GenSigTimeoutTime_GNMM" SG_ 2654339184 WakeupSource_FD08_SGW 0;
BA_ "GenSigTimeoutTime_EVCU2" SG_ 2654339184 WakeupSource_FD08_SGW 0;
BA_ "GenSigTimeoutTime_ESL" SG_ 2654339184 WakeupSource_FD08_SGW 0;
BA_ "GenSigTimeoutTime_ECM" SG_ 2654339184 WakeupSource_FD08_SGW 0;
BA_ "GenSigTimeoutTime_DTCM" SG_ 2654339184 WakeupSource_FD08_SGW 0;
BA_ "GenSigTimeoutTime_DMSM" SG_ 2654339184 WakeupSource_FD08_SGW 0;
BA_ "GenSigTimeoutTime_BSM" SG_ 2654339184 WakeupSource_FD08_SGW 0;
BA_ "GenSigTimeoutTime_BCM" SG_ 2654339184 WakeupSource_FD08_SGW 0;
BA_ "GenSigTimeoutTime_AGSM" SG_ 2654339184 WakeupSource_FD08_SGW 0;
BA_ "GenSigTimeoutTime_ADCAM" SG_ 2654339184 WakeupSource_FD08_SGW 0;
BA_ "GenSigTimeoutTime_SGW" SG_ 2654339184 WakeupSource_FD03_SGW 0;
BA_ "GenSigTimeoutTime_RFHM" SG_ 2654339184 WakeupSource_FD03_SGW 0;
BA_ "GenSigTimeoutTime_MPAD" SG_ 2654339184 WakeupSource_FD03_SGW 0;
BA_ "GenSigTimeoutTime_IPC" SG_ 2654339184 WakeupSource_FD03_SGW 0;
BA_ "GenSigTimeoutTime_GNMM" SG_ 2654339184 WakeupSource_FD03_SGW 0;
BA_ "GenSigTimeoutTime_EVCU2" SG_ 2654339184 WakeupSource_FD03_SGW 0;
BA_ "GenSigTimeoutTime_ESL" SG_ 2654339184 WakeupSource_FD03_SGW 0;
BA_ "GenSigTimeoutTime_ECM" SG_ 2654339184 WakeupSource_FD03_SGW 0;
BA_ "GenSigTimeoutTime_DTCM" SG_ 2654339184 WakeupSource_FD03_SGW 0;
BA_ "GenSigTimeoutTime_DMSM" SG_ 2654339184 WakeupSource_FD03_SGW 0;
BA_ "GenSigTimeoutTime_BSM" SG_ 2654339184 WakeupSource_FD03_SGW 0;
BA_ "GenSigTimeoutTime_BCM" SG_ 2654339184 WakeupSource_FD03_SGW 0;
BA_ "GenSigTimeoutTime_AGSM" SG_ 2654339184 WakeupSource_FD03_SGW 0;
BA_ "GenSigTimeoutTime_ADCAM" SG_ 2654339184 WakeupSource_FD03_SGW 0;
BA_ "GenSigTimeoutTime_SGW" SG_ 2654339184 WakeupSource_FD02_SGW 0;
BA_ "GenSigTimeoutTime_RFHM" SG_ 2654339184 WakeupSource_FD02_SGW 0;
BA_ "GenSigTimeoutTime_MPAD" SG_ 2654339184 WakeupSource_FD02_SGW 0;
BA_ "GenSigTimeoutTime_IPC" SG_ 2654339184 WakeupSource_FD02_SGW 0;
BA_ "GenSigTimeoutTime_GNMM" SG_ 2654339184 WakeupSource_FD02_SGW 0;
BA_ "GenSigTimeoutTime_EVCU2" SG_ 2654339184 WakeupSource_FD02_SGW 0;
BA_ "GenSigTimeoutTime_ESL" SG_ 2654339184 WakeupSource_FD02_SGW 0;
BA_ "GenSigTimeoutTime_ECM" SG_ 2654339184 WakeupSource_FD02_SGW 0;
BA_ "GenSigTimeoutTime_DTCM" SG_ 2654339184 WakeupSource_FD02_SGW 0;
BA_ "GenSigTimeoutTime_DMSM" SG_ 2654339184 WakeupSource_FD02_SGW 0;
BA_ "GenSigTimeoutTime_BSM" SG_ 2654339184 WakeupSource_FD02_SGW 0;
BA_ "GenSigTimeoutTime_BCM" SG_ 2654339184 WakeupSource_FD02_SGW 0;
BA_ "GenSigTimeoutTime_AGSM" SG_ 2654339184 WakeupSource_FD02_SGW 0;
BA_ "GenSigTimeoutTime_ADCAM" SG_ 2654339184 WakeupSource_FD02_SGW 0;
BA_ "GenSigTimeoutTime_SGW" SG_ 2654339184 WakeupSource_FD01_SGW 0;
BA_ "GenSigTimeoutTime_RFHM" SG_ 2654339184 WakeupSource_FD01_SGW 0;
BA_ "GenSigTimeoutTime_MPAD" SG_ 2654339184 WakeupSource_FD01_SGW 0;
BA_ "GenSigTimeoutTime_IPC" SG_ 2654339184 WakeupSource_FD01_SGW 0;
BA_ "GenSigTimeoutTime_GNMM" SG_ 2654339184 WakeupSource_FD01_SGW 0;
BA_ "GenSigTimeoutTime_EVCU2" SG_ 2654339184 WakeupSource_FD01_SGW 0;
BA_ "GenSigTimeoutTime_ESL" SG_ 2654339184 WakeupSource_FD01_SGW 0;
BA_ "GenSigTimeoutTime_ECM" SG_ 2654339184 WakeupSource_FD01_SGW 0;
BA_ "GenSigTimeoutTime_DTCM" SG_ 2654339184 WakeupSource_FD01_SGW 0;
BA_ "GenSigTimeoutTime_DMSM" SG_ 2654339184 WakeupSource_FD01_SGW 0;
BA_ "GenSigTimeoutTime_BSM" SG_ 2654339184 WakeupSource_FD01_SGW 0;
BA_ "GenSigTimeoutTime_BCM" SG_ 2654339184 WakeupSource_FD01_SGW 0;
BA_ "GenSigTimeoutTime_AGSM" SG_ 2654339184 WakeupSource_FD01_SGW 0;
BA_ "GenSigTimeoutTime_ADCAM" SG_ 2654339184 WakeupSource_FD01_SGW 0;
BA_ "GenSigTimeoutTime_ADCAM" SG_ 2654339184 PreviousCanNMState_FD11_SGW 0;
BA_ "GenSigTimeoutTime_SGW" SG_ 2654339184 PreviousCanNMState_FD11_SGW 0;
BA_ "GenSigTimeoutTime_RFHM" SG_ 2654339184 PreviousCanNMState_FD11_SGW 0;
BA_ "GenSigTimeoutTime_MPAD" SG_ 2654339184 PreviousCanNMState_FD11_SGW 0;
BA_ "GenSigTimeoutTime_IPC" SG_ 2654339184 PreviousCanNMState_FD11_SGW 0;
BA_ "GenSigTimeoutTime_GNMM" SG_ 2654339184 PreviousCanNMState_FD11_SGW 0;
BA_ "GenSigTimeoutTime_EVCU2" SG_ 2654339184 PreviousCanNMState_FD11_SGW 0;
BA_ "GenSigTimeoutTime_ESL" SG_ 2654339184 PreviousCanNMState_FD11_SGW 0;
BA_ "GenSigTimeoutTime_ECM" SG_ 2654339184 PreviousCanNMState_FD11_SGW 0;
BA_ "GenSigTimeoutTime_DTCM" SG_ 2654339184 PreviousCanNMState_FD11_SGW 0;
BA_ "GenSigTimeoutTime_DMSM" SG_ 2654339184 PreviousCanNMState_FD11_SGW 0;
BA_ "GenSigTimeoutTime_BSM" SG_ 2654339184 PreviousCanNMState_FD11_SGW 0;
BA_ "GenSigTimeoutTime_BCM" SG_ 2654339184 PreviousCanNMState_FD11_SGW 0;
BA_ "GenSigTimeoutTime_AGSM" SG_ 2654339184 PreviousCanNMState_FD11_SGW 0;
BA_ "GenSigTimeoutTime_SGW" SG_ 2654339184 PreviousCanNMState_FD08_SGW 0;
BA_ "GenSigTimeoutTime_RFHM" SG_ 2654339184 PreviousCanNMState_FD08_SGW 0;
BA_ "GenSigTimeoutTime_MPAD" SG_ 2654339184 PreviousCanNMState_FD08_SGW 0;
BA_ "GenSigTimeoutTime_IPC" SG_ 2654339184 PreviousCanNMState_FD08_SGW 0;
BA_ "GenSigTimeoutTime_GNMM" SG_ 2654339184 PreviousCanNMState_FD08_SGW 0;
BA_ "GenSigTimeoutTime_EVCU2" SG_ 2654339184 PreviousCanNMState_FD08_SGW 0;
BA_ "GenSigTimeoutTime_ESL" SG_ 2654339184 PreviousCanNMState_FD08_SGW 0;
BA_ "GenSigTimeoutTime_ECM" SG_ 2654339184 PreviousCanNMState_FD08_SGW 0;
BA_ "GenSigTimeoutTime_DTCM" SG_ 2654339184 PreviousCanNMState_FD08_SGW 0;
BA_ "GenSigTimeoutTime_DMSM" SG_ 2654339184 PreviousCanNMState_FD08_SGW 0;
BA_ "GenSigTimeoutTime_BSM" SG_ 2654339184 PreviousCanNMState_FD08_SGW 0;
BA_ "GenSigTimeoutTime_BCM" SG_ 2654339184 PreviousCanNMState_FD08_SGW 0;
BA_ "GenSigTimeoutTime_AGSM" SG_ 2654339184 PreviousCanNMState_FD08_SGW 0;
BA_ "GenSigTimeoutTime_ADCAM" SG_ 2654339184 PreviousCanNMState_FD08_SGW 0;
BA_ "GenSigTimeoutTime_SGW" SG_ 2654339184 PreviousCanNMState_FD02_SGW 0;
BA_ "GenSigTimeoutTime_RFHM" SG_ 2654339184 PreviousCanNMState_FD02_SGW 0;
BA_ "GenSigTimeoutTime_SGW" SG_ 2654339184 PreviousCanNMState_FD03_SGW 0;
BA_ "GenSigTimeoutTime_RFHM" SG_ 2654339184 PreviousCanNMState_FD03_SGW 0;
BA_ "GenSigTimeoutTime_MPAD" SG_ 2654339184 PreviousCanNMState_FD03_SGW 0;
BA_ "GenSigTimeoutTime_IPC" SG_ 2654339184 PreviousCanNMState_FD03_SGW 0;
BA_ "GenSigTimeoutTime_GNMM" SG_ 2654339184 PreviousCanNMState_FD03_SGW 0;
BA_ "GenSigTimeoutTime_EVCU2" SG_ 2654339184 PreviousCanNMState_FD03_SGW 0;
BA_ "GenSigTimeoutTime_ESL" SG_ 2654339184 PreviousCanNMState_FD03_SGW 0;
BA_ "GenSigTimeoutTime_ECM" SG_ 2654339184 PreviousCanNMState_FD03_SGW 0;
BA_ "GenSigTimeoutTime_DTCM" SG_ 2654339184 PreviousCanNMState_FD03_SGW 0;
BA_ "GenSigTimeoutTime_DMSM" SG_ 2654339184 PreviousCanNMState_FD03_SGW 0;
BA_ "GenSigTimeoutTime_BSM" SG_ 2654339184 PreviousCanNMState_FD03_SGW 0;
BA_ "GenSigTimeoutTime_BCM" SG_ 2654339184 PreviousCanNMState_FD03_SGW 0;
BA_ "GenSigTimeoutTime_AGSM" SG_ 2654339184 PreviousCanNMState_FD03_SGW 0;
BA_ "GenSigTimeoutTime_ADCAM" SG_ 2654339184 PreviousCanNMState_FD03_SGW 0;
BA_ "GenSigTimeoutTime_DTCM" SG_ 2654339184 DES_FD02_SGW 0;
BA_ "GenSigTimeoutTime_DMSM" SG_ 2654339184 DES_FD02_SGW 0;
BA_ "GenSigTimeoutTime_BSM" SG_ 2654339184 DES_FD02_SGW 0;
BA_ "GenSigTimeoutTime_BCM" SG_ 2654339184 DES_FD02_SGW 0;
BA_ "GenSigTimeoutTime_AGSM" SG_ 2654339184 DES_FD02_SGW 0;
BA_ "GenSigTimeoutTime_ADCAM" SG_ 2654339184 DES_FD02_SGW 0;
BA_ "GenSigTimeoutTime_SGW" SG_ 2654339184 DES_FD01_SGW 0;
BA_ "GenSigTimeoutTime_RFHM" SG_ 2654339184 DES_FD01_SGW 0;
BA_ "GenSigTimeoutTime_MPAD" SG_ 2654339184 DES_FD01_SGW 0;
BA_ "GenSigTimeoutTime_IPC" SG_ 2654339184 DES_FD01_SGW 0;
BA_ "GenSigTimeoutTime_GNMM" SG_ 2654339184 DES_FD01_SGW 0;
BA_ "GenSigTimeoutTime_EVCU2" SG_ 2654339184 DES_FD01_SGW 0;
BA_ "GenSigTimeoutTime_ESL" SG_ 2654339184 DES_FD01_SGW 0;
BA_ "GenSigTimeoutTime_ECM" SG_ 2654339184 DES_FD01_SGW 0;
BA_ "GenSigTimeoutTime_DTCM" SG_ 2654339184 DES_FD01_SGW 0;
BA_ "GenSigTimeoutTime_DMSM" SG_ 2654339184 DES_FD01_SGW 0;
BA_ "GenSigTimeoutTime_BSM" SG_ 2654339184 DES_FD01_SGW 0;
BA_ "GenSigTimeoutTime_BCM" SG_ 2654339184 DES_FD01_SGW 0;
BA_ "GenSigTimeoutTime_AGSM" SG_ 2654339184 DES_FD01_SGW 0;
BA_ "GenSigTimeoutTime_ADCAM" SG_ 2654339184 DES_FD01_SGW 0;
BA_ "GenSigTimeoutTime_SGW" SG_ 2654339184 CurrentCanNMState_FD11_SGW 0;
BA_ "GenSigTimeoutTime_RFHM" SG_ 2654339184 CurrentCanNMState_FD11_SGW 0;
BA_ "GenSigTimeoutTime_MPAD" SG_ 2654339184 CurrentCanNMState_FD11_SGW 0;
BA_ "GenSigTimeoutTime_IPC" SG_ 2654339184 CurrentCanNMState_FD11_SGW 0;
BA_ "GenSigTimeoutTime_GNMM" SG_ 2654339184 CurrentCanNMState_FD11_SGW 0;
BA_ "GenSigTimeoutTime_EVCU2" SG_ 2654339184 CurrentCanNMState_FD11_SGW 0;
BA_ "GenSigTimeoutTime_ESL" SG_ 2654339184 CurrentCanNMState_FD11_SGW 0;
BA_ "GenSigTimeoutTime_ECM" SG_ 2654339184 CurrentCanNMState_FD11_SGW 0;
BA_ "GenSigTimeoutTime_DTCM" SG_ 2654339184 CurrentCanNMState_FD11_SGW 0;
BA_ "GenSigTimeoutTime_DMSM" SG_ 2654339184 CurrentCanNMState_FD11_SGW 0;
BA_ "GenSigTimeoutTime_BSM" SG_ 2654339184 CurrentCanNMState_FD11_SGW 0;
BA_ "GenSigTimeoutTime_BCM" SG_ 2654339184 CurrentCanNMState_FD11_SGW 0;
BA_ "GenSigTimeoutTime_AGSM" SG_ 2654339184 CurrentCanNMState_FD11_SGW 0;
BA_ "GenSigTimeoutTime_ADCAM" SG_ 2654339184 CurrentCanNMState_FD11_SGW 0;
BA_ "GenSigTimeoutTime_SGW" SG_ 2654339184 CurrentCanNMState_FD08_SGW 0;
BA_ "GenSigTimeoutTime_RFHM" SG_ 2654339184 CurrentCanNMState_FD08_SGW 0;
BA_ "GenSigTimeoutTime_MPAD" SG_ 2654339184 CurrentCanNMState_FD08_SGW 0;
BA_ "GenSigTimeoutTime_IPC" SG_ 2654339184 CurrentCanNMState_FD08_SGW 0;
BA_ "GenSigTimeoutTime_GNMM" SG_ 2654339184 CurrentCanNMState_FD08_SGW 0;
BA_ "GenSigTimeoutTime_EVCU2" SG_ 2654339184 CurrentCanNMState_FD08_SGW 0;
BA_ "GenSigTimeoutTime_ESL" SG_ 2654339184 CurrentCanNMState_FD08_SGW 0;
BA_ "GenSigTimeoutTime_ECM" SG_ 2654339184 CurrentCanNMState_FD08_SGW 0;
BA_ "GenSigTimeoutTime_DTCM" SG_ 2654339184 CurrentCanNMState_FD08_SGW 0;
BA_ "GenSigTimeoutTime_DMSM" SG_ 2654339184 CurrentCanNMState_FD08_SGW 0;
BA_ "GenSigTimeoutTime_BSM" SG_ 2654339184 CurrentCanNMState_FD08_SGW 0;
BA_ "GenSigTimeoutTime_BCM" SG_ 2654339184 CurrentCanNMState_FD08_SGW 0;
BA_ "GenSigTimeoutTime_AGSM" SG_ 2654339184 CurrentCanNMState_FD08_SGW 0;
BA_ "GenSigTimeoutTime_ADCAM" SG_ 2654339184 CurrentCanNMState_FD08_SGW 0;
BA_ "GenSigTimeoutTime_SGW" SG_ 2654339184 CurrentCanNMState_FD03_SGW 0;
BA_ "GenSigTimeoutTime_RFHM" SG_ 2654339184 CurrentCanNMState_FD03_SGW 0;
BA_ "GenSigTimeoutTime_MPAD" SG_ 2654339184 CurrentCanNMState_FD03_SGW 0;
BA_ "GenSigTimeoutTime_IPC" SG_ 2654339184 CurrentCanNMState_FD03_SGW 0;
BA_ "GenSigTimeoutTime_GNMM" SG_ 2654339184 CurrentCanNMState_FD03_SGW 0;
BA_ "GenSigTimeoutTime_EVCU2" SG_ 2654339184 CurrentCanNMState_FD03_SGW 0;
BA_ "GenSigTimeoutTime_ESL" SG_ 2654339184 CurrentCanNMState_FD03_SGW 0;
BA_ "GenSigTimeoutTime_ECM" SG_ 2654339184 CurrentCanNMState_FD03_SGW 0;
BA_ "GenSigTimeoutTime_DTCM" SG_ 2654339184 CurrentCanNMState_FD03_SGW 0;
BA_ "GenSigTimeoutTime_DMSM" SG_ 2654339184 CurrentCanNMState_FD03_SGW 0;
BA_ "GenSigTimeoutTime_BSM" SG_ 2654339184 CurrentCanNMState_FD03_SGW 0;
BA_ "GenSigTimeoutTime_BCM" SG_ 2654339184 CurrentCanNMState_FD03_SGW 0;
BA_ "GenSigTimeoutTime_AGSM" SG_ 2654339184 CurrentCanNMState_FD03_SGW 0;
BA_ "GenSigTimeoutTime_ADCAM" SG_ 2654339184 CurrentCanNMState_FD03_SGW 0;
BA_ "GenSigTimeoutTime_SGW" SG_ 2654339184 CurrentCanNMState_FD02_SGW 0;
BA_ "GenSigTimeoutTime_RFHM" SG_ 2654339184 CurrentCanNMState_FD02_SGW 0;
BA_ "GenSigTimeoutTime_MPAD" SG_ 2654339184 CurrentCanNMState_FD02_SGW 0;
BA_ "GenSigTimeoutTime_IPC" SG_ 2654339184 CurrentCanNMState_FD02_SGW 0;
BA_ "GenSigTimeoutTime_GNMM" SG_ 2654339184 CurrentCanNMState_FD02_SGW 0;
BA_ "GenSigTimeoutTime_EVCU2" SG_ 2654339184 CurrentCanNMState_FD02_SGW 0;
BA_ "GenSigTimeoutTime_ESL" SG_ 2654339184 CurrentCanNMState_FD02_SGW 0;
BA_ "GenSigTimeoutTime_ECM" SG_ 2654339184 CurrentCanNMState_FD02_SGW 0;
BA_ "GenSigTimeoutTime_DTCM" SG_ 2654339184 CurrentCanNMState_FD02_SGW 0;
BA_ "GenSigTimeoutTime_DMSM" SG_ 2654339184 CurrentCanNMState_FD02_SGW 0;
BA_ "GenSigTimeoutTime_BSM" SG_ 2654339184 CurrentCanNMState_FD02_SGW 0;
BA_ "GenSigTimeoutTime_BCM" SG_ 2654339184 CurrentCanNMState_FD02_SGW 0;
BA_ "GenSigTimeoutTime_AGSM" SG_ 2654339184 CurrentCanNMState_FD02_SGW 0;
BA_ "GenSigTimeoutTime_ADCAM" SG_ 2654339184 CurrentCanNMState_FD02_SGW 0;
BA_ "GenSigTimeoutTime_SGW" SG_ 2654339184 CurrentCanNMState_FD01_SGW 0;
BA_ "GenSigTimeoutTime_RFHM" SG_ 2654339184 CurrentCanNMState_FD01_SGW 0;
BA_ "GenSigTimeoutTime_MPAD" SG_ 2654339184 CurrentCanNMState_FD01_SGW 0;
BA_ "GenSigTimeoutTime_IPC" SG_ 2654339184 CurrentCanNMState_FD01_SGW 0;
BA_ "GenSigTimeoutTime_GNMM" SG_ 2654339184 CurrentCanNMState_FD01_SGW 0;
BA_ "GenSigTimeoutTime_EVCU2" SG_ 2654339184 CurrentCanNMState_FD01_SGW 0;
BA_ "GenSigTimeoutTime_ESL" SG_ 2654339184 CurrentCanNMState_FD01_SGW 0;
BA_ "GenSigTimeoutTime_ECM" SG_ 2654339184 CurrentCanNMState_FD01_SGW 0;
BA_ "GenSigTimeoutTime_DTCM" SG_ 2654339184 CurrentCanNMState_FD01_SGW 0;
BA_ "GenSigTimeoutTime_DMSM" SG_ 2654339184 CurrentCanNMState_FD01_SGW 0;
BA_ "GenSigTimeoutTime_BSM" SG_ 2654339184 CurrentCanNMState_FD01_SGW 0;
BA_ "GenSigTimeoutTime_BCM" SG_ 2654339184 CurrentCanNMState_FD01_SGW 0;
BA_ "GenSigTimeoutTime_AGSM" SG_ 2654339184 CurrentCanNMState_FD01_SGW 0;
BA_ "GenSigTimeoutTime_ADCAM" SG_ 2654339184 CurrentCanNMState_FD01_SGW 0;
BA_ "GenSigTimeoutTime_SGW" SG_ 2654339184 GenericFailSts_FD11_SGW 0;
BA_ "GenSigTimeoutTime_RFHM" SG_ 2654339184 GenericFailSts_FD11_SGW 0;
BA_ "GenSigTimeoutTime_MPAD" SG_ 2654339184 GenericFailSts_FD11_SGW 0;
BA_ "GenSigTimeoutTime_IPC" SG_ 2654339184 GenericFailSts_FD11_SGW 0;
BA_ "GenSigTimeoutTime_GNMM" SG_ 2654339184 GenericFailSts_FD11_SGW 0;
BA_ "GenSigTimeoutTime_EVCU2" SG_ 2654339184 GenericFailSts_FD11_SGW 0;
BA_ "GenSigTimeoutTime_ESL" SG_ 2654339184 GenericFailSts_FD11_SGW 0;
BA_ "GenSigTimeoutTime_ECM" SG_ 2654339184 GenericFailSts_FD11_SGW 0;
BA_ "GenSigTimeoutTime_DTCM" SG_ 2654339184 GenericFailSts_FD11_SGW 0;
BA_ "GenSigTimeoutTime_DMSM" SG_ 2654339184 GenericFailSts_FD11_SGW 0;
BA_ "GenSigTimeoutTime_BSM" SG_ 2654339184 GenericFailSts_FD11_SGW 0;
BA_ "GenSigTimeoutTime_BCM" SG_ 2654339184 GenericFailSts_FD11_SGW 0;
BA_ "GenSigTimeoutTime_AGSM" SG_ 2654339184 GenericFailSts_FD11_SGW 0;
BA_ "GenSigTimeoutTime_ADCAM" SG_ 2654339184 GenericFailSts_FD11_SGW 0;
BA_ "GenSigTimeoutTime_DMSM" SG_ 2654339184 EOL_FD02_SGW 0;
BA_ "GenSigTimeoutTime_BSM" SG_ 2654339184 EOL_FD02_SGW 0;
BA_ "GenSigTimeoutTime_BCM" SG_ 2654339184 EOL_FD02_SGW 0;
BA_ "GenSigTimeoutTime_AGSM" SG_ 2654339184 EOL_FD02_SGW 0;
BA_ "GenSigTimeoutTime_ADCAM" SG_ 2654339184 EOL_FD02_SGW 0;
BA_ "GenSigTimeoutTime_SGW" SG_ 2654339184 EOL_FD02_SGW 0;
BA_ "GenSigTimeoutTime_RFHM" SG_ 2654339184 EOL_FD02_SGW 0;
BA_ "GenSigTimeoutTime_MPAD" SG_ 2654339184 EOL_FD02_SGW 0;
BA_ "GenSigTimeoutTime_IPC" SG_ 2654339184 EOL_FD02_SGW 0;
BA_ "GenSigTimeoutTime_GNMM" SG_ 2654339184 EOL_FD02_SGW 0;
BA_ "GenSigTimeoutTime_EVCU2" SG_ 2654339184 EOL_FD02_SGW 0;
BA_ "GenSigTimeoutTime_ESL" SG_ 2654339184 EOL_FD02_SGW 0;
BA_ "GenSigTimeoutTime_ECM" SG_ 2654339184 EOL_FD02_SGW 0;
BA_ "GenSigTimeoutTime_DTCM" SG_ 2654339184 EOL_FD02_SGW 0;
BA_ "GenSigTimeoutTime_SGW" SG_ 2654339184 EOL_FD03_SGW 0;
BA_ "GenSigTimeoutTime_RFHM" SG_ 2654339184 EOL_FD03_SGW 0;
BA_ "GenSigTimeoutTime_MPAD" SG_ 2654339184 EOL_FD03_SGW 0;
BA_ "GenSigTimeoutTime_IPC" SG_ 2654339184 EOL_FD03_SGW 0;
BA_ "GenSigTimeoutTime_GNMM" SG_ 2654339184 EOL_FD03_SGW 0;
BA_ "GenSigTimeoutTime_EVCU2" SG_ 2654339184 EOL_FD03_SGW 0;
BA_ "GenSigTimeoutTime_ESL" SG_ 2654339184 EOL_FD03_SGW 0;
BA_ "GenSigTimeoutTime_ECM" SG_ 2654339184 EOL_FD03_SGW 0;
BA_ "GenSigTimeoutTime_DTCM" SG_ 2654339184 EOL_FD03_SGW 0;
BA_ "GenSigTimeoutTime_DMSM" SG_ 2654339184 EOL_FD03_SGW 0;
BA_ "GenSigTimeoutTime_BSM" SG_ 2654339184 EOL_FD03_SGW 0;
BA_ "GenSigTimeoutTime_AGSM" SG_ 2654339184 EOL_FD03_SGW 0;
BA_ "GenSigTimeoutTime_ADCAM" SG_ 2654339184 EOL_FD03_SGW 0;
BA_ "GenSigTimeoutTime_SGW" SG_ 2654339184 EOL_FD08_SGW 0;
BA_ "GenSigTimeoutTime_RFHM" SG_ 2654339184 EOL_FD08_SGW 0;
BA_ "GenSigTimeoutTime_MPAD" SG_ 2654339184 EOL_FD08_SGW 0;
BA_ "GenSigTimeoutTime_IPC" SG_ 2654339184 EOL_FD08_SGW 0;
BA_ "GenSigTimeoutTime_GNMM" SG_ 2654339184 EOL_FD08_SGW 0;
BA_ "GenSigTimeoutTime_EVCU2" SG_ 2654339184 EOL_FD08_SGW 0;
BA_ "GenSigTimeoutTime_ESL" SG_ 2654339184 EOL_FD08_SGW 0;
BA_ "GenSigTimeoutTime_ECM" SG_ 2654339184 EOL_FD08_SGW 0;
BA_ "GenSigTimeoutTime_DTCM" SG_ 2654339184 EOL_FD08_SGW 0;
BA_ "GenSigTimeoutTime_DMSM" SG_ 2654339184 EOL_FD08_SGW 0;
BA_ "GenSigTimeoutTime_BSM" SG_ 2654339184 EOL_FD08_SGW 0;
BA_ "GenSigTimeoutTime_BCM" SG_ 2654339184 EOL_FD08_SGW 0;
BA_ "GenSigTimeoutTime_AGSM" SG_ 2654339184 EOL_FD08_SGW 0;
BA_ "GenSigTimeoutTime_ADCAM" SG_ 2654339184 EOL_FD08_SGW 0;
BA_ "GenSigTimeoutTime_SGW" SG_ 2654339184 EOL_FD11_SGW 0;
BA_ "GenSigTimeoutTime_RFHM" SG_ 2654339184 EOL_FD11_SGW 0;
BA_ "GenSigTimeoutTime_MPAD" SG_ 2654339184 EOL_FD11_SGW 0;
BA_ "GenSigTimeoutTime_IPC" SG_ 2654339184 EOL_FD11_SGW 0;
BA_ "GenSigTimeoutTime_GNMM" SG_ 2654339184 EOL_FD11_SGW 0;
BA_ "GenSigTimeoutTime_EVCU2" SG_ 2654339184 EOL_FD11_SGW 0;
BA_ "GenSigTimeoutTime_ESL" SG_ 2654339184 EOL_FD11_SGW 0;
BA_ "GenSigTimeoutTime_ECM" SG_ 2654339184 EOL_FD11_SGW 0;
BA_ "GenSigTimeoutTime_DTCM" SG_ 2654339184 EOL_FD11_SGW 0;
BA_ "GenSigTimeoutTime_DMSM" SG_ 2654339184 EOL_FD11_SGW 0;
BA_ "GenSigTimeoutTime_BSM" SG_ 2654339184 EOL_FD11_SGW 0;
BA_ "GenSigTimeoutTime_BCM" SG_ 2654339184 EOL_FD11_SGW 0;
BA_ "GenSigTimeoutTime_AGSM" SG_ 2654339184 EOL_FD11_SGW 0;
BA_ "GenSigTimeoutTime_ADCAM" SG_ 2654339184 EOL_FD11_SGW 0;
BA_ "GenSigTimeoutTime_SGW" SG_ 2654339184 GenericFailSts_FD01_SGW 0;
BA_ "GenSigTimeoutTime_RFHM" SG_ 2654339184 GenericFailSts_FD01_SGW 0;
BA_ "GenSigTimeoutTime_MPAD" SG_ 2654339184 GenericFailSts_FD01_SGW 0;
BA_ "GenSigTimeoutTime_IPC" SG_ 2654339184 GenericFailSts_FD01_SGW 0;
BA_ "GenSigTimeoutTime_GNMM" SG_ 2654339184 GenericFailSts_FD01_SGW 0;
BA_ "GenSigTimeoutTime_EVCU2" SG_ 2654339184 GenericFailSts_FD01_SGW 0;
BA_ "GenSigTimeoutTime_ESL" SG_ 2654339184 GenericFailSts_FD01_SGW 0;
BA_ "GenSigTimeoutTime_ECM" SG_ 2654339184 GenericFailSts_FD01_SGW 0;
BA_ "GenSigTimeoutTime_DTCM" SG_ 2654339184 GenericFailSts_FD01_SGW 0;
BA_ "GenSigTimeoutTime_DMSM" SG_ 2654339184 GenericFailSts_FD01_SGW 0;
BA_ "GenSigTimeoutTime_BSM" SG_ 2654339184 GenericFailSts_FD01_SGW 0;
BA_ "GenSigTimeoutTime_BCM" SG_ 2654339184 GenericFailSts_FD01_SGW 0;
BA_ "GenSigTimeoutTime_AGSM" SG_ 2654339184 GenericFailSts_FD01_SGW 0;
BA_ "GenSigTimeoutTime_ADCAM" SG_ 2654339184 GenericFailSts_FD01_SGW 0;
BA_ "GenSigTimeoutTime_SGW" SG_ 2654339184 GenericFailSts_FD02_SGW 0;
BA_ "GenSigTimeoutTime_RFHM" SG_ 2654339184 GenericFailSts_FD02_SGW 0;
BA_ "GenSigTimeoutTime_MPAD" SG_ 2654339184 GenericFailSts_FD02_SGW 0;
BA_ "GenSigTimeoutTime_IPC" SG_ 2654339184 GenericFailSts_FD02_SGW 0;
BA_ "GenSigTimeoutTime_GNMM" SG_ 2654339184 GenericFailSts_FD02_SGW 0;
BA_ "GenSigTimeoutTime_EVCU2" SG_ 2654339184 GenericFailSts_FD02_SGW 0;
BA_ "GenSigTimeoutTime_ESL" SG_ 2654339184 GenericFailSts_FD02_SGW 0;
BA_ "GenSigTimeoutTime_ECM" SG_ 2654339184 GenericFailSts_FD02_SGW 0;
BA_ "GenSigTimeoutTime_DTCM" SG_ 2654339184 GenericFailSts_FD02_SGW 0;
BA_ "GenSigTimeoutTime_DMSM" SG_ 2654339184 GenericFailSts_FD02_SGW 0;
BA_ "GenSigTimeoutTime_BSM" SG_ 2654339184 GenericFailSts_FD02_SGW 0;
BA_ "GenSigTimeoutTime_BCM" SG_ 2654339184 GenericFailSts_FD02_SGW 0;
BA_ "GenSigTimeoutTime_AGSM" SG_ 2654339184 GenericFailSts_FD02_SGW 0;
BA_ "GenSigTimeoutTime_ADCAM" SG_ 2654339184 GenericFailSts_FD02_SGW 0;
BA_ "GenSigTimeoutTime_SGW" SG_ 2654339184 GenericFailSts_FD03_SGW 0;
BA_ "GenSigTimeoutTime_RFHM" SG_ 2654339184 GenericFailSts_FD03_SGW 0;
BA_ "GenSigTimeoutTime_MPAD" SG_ 2654339184 GenericFailSts_FD03_SGW 0;
BA_ "GenSigTimeoutTime_IPC" SG_ 2654339184 GenericFailSts_FD03_SGW 0;
BA_ "GenSigTimeoutTime_GNMM" SG_ 2654339184 GenericFailSts_FD03_SGW 0;
BA_ "GenSigTimeoutTime_EVCU2" SG_ 2654339184 GenericFailSts_FD03_SGW 0;
BA_ "GenSigTimeoutTime_ESL" SG_ 2654339184 GenericFailSts_FD03_SGW 0;
BA_ "GenSigTimeoutTime_ECM" SG_ 2654339184 GenericFailSts_FD03_SGW 0;
BA_ "GenSigTimeoutTime_DTCM" SG_ 2654339184 GenericFailSts_FD03_SGW 0;
BA_ "GenSigTimeoutTime_DMSM" SG_ 2654339184 GenericFailSts_FD03_SGW 0;
BA_ "GenSigTimeoutTime_BSM" SG_ 2654339184 GenericFailSts_FD03_SGW 0;
BA_ "GenSigTimeoutTime_AGSM" SG_ 2654339184 GenericFailSts_FD03_SGW 0;
BA_ "GenSigTimeoutTime_ADCAM" SG_ 2654339184 GenericFailSts_FD03_SGW 0;
BA_ "GenSigTimeoutTime_SGW" SG_ 2654339184 GenericFailSts_FD08_SGW 0;
BA_ "GenSigTimeoutTime_RFHM" SG_ 2654339184 GenericFailSts_FD08_SGW 0;
BA_ "GenSigTimeoutTime_MPAD" SG_ 2654339184 GenericFailSts_FD08_SGW 0;
BA_ "GenSigTimeoutTime_IPC" SG_ 2654339184 GenericFailSts_FD08_SGW 0;
BA_ "GenSigTimeoutTime_GNMM" SG_ 2654339184 GenericFailSts_FD08_SGW 0;
BA_ "GenSigTimeoutTime_EVCU2" SG_ 2654339184 GenericFailSts_FD08_SGW 0;
BA_ "GenSigTimeoutTime_ESL" SG_ 2654339184 GenericFailSts_FD08_SGW 0;
BA_ "GenSigTimeoutTime_ECM" SG_ 2654339184 GenericFailSts_FD08_SGW 0;
BA_ "GenSigTimeoutTime_DTCM" SG_ 2654339184 GenericFailSts_FD08_SGW 0;
BA_ "GenSigTimeoutTime_DMSM" SG_ 2654339184 GenericFailSts_FD08_SGW 0;
BA_ "GenSigTimeoutTime_BSM" SG_ 2654339184 GenericFailSts_FD08_SGW 0;
BA_ "GenSigTimeoutTime_BCM" SG_ 2654339184 GenericFailSts_FD08_SGW 0;
BA_ "GenSigTimeoutTime_AGSM" SG_ 2654339184 GenericFailSts_FD08_SGW 0;
BA_ "GenSigTimeoutTime_ADCAM" SG_ 2654339184 GenericFailSts_FD08_SGW 0;
BA_ "GenSigTimeoutTime_SGW" SG_ 2654339184 EOL_FD01_SGW 0;
BA_ "GenSigTimeoutTime_RFHM" SG_ 2654339184 EOL_FD01_SGW 0;
BA_ "GenSigTimeoutTime_MPAD" SG_ 2654339184 EOL_FD01_SGW 0;
BA_ "GenSigTimeoutTime_IPC" SG_ 2654339184 EOL_FD01_SGW 0;
BA_ "GenSigTimeoutTime_GNMM" SG_ 2654339184 EOL_FD01_SGW 0;
BA_ "GenSigTimeoutTime_EVCU2" SG_ 2654339184 EOL_FD01_SGW 0;
BA_ "GenSigTimeoutTime_ESL" SG_ 2654339184 EOL_FD01_SGW 0;
BA_ "GenSigTimeoutTime_ECM" SG_ 2654339184 EOL_FD01_SGW 0;
BA_ "GenSigTimeoutTime_DTCM" SG_ 2654339184 EOL_FD01_SGW 0;
BA_ "GenSigTimeoutTime_DMSM" SG_ 2654339184 EOL_FD01_SGW 0;
BA_ "GenSigTimeoutTime_BSM" SG_ 2654339184 EOL_FD01_SGW 0;
BA_ "GenSigTimeoutTime_BCM" SG_ 2654339184 EOL_FD01_SGW 0;
BA_ "GenSigTimeoutTime_AGSM" SG_ 2654339184 EOL_FD01_SGW 0;
BA_ "GenSigTimeoutTime_ADCAM" SG_ 2654339184 EOL_FD01_SGW 0;
BA_ "GenSigTimeoutTime_DTCM" SG_ 2654339184 PreviousCanNMState_FD02_SGW 0;
BA_ "GenSigTimeoutTime_RFHM" SG_ 1443 TelematicSetupACK 0;
BA_ "GenSigTimeoutTime_MPAD" SG_ 1443 TelematicSetupACK 0;
BA_ "GenSigTimeoutTime_IPC" SG_ 1443 TelematicSetupACK 0;
BA_ "GenSigTimeoutTime_GNMM" SG_ 1443 TelematicSetupACK 0;
BA_ "GenSigTimeoutTime_EVCU2" SG_ 1443 TelematicSetupACK 0;
BA_ "GenSigTimeoutTime_ESL" SG_ 1443 TelematicSetupACK 0;
BA_ "GenSigTimeoutTime_ECM" SG_ 1443 TelematicSetupACK 0;
BA_ "GenSigTimeoutTime_DTCM" SG_ 1443 TelematicSetupACK 0;
BA_ "GenSigTimeoutTime_DMSM" SG_ 1443 TelematicSetupACK 0;
BA_ "GenSigTimeoutTime_BSM" SG_ 1443 TelematicSetupACK 0;
BA_ "GenSigTimeoutTime_AGSM" SG_ 1443 TelematicSetupACK 0;
BA_ "GenSigTimeoutTime_ADCAM" SG_ 1443 TelematicSetupACK 0;
BA_ "GenSigSendType" SG_ 1443 TelematicSetupACK 3;
BA_ "GenSigTimeoutTime_RFHM" SG_ 1443 SVC_Guidelines 0;
BA_ "GenSigTimeoutTime_MPAD" SG_ 1443 SVC_Guidelines 0;
BA_ "GenSigTimeoutTime_IPC" SG_ 1443 SVC_Guidelines 0;
BA_ "GenSigTimeoutTime_GNMM" SG_ 1443 SVC_Guidelines 0;
BA_ "GenSigTimeoutTime_EVCU2" SG_ 1443 SVC_Guidelines 0;
BA_ "GenSigTimeoutTime_ESL" SG_ 1443 SVC_Guidelines 0;
BA_ "GenSigTimeoutTime_ECM" SG_ 1443 SVC_Guidelines 0;
BA_ "GenSigTimeoutTime_DTCM" SG_ 1443 SVC_Guidelines 0;
BA_ "GenSigTimeoutTime_DMSM" SG_ 1443 SVC_Guidelines 0;
BA_ "GenSigTimeoutTime_BSM" SG_ 1443 SVC_Guidelines 0;
BA_ "GenSigTimeoutTime_AGSM" SG_ 1443 SVC_Guidelines 0;
BA_ "GenSigTimeoutTime_ADCAM" SG_ 1443 SVC_Guidelines 0;
BA_ "GenSigSendType" SG_ 1443 SVC_Guidelines 3;
BA_ "GenSigTimeoutTime_RFHM" SG_ 1443 SVC_Delay 0;
BA_ "GenSigTimeoutTime_MPAD" SG_ 1443 SVC_Delay 0;
BA_ "GenSigTimeoutTime_IPC" SG_ 1443 SVC_Delay 0;
BA_ "GenSigTimeoutTime_GNMM" SG_ 1443 SVC_Delay 0;
BA_ "GenSigTimeoutTime_EVCU2" SG_ 1443 SVC_Delay 0;
BA_ "GenSigTimeoutTime_ESL" SG_ 1443 SVC_Delay 0;
BA_ "GenSigTimeoutTime_ECM" SG_ 1443 SVC_Delay 0;
BA_ "GenSigTimeoutTime_DTCM" SG_ 1443 SVC_Delay 0;
BA_ "GenSigTimeoutTime_DMSM" SG_ 1443 SVC_Delay 0;
BA_ "GenSigTimeoutTime_BSM" SG_ 1443 SVC_Delay 0;
BA_ "GenSigTimeoutTime_AGSM" SG_ 1443 SVC_Delay 0;
BA_ "GenSigTimeoutTime_ADCAM" SG_ 1443 SVC_Delay 0;
BA_ "GenSigSendType" SG_ 1443 SVC_Delay 3;
BA_ "GenSigTimeoutTime_RFHM" SG_ 1443 Steer_Feel 0;
BA_ "GenSigTimeoutTime_MPAD" SG_ 1443 Steer_Feel 0;
BA_ "GenSigTimeoutTime_IPC" SG_ 1443 Steer_Feel 0;
BA_ "GenSigTimeoutTime_GNMM" SG_ 1443 Steer_Feel 0;
BA_ "GenSigTimeoutTime_EVCU2" SG_ 1443 Steer_Feel 0;
BA_ "GenSigTimeoutTime_ESL" SG_ 1443 Steer_Feel 0;
BA_ "GenSigTimeoutTime_ECM" SG_ 1443 Steer_Feel 0;
BA_ "GenSigTimeoutTime_DTCM" SG_ 1443 Steer_Feel 0;
BA_ "GenSigTimeoutTime_DMSM" SG_ 1443 Steer_Feel 0;
BA_ "GenSigTimeoutTime_BSM" SG_ 1443 Steer_Feel 0;
BA_ "GenSigTimeoutTime_AGSM" SG_ 1443 Steer_Feel 0;
BA_ "GenSigTimeoutTime_ADCAM" SG_ 1443 Steer_Feel 0;
BA_ "GenSigSendType" SG_ 1443 Steer_Feel 3;
BA_ "GenSigTimeoutTime_RFHM" SG_ 1443 SpeedLockDoorEnable 0;
BA_ "GenSigTimeoutTime_MPAD" SG_ 1443 SpeedLockDoorEnable 0;
BA_ "GenSigTimeoutTime_IPC" SG_ 1443 SpeedLockDoorEnable 0;
BA_ "GenSigTimeoutTime_GNMM" SG_ 1443 SpeedLockDoorEnable 0;
BA_ "GenSigTimeoutTime_EVCU2" SG_ 1443 SpeedLockDoorEnable 0;
BA_ "GenSigTimeoutTime_ESL" SG_ 1443 SpeedLockDoorEnable 0;
BA_ "GenSigTimeoutTime_ECM" SG_ 1443 SpeedLockDoorEnable 0;
BA_ "GenSigTimeoutTime_DTCM" SG_ 1443 SpeedLockDoorEnable 0;
BA_ "GenSigTimeoutTime_DMSM" SG_ 1443 SpeedLockDoorEnable 0;
BA_ "GenSigTimeoutTime_BSM" SG_ 1443 SpeedLockDoorEnable 0;
BA_ "GenSigTimeoutTime_AGSM" SG_ 1443 SpeedLockDoorEnable 0;
BA_ "GenSigTimeoutTime_ADCAM" SG_ 1443 SpeedLockDoorEnable 0;
BA_ "GenSigSendType" SG_ 1443 SpeedLockDoorEnable 3;
BA_ "GenSigTimeoutTime_RFHM" SG_ 1443 SoundHornRemoteStart 0;
BA_ "GenSigTimeoutTime_MPAD" SG_ 1443 SoundHornRemoteStart 0;
BA_ "GenSigTimeoutTime_IPC" SG_ 1443 SoundHornRemoteStart 0;
BA_ "GenSigTimeoutTime_GNMM" SG_ 1443 SoundHornRemoteStart 0;
BA_ "GenSigTimeoutTime_EVCU2" SG_ 1443 SoundHornRemoteStart 0;
BA_ "GenSigTimeoutTime_ESL" SG_ 1443 SoundHornRemoteStart 0;
BA_ "GenSigTimeoutTime_ECM" SG_ 1443 SoundHornRemoteStart 0;
BA_ "GenSigTimeoutTime_DTCM" SG_ 1443 SoundHornRemoteStart 0;
BA_ "GenSigTimeoutTime_DMSM" SG_ 1443 SoundHornRemoteStart 0;
BA_ "GenSigTimeoutTime_BSM" SG_ 1443 SoundHornRemoteStart 0;
BA_ "GenSigTimeoutTime_AGSM" SG_ 1443 SoundHornRemoteStart 0;
BA_ "GenSigTimeoutTime_ADCAM" SG_ 1443 SoundHornRemoteStart 0;
BA_ "GenSigSendType" SG_ 1443 SoundHornRemoteStart 3;
BA_ "GenSigTimeoutTime_RFHM" SG_ 1443 SoundHornLock 0;
BA_ "GenSigTimeoutTime_MPAD" SG_ 1443 SoundHornLock 0;
BA_ "GenSigTimeoutTime_IPC" SG_ 1443 SoundHornLock 0;
BA_ "GenSigTimeoutTime_GNMM" SG_ 1443 SoundHornLock 0;
BA_ "GenSigTimeoutTime_EVCU2" SG_ 1443 SoundHornLock 0;
BA_ "GenSigTimeoutTime_ESL" SG_ 1443 SoundHornLock 0;
BA_ "GenSigTimeoutTime_ECM" SG_ 1443 SoundHornLock 0;
BA_ "GenSigTimeoutTime_DTCM" SG_ 1443 SoundHornLock 0;
BA_ "GenSigTimeoutTime_DMSM" SG_ 1443 SoundHornLock 0;
BA_ "GenSigTimeoutTime_BSM" SG_ 1443 SoundHornLock 0;
BA_ "GenSigTimeoutTime_AGSM" SG_ 1443 SoundHornLock 0;
BA_ "GenSigTimeoutTime_ADCAM" SG_ 1443 SoundHornLock 0;
BA_ "GenSigSendType" SG_ 1443 SoundHornLock 3;
BA_ "GenSigStartValue" SG_ 1443 SoundHornLock 1;
BA_ "GenSigTimeoutTime_RFHM" SG_ 1443 Sdw 0;
BA_ "GenSigTimeoutTime_MPAD" SG_ 1443 Sdw 0;
BA_ "GenSigTimeoutTime_IPC" SG_ 1443 Sdw 0;
BA_ "GenSigTimeoutTime_GNMM" SG_ 1443 Sdw 0;
BA_ "GenSigTimeoutTime_EVCU2" SG_ 1443 Sdw 0;
BA_ "GenSigTimeoutTime_ESL" SG_ 1443 Sdw 0;
BA_ "GenSigTimeoutTime_ECM" SG_ 1443 Sdw 0;
BA_ "GenSigTimeoutTime_DTCM" SG_ 1443 Sdw 0;
BA_ "GenSigTimeoutTime_DMSM" SG_ 1443 Sdw 0;
BA_ "GenSigTimeoutTime_BSM" SG_ 1443 Sdw 0;
BA_ "GenSigTimeoutTime_AGSM" SG_ 1443 Sdw 0;
BA_ "GenSigTimeoutTime_ADCAM" SG_ 1443 Sdw 0;
BA_ "GenSigSendType" SG_ 1443 Sdw 3;
BA_ "GenSigStartValue" SG_ 1443 Sdw 2;
BA_ "GenSigTimeoutTime_RFHM" SG_ 1443 RKEMemoryLinkEnable 0;
BA_ "GenSigTimeoutTime_MPAD" SG_ 1443 RKEMemoryLinkEnable 0;
BA_ "GenSigTimeoutTime_IPC" SG_ 1443 RKEMemoryLinkEnable 0;
BA_ "GenSigTimeoutTime_GNMM" SG_ 1443 RKEMemoryLinkEnable 0;
BA_ "GenSigTimeoutTime_EVCU2" SG_ 1443 RKEMemoryLinkEnable 0;
BA_ "GenSigTimeoutTime_ESL" SG_ 1443 RKEMemoryLinkEnable 0;
BA_ "GenSigTimeoutTime_ECM" SG_ 1443 RKEMemoryLinkEnable 0;
BA_ "GenSigTimeoutTime_DTCM" SG_ 1443 RKEMemoryLinkEnable 0;
BA_ "GenSigTimeoutTime_DMSM" SG_ 1443 RKEMemoryLinkEnable 0;
BA_ "GenSigTimeoutTime_BSM" SG_ 1443 RKEMemoryLinkEnable 0;
BA_ "GenSigTimeoutTime_AGSM" SG_ 1443 RKEMemoryLinkEnable 0;
BA_ "GenSigTimeoutTime_ADCAM" SG_ 1443 RKEMemoryLinkEnable 0;
BA_ "GenSigSendType" SG_ 1443 RKEMemoryLinkEnable 3;
BA_ "GenSigStartValue" SG_ 1443 RKEMemoryLinkEnable 1;
BA_ "GenSigTimeoutTime_RFHM" SG_ 1443 RemStNrmlStEnbl 0;
BA_ "GenSigTimeoutTime_MPAD" SG_ 1443 RemStNrmlStEnbl 0;
BA_ "GenSigTimeoutTime_IPC" SG_ 1443 RemStNrmlStEnbl 0;
BA_ "GenSigTimeoutTime_GNMM" SG_ 1443 RemStNrmlStEnbl 0;
BA_ "GenSigTimeoutTime_EVCU2" SG_ 1443 RemStNrmlStEnbl 0;
BA_ "GenSigTimeoutTime_ESL" SG_ 1443 RemStNrmlStEnbl 0;
BA_ "GenSigTimeoutTime_ECM" SG_ 1443 RemStNrmlStEnbl 0;
BA_ "GenSigTimeoutTime_DTCM" SG_ 1443 RemStNrmlStEnbl 0;
BA_ "GenSigTimeoutTime_DMSM" SG_ 1443 RemStNrmlStEnbl 0;
BA_ "GenSigTimeoutTime_BSM" SG_ 1443 RemStNrmlStEnbl 0;
BA_ "GenSigTimeoutTime_AGSM" SG_ 1443 RemStNrmlStEnbl 0;
BA_ "GenSigTimeoutTime_ADCAM" SG_ 1443 RemStNrmlStEnbl 0;
BA_ "GenSigSendType" SG_ 1443 RemStNrmlStEnbl 3;
BA_ "GenSigStartValue" SG_ 1443 RemStNrmlStEnbl 2;
BA_ "GenSigTimeoutTime_RFHM" SG_ 1443 RemoteDoorUnlock 0;
BA_ "GenSigTimeoutTime_MPAD" SG_ 1443 RemoteDoorUnlock 0;
BA_ "GenSigTimeoutTime_IPC" SG_ 1443 RemoteDoorUnlock 0;
BA_ "GenSigTimeoutTime_GNMM" SG_ 1443 RemoteDoorUnlock 0;
BA_ "GenSigTimeoutTime_EVCU2" SG_ 1443 RemoteDoorUnlock 0;
BA_ "GenSigTimeoutTime_ESL" SG_ 1443 RemoteDoorUnlock 0;
BA_ "GenSigTimeoutTime_ECM" SG_ 1443 RemoteDoorUnlock 0;
BA_ "GenSigTimeoutTime_DTCM" SG_ 1443 RemoteDoorUnlock 0;
BA_ "GenSigTimeoutTime_DMSM" SG_ 1443 RemoteDoorUnlock 0;
BA_ "GenSigTimeoutTime_BSM" SG_ 1443 RemoteDoorUnlock 0;
BA_ "GenSigTimeoutTime_AGSM" SG_ 1443 RemoteDoorUnlock 0;
BA_ "GenSigTimeoutTime_ADCAM" SG_ 1443 RemoteDoorUnlock 0;
BA_ "GenSigSendType" SG_ 1443 RemoteDoorUnlock 3;
BA_ "GenSigStartValue" SG_ 1443 RemoteDoorUnlock 1;
BA_ "GenSigTimeoutTime_RFHM" SG_ 1443 Rear_Brk_Asst 0;
BA_ "GenSigTimeoutTime_MPAD" SG_ 1443 Rear_Brk_Asst 0;
BA_ "GenSigTimeoutTime_IPC" SG_ 1443 Rear_Brk_Asst 0;
BA_ "GenSigTimeoutTime_GNMM" SG_ 1443 Rear_Brk_Asst 0;
BA_ "GenSigTimeoutTime_EVCU2" SG_ 1443 Rear_Brk_Asst 0;
BA_ "GenSigTimeoutTime_ESL" SG_ 1443 Rear_Brk_Asst 0;
BA_ "GenSigTimeoutTime_ECM" SG_ 1443 Rear_Brk_Asst 0;
BA_ "GenSigTimeoutTime_DTCM" SG_ 1443 Rear_Brk_Asst 0;
BA_ "GenSigTimeoutTime_DMSM" SG_ 1443 Rear_Brk_Asst 0;
BA_ "GenSigTimeoutTime_BSM" SG_ 1443 Rear_Brk_Asst 0;
BA_ "GenSigTimeoutTime_AGSM" SG_ 1443 Rear_Brk_Asst 0;
BA_ "GenSigTimeoutTime_ADCAM" SG_ 1443 Rear_Brk_Asst 0;
BA_ "GenSigSendType" SG_ 1443 Rear_Brk_Asst 3;
BA_ "GenSigTimeoutTime_RFHM" SG_ 1443 Rdy_To_Drive 0;
BA_ "GenSigTimeoutTime_MPAD" SG_ 1443 Rdy_To_Drive 0;
BA_ "GenSigTimeoutTime_IPC" SG_ 1443 Rdy_To_Drive 0;
BA_ "GenSigTimeoutTime_GNMM" SG_ 1443 Rdy_To_Drive 0;
BA_ "GenSigTimeoutTime_EVCU2" SG_ 1443 Rdy_To_Drive 0;
BA_ "GenSigTimeoutTime_ESL" SG_ 1443 Rdy_To_Drive 0;
BA_ "GenSigTimeoutTime_ECM" SG_ 1443 Rdy_To_Drive 0;
BA_ "GenSigTimeoutTime_DTCM" SG_ 1443 Rdy_To_Drive 0;
BA_ "GenSigTimeoutTime_DMSM" SG_ 1443 Rdy_To_Drive 0;
BA_ "GenSigTimeoutTime_BSM" SG_ 1443 Rdy_To_Drive 0;
BA_ "GenSigTimeoutTime_AGSM" SG_ 1443 Rdy_To_Drive 0;
BA_ "GenSigTimeoutTime_ADCAM" SG_ 1443 Rdy_To_Drive 0;
BA_ "GenSigSendType" SG_ 1443 Rdy_To_Drive 3;
BA_ "GenSigTimeoutTime_EVCU2" SG_ 1443 RainSensorLevel 0;
BA_ "GenSigTimeoutTime_ESL" SG_ 1443 RainSensorLevel 0;
BA_ "GenSigTimeoutTime_ECM" SG_ 1443 RainSensorLevel 0;
BA_ "GenSigTimeoutTime_DTCM" SG_ 1443 RainSensorLevel 0;
BA_ "GenSigTimeoutTime_DMSM" SG_ 1443 RainSensorLevel 0;
BA_ "GenSigTimeoutTime_BSM" SG_ 1443 RainSensorLevel 0;
BA_ "GenSigTimeoutTime_AGSM" SG_ 1443 RainSensorLevel 0;
BA_ "GenSigTimeoutTime_ADCAM" SG_ 1443 RainSensorLevel 0;
BA_ "GenSigSendType" SG_ 1443 RainSensorLevel 3;
BA_ "GenSigStartValue" SG_ 1443 RainSensorLevel 1;
BA_ "GenSigTimeoutTime_RFHM" SG_ 1443 RainSensorLevel 0;
BA_ "GenSigTimeoutTime_MPAD" SG_ 1443 RainSensorLevel 0;
BA_ "GenSigTimeoutTime_IPC" SG_ 1443 RainSensorLevel 0;
BA_ "GenSigTimeoutTime_GNMM" SG_ 1443 RainSensorLevel 0;
BA_ "GenSigTimeoutTime_RFHM" SG_ 1443 PLGAlert 0;
BA_ "GenSigTimeoutTime_RFHM" SG_ 1443 Speed_Unit 0;
BA_ "GenSigTimeoutTime_IPC" SG_ 1443 Speed_Unit 0;
BA_ "GenSigTimeoutTime_GNMM" SG_ 1443 Speed_Unit 0;
BA_ "GenSigTimeoutTime_ESL" SG_ 1443 Speed_Unit 0;
BA_ "GenSigTimeoutTime_ECM" SG_ 1443 Speed_Unit 0;
BA_ "GenSigTimeoutTime_DTCM" SG_ 1443 Speed_Unit 0;
BA_ "GenSigTimeoutTime_DMSM" SG_ 1443 Speed_Unit 0;
BA_ "GenSigTimeoutTime_BSM" SG_ 1443 Speed_Unit 0;
BA_ "GenSigTimeoutTime_AGSM" SG_ 1443 Speed_Unit 0;
BA_ "GenSigSendType" SG_ 1443 Speed_Unit 3;
BA_ "GenSigTimeoutTime_SGW" SG_ 2654339072 DES_FD04_BCM 0;
BA_ "GenSigTimeoutTime_RFHM" SG_ 2654339072 DES_FD04_BCM 0;
BA_ "GenSigTimeoutTime_MPAD" SG_ 2654339072 DES_FD04_BCM 0;
BA_ "GenSigTimeoutTime_IPC" SG_ 2654339072 DES_FD04_BCM 0;
BA_ "GenSigTimeoutTime_GNMM" SG_ 2654339072 DES_FD04_BCM 0;
BA_ "GenSigTimeoutTime_EVCU2" SG_ 2654339072 DES_FD04_BCM 0;
BA_ "GenSigTimeoutTime_ESL" SG_ 2654339072 DES_FD04_BCM 0;
BA_ "GenSigTimeoutTime_ECM" SG_ 2654339072 DES_FD04_BCM 0;
BA_ "GenSigTimeoutTime_DTCM" SG_ 2654339072 DES_FD04_BCM 0;
BA_ "GenSigTimeoutTime_DMSM" SG_ 2654339072 DES_FD04_BCM 0;
BA_ "GenSigTimeoutTime_BSM" SG_ 2654339072 DES_FD04_BCM 0;
BA_ "GenSigTimeoutTime_BCM" SG_ 2654339072 DES_FD04_BCM 0;
BA_ "GenSigTimeoutTime_AGSM" SG_ 2654339072 DES_FD04_BCM 0;
BA_ "GenSigTimeoutTime_ADCAM" SG_ 2654339072 DES_FD04_BCM 0;
BA_ "GenSigTimeoutTime_SGW" SG_ 2654339072 DES_FD03_BCM 0;
BA_ "GenSigTimeoutTime_RFHM" SG_ 2654339072 DES_FD03_BCM 0;
BA_ "GenSigTimeoutTime_MPAD" SG_ 2654339072 DES_FD03_BCM 0;
BA_ "GenSigTimeoutTime_IPC" SG_ 2654339072 DES_FD03_BCM 0;
BA_ "GenSigTimeoutTime_GNMM" SG_ 2654339072 DES_FD03_BCM 0;
BA_ "GenSigTimeoutTime_EVCU2" SG_ 2654339072 DES_FD03_BCM 0;
BA_ "GenSigTimeoutTime_ESL" SG_ 2654339072 DES_FD03_BCM 0;
BA_ "GenSigTimeoutTime_ECM" SG_ 2654339072 DES_FD03_BCM 0;
BA_ "GenSigTimeoutTime_DTCM" SG_ 2654339072 DES_FD03_BCM 0;
BA_ "GenSigTimeoutTime_DMSM" SG_ 2654339072 DES_FD03_BCM 0;
BA_ "GenSigTimeoutTime_BSM" SG_ 2654339072 DES_FD03_BCM 0;
BA_ "GenSigTimeoutTime_BCM" SG_ 2654339072 DES_FD03_BCM 0;
BA_ "GenSigTimeoutTime_AGSM" SG_ 2654339072 DES_FD03_BCM 0;
BA_ "GenSigTimeoutTime_ADCAM" SG_ 2654339072 DES_FD03_BCM 0;
BA_ "GenSigTimeoutTime_SGW" SG_ 2654339072 DES_FD02_BCM 0;
BA_ "GenSigTimeoutTime_RFHM" SG_ 2654339072 DES_FD02_BCM 0;
BA_ "GenSigTimeoutTime_MPAD" SG_ 2654339072 DES_FD02_BCM 0;
BA_ "GenSigTimeoutTime_IPC" SG_ 2654339072 DES_FD02_BCM 0;
BA_ "GenSigTimeoutTime_GNMM" SG_ 2654339072 DES_FD02_BCM 0;
BA_ "GenSigTimeoutTime_EVCU2" SG_ 2654339072 DES_FD02_BCM 0;
BA_ "GenSigTimeoutTime_ESL" SG_ 2654339072 DES_FD02_BCM 0;
BA_ "GenSigTimeoutTime_ECM" SG_ 2654339072 DES_FD02_BCM 0;
BA_ "GenSigTimeoutTime_DTCM" SG_ 2654339072 DES_FD02_BCM 0;
BA_ "GenSigTimeoutTime_DMSM" SG_ 2654339072 DES_FD02_BCM 0;
BA_ "GenSigTimeoutTime_BSM" SG_ 2654339072 DES_FD02_BCM 0;
BA_ "GenSigTimeoutTime_BCM" SG_ 2654339072 DES_FD02_BCM 0;
BA_ "GenSigTimeoutTime_AGSM" SG_ 2654339072 DES_FD02_BCM 0;
BA_ "GenSigTimeoutTime_ADCAM" SG_ 2654339072 DES_FD02_BCM 0;
BA_ "GenSigTimeoutTime_SGW" SG_ 2654339072 DES_FD01_BCM 0;
BA_ "GenSigTimeoutTime_RFHM" SG_ 2654339072 DES_FD01_BCM 0;
BA_ "GenSigTimeoutTime_MPAD" SG_ 2654339072 DES_FD01_BCM 0;
BA_ "GenSigTimeoutTime_IPC" SG_ 2654339072 DES_FD01_BCM 0;
BA_ "GenSigTimeoutTime_GNMM" SG_ 2654339072 DES_FD01_BCM 0;
BA_ "GenSigTimeoutTime_EVCU2" SG_ 2654339072 DES_FD01_BCM 0;
BA_ "GenSigTimeoutTime_ESL" SG_ 2654339072 DES_FD01_BCM 0;
BA_ "GenSigTimeoutTime_ECM" SG_ 2654339072 DES_FD01_BCM 0;
BA_ "GenSigTimeoutTime_DTCM" SG_ 2654339072 DES_FD01_BCM 0;
BA_ "GenSigTimeoutTime_DMSM" SG_ 2654339072 DES_FD01_BCM 0;
BA_ "GenSigTimeoutTime_BSM" SG_ 2654339072 DES_FD01_BCM 0;
BA_ "GenSigTimeoutTime_BCM" SG_ 2654339072 DES_FD01_BCM 0;
BA_ "GenSigTimeoutTime_AGSM" SG_ 2654339072 DES_FD01_BCM 0;
BA_ "GenSigTimeoutTime_ADCAM" SG_ 2654339072 DES_FD01_BCM 0;
BA_ "GenSigTimeoutTime_SGW" SG_ 2654339072 CurrentCanNMState_FD04_BCM 0;
BA_ "GenSigTimeoutTime_RFHM" SG_ 2654339072 CurrentCanNMState_FD04_BCM 0;
BA_ "GenSigTimeoutTime_MPAD" SG_ 2654339072 CurrentCanNMState_FD04_BCM 0;
BA_ "GenSigTimeoutTime_IPC" SG_ 2654339072 CurrentCanNMState_FD04_BCM 0;
BA_ "GenSigTimeoutTime_GNMM" SG_ 2654339072 CurrentCanNMState_FD04_BCM 0;
BA_ "GenSigTimeoutTime_EVCU2" SG_ 2654339072 CurrentCanNMState_FD04_BCM 0;
BA_ "GenSigTimeoutTime_ESL" SG_ 2654339072 CurrentCanNMState_FD04_BCM 0;
BA_ "GenSigTimeoutTime_ECM" SG_ 2654339072 CurrentCanNMState_FD04_BCM 0;
BA_ "GenSigTimeoutTime_DTCM" SG_ 2654339072 CurrentCanNMState_FD04_BCM 0;
BA_ "GenSigTimeoutTime_DMSM" SG_ 2654339072 CurrentCanNMState_FD04_BCM 0;
BA_ "GenSigTimeoutTime_BSM" SG_ 2654339072 CurrentCanNMState_FD04_BCM 0;
BA_ "GenSigTimeoutTime_BCM" SG_ 2654339072 CurrentCanNMState_FD04_BCM 0;
BA_ "GenSigTimeoutTime_AGSM" SG_ 2654339072 CurrentCanNMState_FD04_BCM 0;
BA_ "GenSigTimeoutTime_ADCAM" SG_ 2654339072 CurrentCanNMState_FD04_BCM 0;
BA_ "GenSigTimeoutTime_SGW" SG_ 2654339072 CurrentCanNMState_FD03_BCM 0;
BA_ "GenSigTimeoutTime_RFHM" SG_ 2654339072 CurrentCanNMState_FD03_BCM 0;
BA_ "GenSigTimeoutTime_MPAD" SG_ 2654339072 CurrentCanNMState_FD03_BCM 0;
BA_ "GenSigTimeoutTime_IPC" SG_ 2654339072 CurrentCanNMState_FD03_BCM 0;
BA_ "GenSigTimeoutTime_GNMM" SG_ 2654339072 CurrentCanNMState_FD03_BCM 0;
BA_ "GenSigTimeoutTime_EVCU2" SG_ 2654339072 CurrentCanNMState_FD03_BCM 0;
BA_ "GenSigTimeoutTime_ESL" SG_ 2654339072 CurrentCanNMState_FD03_BCM 0;
BA_ "GenSigTimeoutTime_ECM" SG_ 2654339072 CurrentCanNMState_FD03_BCM 0;
BA_ "GenSigTimeoutTime_DTCM" SG_ 2654339072 CurrentCanNMState_FD03_BCM 0;
BA_ "GenSigTimeoutTime_DMSM" SG_ 2654339072 CurrentCanNMState_FD03_BCM 0;
BA_ "GenSigTimeoutTime_BSM" SG_ 2654339072 CurrentCanNMState_FD03_BCM 0;
BA_ "GenSigTimeoutTime_BCM" SG_ 2654339072 CurrentCanNMState_FD03_BCM 0;
BA_ "GenSigTimeoutTime_AGSM" SG_ 2654339072 CurrentCanNMState_FD03_BCM 0;
BA_ "GenSigTimeoutTime_ADCAM" SG_ 2654339072 CurrentCanNMState_FD03_BCM 0;
BA_ "GenSigTimeoutTime_BCM" SG_ 2654339072 CurrentCanNMState_FD01_BCM 0;
BA_ "GenSigTimeoutTime_AGSM" SG_ 2654339072 CurrentCanNMState_FD01_BCM 0;
BA_ "GenSigTimeoutTime_ADCAM" SG_ 2654339072 CurrentCanNMState_FD01_BCM 0;
BA_ "GenSigTimeoutTime_SGW" SG_ 2654339072 CurrentCanNMState_FD01_BCM 0;
BA_ "GenSigTimeoutTime_RFHM" SG_ 2654339072 CurrentCanNMState_FD01_BCM 0;
BA_ "GenSigTimeoutTime_MPAD" SG_ 2654339072 CurrentCanNMState_FD01_BCM 0;
BA_ "GenSigTimeoutTime_IPC" SG_ 2654339072 CurrentCanNMState_FD01_BCM 0;
BA_ "GenSigTimeoutTime_GNMM" SG_ 2654339072 CurrentCanNMState_FD01_BCM 0;
BA_ "GenSigTimeoutTime_EVCU2" SG_ 2654339072 CurrentCanNMState_FD01_BCM 0;
BA_ "GenSigTimeoutTime_ESL" SG_ 2654339072 CurrentCanNMState_FD01_BCM 0;
BA_ "GenSigTimeoutTime_ECM" SG_ 2654339072 CurrentCanNMState_FD01_BCM 0;
BA_ "GenSigTimeoutTime_DTCM" SG_ 2654339072 CurrentCanNMState_FD01_BCM 0;
BA_ "GenSigTimeoutTime_DMSM" SG_ 2654339072 CurrentCanNMState_FD01_BCM 0;
BA_ "GenSigTimeoutTime_BSM" SG_ 2654339072 CurrentCanNMState_FD01_BCM 0;
BA_ "GenSigTimeoutTime_SGW" SG_ 2654339072 CurrentCanNMState_FD02_BCM 0;
BA_ "GenSigTimeoutTime_RFHM" SG_ 2654339072 CurrentCanNMState_FD02_BCM 0;
BA_ "GenSigTimeoutTime_MPAD" SG_ 2654339072 CurrentCanNMState_FD02_BCM 0;
BA_ "GenSigTimeoutTime_IPC" SG_ 2654339072 CurrentCanNMState_FD02_BCM 0;
BA_ "GenSigTimeoutTime_GNMM" SG_ 2654339072 CurrentCanNMState_FD02_BCM 0;
BA_ "GenSigTimeoutTime_EVCU2" SG_ 2654339072 CurrentCanNMState_FD02_BCM 0;
BA_ "GenSigTimeoutTime_ESL" SG_ 2654339072 CurrentCanNMState_FD02_BCM 0;
BA_ "GenSigTimeoutTime_ECM" SG_ 2654339072 CurrentCanNMState_FD02_BCM 0;
BA_ "GenSigTimeoutTime_DTCM" SG_ 2654339072 CurrentCanNMState_FD02_BCM 0;
BA_ "GenSigTimeoutTime_DMSM" SG_ 2654339072 CurrentCanNMState_FD02_BCM 0;
BA_ "GenSigTimeoutTime_BSM" SG_ 2654339072 CurrentCanNMState_FD02_BCM 0;
BA_ "GenSigTimeoutTime_BCM" SG_ 2654339072 CurrentCanNMState_FD02_BCM 0;
BA_ "GenSigTimeoutTime_AGSM" SG_ 2654339072 CurrentCanNMState_FD02_BCM 0;
BA_ "GenSigTimeoutTime_ADCAM" SG_ 2654339072 CurrentCanNMState_FD02_BCM 0;
BA_ "GenSigTimeoutTime_SGW" SG_ 2654339184 CurrentFailSts_FD11_SGW 0;
BA_ "GenSigTimeoutTime_RFHM" SG_ 2654339184 CurrentFailSts_FD11_SGW 0;
BA_ "GenSigTimeoutTime_MPAD" SG_ 2654339184 CurrentFailSts_FD11_SGW 0;
BA_ "GenSigTimeoutTime_IPC" SG_ 2654339184 CurrentFailSts_FD11_SGW 0;
BA_ "GenSigTimeoutTime_GNMM" SG_ 2654339184 CurrentFailSts_FD11_SGW 0;
BA_ "GenSigTimeoutTime_EVCU2" SG_ 2654339184 CurrentFailSts_FD11_SGW 0;
BA_ "GenSigTimeoutTime_ESL" SG_ 2654339184 CurrentFailSts_FD11_SGW 0;
BA_ "GenSigTimeoutTime_ECM" SG_ 2654339184 CurrentFailSts_FD11_SGW 0;
BA_ "GenSigTimeoutTime_DTCM" SG_ 2654339184 CurrentFailSts_FD11_SGW 0;
BA_ "GenSigTimeoutTime_DMSM" SG_ 2654339184 CurrentFailSts_FD11_SGW 0;
BA_ "GenSigTimeoutTime_BSM" SG_ 2654339184 CurrentFailSts_FD11_SGW 0;
BA_ "GenSigTimeoutTime_BCM" SG_ 2654339184 CurrentFailSts_FD11_SGW 0;
BA_ "GenSigTimeoutTime_AGSM" SG_ 2654339184 CurrentFailSts_FD11_SGW 0;
BA_ "GenSigTimeoutTime_ADCAM" SG_ 2654339184 CurrentFailSts_FD11_SGW 0;
BA_ "GenSigTimeoutTime_SGW" SG_ 2654339184 CurrentFailSts_FD08_SGW 0;
BA_ "GenSigTimeoutTime_RFHM" SG_ 2654339184 CurrentFailSts_FD08_SGW 0;
BA_ "GenSigTimeoutTime_MPAD" SG_ 2654339184 CurrentFailSts_FD08_SGW 0;
BA_ "GenSigTimeoutTime_IPC" SG_ 2654339184 CurrentFailSts_FD08_SGW 0;
BA_ "GenSigTimeoutTime_GNMM" SG_ 2654339184 CurrentFailSts_FD08_SGW 0;
BA_ "GenSigTimeoutTime_EVCU2" SG_ 2654339184 CurrentFailSts_FD08_SGW 0;
BA_ "GenSigTimeoutTime_ESL" SG_ 2654339184 CurrentFailSts_FD08_SGW 0;
BA_ "GenSigTimeoutTime_ECM" SG_ 2654339184 CurrentFailSts_FD08_SGW 0;
BA_ "GenSigTimeoutTime_DTCM" SG_ 2654339184 CurrentFailSts_FD08_SGW 0;
BA_ "GenSigTimeoutTime_DMSM" SG_ 2654339184 CurrentFailSts_FD08_SGW 0;
BA_ "GenSigTimeoutTime_BSM" SG_ 2654339184 CurrentFailSts_FD08_SGW 0;
BA_ "GenSigTimeoutTime_BCM" SG_ 2654339184 CurrentFailSts_FD08_SGW 0;
BA_ "GenSigTimeoutTime_AGSM" SG_ 2654339184 CurrentFailSts_FD08_SGW 0;
BA_ "GenSigTimeoutTime_ADCAM" SG_ 2654339184 CurrentFailSts_FD08_SGW 0;
BA_ "GenSigTimeoutTime_SGW" SG_ 2654339184 CurrentFailSts_FD03_SGW 0;
BA_ "GenSigTimeoutTime_RFHM" SG_ 2654339184 CurrentFailSts_FD03_SGW 0;
BA_ "GenSigTimeoutTime_MPAD" SG_ 2654339184 CurrentFailSts_FD03_SGW 0;
BA_ "GenSigTimeoutTime_IPC" SG_ 2654339184 CurrentFailSts_FD03_SGW 0;
BA_ "GenSigTimeoutTime_GNMM" SG_ 2654339184 CurrentFailSts_FD03_SGW 0;
BA_ "GenSigTimeoutTime_EVCU2" SG_ 2654339184 CurrentFailSts_FD03_SGW 0;
BA_ "GenSigTimeoutTime_ESL" SG_ 2654339184 CurrentFailSts_FD03_SGW 0;
BA_ "GenSigTimeoutTime_ECM" SG_ 2654339184 CurrentFailSts_FD03_SGW 0;
BA_ "GenSigTimeoutTime_DTCM" SG_ 2654339184 CurrentFailSts_FD03_SGW 0;
BA_ "GenSigTimeoutTime_DMSM" SG_ 2654339184 CurrentFailSts_FD03_SGW 0;
BA_ "GenSigTimeoutTime_BSM" SG_ 2654339184 CurrentFailSts_FD03_SGW 0;
BA_ "GenSigTimeoutTime_AGSM" SG_ 2654339184 CurrentFailSts_FD03_SGW 0;
BA_ "GenSigTimeoutTime_ADCAM" SG_ 2654339184 CurrentFailSts_FD03_SGW 0;
BA_ "GenSigTimeoutTime_SGW" SG_ 2654339184 CurrentFailSts_FD02_SGW 0;
BA_ "GenSigTimeoutTime_RFHM" SG_ 2654339184 CurrentFailSts_FD02_SGW 0;
BA_ "GenSigTimeoutTime_MPAD" SG_ 2654339184 CurrentFailSts_FD02_SGW 0;
BA_ "GenSigTimeoutTime_IPC" SG_ 2654339184 CurrentFailSts_FD02_SGW 0;
BA_ "GenSigTimeoutTime_GNMM" SG_ 2654339184 CurrentFailSts_FD02_SGW 0;
BA_ "GenSigTimeoutTime_EVCU2" SG_ 2654339184 CurrentFailSts_FD02_SGW 0;
BA_ "GenSigTimeoutTime_ESL" SG_ 2654339184 CurrentFailSts_FD02_SGW 0;
BA_ "GenSigTimeoutTime_ECM" SG_ 2654339184 CurrentFailSts_FD02_SGW 0;
BA_ "GenSigTimeoutTime_DTCM" SG_ 2654339184 CurrentFailSts_FD02_SGW 0;
BA_ "GenSigTimeoutTime_DMSM" SG_ 2654339184 CurrentFailSts_FD02_SGW 0;
BA_ "GenSigTimeoutTime_BSM" SG_ 2654339184 CurrentFailSts_FD02_SGW 0;
BA_ "GenSigTimeoutTime_BCM" SG_ 2654339184 CurrentFailSts_FD02_SGW 0;
BA_ "GenSigTimeoutTime_AGSM" SG_ 2654339184 CurrentFailSts_FD02_SGW 0;
BA_ "GenSigTimeoutTime_ADCAM" SG_ 2654339184 CurrentFailSts_FD02_SGW 0;
BA_ "GenSigTimeoutTime_SGW" SG_ 2654339184 CurrentFailSts_FD01_SGW 0;
BA_ "GenSigTimeoutTime_RFHM" SG_ 2654339184 CurrentFailSts_FD01_SGW 0;
BA_ "GenSigTimeoutTime_MPAD" SG_ 2654339184 CurrentFailSts_FD01_SGW 0;
BA_ "GenSigTimeoutTime_IPC" SG_ 2654339184 CurrentFailSts_FD01_SGW 0;
BA_ "GenSigTimeoutTime_GNMM" SG_ 2654339184 CurrentFailSts_FD01_SGW 0;
BA_ "GenSigTimeoutTime_EVCU2" SG_ 2654339184 CurrentFailSts_FD01_SGW 0;
BA_ "GenSigTimeoutTime_ESL" SG_ 2654339184 CurrentFailSts_FD01_SGW 0;
BA_ "GenSigTimeoutTime_ECM" SG_ 2654339184 CurrentFailSts_FD01_SGW 0;
BA_ "GenSigTimeoutTime_DTCM" SG_ 2654339184 CurrentFailSts_FD01_SGW 0;
BA_ "GenSigTimeoutTime_DMSM" SG_ 2654339184 CurrentFailSts_FD01_SGW 0;
BA_ "GenSigTimeoutTime_BSM" SG_ 2654339184 CurrentFailSts_FD01_SGW 0;
BA_ "GenSigTimeoutTime_BCM" SG_ 2654339184 CurrentFailSts_FD01_SGW 0;
BA_ "GenSigTimeoutTime_AGSM" SG_ 2654339184 CurrentFailSts_FD01_SGW 0;
BA_ "GenSigTimeoutTime_ADCAM" SG_ 2654339184 CurrentFailSts_FD01_SGW 0;
BA_ "GenSigTimeoutTime_BSM" SG_ 2654339072 EOL_FD04_BCM 0;
BA_ "GenSigTimeoutTime_BCM" SG_ 2654339072 EOL_FD04_BCM 0;
BA_ "GenSigTimeoutTime_AGSM" SG_ 2654339072 EOL_FD04_BCM 0;
BA_ "GenSigTimeoutTime_ADCAM" SG_ 2654339072 EOL_FD04_BCM 0;
BA_ "GenSigTimeoutTime_SGW" SG_ 2654339072 EOL_FD03_BCM 0;
BA_ "GenSigTimeoutTime_RFHM" SG_ 2654339072 EOL_FD03_BCM 0;
BA_ "GenSigTimeoutTime_MPAD" SG_ 2654339072 EOL_FD03_BCM 0;
BA_ "GenSigTimeoutTime_IPC" SG_ 2654339072 EOL_FD03_BCM 0;
BA_ "GenSigTimeoutTime_GNMM" SG_ 2654339072 EOL_FD03_BCM 0;
BA_ "GenSigTimeoutTime_EVCU2" SG_ 2654339072 EOL_FD03_BCM 0;
BA_ "GenSigTimeoutTime_ESL" SG_ 2654339072 EOL_FD03_BCM 0;
BA_ "GenSigTimeoutTime_ECM" SG_ 2654339072 EOL_FD03_BCM 0;
BA_ "GenSigTimeoutTime_DTCM" SG_ 2654339072 EOL_FD03_BCM 0;
BA_ "GenSigTimeoutTime_DMSM" SG_ 2654339072 EOL_FD03_BCM 0;
BA_ "GenSigTimeoutTime_BSM" SG_ 2654339072 EOL_FD03_BCM 0;
BA_ "GenSigTimeoutTime_BCM" SG_ 2654339072 EOL_FD03_BCM 0;
BA_ "GenSigTimeoutTime_AGSM" SG_ 2654339072 EOL_FD03_BCM 0;
BA_ "GenSigTimeoutTime_ADCAM" SG_ 2654339072 EOL_FD03_BCM 0;
BA_ "GenSigTimeoutTime_SGW" SG_ 2654339072 EOL_FD02_BCM 0;
BA_ "GenSigTimeoutTime_RFHM" SG_ 2654339072 EOL_FD02_BCM 0;
BA_ "GenSigTimeoutTime_MPAD" SG_ 2654339072 EOL_FD02_BCM 0;
BA_ "GenSigTimeoutTime_IPC" SG_ 2654339072 EOL_FD02_BCM 0;
BA_ "GenSigTimeoutTime_GNMM" SG_ 2654339072 EOL_FD02_BCM 0;
BA_ "GenSigTimeoutTime_EVCU2" SG_ 2654339072 EOL_FD02_BCM 0;
BA_ "GenSigTimeoutTime_ESL" SG_ 2654339072 EOL_FD02_BCM 0;
BA_ "GenSigTimeoutTime_ECM" SG_ 2654339072 EOL_FD02_BCM 0;
BA_ "GenSigTimeoutTime_DTCM" SG_ 2654339072 EOL_FD02_BCM 0;
BA_ "GenSigTimeoutTime_DMSM" SG_ 2654339072 EOL_FD02_BCM 0;
BA_ "GenSigTimeoutTime_BSM" SG_ 2654339072 EOL_FD02_BCM 0;
BA_ "GenSigTimeoutTime_BCM" SG_ 2654339072 EOL_FD02_BCM 0;
BA_ "GenSigTimeoutTime_AGSM" SG_ 2654339072 EOL_FD02_BCM 0;
BA_ "GenSigTimeoutTime_ADCAM" SG_ 2654339072 EOL_FD02_BCM 0;
BA_ "GenSigTimeoutTime_SGW" SG_ 2654339072 EOL_FD01_BCM 0;
BA_ "GenSigTimeoutTime_RFHM" SG_ 2654339072 EOL_FD01_BCM 0;
BA_ "GenSigTimeoutTime_MPAD" SG_ 2654339072 EOL_FD01_BCM 0;
BA_ "GenSigTimeoutTime_IPC" SG_ 2654339072 EOL_FD01_BCM 0;
BA_ "GenSigTimeoutTime_GNMM" SG_ 2654339072 EOL_FD01_BCM 0;
BA_ "GenSigTimeoutTime_EVCU2" SG_ 2654339072 EOL_FD01_BCM 0;
BA_ "GenSigTimeoutTime_ESL" SG_ 2654339072 EOL_FD01_BCM 0;
BA_ "GenSigTimeoutTime_ECM" SG_ 2654339072 EOL_FD01_BCM 0;
BA_ "GenSigTimeoutTime_DTCM" SG_ 2654339072 EOL_FD01_BCM 0;
BA_ "GenSigTimeoutTime_DMSM" SG_ 2654339072 EOL_FD01_BCM 0;
BA_ "GenSigTimeoutTime_BSM" SG_ 2654339072 EOL_FD01_BCM 0;
BA_ "GenSigTimeoutTime_BCM" SG_ 2654339072 EOL_FD01_BCM 0;
BA_ "GenSigTimeoutTime_AGSM" SG_ 2654339072 EOL_FD01_BCM 0;
BA_ "GenSigTimeoutTime_ADCAM" SG_ 2654339072 EOL_FD01_BCM 0;
BA_ "GenSigTimeoutTime_SGW" SG_ 2654339072 CurrentFailSts_FD04_BCM 0;
BA_ "GenSigTimeoutTime_RFHM" SG_ 2654339072 CurrentFailSts_FD04_BCM 0;
BA_ "GenSigTimeoutTime_MPAD" SG_ 2654339072 CurrentFailSts_FD04_BCM 0;
BA_ "GenSigTimeoutTime_IPC" SG_ 2654339072 CurrentFailSts_FD04_BCM 0;
BA_ "GenSigTimeoutTime_GNMM" SG_ 2654339072 CurrentFailSts_FD04_BCM 0;
BA_ "GenSigTimeoutTime_EVCU2" SG_ 2654339072 CurrentFailSts_FD04_BCM 0;
BA_ "GenSigTimeoutTime_ESL" SG_ 2654339072 CurrentFailSts_FD04_BCM 0;
BA_ "GenSigTimeoutTime_ECM" SG_ 2654339072 CurrentFailSts_FD04_BCM 0;
BA_ "GenSigTimeoutTime_DTCM" SG_ 2654339072 CurrentFailSts_FD04_BCM 0;
BA_ "GenSigTimeoutTime_DMSM" SG_ 2654339072 CurrentFailSts_FD04_BCM 0;
BA_ "GenSigTimeoutTime_BSM" SG_ 2654339072 CurrentFailSts_FD04_BCM 0;
BA_ "GenSigTimeoutTime_BCM" SG_ 2654339072 CurrentFailSts_FD04_BCM 0;
BA_ "GenSigTimeoutTime_AGSM" SG_ 2654339072 CurrentFailSts_FD04_BCM 0;
BA_ "GenSigTimeoutTime_ADCAM" SG_ 2654339072 CurrentFailSts_FD04_BCM 0;
BA_ "GenSigTimeoutTime_SGW" SG_ 2654339072 CurrentFailSts_FD03_BCM 0;
BA_ "GenSigTimeoutTime_RFHM" SG_ 2654339072 CurrentFailSts_FD03_BCM 0;
BA_ "GenSigTimeoutTime_MPAD" SG_ 2654339072 CurrentFailSts_FD03_BCM 0;
BA_ "GenSigTimeoutTime_IPC" SG_ 2654339072 CurrentFailSts_FD03_BCM 0;
BA_ "GenSigTimeoutTime_GNMM" SG_ 2654339072 CurrentFailSts_FD03_BCM 0;
BA_ "GenSigTimeoutTime_EVCU2" SG_ 2654339072 CurrentFailSts_FD03_BCM 0;
BA_ "GenSigTimeoutTime_ESL" SG_ 2654339072 CurrentFailSts_FD03_BCM 0;
BA_ "GenSigTimeoutTime_ECM" SG_ 2654339072 CurrentFailSts_FD03_BCM 0;
BA_ "GenSigTimeoutTime_DTCM" SG_ 2654339072 CurrentFailSts_FD03_BCM 0;
BA_ "GenSigTimeoutTime_DMSM" SG_ 2654339072 CurrentFailSts_FD03_BCM 0;
BA_ "GenSigTimeoutTime_BSM" SG_ 2654339072 CurrentFailSts_FD03_BCM 0;
BA_ "GenSigTimeoutTime_BCM" SG_ 2654339072 CurrentFailSts_FD03_BCM 0;
BA_ "GenSigTimeoutTime_AGSM" SG_ 2654339072 CurrentFailSts_FD03_BCM 0;
BA_ "GenSigTimeoutTime_ADCAM" SG_ 2654339072 CurrentFailSts_FD03_BCM 0;
BA_ "GenSigTimeoutTime_SGW" SG_ 2654339072 CurrentFailSts_FD02_BCM 0;
BA_ "GenSigTimeoutTime_RFHM" SG_ 2654339072 CurrentFailSts_FD02_BCM 0;
BA_ "GenSigTimeoutTime_MPAD" SG_ 2654339072 CurrentFailSts_FD02_BCM 0;
BA_ "GenSigTimeoutTime_IPC" SG_ 2654339072 CurrentFailSts_FD02_BCM 0;
BA_ "GenSigTimeoutTime_GNMM" SG_ 2654339072 CurrentFailSts_FD02_BCM 0;
BA_ "GenSigTimeoutTime_EVCU2" SG_ 2654339072 CurrentFailSts_FD02_BCM 0;
BA_ "GenSigTimeoutTime_ESL" SG_ 2654339072 CurrentFailSts_FD02_BCM 0;
BA_ "GenSigTimeoutTime_ECM" SG_ 2654339072 CurrentFailSts_FD02_BCM 0;
BA_ "GenSigTimeoutTime_DTCM" SG_ 2654339072 CurrentFailSts_FD02_BCM 0;
BA_ "GenSigTimeoutTime_DMSM" SG_ 2654339072 CurrentFailSts_FD02_BCM 0;
BA_ "GenSigTimeoutTime_BSM" SG_ 2654339072 CurrentFailSts_FD02_BCM 0;
BA_ "GenSigTimeoutTime_BCM" SG_ 2654339072 CurrentFailSts_FD02_BCM 0;
BA_ "GenSigTimeoutTime_AGSM" SG_ 2654339072 CurrentFailSts_FD02_BCM 0;
BA_ "GenSigTimeoutTime_ADCAM" SG_ 2654339072 CurrentFailSts_FD02_BCM 0;
BA_ "GenSigTimeoutTime_RFHM" SG_ 1443 AutoParkBrake 0;
BA_ "GenSigTimeoutTime_MPAD" SG_ 1443 AutoParkBrake 0;
BA_ "GenSigTimeoutTime_IPC" SG_ 1443 AutoParkBrake 0;
BA_ "GenSigTimeoutTime_GNMM" SG_ 1443 AutoParkBrake 0;
BA_ "GenSigTimeoutTime_EVCU2" SG_ 1443 AutoParkBrake 0;
BA_ "GenSigTimeoutTime_ESL" SG_ 1443 AutoParkBrake 0;
BA_ "GenSigTimeoutTime_ECM" SG_ 1443 AutoParkBrake 0;
BA_ "GenSigTimeoutTime_DTCM" SG_ 1443 AutoParkBrake 0;
BA_ "GenSigTimeoutTime_DMSM" SG_ 1443 AutoParkBrake 0;
BA_ "GenSigTimeoutTime_AGSM" SG_ 1443 AutoParkBrake 0;
BA_ "GenSigTimeoutTime_ADCAM" SG_ 1443 AutoParkBrake 0;
BA_ "GenSigSendType" SG_ 1443 AutoParkBrake 3;
BA_ "GenSigTimeoutTime_ESL" SG_ 1443 AutoUnlockDoorExit 0;
BA_ "GenSigTimeoutTime_ECM" SG_ 1443 AutoUnlockDoorExit 0;
BA_ "GenSigTimeoutTime_DTCM" SG_ 1443 AutoUnlockDoorExit 0;
BA_ "GenSigTimeoutTime_DMSM" SG_ 1443 AutoUnlockDoorExit 0;
BA_ "GenSigTimeoutTime_BSM" SG_ 1443 AutoUnlockDoorExit 0;
BA_ "GenSigTimeoutTime_AGSM" SG_ 1443 AutoUnlockDoorExit 0;
BA_ "GenSigTimeoutTime_ADCAM" SG_ 1443 AutoUnlockDoorExit 0;
BA_ "GenSigSendType" SG_ 1443 AutoUnlockDoorExit 3;
BA_ "GenSigStartValue" SG_ 1443 AutoUnlockDoorExit 1;
BA_ "GenSigTimeoutTime_RFHM" SG_ 1443 AutoHighBeamEnable 0;
BA_ "GenSigTimeoutTime_MPAD" SG_ 1443 AutoHighBeamEnable 0;
BA_ "GenSigTimeoutTime_IPC" SG_ 1443 AutoHighBeamEnable 0;
BA_ "GenSigTimeoutTime_GNMM" SG_ 1443 AutoHighBeamEnable 0;
BA_ "GenSigTimeoutTime_EVCU2" SG_ 1443 AutoHighBeamEnable 0;
BA_ "GenSigTimeoutTime_ESL" SG_ 1443 AutoHighBeamEnable 0;
BA_ "GenSigTimeoutTime_ECM" SG_ 1443 AutoHighBeamEnable 0;
BA_ "GenSigTimeoutTime_DTCM" SG_ 1443 AutoHighBeamEnable 0;
BA_ "GenSigTimeoutTime_DMSM" SG_ 1443 AutoHighBeamEnable 0;
BA_ "GenSigTimeoutTime_BSM" SG_ 1443 AutoHighBeamEnable 0;
BA_ "GenSigTimeoutTime_AGSM" SG_ 1443 AutoHighBeamEnable 0;
BA_ "GenSigTimeoutTime_ADCAM" SG_ 1443 AutoHighBeamEnable 0;
BA_ "GenSigSendType" SG_ 1443 AutoHighBeamEnable 3;
BA_ "GenSigStartValue" SG_ 1443 AutoHighBeamEnable 1;
BA_ "GenSigTimeoutTime_RFHM" SG_ 1443 Auto_Fold_Mirr 0;
BA_ "GenSigTimeoutTime_MPAD" SG_ 1443 Auto_Fold_Mirr 0;
BA_ "GenSigTimeoutTime_IPC" SG_ 1443 Auto_Fold_Mirr 0;
BA_ "GenSigTimeoutTime_GNMM" SG_ 1443 Auto_Fold_Mirr 0;
BA_ "GenSigTimeoutTime_EVCU2" SG_ 1443 Auto_Fold_Mirr 0;
BA_ "GenSigTimeoutTime_ESL" SG_ 1443 Auto_Fold_Mirr 0;
BA_ "GenSigTimeoutTime_ECM" SG_ 1443 Auto_Fold_Mirr 0;
BA_ "GenSigTimeoutTime_DTCM" SG_ 1443 Auto_Fold_Mirr 0;
BA_ "GenSigTimeoutTime_DMSM" SG_ 1443 Auto_Fold_Mirr 0;
BA_ "GenSigTimeoutTime_BSM" SG_ 1443 Auto_Fold_Mirr 0;
BA_ "GenSigTimeoutTime_AGSM" SG_ 1443 Auto_Fold_Mirr 0;
BA_ "GenSigTimeoutTime_ADCAM" SG_ 1443 Auto_Fold_Mirr 0;
BA_ "GenSigSendType" SG_ 1443 Auto_Fold_Mirr 3;
BA_ "GenSigTimeoutTime_RFHM" SG_ 1443 AmbientLightingLevel 0;
BA_ "GenSigTimeoutTime_MPAD" SG_ 1443 AmbientLightingLevel 0;
BA_ "GenSigTimeoutTime_IPC" SG_ 1443 AmbientLightingLevel 0;
BA_ "GenSigTimeoutTime_GNMM" SG_ 1443 AmbientLightingLevel 0;
BA_ "GenSigTimeoutTime_EVCU2" SG_ 1443 AmbientLightingLevel 0;
BA_ "GenSigTimeoutTime_ESL" SG_ 1443 AmbientLightingLevel 0;
BA_ "GenSigTimeoutTime_ECM" SG_ 1443 AmbientLightingLevel 0;
BA_ "GenSigTimeoutTime_DTCM" SG_ 1443 AmbientLightingLevel 0;
BA_ "GenSigTimeoutTime_DMSM" SG_ 1443 AmbientLightingLevel 0;
BA_ "GenSigTimeoutTime_BSM" SG_ 1443 AmbientLightingLevel 0;
BA_ "GenSigTimeoutTime_BCM" SG_ 1443 AmbientLightingLevel 0;
BA_ "GenSigTimeoutTime_AGSM" SG_ 1443 AmbientLightingLevel 0;
BA_ "GenSigTimeoutTime_ADCAM" SG_ 1443 AmbientLightingLevel 0;
BA_ "GenSigSendType" SG_ 1443 AmbientLightingLevel 3;
BA_ "GenSigStartValue" SG_ 1443 AmbientLightingLevel 4;
VAL_ 1443 FlashLightWLock 0 "Off" 1 "On";
VAL_ 2654339184 GenericFailSts_FD11_SGW 0 "No_Fail_Present" 1 "Fail_Present";
VAL_ 2654339184 GenericFailSts_FD08_SGW 0 "No_Fail_Present" 1 "Fail_Present";
VAL_ 2654339184 GenericFailSts_FD03_SGW 0 "No_Fail_Present" 1 "Fail_Present";
VAL_ 2654339184 GenericFailSts_FD02_SGW 0 "No_Fail_Present" 1 "Fail_Present";
VAL_ 2654339184 GenericFailSts_FD01_SGW 0 "No_Fail_Present" 1 "Fail_Present";
VAL_ 2654339184 EOL_FD11_SGW 0 "No_EOL_Programming" 1 "EOL_Programming";
VAL_ 2654339184 EOL_FD08_SGW 0 "No_EOL_Programming" 1 "EOL_Programming";
VAL_ 2654339184 EOL_FD03_SGW 0 "No_EOL_Programming" 1 "EOL_Programming";
VAL_ 2654339184 EOL_FD02_SGW 0 "No_EOL_Programming" 1 "EOL_Programming";
VAL_ 2654339184 EOL_FD01_SGW 0 "No_EOL_Programming" 1 "EOL_Programming";
VAL_ 2654339184 CurrentFailSts_FD11_SGW 0 "No_Fail_Present" 1 "Fail_Present";
VAL_ 2654339184 CurrentFailSts_FD08_SGW 0 "No_Fail_Present" 1 "Fail_Present";
VAL_ 2654339184 CurrentFailSts_FD03_SGW 0 "No_Fail_Present" 1 "Fail_Present";
VAL_ 2654339184 CurrentFailSts_FD02_SGW 0 "No_Fail_Present" 1 "Fail_Present";
VAL_ 2654339184 CurrentFailSts_FD01_SGW 0 "No_Fail_Present" 1 "Fail_Present";
VAL_ 2654339072 GenericFailSts_FD04_BCM 0 "No_Fail_Present" 1 "Fail_Present";
VAL_ 2654339072 GenericFailSts_FD03_BCM 0 "No_Fail_Present" 1 "Fail_Present";
VAL_ 2654339072 GenericFailSts_FD02_BCM 0 "No_Fail_Present" 1 "Fail_Present";
VAL_ 2654339072 GenericFailSts_FD01_BCM 0 "No_Fail_Present" 1 "Fail_Present";
VAL_ 2654339072 EOL_FD04_BCM 0 "No_EOL_Programming" 1 "EOL_Programming";
VAL_ 2654339072 EOL_FD03_BCM 0 "No_EOL_Programming" 1 "EOL_Programming";
VAL_ 2654339072 EOL_FD02_BCM 0 "No_EOL_Programming" 1 "EOL_Programming";
VAL_ 2654339072 EOL_FD01_BCM 0 "No_EOL_Programming" 1 "EOL_Programming";
VAL_ 2654339072 CurrentFailSts_FD04_BCM 0 "No_Fail_Present" 1 "Fail_Present";
VAL_ 2654339072 CurrentFailSts_FD03_BCM 0 "No_Fail_Present" 1 "Fail_Present";
VAL_ 2654339072 CurrentFailSts_FD02_BCM 0 "No_Fail_Present" 1 "Fail_Present";
VAL_ 2654339072 CurrentFailSts_FD01_BCM 0 "No_Fail_Present" 1 "Fail_Present";
VAL_ 1443 Windows_With_Fob 0 "Off" 1 "On";
VAL_ 1443 TyrePress_Unit 0 "KPa" 1 "psi" 2 "bar";
VAL_ 1443 Traffic_Sign_Warn 0 "Off" 1 "Visual" 2 "Visual_Chime";
VAL_ 1443 Traffic_Sign_Info 0 "Off" 1 "On";
VAL_ 1443 Torque_Unit 0 "Nm" 1 "lb_ft";
VAL_ 1443 Tire_Fill_Alert 0 "Off" 1 "On";
VAL_ 1443 Tilt_Mirr_Rev 0 "Off" 1 "On";
VAL_ 1443 Temp_Unit 0 "°C" 1 "°F";
VAL_ 1443 TelematicSetupACK 0 "No_ACK_Required" 1 "ACK_KO" 3 "ACK_OK";
VAL_ 1443 SVC_Guidelines 0 "Off" 1 "On";
VAL_ 1443 SVC_Delay 0 "Off" 1 "On";
VAL_ 1443 Steer_Feel 0 "Normal" 1 "Sport" 2 "Comfort";
VAL_ 1443 SpeedLockDoorEnable 0 "Not_Enable" 1 "Enable";
VAL_ 1443 Speed_Unit 0 "mph" 1 "kph";
VAL_ 1443 SoundHornRemoteStart 0 "On" 1 "Off";
VAL_ 1443 SoundHornLock 0 "Off" 1 "1st Press" 2 "2nd Press";
VAL_ 1443 Sdw 0 "Off" 1 "Sound" 2 "Sound_Display";
VAL_ 1443 RKEMemoryLinkEnable 0 "Off" 1 "On";
VAL_ 1443 RemStNrmlStEnbl 0 "Off" 1 "Remote_Start_Only" 2 "Remote_And_Normal_Start" 3 "Normal_Start_Only";
VAL_ 1443 RemoteDoorUnlock 0 "Driver" 1 "All";
VAL_ 1443 Rear_Brk_Asst 0 "Warn" 1 "Warn_Braking";
VAL_ 1443 Rdy_To_Drive 0 "Off" 1 "On";
VAL_ 1443 RainSensorLevel 0 "Not_Enable" 1 "Enable";
VAL_ 1443 PLGAlert 0 "Off" 1 "On";
VAL_ 1443 PhoneRepetition 0 "Absent" 1 "Present";
VAL_ 1443 Ped_EM_Brk_Warn_Act 0 "Off" 1 "On";
VAL_ 1443 PassiveEntry 0 "On" 1 "Off";
VAL_ 1443 PamChimeVolumeRear 0 "Low" 1 "Medium" 2 "High";
VAL_ 1443 PamChimeVolumeFront 0 "Low" 1 "Medium" 2 "High";
VAL_ 1443 Night_Vision 0 "Off" 1 "On";
VAL_ 1443 New_Spd_Zone_Ind 0 "Off" 1 "Visual" 2 "Chime" 3 "Visual_Chime";
VAL_ 1443 NavRepetition 0 "Absent" 1 "Present";
VAL_ 1443 LDW_Sensibility 0 "Early" 1 "Med" 2 "Late";
VAL_ 1443 LDW_Intensity 0 "Low" 1 "Med" 2 "High";
VAL_ 1443 LanguageSelection 0 "Italian" 1 "Deutsch" 2 "English" 3 "Espanol" 4 "Francais" 5 "Portugues" 6 "Polish" 7 "Dutch" 8 "Brazilian" 9 "Turkish" 10 "Mexican" 11 "English_US" 12 "Canadian" 13 "Russian" 14 "Chinese" 15 "Japanese" 16 "Korean" 17 "Arabic" 18 "Czech" 19 "Slovakian" 20 "Hungarian" 21 "Hindi";
VAL_ 1443 IPCProgrammed 0 "Not_Programmed" 1 "Programmed";
VAL_ 1443 Intelligent_Speed 0 "Off" 1 "On";
VAL_ 1443 Illuminated_Approach 0 "Zero" 1 "Thirty" 2 "Sixty" 3 "Ninety";
VAL_ 1443 HP_Unit 0 "HP" 1 "kW" 2 "PS";
VAL_ 1443 HourMode 0 "0_24_h" 1 "0_12_h";
VAL_ 1443 Hill_Start_Assist 0 "Off" 1 "On";
VAL_ 1443 HeadLightWipers 0 "Off" 1 "On";
VAL_ 1443 HeadlightsOffDelay 0 "0sec" 1 "30sec" 2 "60sec" 3 "90ec";
VAL_ 1443 Handsfree_Liftgate 0 "Off" 1 "On";
VAL_ 1443 GreetingLightsEnable 0 "True" 1 "False";
VAL_ 1443 Fwrd_Cam_Guidelines 0 "Off" 1 "On";
VAL_ 1443 FSFCWPlusSetting 0 "Off" 1 "Audio" 2 "Brake" 3 "Audio_Brake" 4 "Not_Request";
VAL_ 1443 FSFCWPlusActivationMode 0 "Near" 1 "Med" 2 "Far";
VAL_ 1443 EPB_MaintenanceMode 0 "Off" 1 "On";
VAL_ 1443 Eng_Off_Pwr_Delay 0 "Zero" 1 "Fourty_Five_Sec" 2 "Five_Min" 3 "Ten_Min";
VAL_ 1443 Easy_Exit_D 0 "Off" 1 "On";
VAL_ 1443 DynamicGrid 0 "Dynamic Gridlines OFF" 1 "Dynamic Gridlines ON";
VAL_ 1443 DRLEnable 0 "True" 1 "False";
VAL_ 1443 Dist_Unit 0 "km" 1 "miles";
VAL_ 1443 CorneringEnable 0 "True" 1 "False";
VAL_ 1443 Consum_Unit 0 "Km_Per_Litre" 1 "Litres_Per_100Km" 2 "Miles_Per_Gallon_UK" 3 "Miles_Per_Gallon_US" 4 "km/kWh" 5 "kWh/100km" 6 "mi/kWh" 7 "kWh/mi";
VAL_ 1443 BSDEnable 0 "Not_Enable" 1 "Enable_LED" 2 "Enable_ LED_Chime";
VAL_ 1443 Backup_Cam_Delay 0 "Off" 1 "On";
VAL_ 1443 AutoUnlockDoorExit 0 "Not_Enable" 1 "Enable";
VAL_ 1443 AutoParkBrake 0 "On" 1 "Off";
VAL_ 1443 AutoHighBeamEnable 0 "Not_Enable" 1 "Enable";
VAL_ 1443 Auto_Fold_Mirr 0 "Off" 1 "On";
VAL_ 1443 AmbientLightingLevel 0 "Level_1" 1 "Level_2" 2 "Level_3" 3 "Level_4" 4 "Level_5" 5 "Level_6" 6 "Level_7" 7 "Level_8" 8 "Level_9" 9 "Level_10" 10 "Level_11" 11 "Level_12" 12 "Level_13" 13 "Level_14" 14 "Level_15" 15 "Level_16";
VAL_ 1443 Proximity_WU 0 "Off" 1 "On";
VAL_ 1443 Drowsy_Driver_Alert 0 "Off" 1 "On";
VAL_ 1443 Active_Park_Prox_Chime 0 "Off" 1 "On";
VAL_ 1443 Active_Park_Mode 0 "Full_Auto" 1 "Steering_Only";
VAL_ 2654339184 WakeupSource_FD11_SGW 0 "No_Wakeup" 1 "IGN_ON" 129 "FD1_Psv_WU" 130 "FD2_Psv_WU" 131 "FD3_Psv_WU" 132 "FD4_Psv_WU" 133 "FD5_Psv_WU" 134 "FD6_Psv_WU" 135 "FD7_Psv_WU" 136 "FD8_Psv_WU" 137 "FD9_Psv_WU" 138 "FD10_Psv_WU" 139 "FD11_Psv_WU" 140 "FD12_Psv_WU" 141 "FD13_Psv_WU" 142 "FD14_Psv_WU" 143 "FD15_Psv_WU" 144 "FD16_Psv_WU" 145 "FD17_Psv_WU" 146 "FD18_Psv_WU" 147 "FD19_Psv_WU" 148 "FD20_Psv_WU" 149 "FD21_Psv_WU" 150 "FD22_Psv_WU" 151 "FD23_Psv_WU" 152 "FD24_Psv_WU" 153 "FD25_Psv_WU" 154 "FD26_Psv_WU" 155 "FD27_Psv_WU" 156 "FD28_Psv_WU" 157 "FD29_Psv_WU" 158 "BHCAN_Psv_WU" 159 "CCAN_Psv_WU" 254 "WUSource_Not_Listed";
VAL_ 2654339184 WakeupSource_FD08_SGW 0 "No_Wakeup" 1 "IGN_ON" 129 "FD1_Psv_WU" 130 "FD2_Psv_WU" 131 "FD3_Psv_WU" 132 "FD4_Psv_WU" 133 "FD5_Psv_WU" 134 "FD6_Psv_WU" 135 "FD7_Psv_WU" 136 "FD8_Psv_WU" 137 "FD9_Psv_WU" 138 "FD10_Psv_WU" 139 "FD11_Psv_WU" 140 "FD12_Psv_WU" 141 "FD13_Psv_WU" 142 "FD14_Psv_WU" 143 "FD15_Psv_WU" 144 "FD16_Psv_WU" 145 "FD17_Psv_WU" 146 "FD18_Psv_WU" 147 "FD19_Psv_WU" 148 "FD20_Psv_WU" 149 "FD21_Psv_WU" 150 "FD22_Psv_WU" 151 "FD23_Psv_WU" 152 "FD24_Psv_WU" 153 "FD25_Psv_WU" 154 "FD26_Psv_WU" 155 "FD27_Psv_WU" 156 "FD28_Psv_WU" 157 "FD29_Psv_WU" 158 "BHCAN_Psv_WU" 159 "CCAN_Psv_WU" 254 "WUSource_Not_Listed";
VAL_ 2654339184 WakeupSource_FD03_SGW 0 "No_Wakeup" 1 "IGN_ON" 129 "FD1_Psv_WU" 130 "FD2_Psv_WU" 131 "FD3_Psv_WU" 132 "FD4_Psv_WU" 133 "FD5_Psv_WU" 134 "FD6_Psv_WU" 135 "FD7_Psv_WU" 136 "FD8_Psv_WU" 137 "FD9_Psv_WU" 138 "FD10_Psv_WU" 139 "FD11_Psv_WU" 140 "FD12_Psv_WU" 141 "FD13_Psv_WU" 142 "FD14_Psv_WU" 143 "FD15_Psv_WU" 144 "FD16_Psv_WU" 145 "FD17_Psv_WU" 146 "FD18_Psv_WU" 147 "FD19_Psv_WU" 148 "FD20_Psv_WU" 149 "FD21_Psv_WU" 150 "FD22_Psv_WU" 151 "FD23_Psv_WU" 152 "FD24_Psv_WU" 153 "FD25_Psv_WU" 154 "FD26_Psv_WU" 155 "FD27_Psv_WU" 156 "FD28_Psv_WU" 157 "FD29_Psv_WU" 158 "BHCAN_Psv_WU" 159 "CCAN_Psv_WU" 254 "WUSource_Not_Listed";
VAL_ 2654339184 WakeupSource_FD02_SGW 0 "No_Wakeup" 1 "IGN_ON" 129 "FD1_Psv_WU" 130 "FD2_Psv_WU" 131 "FD3_Psv_WU" 132 "FD4_Psv_WU" 133 "FD5_Psv_WU" 134 "FD6_Psv_WU" 135 "FD7_Psv_WU" 136 "FD8_Psv_WU" 137 "FD9_Psv_WU" 138 "FD10_Psv_WU" 139 "FD11_Psv_WU" 140 "FD12_Psv_WU" 141 "FD13_Psv_WU" 142 "FD14_Psv_WU" 143 "FD15_Psv_WU" 144 "FD16_Psv_WU" 145 "FD17_Psv_WU" 146 "FD18_Psv_WU" 147 "FD19_Psv_WU" 148 "FD20_Psv_WU" 149 "FD21_Psv_WU" 150 "FD22_Psv_WU" 151 "FD23_Psv_WU" 152 "FD24_Psv_WU" 153 "FD25_Psv_WU" 154 "FD26_Psv_WU" 155 "FD27_Psv_WU" 156 "FD28_Psv_WU" 157 "FD29_Psv_WU" 158 "BHCAN_Psv_WU" 159 "CCAN_Psv_WU" 254 "WUSource_Not_Listed";
VAL_ 2654339184 WakeupSource_FD01_SGW 0 "No_Wakeup" 1 "IGN_ON" 129 "FD1_Psv_WU" 130 "FD2_Psv_WU" 131 "FD3_Psv_WU" 132 "FD4_Psv_WU" 133 "FD5_Psv_WU" 134 "FD6_Psv_WU" 135 "FD7_Psv_WU" 136 "FD8_Psv_WU" 137 "FD9_Psv_WU" 138 "FD10_Psv_WU" 139 "FD11_Psv_WU" 140 "FD12_Psv_WU" 141 "FD13_Psv_WU" 142 "FD14_Psv_WU" 143 "FD15_Psv_WU" 144 "FD16_Psv_WU" 145 "FD17_Psv_WU" 146 "FD18_Psv_WU" 147 "FD19_Psv_WU" 148 "FD20_Psv_WU" 149 "FD21_Psv_WU" 150 "FD22_Psv_WU" 151 "FD23_Psv_WU" 152 "FD24_Psv_WU" 153 "FD25_Psv_WU" 154 "FD26_Psv_WU" 155 "FD27_Psv_WU" 156 "FD28_Psv_WU" 157 "FD29_Psv_WU" 158 "BHCAN_Psv_WU" 159 "CCAN_Psv_WU" 254 "WUSource_Not_Listed";
VAL_ 2654339184 PreviousCanNMState_FD11_SGW 0 "Uninitialized State" 1 "Bus-Sleep State" 2 "Prepare-Bus State" 3 "Ready-Sleep State" 4 "Normal Operation State" 5 "Repeat Message State" 6 "Synchronize State" 7 "Offline State";
VAL_ 2654339184 PreviousCanNMState_FD08_SGW 0 "Uninitialized State" 1 "Bus-Sleep State" 2 "Prepare-Bus State" 3 "Ready-Sleep State" 4 "Normal Operation State" 5 "Repeat Message State" 6 "Synchronize State" 7 "Offline State";
VAL_ 2654339184 PreviousCanNMState_FD03_SGW 0 "Uninitialized State" 1 "Bus-Sleep State" 2 "Prepare-Bus State" 3 "Ready-Sleep State" 4 "Normal Operation State" 5 "Repeat Message State" 6 "Synchronize State" 7 "Offline State";
VAL_ 2654339184 PreviousCanNMState_FD02_SGW 0 "Uninitialized State" 1 "Bus-Sleep State" 2 "Prepare-Bus State" 3 "Ready-Sleep State" 4 "Normal Operation State" 5 "Repeat Message State" 6 "Synchronize State" 7 "Offline State";
VAL_ 2654339184 PreviousCanNMState_FD01_SGW 0 "Uninitialized State" 1 "Bus-Sleep State" 2 "Prepare-Bus State" 3 "Ready-Sleep State" 4 "Normal Operation State" 5 "Repeat Message State" 6 "Synchronize State" 7 "Offline State";
VAL_ 2654339184 DES_FD11_SGW 0 "Error_Active_state" 1 "Error_passive_warning_state" 2 "Bus_off_state" 3 "Not_used";
VAL_ 2654339184 DES_FD08_SGW 0 "Error_Active_state" 1 "Error_passive_warning_state" 2 "Bus_off_state" 3 "Not_used";
VAL_ 2654339184 DES_FD03_SGW 0 "Error_Active_state" 1 "Error_passive_warning_state" 2 "Bus_off_state" 3 "Not_used";
VAL_ 2654339184 DES_FD02_SGW 0 "Error_Active_state" 1 "Error_passive_warning_state" 2 "Bus_off_state" 3 "Not_used";
VAL_ 2654339184 DES_FD01_SGW 0 "Error_Active_state" 1 "Error_passive_warning_state" 2 "Bus_off_state" 3 "Not_used";
VAL_ 2654339184 CurrentCanNMState_FD11_SGW 0 "Uninitialized State" 1 "Bus-Sleep State" 2 "Prepare-Bus State" 3 "Ready-Sleep State" 4 "Normal Operation State" 5 "Repeat Message State" 6 "Synchronize State" 7 "Offline State";
VAL_ 2654339184 CurrentCanNMState_FD08_SGW 0 "Uninitialized State" 1 "Bus-Sleep State" 2 "Prepare-Bus State" 3 "Ready-Sleep State" 4 "Normal Operation State" 5 "Repeat Message State" 6 "Synchronize State" 7 "Offline State";
VAL_ 2654339184 CurrentCanNMState_FD03_SGW 0 "Uninitialized State" 1 "Bus-Sleep State" 2 "Prepare-Bus State" 3 "Ready-Sleep State" 4 "Normal Operation State" 5 "Repeat Message State" 6 "Synchronize State" 7 "Offline State";
VAL_ 2654339184 CurrentCanNMState_FD02_SGW 0 "Uninitialized State" 1 "Bus-Sleep State" 2 "Prepare-Bus State" 3 "Ready-Sleep State" 4 "Normal Operation State" 5 "Repeat Message State" 6 "Synchronize State" 7 "Offline State";
VAL_ 2654339184 CurrentCanNMState_FD01_SGW 0 "Uninitialized State" 1 "Bus-Sleep State" 2 "Prepare-Bus State" 3 "Ready-Sleep State" 4 "Normal Operation State" 5 "Repeat Message State" 6 "Synchronize State" 7 "Offline State";
VAL_ 2654339072 PreviousCanNMState_FD01_BCM 0 "Uninitialized State" 1 "Bus-Sleep State" 2 "Prepare-Bus State" 3 "Ready-Sleep State" 4 "Normal Operation State" 5 "Repeat Message State" 6 "Synchronize State" 7 "Offline State";
VAL_ 2654339072 DES_FD04_BCM 0 "Error_Active_state" 1 "Error_passive_warning_state" 2 "Bus_off_state" 3 "Not_used";
VAL_ 2654339072 DES_FD03_BCM 0 "Error_Active_state" 1 "Error_passive_warning_state" 2 "Bus_off_state" 3 "Not_used";
VAL_ 2654339072 DES_FD02_BCM 0 "Error_Active_state" 1 "Error_passive_warning_state" 2 "Bus_off_state" 3 "Not_used";
VAL_ 2654339072 DES_FD01_BCM 0 "Error_Active_state" 1 "Error_passive_warning_state" 2 "Bus_off_state" 3 "Not_used";
VAL_ 2654339072 CurrentCanNMState_FD04_BCM 0 "Uninitialized State" 1 "Bus-Sleep State" 2 "Prepare-Bus State" 3 "Ready-Sleep State" 4 "Normal Operation State" 5 "Repeat Message State" 6 "Synchronize State" 7 "Offline State";
VAL_ 2654339072 CurrentCanNMState_FD03_BCM 0 "Uninitialized State" 1 "Bus-Sleep State" 2 "Prepare-Bus State" 3 "Ready-Sleep State" 4 "Normal Operation State" 5 "Repeat Message State" 6 "Synchronize State" 7 "Offline State";
VAL_ 2654339072 CurrentCanNMState_FD02_BCM 0 "Uninitialized State" 1 "Bus-Sleep State" 2 "Prepare-Bus State" 3 "Ready-Sleep State" 4 "Normal Operation State" 5 "Repeat Message State" 6 "Synchronize State" 7 "Offline State";
VAL_ 2654339072 CurrentCanNMState_FD01_BCM 0 "Uninitialized State" 1 "Bus-Sleep State" 2 "Prepare-Bus State" 3 "Ready-Sleep State" 4 "Normal Operation State" 5 "Repeat Message State" 6 "Synchronize State" 7 "Offline State";
VAL_ 2654339072 WakeupSource_FD04_BCM 0 "None" 1 "Ignition_Active" 2 "CmdIgnSts_LK_to_ACC_RUN_START" 3 "HazardSwitch_ON" 4 "DrvDoorAjar" 5 "DrvDoor2Ajar" 6 "PsngrDoorAjar" 7 "LR_DoorAjar" 8 "RR_DoorAjar" 9 "TrunkAjar" 10 "BonnetAjar" 11 "RAPHandle_Req" 12 "MainLightSelector_Req_OFF" 13 "HiBmLvr_Stat_HIBM_FLASH_ON_PSD" 14 "LowBeamSts_SET" 15 "ParkingLightSts_SET" 16 "FlashToPass_SET" 17 "RemStActvSts_Active" 18 "Fuel_Door_Release_Switch" 19 "ENGINE_FD_8_RefuelEvent_Pending" 20 "OHC_1_Front_Int_LG_Sw_1" 21 "HFRM_1_RearKick" 22 "LeakCheckTimerExpired" 23 "Horn_Req_Not Pressed_to_Pressed" 24 "Comfort_Enable_Time_not_0" 25 "CmdIgnSts_ACC_RUN_START" 26 "ENGINE_FD_8_LeakTestSts_1" 27 "Non_Default_Diagnostic_Session" 28 "RL_Lk_Sw_LK_RQ_or_UNLK_RQ" 29 "RR_Lk_Sw_LK_RQ_or_UNLK_RQ" 30 "FD-CAN1" 31 "FD-CAN2" 32 "FD-CAN3" 33 "FD-CAN4" 34 "BH-CAN" 35 "C-CAN1" 36 "EVAP_SWC" 37 "FUEL_DR_REL_SWC" 38 "Other_Software_Factory_Component" 39 "OHC_1_Front_Map_LGT_RT_Sw" 40 "OHC_1_Front_Map_LGT_LT_Sw" 41 "Fog_Lights_Signal " 42 "DOME_ON_OR_DOME_DEFEAT " 43 "Screen_Open_Close_is_pressed" 44 "Diagnostic_Message_Routing_DMR" 45 "Reserved" 46 "Reserved" 47 "Reserved" 48 "Reserved" 49 "Reserved" 50 "Reserved" 51 "Reserved" 52 "Reserved" 53 "Reserved" 54 "Reserved" 55 "Reserved" 56 "Reserved" 57 "Reserved" 58 "Reserved" 59 "Reserved" 60 "Reserved" 61 "Reserved" 62 "Reserved" 63 "Reserved" 64 "Reserved" 65 "Reserved" 66 "Reserved" 67 "Reserved" 68 "Reserved" 69 "Reserved" 70 "Reserved" 71 "Reserved" 72 "Reserved" 73 "Reserved" 74 "Reserved" 75 "Reserved" 76 "Reserved" 77 "Reserved" 78 "Reserved" 79 "Reserved" 80 "Reserved" 81 "Reserved" 82 "Reserved" 83 "Reserved" 84 "Reserved" 85 "Reserved" 86 "Reserved" 87 "Reserved" 88 "Reserved" 89 "Reserved" 90 "Reserved" 91 "Reserved" 92 "Reserved" 93 "Reserved" 94 "Reserved" 95 "Reserved" 96 "Reserved" 97 "Reserved" 98 "Reserved" 99 "Reserved" 100 "Reserved" 101 "Reserved" 102 "Reserved" 103 "Reserved" 104 "Reserved" 105 "Reserved" 106 "Reserved" 107 "Reserved" 108 "Reserved" 109 "Reserved" 110 "Reserved" 111 "Reserved" 112 "Reserved" 113 "Reserved" 114 "Reserved" 115 "Reserved" 116 "Reserved" 117 "Reserved" 118 "Reserved" 119 "Reserved" 120 "Reserved" 121 "Reserved" 122 "Reserved" 123 "Reserved" 124 "Reserved" 125 "Reserved" 126 "Reserved" 127 "Reserved" 128 "Reserved" 129 "FD_CAN1" 130 "FD_CAN2" 131 "FD_CAN3" 132 "FD_CAN4" 133 "FD_CAN5" 134 "FD_CAN6" 135 "FD_CAN7" 136 "FD_CAN8" 137 "FD_CAN9" 138 "FD_CAN10" 139 "FD_CAN11" 140 "FD_CAN12" 141 "FD_CAN13" 142 "FD_CAN14" 143 "FD_CAN15" 144 "FD_CAN16" 145 "FD_CAN17" 146 "FD_CAN18" 147 "FD_CAN19" 148 "FD_CAN20" 149 "FD_CAN21" 150 "FD_CAN22" 151 "FD_CAN23" 152 "FD_CAN24" 153 "FD_CAN25" 154 "FD_CAN26" 155 "FD_CAN27" 156 "FD_CAN28" 157 "FD_CAN29" 158 "FD_CAN30" 159 "FD_CAN31" 160 "BH-CAN" 161 "BH-CAN1" 162 "BH-CAN2" 163 "C-CAN" 164 "C-CAN1" 165 "Reserved" 166 "Reserved" 167 "Reserved" 168 "Reserved" 169 "Reserved" 170 "Reserved" 171 "Reserved" 172 "Reserved" 173 "Reserved" 174 "Reserved" 175 "Reserved" 176 "Reserved" 177 "Reserved" 178 "Reserved" 179 "Reserved" 180 "Reserved" 181 "Reserved" 182 "Reserved" 183 "Reserved" 184 "Reserved" 185 "Reserved" 186 "Reserved" 187 "Reserved" 188 "Reserved" 189 "Reserved" 190 "Reserved" 191 "Reserved" 192 "Reserved" 193 "Reserved" 194 "Reserved" 195 "Reserved" 196 "Reserved" 197 "Reserved" 198 "Reserved" 199 "Reserved" 200 "Reserved" 201 "Reserved" 202 "Reserved" 203 "Reserved" 204 "Reserved" 205 "Reserved" 206 "Reserved" 207 "Reserved" 208 "Reserved" 209 "Reserved" 210 "Reserved" 211 "Reserved" 212 "Reserved" 213 "Reserved" 214 "Reserved" 215 "Reserved" 216 "Reserved" 217 "Reserved" 218 "Reserved" 219 "Reserved" 220 "Reserved" 221 "Reserved" 222 "Reserved" 223 "Reserved" 224 "Reserved" 225 "Reserved" 226 "Reserved" 227 "Reserved" 228 "Reserved" 229 "Reserved" 230 "Reserved" 231 "Reserved" 232 "Reserved" 233 "Reserved" 234 "Reserved" 235 "Reserved" 236 "Reserved" 237 "Reserved" 238 "Reserved" 239 "Reserved" 240 "Reserved" 241 "Reserved" 242 "Reserved" 243 "Reserved" 244 "Reserved" 245 "Reserved" 246 "Reserved" 247 "Reserved" 248 "Reserved" 249 "Reserved" 250 "Reserved" 251 "Reserved" 252 "Reserved" 253 "Reserved" 254 "Reserved" 255 "Reserved";
VAL_ 2654339072 WakeupSource_FD03_BCM 0 "None" 1 "Ignition_Active" 2 "CmdIgnSts_LK_to_ACC_RUN_START" 3 "HazardSwitch_ON" 4 "DrvDoorAjar" 5 "DrvDoor2Ajar" 6 "PsngrDoorAjar" 7 "LR_DoorAjar" 8 "RR_DoorAjar" 9 "TrunkAjar" 10 "BonnetAjar" 11 "RAPHandle_Req" 12 "MainLightSelector_Req_OFF" 13 "HiBmLvr_Stat_HIBM_FLASH_ON_PSD" 14 "LowBeamSts_SET" 15 "ParkingLightSts_SET" 16 "FlashToPass_SET" 17 "RemStActvSts_Active" 18 "Fuel_Door_Release_Switch" 19 "ENGINE_FD_8_RefuelEvent_Pending" 20 "OHC_1_Front_Int_LG_Sw_1" 21 "HFRM_1_RearKick" 22 "LeakCheckTimerExpired" 23 "Horn_Req_Not Pressed_to_Pressed" 24 "Comfort_Enable_Time_not_0" 25 "CmdIgnSts_ACC_RUN_START" 26 "ENGINE_FD_8_LeakTestSts_1" 27 "Non_Default_Diagnostic_Session" 28 "RL_Lk_Sw_LK_RQ_or_UNLK_RQ" 29 "RR_Lk_Sw_LK_RQ_or_UNLK_RQ" 30 "FD-CAN1" 31 "FD-CAN2" 32 "FD-CAN3" 33 "FD-CAN4" 34 "BH-CAN" 35 "C-CAN1" 36 "EVAP_SWC" 37 "FUEL_DR_REL_SWC" 38 "Other_Software_Factory_Component" 39 "OHC_1_Front_Map_LGT_RT_Sw" 40 "OHC_1_Front_Map_LGT_LT_Sw" 41 "Fog_Lights_Signal " 42 "DOME_ON_OR_DOME_DEFEAT " 43 "Screen_Open_Close_is_pressed" 44 "Diagnostic_Message_Routing_DMR" 45 "Reserved" 46 "Reserved" 47 "Reserved" 48 "Reserved" 49 "Reserved" 50 "Reserved" 51 "Reserved" 52 "Reserved" 53 "Reserved" 54 "Reserved" 55 "Reserved" 56 "Reserved" 57 "Reserved" 58 "Reserved" 59 "Reserved" 60 "Reserved" 61 "Reserved" 62 "Reserved" 63 "Reserved" 64 "Reserved" 65 "Reserved" 66 "Reserved" 67 "Reserved" 68 "Reserved" 69 "Reserved" 70 "Reserved" 71 "Reserved" 72 "Reserved" 73 "Reserved" 74 "Reserved" 75 "Reserved" 76 "Reserved" 77 "Reserved" 78 "Reserved" 79 "Reserved" 80 "Reserved" 81 "Reserved" 82 "Reserved" 83 "Reserved" 84 "Reserved" 85 "Reserved" 86 "Reserved" 87 "Reserved" 88 "Reserved" 89 "Reserved" 90 "Reserved" 91 "Reserved" 92 "Reserved" 93 "Reserved" 94 "Reserved" 95 "Reserved" 96 "Reserved" 97 "Reserved" 98 "Reserved" 99 "Reserved" 100 "Reserved" 101 "Reserved" 102 "Reserved" 103 "Reserved" 104 "Reserved" 105 "Reserved" 106 "Reserved" 107 "Reserved" 108 "Reserved" 109 "Reserved" 110 "Reserved" 111 "Reserved" 112 "Reserved" 113 "Reserved" 114 "Reserved" 115 "Reserved" 116 "Reserved" 117 "Reserved" 118 "Reserved" 119 "Reserved" 120 "Reserved" 121 "Reserved" 122 "Reserved" 123 "Reserved" 124 "Reserved" 125 "Reserved" 126 "Reserved" 127 "Reserved" 128 "Reserved" 129 "FD_CAN1" 130 "FD_CAN2" 131 "FD_CAN3" 132 "FD_CAN4" 133 "FD_CAN5" 134 "FD_CAN6" 135 "FD_CAN7" 136 "FD_CAN8" 137 "FD_CAN9" 138 "FD_CAN10" 139 "FD_CAN11" 140 "FD_CAN12" 141 "FD_CAN13" 142 "FD_CAN14" 143 "FD_CAN15" 144 "FD_CAN16" 145 "FD_CAN17" 146 "FD_CAN18" 147 "FD_CAN19" 148 "FD_CAN20" 149 "FD_CAN21" 150 "FD_CAN22" 151 "FD_CAN23" 152 "FD_CAN24" 153 "FD_CAN25" 154 "FD_CAN26" 155 "FD_CAN27" 156 "FD_CAN28" 157 "FD_CAN29" 158 "FD_CAN30" 159 "FD_CAN31" 160 "BH-CAN" 161 "BH-CAN1" 162 "BH-CAN2" 163 "C-CAN" 164 "C-CAN1" 165 "Reserved" 166 "Reserved" 167 "Reserved" 168 "Reserved" 169 "Reserved" 170 "Reserved" 171 "Reserved" 172 "Reserved" 173 "Reserved" 174 "Reserved" 175 "Reserved" 176 "Reserved" 177 "Reserved" 178 "Reserved" 179 "Reserved" 180 "Reserved" 181 "Reserved" 182 "Reserved" 183 "Reserved" 184 "Reserved" 185 "Reserved" 186 "Reserved" 187 "Reserved" 188 "Reserved" 189 "Reserved" 190 "Reserved" 191 "Reserved" 192 "Reserved" 193 "Reserved" 194 "Reserved" 195 "Reserved" 196 "Reserved" 197 "Reserved" 198 "Reserved" 199 "Reserved" 200 "Reserved" 201 "Reserved" 202 "Reserved" 203 "Reserved" 204 "Reserved" 205 "Reserved" 206 "Reserved" 207 "Reserved" 208 "Reserved" 209 "Reserved" 210 "Reserved" 211 "Reserved" 212 "Reserved" 213 "Reserved" 214 "Reserved" 215 "Reserved" 216 "Reserved" 217 "Reserved" 218 "Reserved" 219 "Reserved" 220 "Reserved" 221 "Reserved" 222 "Reserved" 223 "Reserved" 224 "Reserved" 225 "Reserved" 226 "Reserved" 227 "Reserved" 228 "Reserved" 229 "Reserved" 230 "Reserved" 231 "Reserved" 232 "Reserved" 233 "Reserved" 234 "Reserved" 235 "Reserved" 236 "Reserved" 237 "Reserved" 238 "Reserved" 239 "Reserved" 240 "Reserved" 241 "Reserved" 242 "Reserved" 243 "Reserved" 244 "Reserved" 245 "Reserved" 246 "Reserved" 247 "Reserved" 248 "Reserved" 249 "Reserved" 250 "Reserved" 251 "Reserved" 252 "Reserved" 253 "Reserved" 254 "Reserved" 255 "Reserved";
VAL_ 2654339072 WakeupSource_FD02_BCM 0 "None" 1 "Ignition_Active" 2 "CmdIgnSts_LK_to_ACC_RUN_START" 3 "HazardSwitch_ON" 4 "DrvDoorAjar" 5 "DrvDoor2Ajar" 6 "PsngrDoorAjar" 7 "LR_DoorAjar" 8 "RR_DoorAjar" 9 "TrunkAjar" 10 "BonnetAjar" 11 "RAPHandle_Req" 12 "MainLightSelector_Req_OFF" 13 "HiBmLvr_Stat_HIBM_FLASH_ON_PSD" 14 "LowBeamSts_SET" 15 "ParkingLightSts_SET" 16 "FlashToPass_SET" 17 "RemStActvSts_Active" 18 "Fuel_Door_Release_Switch" 19 "ENGINE_FD_8_RefuelEvent_Pending" 20 "OHC_1_Front_Int_LG_Sw_1" 21 "HFRM_1_RearKick" 22 "LeakCheckTimerExpired" 23 "Horn_Req_Not Pressed_to_Pressed" 24 "Comfort_Enable_Time_not_0" 25 "CmdIgnSts_ACC_RUN_START" 26 "ENGINE_FD_8_LeakTestSts_1" 27 "Non_Default_Diagnostic_Session" 28 "RL_Lk_Sw_LK_RQ_or_UNLK_RQ" 29 "RR_Lk_Sw_LK_RQ_or_UNLK_RQ" 30 "FD-CAN1" 31 "FD-CAN2" 32 "FD-CAN3" 33 "FD-CAN4" 34 "BH-CAN" 35 "C-CAN1" 36 "EVAP_SWC" 37 "FUEL_DR_REL_SWC" 38 "Other_Software_Factory_Component" 39 "OHC_1_Front_Map_LGT_RT_Sw" 40 "OHC_1_Front_Map_LGT_LT_Sw" 41 "Fog_Lights_Signal " 42 "DOME_ON_OR_DOME_DEFEAT " 43 "Screen_Open_Close_is_pressed" 44 "Diagnostic_Message_Routing_DMR" 45 "Reserved" 46 "Reserved" 47 "Reserved" 48 "Reserved" 49 "Reserved" 50 "Reserved" 51 "Reserved" 52 "Reserved" 53 "Reserved" 54 "Reserved" 55 "Reserved" 56 "Reserved" 57 "Reserved" 58 "Reserved" 59 "Reserved" 60 "Reserved" 61 "Reserved" 62 "Reserved" 63 "Reserved" 64 "Reserved" 65 "Reserved" 66 "Reserved" 67 "Reserved" 68 "Reserved" 69 "Reserved" 70 "Reserved" 71 "Reserved" 72 "Reserved" 73 "Reserved" 74 "Reserved" 75 "Reserved" 76 "Reserved" 77 "Reserved" 78 "Reserved" 79 "Reserved" 80 "Reserved" 81 "Reserved" 82 "Reserved" 83 "Reserved" 84 "Reserved" 85 "Reserved" 86 "Reserved" 87 "Reserved" 88 "Reserved" 89 "Reserved" 90 "Reserved" 91 "Reserved" 92 "Reserved" 93 "Reserved" 94 "Reserved" 95 "Reserved" 96 "Reserved" 97 "Reserved" 98 "Reserved" 99 "Reserved" 100 "Reserved" 101 "Reserved" 102 "Reserved" 103 "Reserved" 104 "Reserved" 105 "Reserved" 106 "Reserved" 107 "Reserved" 108 "Reserved" 109 "Reserved" 110 "Reserved" 111 "Reserved" 112 "Reserved" 113 "Reserved" 114 "Reserved" 115 "Reserved" 116 "Reserved" 117 "Reserved" 118 "Reserved" 119 "Reserved" 120 "Reserved" 121 "Reserved" 122 "Reserved" 123 "Reserved" 124 "Reserved" 125 "Reserved" 126 "Reserved" 127 "Reserved" 128 "Reserved" 129 "FD_CAN1" 130 "FD_CAN2" 131 "FD_CAN3" 132 "FD_CAN4" 133 "FD_CAN5" 134 "FD_CAN6" 135 "FD_CAN7" 136 "FD_CAN8" 137 "FD_CAN9" 138 "FD_CAN10" 139 "FD_CAN11" 140 "FD_CAN12" 141 "FD_CAN13" 142 "FD_CAN14" 143 "FD_CAN15" 144 "FD_CAN16" 145 "FD_CAN17" 146 "FD_CAN18" 147 "FD_CAN19" 148 "FD_CAN20" 149 "FD_CAN21" 150 "FD_CAN22" 151 "FD_CAN23" 152 "FD_CAN24" 153 "FD_CAN25" 154 "FD_CAN26" 155 "FD_CAN27" 156 "FD_CAN28" 157 "FD_CAN29" 158 "FD_CAN30" 159 "FD_CAN31" 160 "BH-CAN" 161 "BH-CAN1" 162 "BH-CAN2" 163 "C-CAN" 164 "C-CAN1" 165 "Reserved" 166 "Reserved" 167 "Reserved" 168 "Reserved" 169 "Reserved" 170 "Reserved" 171 "Reserved" 172 "Reserved" 173 "Reserved" 174 "Reserved" 175 "Reserved" 176 "Reserved" 177 "Reserved" 178 "Reserved" 179 "Reserved" 180 "Reserved" 181 "Reserved" 182 "Reserved" 183 "Reserved" 184 "Reserved" 185 "Reserved" 186 "Reserved" 187 "Reserved" 188 "Reserved" 189 "Reserved" 190 "Reserved" 191 "Reserved" 192 "Reserved" 193 "Reserved" 194 "Reserved" 195 "Reserved" 196 "Reserved" 197 "Reserved" 198 "Reserved" 199 "Reserved" 200 "Reserved" 201 "Reserved" 202 "Reserved" 203 "Reserved" 204 "Reserved" 205 "Reserved" 206 "Reserved" 207 "Reserved" 208 "Reserved" 209 "Reserved" 210 "Reserved" 211 "Reserved" 212 "Reserved" 213 "Reserved" 214 "Reserved" 215 "Reserved" 216 "Reserved" 217 "Reserved" 218 "Reserved" 219 "Reserved" 220 "Reserved" 221 "Reserved" 222 "Reserved" 223 "Reserved" 224 "Reserved" 225 "Reserved" 226 "Reserved" 227 "Reserved" 228 "Reserved" 229 "Reserved" 230 "Reserved" 231 "Reserved" 232 "Reserved" 233 "Reserved" 234 "Reserved" 235 "Reserved" 236 "Reserved" 237 "Reserved" 238 "Reserved" 239 "Reserved" 240 "Reserved" 241 "Reserved" 242 "Reserved" 243 "Reserved" 244 "Reserved" 245 "Reserved" 246 "Reserved" 247 "Reserved" 248 "Reserved" 249 "Reserved" 250 "Reserved" 251 "Reserved" 252 "Reserved" 253 "Reserved" 254 "Reserved" 255 "Reserved";
VAL_ 2654339072 WakeupSource_FD01_BCM 0 "None" 1 "Ignition_Active" 2 "CmdIgnSts_LK_to_ACC_RUN_START" 3 "HazardSwitch_ON" 4 "DrvDoorAjar" 5 "DrvDoor2Ajar" 6 "PsngrDoorAjar" 7 "LR_DoorAjar" 8 "RR_DoorAjar" 9 "TrunkAjar" 10 "BonnetAjar" 11 "RAPHandle_Req" 12 "MainLightSelector_Req_OFF" 13 "HiBmLvr_Stat_HIBM_FLASH_ON_PSD" 14 "LowBeamSts_SET" 15 "ParkingLightSts_SET" 16 "FlashToPass_SET" 17 "RemStActvSts_Active" 18 "Fuel_Door_Release_Switch" 19 "ENGINE_FD_8_RefuelEvent_Pending" 20 "OHC_1_Front_Int_LG_Sw_1" 21 "HFRM_1_RearKick" 22 "LeakCheckTimerExpired" 23 "Horn_Req_Not Pressed_to_Pressed" 24 "Comfort_Enable_Time_not_0" 25 "CmdIgnSts_ACC_RUN_START" 26 "ENGINE_FD_8_LeakTestSts_1" 27 "Non_Default_Diagnostic_Session" 28 "RL_Lk_Sw_LK_RQ_or_UNLK_RQ" 29 "RR_Lk_Sw_LK_RQ_or_UNLK_RQ" 30 "FD-CAN1" 31 "FD-CAN2" 32 "FD-CAN3" 33 "FD-CAN4" 34 "BH-CAN" 35 "C-CAN1" 36 "EVAP_SWC" 37 "FUEL_DR_REL_SWC" 38 "Other_Software_Factory_Component" 39 "OHC_1_Front_Map_LGT_RT_Sw" 40 "OHC_1_Front_Map_LGT_LT_Sw" 41 "Fog_Lights_Signal " 42 "DOME_ON_OR_DOME_DEFEAT " 43 "Screen_Open_Close_is_pressed" 44 "Diagnostic_Message_Routing_DMR" 45 "Reserved" 46 "Reserved" 47 "Reserved" 48 "Reserved" 49 "Reserved" 50 "Reserved" 51 "Reserved" 52 "Reserved" 53 "Reserved" 54 "Reserved" 55 "Reserved" 56 "Reserved" 57 "Reserved" 58 "Reserved" 59 "Reserved" 60 "Reserved" 61 "Reserved" 62 "Reserved" 63 "Reserved" 64 "Reserved" 65 "Reserved" 66 "Reserved" 67 "Reserved" 68 "Reserved" 69 "Reserved" 70 "Reserved" 71 "Reserved" 72 "Reserved" 73 "Reserved" 74 "Reserved" 75 "Reserved" 76 "Reserved" 77 "Reserved" 78 "Reserved" 79 "Reserved" 80 "Reserved" 81 "Reserved" 82 "Reserved" 83 "Reserved" 84 "Reserved" 85 "Reserved" 86 "Reserved" 87 "Reserved" 88 "Reserved" 89 "Reserved" 90 "Reserved" 91 "Reserved" 92 "Reserved" 93 "Reserved" 94 "Reserved" 95 "Reserved" 96 "Reserved" 97 "Reserved" 98 "Reserved" 99 "Reserved" 100 "Reserved" 101 "Reserved" 102 "Reserved" 103 "Reserved" 104 "Reserved" 105 "Reserved" 106 "Reserved" 107 "Reserved" 108 "Reserved" 109 "Reserved" 110 "Reserved" 111 "Reserved" 112 "Reserved" 113 "Reserved" 114 "Reserved" 115 "Reserved" 116 "Reserved" 117 "Reserved" 118 "Reserved" 119 "Reserved" 120 "Reserved" 121 "Reserved" 122 "Reserved" 123 "Reserved" 124 "Reserved" 125 "Reserved" 126 "Reserved" 127 "Reserved" 128 "Reserved" 129 "FD_CAN1" 130 "FD_CAN2" 131 "FD_CAN3" 132 "FD_CAN4" 133 "FD_CAN5" 134 "FD_CAN6" 135 "FD_CAN7" 136 "FD_CAN8" 137 "FD_CAN9" 138 "FD_CAN10" 139 "FD_CAN11" 140 "FD_CAN12" 141 "FD_CAN13" 142 "FD_CAN14" 143 "FD_CAN15" 144 "FD_CAN16" 145 "FD_CAN17" 146 "FD_CAN18" 147 "FD_CAN19" 148 "FD_CAN20" 149 "FD_CAN21" 150 "FD_CAN22" 151 "FD_CAN23" 152 "FD_CAN24" 153 "FD_CAN25" 154 "FD_CAN26" 155 "FD_CAN27" 156 "FD_CAN28" 157 "FD_CAN29" 158 "FD_CAN30" 159 "FD_CAN31" 160 "BH-CAN" 161 "BH-CAN1" 162 "BH-CAN2" 163 "C-CAN" 164 "C-CAN1" 165 "Reserved" 166 "Reserved" 167 "Reserved" 168 "Reserved" 169 "Reserved" 170 "Reserved" 171 "Reserved" 172 "Reserved" 173 "Reserved" 174 "Reserved" 175 "Reserved" 176 "Reserved" 177 "Reserved" 178 "Reserved" 179 "Reserved" 180 "Reserved" 181 "Reserved" 182 "Reserved" 183 "Reserved" 184 "Reserved" 185 "Reserved" 186 "Reserved" 187 "Reserved" 188 "Reserved" 189 "Reserved" 190 "Reserved" 191 "Reserved" 192 "Reserved" 193 "Reserved" 194 "Reserved" 195 "Reserved" 196 "Reserved" 197 "Reserved" 198 "Reserved" 199 "Reserved" 200 "Reserved" 201 "Reserved" 202 "Reserved" 203 "Reserved" 204 "Reserved" 205 "Reserved" 206 "Reserved" 207 "Reserved" 208 "Reserved" 209 "Reserved" 210 "Reserved" 211 "Reserved" 212 "Reserved" 213 "Reserved" 214 "Reserved" 215 "Reserved" 216 "Reserved" 217 "Reserved" 218 "Reserved" 219 "Reserved" 220 "Reserved" 221 "Reserved" 222 "Reserved" 223 "Reserved" 224 "Reserved" 225 "Reserved" 226 "Reserved" 227 "Reserved" 228 "Reserved" 229 "Reserved" 230 "Reserved" 231 "Reserved" 232 "Reserved" 233 "Reserved" 234 "Reserved" 235 "Reserved" 236 "Reserved" 237 "Reserved" 238 "Reserved" 239 "Reserved" 240 "Reserved" 241 "Reserved" 242 "Reserved" 243 "Reserved" 244 "Reserved" 245 "Reserved" 246 "Reserved" 247 "Reserved" 248 "Reserved" 249 "Reserved" 250 "Reserved" 251 "Reserved" 252 "Reserved" 253 "Reserved" 254 "WUSource_Not_Listed" 255 "Reserved";
VAL_ 2654339072 PreviousCanNMState_FD04_BCM 0 "Uninitialized State" 1 "Bus-Sleep State" 2 "Prepare-Bus State" 3 "Ready-Sleep State" 4 "Normal Operation State" 5 "Repeat Message State" 6 "Synchronize State" 7 "Offline State";
VAL_ 2654339072 PreviousCanNMState_FD03_BCM 0 "Uninitialized State" 1 "Bus-Sleep State" 2 "Prepare-Bus State" 3 "Ready-Sleep State" 4 "Normal Operation State" 5 "Repeat Message State" 6 "Synchronize State" 7 "Offline State";
VAL_ 2654339072 PreviousCanNMState_FD02_BCM 0 "Uninitialized State" 1 "Bus-Sleep State" 2 "Prepare-Bus State" 3 "Ready-Sleep State" 4 "Normal Operation State" 5 "Repeat Message State" 6 "Synchronize State" 7 "Offline State";
VAL_ 1443 Act_Lane_Mgt_Strength 0 "Low" 1 "Medium" 2 "High";
VAL_ 1443 Act_Lane_Mgt 0 "Vib_Only" 1 "Steer_Asst_Only" 2 "Vib_Steer_Asst";
VAL_ 1443 StaticGrid 0 "Static Gridlines OFF" 1 "Static Gridlines ON";
VAL_ 1443 PwrLev 0 "Level1" 1 "Level2" 2 "Level3" 3 "Level4" 4 "Level5";
VAL_ 1443 Adaptive_Front_Lighting 0 "Disable" 1 "Enable";
VAL_ 1443 FOA_AppAlert_Disable_UserReq 0 "Not_Active" 1 "Active";
VAL_ 1443 Spaak 0 "Off" 1 "On";
VAL_ 1443 Trailer_detection_blind_spot 0 "Auto" 1 "Max";
VAL_ 1443 SOC_Max_Lev 0 "Level1" 1 "Level2";
VAL_ 2654339072 StayActiveSource_FD04_BCM 0 "None" 1 "Ignition_Active" 2 "CmdIgnSts_LK_to_ACC_RUN_START" 4 "HazardSwitch_ON" 8 "DrvDoorAjar" 16 "DrvDoor2Ajar" 32 "PsngrDoorAjar" 64 "LR_DoorAjar" 128 "RR_DoorAjar" 256 "TrunkAjar" 512 "BonnetAjar" 1024 "RAPHandle_Req" 2048 "MainLightSelector_Req_OFF" 4096 "HiBmLvr_Stat_HIBM_FLASH_ON_PSD" 8192 "LowBeamSts_SET" 16384 "ParkingLightSts_SET" 32768 "FlashToPass_SET" 65536 "RemStActvSts_Active" 131072 "Fuel_Door_Release_Switch" 262144 "ENGINE_FD_8_RefuelEvent_Pending" 524288 "OHC_1_Front_Int_LG_Sw_1" 1048576 "HFRM_1_RearKick" 2097152 "LeakCheckTimerExpired" 4194304 "Horn_Req_Not_Pressed_to_Pressed" 8388608 "Comfort_Enable_Time_not_0" 16777216 "CmdIgnSts_ACC_RUN_START" 33554432 "ENGINE_FD_8_LeakTestSts_1" 67108864 "Non_Default_Diagnostic_Session" 134217728 "RL_Lk_Sw_LK_RQ_or_UNLK_RQ" 268435456 "RR_Lk_Sw_LK_RQ_or_UNLK_RQ" 536870912 "FD_CAN1" 1073741824 "FD_CAN2";
VAL_ 2654339072 StayActiveSource_FD03_BCM 0 "None" 1 "Ignition_Active" 2 "CmdIgnSts_LK_to_ACC_RUN_START" 4 "HazardSwitch_ON" 8 "DrvDoorAjar" 16 "DrvDoor2Ajar" 32 "PsngrDoorAjar" 64 "LR_DoorAjar" 128 "RR_DoorAjar" 256 "TrunkAjar" 512 "BonnetAjar" 1024 "RAPHandle_Req" 2048 "MainLightSelector_Req_OFF" 4096 "HiBmLvr_Stat_HIBM_FLASH_ON_PSD" 8192 "LowBeamSts_SET" 16384 "ParkingLightSts_SET" 32768 "FlashToPass_SET" 65536 "RemStActvSts_Active" 131072 "Fuel_Door_Release_Switch" 262144 "ENGINE_FD_8_RefuelEvent_Pending" 524288 "OHC_1_Front_Int_LG_Sw_1" 1048576 "HFRM_1_RearKick" 2097152 "LeakCheckTimerExpired" 4194304 "Horn_Req_Not_Pressed_to_Pressed" 8388608 "Comfort_Enable_Time_not_0" 16777216 "CmdIgnSts_ACC_RUN_START" 33554432 "ENGINE_FD_8_LeakTestSts_1" 67108864 "Non_Default_Diagnostic_Session" 134217728 "RL_Lk_Sw_LK_RQ_or_UNLK_RQ" 268435456 "RR_Lk_Sw_LK_RQ_or_UNLK_RQ" 536870912 "FD_CAN1" 1073741824 "FD_CAN2";
VAL_ 2654339072 StayActiveSource_FD02_BCM 0 "None" 1 "Ignition_Active" 2 "CmdIgnSts_LK_to_ACC_RUN_START" 4 "HazardSwitch_ON" 8 "DrvDoorAjar" 16 "DrvDoor2Ajar" 32 "PsngrDoorAjar" 64 "LR_DoorAjar" 128 "RR_DoorAjar" 256 "TrunkAjar" 512 "BonnetAjar" 1024 "RAPHandle_Req" 2048 "MainLightSelector_Req_OFF" 4096 "HiBmLvr_Stat_HIBM_FLASH_ON_PSD" 8192 "LowBeamSts_SET" 16384 "ParkingLightSts_SET" 32768 "FlashToPass_SET" 65536 "RemStActvSts_Active" 131072 "Fuel_Door_Release_Switch" 262144 "ENGINE_FD_8_RefuelEvent_Pending" 524288 "OHC_1_Front_Int_LG_Sw_1" 1048576 "HFRM_1_RearKick" 2097152 "LeakCheckTimerExpired" 4194304 "Horn_Req_Not_Pressed_to_Pressed" 8388608 "Comfort_Enable_Time_not_0" 16777216 "CmdIgnSts_ACC_RUN_START" 33554432 "ENGINE_FD_8_LeakTestSts_1" 67108864 "Non_Default_Diagnostic_Session" 134217728 "RL_Lk_Sw_LK_RQ_or_UNLK_RQ" 268435456 "RR_Lk_Sw_LK_RQ_or_UNLK_RQ" 536870912 "FD_CAN1" 1073741824 "FD_CAN2";
VAL_ 2654339072 StayActiveSource_FD01_BCM 0 "None" 1 "Ignition_Active" 2 "CmdIgnSts_LK_to_ACC_RUN_START" 4 "HazardSwitch_ON" 8 "DrvDoorAjar" 16 "DrvDoor2Ajar" 32 "PsngrDoorAjar" 64 "LR_DoorAjar" 128 "RR_DoorAjar" 256 "TrunkAjar" 512 "BonnetAjar" 1024 "RAPHandle_Req" 2048 "MainLightSelector_Req_OFF" 4096 "HiBmLvr_Stat_HIBM_FLASH_ON_PSD" 8192 "LowBeamSts_SET" 16384 "ParkingLightSts_SET" 32768 "FlashToPass_SET" 65536 "RemStActvSts_Active" 131072 "Fuel_Door_Release_Switch" 262144 "ENGINE_FD_8_RefuelEvent_Pending" 524288 "OHC_1_Front_Int_LG_Sw_1" 1048576 "HFRM_1_RearKick" 2097152 "LeakCheckTimerExpired" 4194304 "Horn_Req_Not_Pressed_to_Pressed" 8388608 "Comfort_Enable_Time_not_0" 16777216 "CmdIgnSts_ACC_RUN_START" 33554432 "ENGINE_FD_8_LeakTestSts_1" 67108864 "Non_Default_Diagnostic_Session" 134217728 "RL_Lk_Sw_LK_RQ_or_UNLK_RQ" 268435456 "RR_Lk_Sw_LK_RQ_or_UNLK_RQ" 536870912 "FD_CAN1" 1073741824 "FD_CAN2";
VAL_ 2654339184 StayActiveSource_FD11_SGW 0 "CANNM_Ready_Sleep" 1 "IGN_ON" 2 "NonDefault_Diag" 4 "ING_OFF_NormSt_RptSt" 1073741824 "SASource_Not_Listed";
VAL_ 2654339184 StayActiveSource_FD08_SGW 0 "CANNM_Ready_Sleep" 1 "IGN_ON" 2 "NonDefault_Diag" 4 "ING_OFF_NormSt_RptSt" 1073741824 "SASource_Not_Listed";
VAL_ 2654339184 StayActiveSource_FD03_SGW 0 "CANNM_Ready_Sleep" 1 "IGN_ON" 2 "NonDefault_Diag" 4 "ING_OFF_NormSt_RptSt" 1073741824 "SASource_Not_Listed";
VAL_ 2654339184 StayActiveSource_FD02_SGW 0 "CANNM_Ready_Sleep" 1 "IGN_ON" 2 "NonDefault_Diag" 4 "ING_OFF_NormSt_RptSt" 1073741824 "SASource_Not_Listed";
VAL_ 2654339184 StayActiveSource_FD01_SGW 0 "CANNM_Ready_Sleep" 1 "IGN_ON" 2 "NonDefault_Diag" 4 "ING_OFF_NormSt_RptSt" 1073741824 "SASource_Not_Listed";
SIG_GROUP_ 1443 IPC_VEHICLE_SETUP_Pkt 1 : FlashLightWLock Windows_With_Fob TyrePress_Unit Traffic_Sign_Warn Traffic_Sign_Info Torque_Unit Tire_Fill_Alert Tilt_Mirr_Rev Temp_Unit TelematicSetupACK SVC_Guidelines SVC_Delay Steer_Feel SpeedLockDoorEnable Speed_Unit SoundHornRemoteStart SoundHornLock Sdw RKEMemoryLinkEnable RemStNrmlStEnbl RemoteDoorUnlock Rear_Brk_Asst Rdy_To_Drive RainSensorLevel PLGAlert PhoneRepetition Ped_EM_Brk_Warn_Act PassiveEntry PamChimeVolumeRear PamChimeVolumeFront Night_Vision New_Spd_Zone_Ind NavRepetition LDW_Sensibility LDW_Intensity LanguageSelection IPCProgrammed Intelligent_Speed Illuminated_Approach HP_Unit HourMode Hill_Start_Assist HeadLightWipers HeadlightsOffDelay Handsfree_Liftgate GreetingLightsEnable Fwrd_Cam_Guidelines FSFCWPlusSetting FSFCWPlusActivationMode EPB_MaintenanceMode Eng_Off_Pwr_Delay Easy_Exit_D DynamicGrid DRLEnable Dist_Unit CorneringEnable Consum_Unit BSDEnable Backup_Cam_Delay AutoUnlockDoorExit AutoParkBrake AutoHighBeamEnable Auto_Fold_Mirr AmbientLightingLevel Proximity_WU Drowsy_Driver_Alert Active_Park_Prox_Chime Active_Park_Mode MessageCounter_IPCVS1 CRC_IPCVS1 Act_Lane_Mgt_Strength Act_Lane_Mgt StaticGrid PwrLev Adaptive_Front_Lighting FOA_AppAlert_Disable_UserReq Spaak Trailer_detection_blind_spot SOC_Max_Lev;

VERSION ""

NS_ :

BS_:

BU_: SGW RFHM MPAD IPC GNMM EVCU2 ESL ECM DTCM DMSM BSM BCM AGSM ADCAM

BO_ 2654339136 PDC_INFO_FD_EVCU2: 64 EVCU2
 SG_ WakeupSource_FD03_EVCU2 : 335|8@0+ (1,0) [0|255] "" SGW
 SG_ StayActiveSource_FD03_EVCU2 : 31|64@0+ (1,0) [0|0] "" SGW
 SG_ PreviousCanNMState_FD03_EVCU2 : 343|4@0+ (1,0) [0|15] "" SGW
 SG_ GenericFailSts_FD03_EVCU2 : 1|1@0+ (1,0) [0|1] "" SGW,BCM
 SG_ EOL_FD03_EVCU2 : 0|1@0+ (1,0) [0|1] "-"  SGW,BCM
 SG_ DES_FD03_EVCU2 : 23|2@0+ (1,0) [0|3] "" SGW
 SG_ CurrentFailSts_FD03_EVCU2 : 7|1@0+ (1,0) [0|1] "" SGW,BCM
 SG_ CurrentCanNMState_FD03_EVCU2 : 339|4@0+ (1,0) [0|15] "" SGW
 SG_ WakeupSource_FD11_EVCU2 : 175|8@0+ (1,0) [0|255] "" SGW
 SG_ StayActiveSource_FD11_EVCU2 : 271|64@0+ (1,0) [0|18446744073709551615] "" SGW
 SG_ PreviousCanNMState_FD11_EVCU2 : 11|4@0+ (1,0) [0|15] "" SGW
 SG_ GenericFailSts_FD11_EVCU2 : 5|1@0+ (1,0) [0|1] "" SGW
 SG_ EOL_FD11_EVCU2 : 20|1@0+ (1,0) [0|1] "-"  SGW
 SG_ DES_FD11_EVCU2 : 4|2@0+ (1,0) [0|3] "" SGW
 SG_ CurrentFailSts_FD11_EVCU2 : 2|1@0+ (1,0) [0|1] "" SGW
 SG_ CurrentCanNMState_FD11_EVCU2 : 15|4@0+ (1,0) [0|15] "" SGW
 SG_ WakeupSource_FD16_EVCU2 : 199|8@0+ (1,0) [0|255] "" SGW
 SG_ WakeupSource_FD05_EVCU2 : 95|8@0+ (1,0) [0|255] "" SGW
 SG_ StayActiveSource_FD16_EVCU2 : 207|64@0+ (1,0) [0|0] "" SGW
 SG_ StayActiveSource_FD05_EVCU2 : 111|64@0+ (1,0) [0|0] "" SGW
 SG_ PreviousCanNMState_FD16_EVCU2 : 191|4@0+ (1,0) [0|15] "" SGW
 SG_ PreviousCanNMState_FD05_EVCU2 : 103|4@0+ (1,0) [0|15] "" SGW
 SG_ GenericFailSts_FD16_EVCU2 : 184|1@0+ (1,0) [0|1] "" SGW
 SG_ GenericFailSts_FD05_EVCU2 : 180|1@0+ (1,0) [0|1] "" SGW
 SG_ EOL_FD16_EVCU2 : 19|1@0+ (1,0) [0|1] "-"  SGW
 SG_ EOL_FD05_EVCU2 : 21|1@0+ (1,0) [0|1] "-"  SGW
 SG_ DES_FD16_EVCU2 : 187|2@0+ (1,0) [0|1] "" SGW
 SG_ DES_FD05_EVCU2 : 183|2@0+ (1,0) [0|1] "" SGW
 SG_ CurrentFailSts_FD16_EVCU2 : 185|1@0+ (1,0) [0|1] "" SGW
 SG_ CurrentFailSts_FD05_EVCU2 : 181|1@0+ (1,0) [0|1] "" SGW
 SG_ CurrentCanNMState_FD16_EVCU2 : 179|4@0+ (1,0) [0|15] "" SGW
 SG_ CurrentCanNMState_FD05_EVCU2 : 99|4@0+ (1,0) [0|15] "" SGW

BO_ 2654339073 PDC_INFO_FD_ECM: 48 ECM
 SG_ GenericFailSts_FD03_ECM : 5|1@0+ (1,0) [0|1] "" SGW,BCM
 SG_ EOL_FD03_ECM : 7|1@0+ (1,0) [0|1] "-"  SGW,BCM
 SG_ DES_FD03_ECM : 4|2@0+ (1,0) [0|1] "" SGW
 SG_ CurrentFailSts_FD03_ECM : 6|1@0+ (1,0) [0|1] "" SGW,BCM
 SG_ WakeupSource_FD03_ECM : 23|8@0+ (1,0) [0|255] "" SGW
 SG_ PreviousCanNMState_FD03_ECM : 11|4@0+ (1,0) [0|15] "" SGW
 SG_ CurrentCanNMState_FD03_ECM : 15|4@0+ (1,0) [0|15] "" SGW
 SG_ StayActiveSource_FD03_ECM : 31|64@0+ (1,0) [0|18446744073709600000] "" SGW
 SG_ WakeupSource_FD05_ECM : 95|8@0+ (1,0) [0|255] "" SGW
 SG_ StayActiveSource_FD05_ECM : 111|64@0+ (1,0) [0|0] "" SGW
 SG_ PreviousCanNMState_FD05_ECM : 103|4@0+ (1,0) [0|15] "" SGW
 SG_ GenericFailSts_FD05_ECM : 180|1@0+ (1,0) [0|1] "" SGW
 SG_ EOL_FD05_ECM : 2|1@0+ (1,0) [0|1] "-"  SGW
 SG_ DES_FD05_ECM : 183|2@0+ (1,0) [0|1] "" SGW
 SG_ CurrentFailSts_FD05_ECM : 181|1@0+ (1,0) [0|1] "" SGW
 SG_ CurrentCanNMState_FD05_ECM : 99|4@0+ (1,0) [0|15] "" SGW
 SG_ WakeupSource_FD11_ECM : 343|8@0+ (1,0) [0|255] "" SGW
 SG_ StayActiveSource_FD11_ECM : 279|64@0+ (1,0) [0|0] "" SGW
 SG_ PreviousCanNMState_FD11_ECM : 271|4@0+ (1,0) [0|15] "" SGW
 SG_ GenericFailSts_FD11_ECM : 174|1@0+ (1,0) [0|1] "" SGW
 SG_ EOL_FD11_ECM : 0|1@0+ (1,0) [0|1] "-"  SGW
 SG_ DES_FD11_ECM : 173|2@0+ (1,0) [0|1] "" SGW
 SG_ CurrentFailSts_FD11_ECM : 175|1@0+ (1,0) [0|1] "" SGW
 SG_ CurrentCanNMState_FD11_ECM : 171|4@0+ (1,0) [0|15] "" SGW

BO_ 2654339142 PDC_INFO_FD_BPCM: 32 EVCU2
 SG_ GenericFailSts_FD11_BPCM : 5|1@0+ (1,0) [0|1] "" Vector__XXX
 SG_ EOL_FD11_BPCM : 7|1@0+ (1,0) [0|1] "-"  Vector__XXX
 SG_ WakeupSource_FD11_BPCM : 23|8@0+ (1,0) [0|255] "" Vector__XXX
 SG_ PreviousCanNMState_FD11_BPCM : 11|4@0+ (1,0) [0|15] "" Vector__XXX
 SG_ DES_FD11_BPCM : 4|2@0+ (1,0) [0|3] "" Vector__XXX
 SG_ CurrentCanNMState_FD11_BPCM : 15|4@0+ (1,0) [0|15] "" Vector__XXX
 SG_ CurrentFailSts_FD11_BPCM : 2|1@0+ (1,0) [0|1] "" Vector__XXX
 SG_ WakeupSource_FD05_BPCM : 175|8@0+ (1,0) [0|255] "" Vector__XXX
 SG_ StayActiveSource_FD05_BPCM : 99|64@0+ (1,0) [0|0] "" Vector__XXX
 SG_ PreviousCanNMState_FD05_BPCM : 103|4@0+ (1,0) [0|15] "" Vector__XXX
 SG_ GenericFailSts_FD05_BPCM : 89|1@0+ (1,0) [0|1] "" BCM
 SG_ EOL_FD05_BPCM : 1|1@0+ (1,0) [0|1] "-"  BCM
 SG_ DES_FD05_BPCM : 91|2@0+ (1,0) [0|3] "" Vector__XXX
 SG_ CurrentFailSts_FD05_BPCM : 6|1@0+ (1,0) [0|1] "" BCM
 SG_ CurrentCanNMState_FD05_BPCM : 95|4@0+ (1,0) [0|15] "" Vector__XXX
 SG_ StayActiveSource_FD11_BPCM : 31|64@0+ (1,0) [0|0] "" Vector__XXX

BO_ 2654339094 PDC_INFO_FD_AGSM: 32 AGSM
 SG_ GenericFailSts_FD03_AGSM : 5|1@0+ (1,0) [0|1] "" SGW,BCM
 SG_ EOL_FD03_AGSM : 7|1@0+ (1,0) [0|1] "-"  SGW,BCM
 SG_ CurrentFailSts_FD03_AGSM : 6|1@0+ (1,0) [0|1] "" SGW,BCM
 SG_ WakeupSource_FD03_AGSM : 23|8@0+ (1,0) [0|255] "" SGW
 SG_ PreviousCanNMState_FD03_AGSM : 11|4@0+ (1,0) [0|15] "" SGW
 SG_ DES_FD03_AGSM : 4|2@0+ (1,0) [0|3] "" SGW
 SG_ CurrentCanNMState_FD03_AGSM : 15|4@0+ (1,0) [0|15] "" SGW
 SG_ StayActiveSource_FD03_AGSM : 31|64@0+ (1,0) [0|0] "" SGW
 SG_ WakeupSource_FD16_AGSM : 95|8@0+ (1,0) [0|255] "" SGW
 SG_ StayActiveSource_FD16_AGSM : 111|64@0+ (1,0) [0|0] "" SGW
 SG_ PreviousCanNMState_FD16_AGSM : 103|4@0+ (1,0) [0|15] "" SGW
 SG_ GenericFailSts_FD16_AGSM : 180|1@0+ (1,0) [0|1] "" SGW
 SG_ EOL_FD16_AGSM : 2|1@0+ (1,0) [0|1] "-"  SGW
 SG_ DES_FD16_AGSM : 183|2@0+ (1,0) [0|3] "" SGW
 SG_ CurrentFailSts_FD16_AGSM : 181|1@0+ (1,0) [0|1] "" SGW
 SG_ CurrentCanNMState_FD16_AGSM : 99|4@0+ (1,0) [0|15] "" SGW
 SG_ WakeupSource_FD11_AGSM : 175|8@0+ (1,0) [0|255] "" SGW
 SG_ StayActiveSource_FD11_AGSM : 199|64@0+ (1,0) [0|0] "" SGW
 SG_ PreviousCanNMState_FD11_AGSM : 191|4@0+ (1,0) [0|15] "" SGW
 SG_ GenericFailSts_FD11_AGSM : 187|1@0+ (1,0) [0|1] "" SGW
 SG_ EOL_FD11_AGSM : 185|1@0+ (1,0) [0|1] "-"  SGW
 SG_ DES_FD11_AGSM : 1|2@0+ (1,0) [0|3] "" SGW
 SG_ CurrentFailSts_FD11_AGSM : 186|1@0+ (1,0) [0|1] "" SGW
 SG_ CurrentCanNMState_FD11_AGSM : 179|4@0+ (1,0) [0|15] "" SGW

BO_ 263 PT_SYSTEM_FD_1: 64 EVCU2
 SG_ PowertrainPrplsnActv_PT : 146|1@0+ (1,0) [0|1] "" ADCAM,MPAD,SGW,BCM,BSM,IPC,RFHM,ECM
 SG_ GearEngagedForDisplay_PT : 12|5@0+ (1,0) [0|31] "" ADCAM,MPAD,GNMM,SGW,AGSM,BCM,BSM,IPC,RFHM,ECM,DTCM
 SG_ GearEngaged_PT : 132|4@0+ (1,0) [0|15] "" ADCAM,MPAD,DMSM,SGW,BCM,BSM,IPC,RFHM,ECM,DTCM
 SG_ DriveReady_PT : 166|1@0+ (1,0) [0|1] "" BCM,BSM,IPC
 SG_ VehSpd_Overridden_PT : 84|3@0+ (1,0) [0|7] "" IPC
 SG_ Vehicle_Hold_Rq_PT : 158|1@0+ (1,0) [0|1] "" Vector__XXX
 SG_ TurtleModeSts_PT : 98|3@0+ (1,0) [0|7] "" SGW,BCM,IPC
 SG_ TransmissionFailSts_PT : 152|1@0+ (1,0) [0|1] "" SGW,AGSM,BCM,BSM,ECM
 SG_ TerrainModeStat_PT : 119|5@0+ (1,0) [0|31] "" ADCAM,MPAD,SGW,BCM,BSM,IPC,ECM,DTCM
 SG_ TargetGear_PT : 55|4@0+ (1,0) [0|15] "" MPAD,SGW,BCM,BSM,IPC,ECM,DTCM
 SG_ SpeedLimitSts_PT : 140|3@0+ (1,0) [0|7] "" ADCAM,MPAD,BCM,IPC
 SG_ ShiftLeverPosition_PT : 51|4@0+ (1,0) [0|15] "" ADCAM,MPAD,SGW,AGSM,BCM,BSM,IPC,DTCM
 SG_ ShiftLeverLockReq_PT : 155|1@0+ (1,0) [0|1] "" AGSM
 SG_ R_SHFT_LOCK_PT : 154|1@0+ (1,0) [0|1] "" AGSM
 SG_ PdlPosActual_PT : 39|8@0+ (0.4,0) [0|102] "%"  ADCAM,MPAD,BCM,BSM
 SG_ ParkingSts_PT : 164|1@0+ (1,0) [0|1] "" BCM
 SG_ ParkingFailSts_PT : 165|1@0+ (1,0) [0|1] "" BCM
 SG_ MessageCounter_PT_SYSTEM_FD_1 : 435|4@0+ (1,0) [0|15] "-"  ADCAM,MPAD,GNMM,SGW,AGSM,BSM,IPC
 SG_ ISASts_PT : 149|1@0+ (1,0) [0|1] "" IPC
 SG_ HAS_SoH_PT : 128|1@0+ (1,0) [0|1] "" MPAD,BCM
 SG_ GearIndicationSts_PT : 153|1@0+ (1,0) [0|1] "" AGSM,BSM,IPC
 SG_ GasPedalPositionFailSts_PT : 145|1@0+ (1,0) [0|1] "" ADCAM,MPAD,BCM,BSM,DTCM
 SG_ GasPedalPosition_PT : 31|8@0+ (0.392,0) [0|99.96] "%"  MPAD,BCM,BSM,DTCM
 SG_ ESS_RqShftPark_PT : 144|1@0+ (1,0) [0|1] "" BCM
 SG_ DrvAway_Inhibit_PT : 157|1@0+ (1,0) [0|1] "" IPC
 SG_ DrvAway_Alert_PT : 156|1@0+ (1,0) [0|1] "" BCM,IPC
 SG_ DriverPowerReq_PT : 127|11@0+ (1,0) [0|2047] "kW"  Vector__XXX
 SG_ CruiseControlSts_PT : 148|1@0+ (1,0) [0|1] "" SGW
 SG_ CruiseControlLampSts_PT : 147|1@0+ (1,0) [0|1] "" SGW
 SG_ CRC_PT_SYSTEM_FD_1 : 447|8@0+ (1,0) [0|255] "-"  ADCAM,MPAD,GNMM,SGW,AGSM,BSM,IPC
 SG_ CrankEnable_PT : 167|1@0+ (1,0) [0|1] "" SGW,RFHM
 SG_ CC_SetSpdDspl_MPH_PT : 23|8@0+ (1,0) [0|255] "mph"  SGW,BCM,IPC
 SG_ CC_SetSpdDspl_KPH_PT : 95|13@0+ (0.0625,0) [0|511.9375] "kph"  IPC
 SG_ AWD_Status_PT : 114|3@0+ (1,0) [0|6] "" SGW,BCM
 SG_ AtmosphericPressure_PT : 47|8@0+ (3.6,300) [300|1218] "mbar"  SGW,RFHM
 SG_ APCM_Rq_PT : 137|2@0+ (1,0) [0|3] "" AGSM
 SG_ AlternatorFail_PT : 159|1@0+ (1,0) [0|1] "" SGW,IPC
 SG_ Warn_BTO_PT : 247|1@0+ (1,0) [0|1] "" IPC
 SG_ TerrainModeDesiredStat_PT : 311|5@0+ (1,0) [0|31] "" MPAD,BCM,IPC
 SG_ Terrain_HMI_Rq_PT : 319|5@0+ (1,0) [0|31] "" BCM,IPC
 SG_ Selector_SystemFailSts_PT : 263|1@0+ (1,0) [0|1] "" Vector__XXX
 SG_ RawPVS2_PT : 303|8@0+ (0.019607843,0) [0|4.999999965] "V"  BCM
 SG_ RawPVS1_PT : 295|8@0+ (0.019607843,0) [0|4.999999965] "V"  BCM
 SG_ WED_STATUS : 335|3@0+ (1,0) [0|7] "" BSM
 SG_ BPCM_HV_SOC1 : 329|10@0+ (0.1,0) [0|102.3] "%"  BSM
 SG_ AWD_SysStat : 331|2@0+ (1,0) [0|3] "" SGW,BSM
 SG_ SpeedSyncAvailable : 332|1@0+ (1,0) [0|1] "" DTCM
 SG_ AHH_Modify_Accel_Rq : 60|2@0+ (1,0) [0|3] "" Vector__XXX
 SG_ AHH_Apply_Release_Rqst : 58|3@0+ (1,0) [0|7] "" BSM
 SG_ TransmissionWarnings_PT : 111|6@0+ (1,0) [0|63] "" MPAD,SGW,BCM,BSM,IPC
 SG_ Braking_Mode_Sts : 62|2@0+ (1,0) [0|3] "" BCM
 SG_ Braking_Mode_Indication_Sts : 366|2@0+ (1,0) [0|3] "" BCM,IPC

CM_ SG_ 2654339094 CurrentFailSts_FD11_AGSM "Indicates the presence/absence of at least one DTC with DTCStatus = present in the System Memory";
CM_ SG_ 2654339094 WakeupSource_FD03_AGSM "Indicates the reason the ECU was most recently awakened";
CM_ SG_ 2654339094 StayActiveSource_FD16_AGSM "Indicates the source that requests the ECU to stay active";
CM_ SG_ 2654339094 WakeupSource_FD11_AGSM "Indicates the reason the ECU was most recently awakened";
CM_ SG_ 2654339094 WakeupSource_FD16_AGSM "Indicates the reason the ECU was most recently awakened";
CM_ SG_ 263 Vehicle_Hold_Rq_PT "Transmission Vehicle Hold Request";
CM_ SG_ 263 VehSpd_Overridden_PT "Vehicle Speed Override Indication";
CM_ SG_ 263 Warn_BTO_PT "Brake Throttle Override status";
CM_ SG_ 263 WED_STATUS "WED Status";
CM_ SG_ 263 AHH_Apply_Release_Rqst "AHH Apply Release Request";
CM_ SG_ 263 AHH_Modify_Accel_Rq "AHH Modify Acceleration Request";
CM_ SG_ 263 AlternatorFail_PT "Alternator Fail Status";
CM_ SG_ 263 APCM_Rq_PT "Auto position correction mode request";
CM_ SG_ 263 AtmosphericPressure_PT "Atmoshperic pressure";
CM_ SG_ 263 SpeedLimitSts_PT "Speed limiter status";
CM_ SG_ 263 ShiftLeverPosition_PT "Shift Lever Position";
CM_ SG_ 263 TargetGear_PT "Intended Gear that the transmission will shift to.";
CM_ SG_ 263 SpeedSyncAvailable "Speed Sync Available";
CM_ SG_ 263 Terrain_HMI_Rq_PT "Signal indicates the terrain mode indication messages sent to the cluster.";
CM_ SG_ 263 TerrainModeDesiredStat_PT "Signal indicates customer desired terrain mode status.";
CM_ SG_ 263 TerrainModeStat_PT "Terrain Mode";
CM_ SG_ 263 TransmissionFailSts_PT "Transmission Failure Status";
CM_ SG_ 263 TransmissionWarnings_PT "Transmission Warnings";
CM_ SG_ 263 TurtleModeSts_PT "Turtle Mode State";
CM_ SG_ 263 AWD_Status_PT "AWD Status";
CM_ SG_ 263 AWD_SysStat "All Wheel Drive System Status";
CM_ SG_ 263 BPCM_HV_SOC1 "State of Charge";
CM_ SG_ 263 Braking_Mode_Indication_Sts "Signal Indicating L Mode Indication Status";
CM_ SG_ 263 Braking_Mode_Sts "Signal Indicating L Mode Status";
CM_ SG_ 263 CC_SetSpdDspl_KPH_PT "Cruise Control Vehicle Set Speed in Kilometers per Hour";
CM_ SG_ 263 CrankEnable_PT "This signal is used to enable the cranking in safety conditions";
CM_ SG_ 263 CC_SetSpdDspl_MPH_PT "Cruise Control Vehicle Set Speed status in miles per hour";
CM_ SG_ 263 CRC_PT_SYSTEM_FD_1 "CRC according to SAE J1850 standard at each frame transmission.";
CM_ SG_ 263 CruiseControlLampSts_PT "Cruise Control Light Command";
CM_ SG_ 263 CruiseControlSts_PT "Cruise Control Status";
CM_ SG_ 263 ESS_RqShftPark_PT "ESS Request Shift to Park";
CM_ SG_ 263 DriveReady_PT "Drive Ready allowed status";
CM_ SG_ 263 MessageCounter_PT_SYSTEM_FD_1 "This signal is a counter used for safety checks strategies. This counter is incremented of 1 (one) unit at each frame transmission.";
CM_ SG_ 263 ParkingFailSts_PT "Parking Fail Sts";
CM_ SG_ 263 PdlPosActual_PT "Actual Pedal Position";
CM_ SG_ 263 ShiftLeverLockReq_PT "Shift Lever Lock Request";
CM_ SG_ 263 PowertrainPrplsnActv_PT "Powertrain Propulsion System Status";
CM_ SG_ 263 R_SHFT_LOCK_PT "Shift lock for reverse";
CM_ SG_ 263 RawPVS1_PT "Raw Pedal Voltage - Sensor 1";
CM_ SG_ 263 RawPVS2_PT "Raw Pedal Voltage - Sensor 2";
CM_ SG_ 263 Selector_SystemFailSts_PT "Signal indicates that the terrain mode is no longer selectable by the customer.";
CM_ SG_ 263 DriverPowerReq_PT "Current delivered power";
CM_ SG_ 263 DrvAway_Alert_PT "Drive Away Alert";
CM_ SG_ 263 DrvAway_Inhibit_PT "Drive Away Inhibit";
CM_ SG_ 263 GasPedalPosition_PT "Gas Pedal Position in percentage";
CM_ SG_ 263 GasPedalPositionFailSts_PT "Gas Pedal Position Failure Status";
CM_ SG_ 263 HAS_SoH_PT "HAS SoH";
CM_ SG_ 263 ISASts_PT "Intelligent Speed Assist status";
CM_ SG_ 263 ParkingSts_PT "Parking Status";
CM_ SG_ 263 GearIndicationSts_PT "Gear Indication Status";
CM_ SG_ 263 GearEngagedForDisplay_PT "Transmission Gear Engaged signal for the instrument cluster display";
CM_ SG_ 263 GearEngaged_PT "Current engaged gear";
CM_ SG_ 2654339136 EOL_FD16_EVCU2 "Indicates if the ECU requires configuration data at the assembly plant End Of Line";
CM_ SG_ 2654339136 DES_FD05_EVCU2 "Indicates whether the ECU?s CAN cell is in either ErrorActive, or ErrorPassive state OR has just now recovered from a BusOff condition";
CM_ SG_ 2654339136 DES_FD11_EVCU2 "Indicates whether the ECU?s CAN cell is in either ErrorActive, or ErrorPassive state OR has just now recovered from a BusOff condition";
CM_ SG_ 2654339136 DES_FD03_EVCU2 "Indicates whether the ECU?s CAN cell is in either ErrorActive, or ErrorPassive state OR has just now recovered from a BusOff condition";
CM_ SG_ 2654339136 CurrentFailSts_FD05_EVCU2 "Indicates the presence/absence of at least one DTC with DTCStatus = present in the System Memory";
CM_ SG_ 2654339136 CurrentCanNMState_FD16_EVCU2 "Indicates that CanNM state the ECU is currently executing";
CM_ SG_ 2654339136 CurrentFailSts_FD03_EVCU2 "Indicates the presence/absence of at least one DTC with DTCStatus = present in the System Memory";
CM_ SG_ 2654339136 PreviousCanNMState_FD03_EVCU2 "Indicates the last CanNM state that the ECU existed in";
CM_ SG_ 2654339136 PreviousCanNMState_FD05_EVCU2 "Indicates the last CanNM state that the ECU existed in";
CM_ SG_ 2654339136 PreviousCanNMState_FD11_EVCU2 "Indicates the last CanNM state that the ECU existed in";
CM_ SG_ 2654339136 PreviousCanNMState_FD16_EVCU2 "Indicates the last CanNM state that the ECU existed in";
CM_ SG_ 2654339136 StayActiveSource_FD03_EVCU2 "Indicates the source that requests the ECU to stay active";
CM_ SG_ 2654339136 StayActiveSource_FD05_EVCU2 "Indicates the source that requests the ECU to stay active";
CM_ SG_ 2654339136 StayActiveSource_FD11_EVCU2 "Indicates the source that requests the ECU to stay active";
CM_ SG_ 2654339136 StayActiveSource_FD16_EVCU2 "Indicates the source that requests the ECU to stay active";
CM_ SG_ 2654339136 CurrentFailSts_FD11_EVCU2 "Indicates the presence/absence of at least one DTC with DTCStatus = present in the System Memory";
CM_ SG_ 2654339136 CurrentFailSts_FD16_EVCU2 "Indicates the presence/absence of at least one DTC with DTCStatus = present in the System Memory";
CM_ SG_ 2654339136 GenericFailSts_FD03_EVCU2 "Indicates the presence/absent of at least one DTC in the System Memory";
CM_ SG_ 2654339136 GenericFailSts_FD05_EVCU2 "Indicates the presence/absent of at least one DTC in the System Memory";
CM_ SG_ 2654339136 GenericFailSts_FD11_EVCU2 "Indicates the presence/absent of at least one DTC in the System Memory";
CM_ SG_ 2654339136 GenericFailSts_FD16_EVCU2 "Indicates the presence/absent of at least one DTC in the System Memory";
CM_ SG_ 2654339136 DES_FD16_EVCU2 "Indicates whether the ECU?s CAN cell is in either ErrorActive, or ErrorPassive state OR has just now recovered from a BusOff condition";
CM_ SG_ 2654339136 EOL_FD03_EVCU2 "Indicates if the ECU requires configuration data at the assembly plant End Of Line";
CM_ SG_ 2654339136 EOL_FD05_EVCU2 "Indicates if the ECU requires configuration data at the assembly plant End Of Line";
CM_ SG_ 2654339136 EOL_FD11_EVCU2 "Indicates if the ECU requires configuration data at the assembly plant End Of Line";
CM_ SG_ 2654339136 WakeupSource_FD16_EVCU2 "Indicates the reason the ECU was most recently awakened";
CM_ SG_ 2654339136 WakeupSource_FD11_EVCU2 "Indicates the reason the ECU was most recently awakened";
CM_ SG_ 2654339136 WakeupSource_FD03_EVCU2 "Indicates the reason the ECU was most recently awakened";
CM_ SG_ 2654339136 WakeupSource_FD05_EVCU2 "Indicates the reason the ECU was most recently awakened";
CM_ SG_ 2654339136 CurrentCanNMState_FD03_EVCU2 "Indicates that CanNM state the ECU is currently executing";
CM_ SG_ 2654339136 CurrentCanNMState_FD05_EVCU2 "Indicates that CanNM state the ECU is currently executing";
CM_ SG_ 2654339136 CurrentCanNMState_FD11_EVCU2 "Indicates that CanNM state the ECU is currently executing";
CM_ SG_ 2654339073 WakeupSource_FD05_ECM "Indicates the reason the ECU was most recently awakened";
CM_ SG_ 2654339073 StayActiveSource_FD11_ECM "Indicates the source that requests the ECU to stay active";
CM_ SG_ 2654339073 WakeupSource_FD03_ECM "Indicates the reason the ECU was most recently awakened";
CM_ SG_ 2654339073 GenericFailSts_FD11_ECM "Indicates the presence/absent of at least one DTC in the System Memory";
CM_ SG_ 2654339073 PreviousCanNMState_FD03_ECM "Indicates the last CanNM state that the ECU existed in";
CM_ SG_ 2654339073 GenericFailSts_FD03_ECM "Indicates the presence/absent of at least one DTC in the System Memory";
CM_ SG_ 2654339073 GenericFailSts_FD05_ECM "Indicates the presence/absent of at least one DTC in the System Memory";
CM_ SG_ 2654339073 StayActiveSource_FD05_ECM "Indicates the source that requests the ECU to stay active";
CM_ SG_ 2654339073 StayActiveSource_FD03_ECM "Indicates the source that requests the ECU to stay active";
CM_ SG_ 2654339073 PreviousCanNMState_FD05_ECM "Indicates the last CanNM state that the ECU existed in";
CM_ SG_ 2654339073 PreviousCanNMState_FD11_ECM "Indicates the last CanNM state that the ECU existed in";
CM_ SG_ 2654339073 EOL_FD11_ECM "Indicates if the ECU requires configuration data at the assembly plant End Of Line";
CM_ SG_ 2654339073 EOL_FD05_ECM "Indicates if the ECU requires configuration data at the assembly plant End Of Line";
CM_ SG_ 2654339073 EOL_FD03_ECM "Indicates if the ECU requires configuration data at the assembly plant End Of Line";
CM_ SG_ 2654339073 DES_FD05_ECM "Indicates whether the ECU?s CAN cell is in either ErrorActive, or ErrorPassive state OR has just now recovered from a BusOff condition";
CM_ SG_ 2654339073 CurrentFailSts_FD03_ECM "Indicates the presence/absence of at least one DTC with DTCStatus = present in the System Memory";
CM_ SG_ 2654339073 CurrentFailSts_FD05_ECM "Indicates the presence/absence of at least one DTC with DTCStatus = present in the System Memory";
CM_ SG_ 2654339073 CurrentFailSts_FD11_ECM "Indicates the presence/absence of at least one DTC with DTCStatus = present in the System Memory";
CM_ SG_ 2654339073 DES_FD03_ECM "Indicates whether the ECU?s CAN cell is in either ErrorActive, or ErrorPassive state OR has just now recovered from a BusOff condition";
CM_ SG_ 2654339073 CurrentCanNMState_FD03_ECM "Indicates that CanNM state the ECU is currently executing";
CM_ SG_ 2654339073 CurrentCanNMState_FD05_ECM "Indicates that CanNM state the ECU is currently executing";
CM_ SG_ 2654339073 CurrentCanNMState_FD11_ECM "Indicates that CanNM state the ECU is currently executing";
CM_ SG_ 2654339073 DES_FD11_ECM "Indicates whether the ECU?s CAN cell is in either ErrorActive, or ErrorPassive state OR has just now recovered from a BusOff condition";
CM_ SG_ 2654339073 WakeupSource_FD11_ECM "Indicates the reason the ECU was most recently awakened";
CM_ SG_ 2654339142 GenericFailSts_FD05_BPCM "Indicates the presence/absent of at least one DTC in the System Memory";
CM_ SG_ 2654339142 GenericFailSts_FD11_BPCM "Indicates the presence/absent of at least one DTC in the System Memory";
CM_ SG_ 2654339142 DES_FD05_BPCM "Indicates whether the ECU?s CAN cell is in either ErrorActive, or ErrorPassive state OR has just now recovered from a BusOff condition";
CM_ SG_ 2654339142 DES_FD11_BPCM "Indicates whether the ECU?s CAN cell is in either ErrorActive, or ErrorPassive state OR has just now recovered from a BusOff condition";
CM_ SG_ 2654339142 EOL_FD05_BPCM "Indicates if the ECU requires configuration data at the assembly plant End Of Line";
CM_ SG_ 2654339142 EOL_FD11_BPCM "Indicates if the ECU requires configuration data at the assembly plant End Of Line";
CM_ SG_ 2654339142 CurrentCanNMState_FD05_BPCM "Indicates that CanNM state the ECU is currently executing";
CM_ SG_ 2654339142 CurrentCanNMState_FD11_BPCM "Indicates that CanNM state the ECU is currently executing";
CM_ SG_ 2654339142 CurrentFailSts_FD05_BPCM "Indicates the presence/absence of at least one DTC with DTCStatus = present in the System Memory";
CM_ SG_ 2654339142 CurrentFailSts_FD11_BPCM "Indicates the presence/absence of at least one DTC with DTCStatus = present in the System Memory";
CM_ SG_ 2654339142 PreviousCanNMState_FD05_BPCM "Indicates the last CanNM state that the ECU existed in";
CM_ SG_ 2654339142 PreviousCanNMState_FD11_BPCM "Indicates the last CanNM state that the ECU existed in";
CM_ SG_ 2654339142 StayActiveSource_FD05_BPCM "Indicates the source that requests the ECU to stay active";
CM_ SG_ 2654339142 StayActiveSource_FD11_BPCM "Indicates the source that requests the ECU to stay active";
CM_ SG_ 2654339142 WakeupSource_FD05_BPCM "Indicates the reason the ECU was most recently awakened";
CM_ SG_ 2654339142 WakeupSource_FD11_BPCM "Indicates the reason the ECU was most recently awakened";
CM_ SG_ 2654339094 CurrentFailSts_FD03_AGSM "Indicates the presence/absence of at least one DTC with DTCStatus = present in the System Memory";
CM_ SG_ 2654339094 CurrentCanNMState_FD16_AGSM "Indicates that CanNM state the ECU is currently executing";
CM_ SG_ 2654339094 CurrentCanNMState_FD11_AGSM "Indicates that CanNM state the ECU is currently executing";
CM_ SG_ 2654339094 CurrentCanNMState_FD03_AGSM "Indicates that CanNM state the ECU is currently executing";
CM_ SG_ 2654339094 StayActiveSource_FD11_AGSM "Indicates the source that requests the ECU to stay active";
CM_ SG_ 2654339094 StayActiveSource_FD03_AGSM "Indicates the source that requests the ECU to stay active";
CM_ SG_ 2654339094 PreviousCanNMState_FD16_AGSM "Indicates the last CanNM state that the ECU existed in";
CM_ SG_ 2654339094 PreviousCanNMState_FD11_AGSM "Indicates the last CanNM state that the ECU existed in";
CM_ SG_ 2654339094 PreviousCanNMState_FD03_AGSM "Indicates the last CanNM state that the ECU existed in";
CM_ SG_ 2654339094 GenericFailSts_FD16_AGSM "Indicates the presence/absent of at least one DTC in the System Memory";
CM_ SG_ 2654339094 GenericFailSts_FD11_AGSM "Indicates the presence/absent of at least one DTC in the System Memory";
CM_ SG_ 2654339094 GenericFailSts_FD03_AGSM "Indicates the presence/absent of at least one DTC in the System Memory";
CM_ SG_ 2654339094 EOL_FD16_AGSM "Indicates if the ECU requires configuration data at the assembly plant End Of Line";
CM_ SG_ 2654339094 EOL_FD11_AGSM "Indicates if the ECU requires configuration data at the assembly plant End Of Line";
CM_ SG_ 2654339094 EOL_FD03_AGSM "Indicates if the ECU requires configuration data at the assembly plant End Of Line";
CM_ SG_ 2654339094 DES_FD16_AGSM "Indicates whether the ECU?s CAN cell is in either ErrorActive, or ErrorPassive state OR has just now recovered from a BusOff condition";
CM_ SG_ 2654339094 DES_FD11_AGSM "Indicates whether the ECU?s CAN cell is in either ErrorActive, or ErrorPassive state OR has just now recovered from a BusOff condition";
CM_ SG_ 2654339094 DES_FD03_AGSM "Indicates whether the ECU?s CAN cell is in either ErrorActive, or ErrorPassive state OR has just now recovered from a BusOff condition";
CM_ SG_ 2654339094 CurrentFailSts_FD16_AGSM "Indicates the presence/absence of at least one DTC with DTCStatus = present in the System Memory";
BA_DEF_ BO_ "CANFD_BRS" ENUM "0","1";
BA_DEF_ BO_ "VFrameFormat" ENUM "StandardCAN","ExtendedCAN","reserved","reserved","reserved","reserved","reserved","reserved","reserved","reserved","reserved","reserved","reserved","reserved","StandardCAN_FD","ExtendedCAN_FD";
BA_DEF_ BO_ "DiagConnection" HEX 0 65535;
BA_DEF_ BO_ "DiagState" ENUM "No","Yes";
BA_DEF_ BO_ "NmAsrMessage" ENUM "No","Yes";
BA_DEF_ BO_ "GenMsgDelayTime" INT 0 65535;
BA_DEF_ BO_ "GenMsgCycleTime" INT 0 65535;
BA_DEF_ BO_ "GenMsgCycleTimeFast" INT 0 65535;
BA_DEF_ BO_ "GenMsgStartDelayTime" INT 0 65535;
BA_DEF_ BO_ "GenMsgILSupport" ENUM "No","Yes";
BA_DEF_ BO_ "GenMsgNrOfRepetition" INT 0 255;
BA_DEF_ BO_ "GenMsgSendType" ENUM "Cyclic","NotUsed","NotUsed","NotUsed","NotUsed","NotUsed","NotUsed","NotUsed","NoMsgSendType";
BA_DEF_ BO_ "NmMessage" ENUM "No","Yes";
BA_DEF_ BO_ "DiagResponse" ENUM "No","Yes";
BA_DEF_ BO_ "Type" ENUM "P","C","PE","COC","PE_Cntrl","E","E_Cntrl","OC","S","BAF","DC","EM","MM","ISO-TP","-";
BA_DEF_ BO_ "DiagRequest" ENUM "No","Yes";
BA_DEF_ SG_ "GenSigTimeoutTime_SGW" INT 0 65535;
BA_DEF_ SG_ "GenSigTimeoutTime_RFHM" INT 0 65535;
BA_DEF_ SG_ "GenSigTimeoutTime_MPAD" INT 0 65535;
BA_DEF_ SG_ "GenSigTimeoutTime_IPC" INT 0 65535;
BA_DEF_ SG_ "GenSigTimeoutTime_GNMM" INT 0 65535;
BA_DEF_ SG_ "GenSigTimeoutTime_EVCU2" INT 0 65535;
BA_DEF_ SG_ "GenSigTimeoutTime_ESL" INT 0 65535;
BA_DEF_ SG_ "GenSigTimeoutTime_ECM" INT 0 65535;
BA_DEF_ SG_ "GenSigTimeoutTime_DTCM" INT 0 65535;
BA_DEF_ SG_ "GenSigTimeoutTime_DMSM" INT 0 65535;
BA_DEF_ SG_ "GenSigTimeoutTime_BSM" INT 0 65535;
BA_DEF_ SG_ "GenSigTimeoutTime_BCM" INT 0 65535;
BA_DEF_ SG_ "GenSigTimeoutTime_AGSM" INT 0 65535;
BA_DEF_ SG_ "GenSigTimeoutTime_ADCAM" INT 0 65535;
BA_DEF_ SG_ "SystemSignalLongSymbol" STRING ;
BA_DEF_ SG_ "GenSigSendType" ENUM "NotUsed","OnWrite","OnWriteWithRepetition","OnChange","OnChangeWithRepetition","IfActive","IfActiveWithRepetition","NoSigSendType";
BA_DEF_ SG_ "GenSigInactiveValue" INT 0 2147483647;
BA_DEF_ SG_ "GenSigStartValue" INT 0 2147483647;
BA_DEF_DEF_ "CANFD_BRS" "0";
BA_DEF_DEF_ "VFrameFormat" "StandardCAN_FD";
BA_DEF_DEF_ "DiagConnection" 0;
BA_DEF_DEF_ "DiagState" "No";
BA_DEF_DEF_ "NmAsrMessage" "No";
BA_DEF_DEF_ "GenMsgDelayTime" 0;
BA_DEF_DEF_ "GenMsgCycleTime" 0;
BA_DEF_DEF_ "GenMsgCycleTimeFast" 0;
BA_DEF_DEF_ "GenMsgStartDelayTime" 0;
BA_DEF_DEF_ "GenMsgILSupport" "No";
BA_DEF_DEF_ "GenMsgNrOfRepetition" 0;
BA_DEF_DEF_ "GenMsgSendType" "NoMsgSendType";
BA_DEF_DEF_ "NmMessage" "No";
BA_DEF_DEF_ "DiagResponse" "No";
BA_DEF_DEF_ "Type" "-";
BA_DEF_DEF_ "DiagRequest" "No";
BA_DEF_DEF_ "GenSigTimeoutTime_SGW" 2500;
BA_DEF_DEF_ "GenSigTimeoutTime_RFHM" 2500;
BA_DEF_DEF_ "GenSigTimeoutTime_MPAD" 2500;
BA_DEF_DEF_ "GenSigTimeoutTime_IPC" 2500;
BA_DEF_DEF_ "GenSigTimeoutTime_GNMM" 2500;
BA_DEF_DEF_ "GenSigTimeoutTime_EVCU2" 2500;
BA_DEF_DEF_ "GenSigTimeoutTime_ESL" 2500;
BA_DEF_DEF_ "GenSigTimeoutTime_ECM" 2500;
BA_DEF_DEF_ "GenSigTimeoutTime_DTCM" 2500;
BA_DEF_DEF_ "GenSigTimeoutTime_DMSM" 2500;
BA_DEF_DEF_ "GenSigTimeoutTime_BSM" 2500;
BA_DEF_DEF_ "GenSigTimeoutTime_BCM" 2500;
BA_DEF_DEF_ "GenSigTimeoutTime_AGSM" 2500;
BA_DEF_DEF_ "GenSigTimeoutTime_ADCAM" 2500;
BA_DEF_DEF_ "SystemSignalLongSymbol" "";
BA_DEF_DEF_ "GenSigSendType" "NoSigSendType";
BA_DEF_DEF_ "GenSigInactiveValue" 0;
BA_DEF_DEF_ "GenSigStartValue" 0;
BA_ "CANFD_BRS" BO_ 2654339136 1;
BA_ "VFrameFormat" BO_ 2654339136 15;
BA_ "GenMsgCycleTime" BO_ 2654339136 1000;
BA_ "GenMsgILSupport" BO_ 2654339136 1;
BA_ "GenMsgSendType" BO_ 2654339136 0;
BA_ "Type" BO_ 2654339136 1;
BA_ "CANFD_BRS" BO_ 2654339073 1;
BA_ "VFrameFormat" BO_ 2654339073 15;
BA_ "GenMsgCycleTime" BO_ 2654339073 1000;
BA_ "GenMsgILSupport" BO_ 2654339073 1;
BA_ "GenMsgSendType" BO_ 2654339073 0;
BA_ "Type" BO_ 2654339073 1;
BA_ "CANFD_BRS" BO_ 2654339142 1;
BA_ "VFrameFormat" BO_ 2654339142 15;
BA_ "GenMsgCycleTime" BO_ 2654339142 1000;
BA_ "GenMsgILSupport" BO_ 2654339142 1;
BA_ "GenMsgSendType" BO_ 2654339142 0;
BA_ "Type" BO_ 2654339142 1;
BA_ "CANFD_BRS" BO_ 2654339094 1;
BA_ "VFrameFormat" BO_ 2654339094 15;
BA_ "GenMsgCycleTime" BO_ 2654339094 1000;
BA_ "GenMsgILSupport" BO_ 2654339094 1;
BA_ "GenMsgSendType" BO_ 2654339094 0;
BA_ "Type" BO_ 2654339094 1;
BA_ "CANFD_BRS" BO_ 263 1;
BA_ "GenMsgCycleTime" BO_ 263 10;
BA_ "GenMsgILSupport" BO_ 263 1;
BA_ "GenMsgSendType" BO_ 263 0;
BA_ "Type" BO_ 263 1;
BA_ "GenSigTimeoutTime_SGW" SG_ 263 SpeedLimitSts_PT 0;
BA_ "GenSigTimeoutTime_RFHM" SG_ 263 SpeedLimitSts_PT 0;
BA_ "GenSigTimeoutTime_GNMM" SG_ 263 SpeedLimitSts_PT 0;
BA_ "GenSigTimeoutTime_EVCU2" SG_ 263 SpeedLimitSts_PT 0;
BA_ "GenSigTimeoutTime_ESL" SG_ 263 SpeedLimitSts_PT 0;
BA_ "GenSigTimeoutTime_ECM" SG_ 263 SpeedLimitSts_PT 0;
BA_ "GenSigTimeoutTime_DTCM" SG_ 263 SpeedLimitSts_PT 0;
BA_ "GenSigTimeoutTime_DMSM" SG_ 263 SpeedLimitSts_PT 0;
BA_ "GenSigTimeoutTime_BSM" SG_ 263 SpeedLimitSts_PT 0;
BA_ "GenSigTimeoutTime_AGSM" SG_ 263 SpeedLimitSts_PT 0;
BA_ "GenSigTimeoutTime_RFHM" SG_ 263 ShiftLeverPosition_PT 0;
BA_ "GenSigTimeoutTime_GNMM" SG_ 263 ShiftLeverPosition_PT 0;
BA_ "GenSigTimeoutTime_EVCU2" SG_ 263 ShiftLeverPosition_PT 0;
BA_ "GenSigTimeoutTime_ESL" SG_ 263 ShiftLeverPosition_PT 0;
BA_ "GenSigTimeoutTime_ECM" SG_ 263 ShiftLeverPosition_PT 0;
BA_ "GenSigTimeoutTime_DMSM" SG_ 263 ShiftLeverPosition_PT 0;
BA_ "GenSigTimeoutTime_SGW" SG_ 263 ShiftLeverLockReq_PT 0;
BA_ "GenSigTimeoutTime_RFHM" SG_ 263 ShiftLeverLockReq_PT 0;
BA_ "GenSigTimeoutTime_MPAD" SG_ 263 ShiftLeverLockReq_PT 0;
BA_ "GenSigTimeoutTime_IPC" SG_ 263 ShiftLeverLockReq_PT 0;
BA_ "GenSigTimeoutTime_GNMM" SG_ 263 ShiftLeverLockReq_PT 0;
BA_ "GenSigTimeoutTime_EVCU2" SG_ 263 ShiftLeverLockReq_PT 0;
BA_ "GenSigTimeoutTime_ESL" SG_ 263 ShiftLeverLockReq_PT 0;
BA_ "GenSigTimeoutTime_ECM" SG_ 263 ShiftLeverLockReq_PT 0;
BA_ "GenSigTimeoutTime_DTCM" SG_ 263 ShiftLeverLockReq_PT 0;
BA_ "GenSigTimeoutTime_DMSM" SG_ 263 ShiftLeverLockReq_PT 0;
BA_ "GenSigTimeoutTime_BSM" SG_ 263 ShiftLeverLockReq_PT 0;
BA_ "GenSigTimeoutTime_BCM" SG_ 263 ShiftLeverLockReq_PT 0;
BA_ "GenSigTimeoutTime_ADCAM" SG_ 263 ShiftLeverLockReq_PT 0;
BA_ "GenSigTimeoutTime_SGW" SG_ 263 Selector_SystemFailSts_PT 0;
BA_ "GenSigTimeoutTime_RFHM" SG_ 263 Selector_SystemFailSts_PT 0;
BA_ "GenSigTimeoutTime_MPAD" SG_ 263 Selector_SystemFailSts_PT 0;
BA_ "GenSigTimeoutTime_IPC" SG_ 263 Selector_SystemFailSts_PT 0;
BA_ "GenSigTimeoutTime_GNMM" SG_ 263 Selector_SystemFailSts_PT 0;
BA_ "GenSigTimeoutTime_EVCU2" SG_ 263 Selector_SystemFailSts_PT 0;
BA_ "GenSigTimeoutTime_ESL" SG_ 263 Selector_SystemFailSts_PT 0;
BA_ "GenSigTimeoutTime_ECM" SG_ 263 Selector_SystemFailSts_PT 0;
BA_ "GenSigTimeoutTime_DTCM" SG_ 263 Selector_SystemFailSts_PT 0;
BA_ "GenSigTimeoutTime_DMSM" SG_ 263 Selector_SystemFailSts_PT 0;
BA_ "GenSigTimeoutTime_BSM" SG_ 263 Selector_SystemFailSts_PT 0;
BA_ "GenSigTimeoutTime_BCM" SG_ 263 Selector_SystemFailSts_PT 0;
BA_ "GenSigTimeoutTime_AGSM" SG_ 263 Selector_SystemFailSts_PT 0;
BA_ "GenSigTimeoutTime_ADCAM" SG_ 263 Selector_SystemFailSts_PT 0;
BA_ "GenSigTimeoutTime_SGW" SG_ 263 RawPVS2_PT 0;
BA_ "GenSigTimeoutTime_RFHM" SG_ 263 RawPVS2_PT 0;
BA_ "GenSigTimeoutTime_MPAD" SG_ 263 RawPVS2_PT 0;
BA_ "GenSigTimeoutTime_IPC" SG_ 263 RawPVS2_PT 0;
BA_ "GenSigTimeoutTime_GNMM" SG_ 263 RawPVS2_PT 0;
BA_ "GenSigTimeoutTime_EVCU2" SG_ 263 RawPVS2_PT 0;
BA_ "GenSigTimeoutTime_ESL" SG_ 263 RawPVS2_PT 0;
BA_ "GenSigTimeoutTime_ECM" SG_ 263 RawPVS2_PT 0;
BA_ "GenSigTimeoutTime_DTCM" SG_ 263 RawPVS2_PT 0;
BA_ "GenSigTimeoutTime_DMSM" SG_ 263 RawPVS2_PT 0;
BA_ "GenSigTimeoutTime_BSM" SG_ 263 RawPVS2_PT 0;
BA_ "GenSigTimeoutTime_AGSM" SG_ 263 RawPVS2_PT 0;
BA_ "GenSigTimeoutTime_ADCAM" SG_ 263 RawPVS2_PT 0;
BA_ "GenSigStartValue" SG_ 263 RawPVS2_PT 255;
BA_ "GenSigTimeoutTime_SGW" SG_ 263 RawPVS1_PT 0;
BA_ "GenSigTimeoutTime_RFHM" SG_ 263 RawPVS1_PT 0;
BA_ "GenSigTimeoutTime_MPAD" SG_ 263 RawPVS1_PT 0;
BA_ "GenSigTimeoutTime_IPC" SG_ 263 RawPVS1_PT 0;
BA_ "GenSigTimeoutTime_GNMM" SG_ 263 RawPVS1_PT 0;
BA_ "GenSigTimeoutTime_EVCU2" SG_ 263 RawPVS1_PT 0;
BA_ "GenSigTimeoutTime_ESL" SG_ 263 RawPVS1_PT 0;
BA_ "GenSigTimeoutTime_ECM" SG_ 263 RawPVS1_PT 0;
BA_ "GenSigTimeoutTime_DTCM" SG_ 263 RawPVS1_PT 0;
BA_ "GenSigTimeoutTime_DMSM" SG_ 263 RawPVS1_PT 0;
BA_ "GenSigTimeoutTime_BSM" SG_ 263 RawPVS1_PT 0;
BA_ "GenSigTimeoutTime_AGSM" SG_ 263 RawPVS1_PT 0;
BA_ "GenSigTimeoutTime_ADCAM" SG_ 263 RawPVS1_PT 0;
BA_ "GenSigStartValue" SG_ 263 RawPVS1_PT 255;
BA_ "GenSigTimeoutTime_SGW" SG_ 263 R_SHFT_LOCK_PT 0;
BA_ "GenSigTimeoutTime_RFHM" SG_ 263 R_SHFT_LOCK_PT 0;
BA_ "GenSigTimeoutTime_MPAD" SG_ 263 R_SHFT_LOCK_PT 0;
BA_ "GenSigTimeoutTime_IPC" SG_ 263 R_SHFT_LOCK_PT 0;
BA_ "GenSigTimeoutTime_GNMM" SG_ 263 R_SHFT_LOCK_PT 0;
BA_ "GenSigTimeoutTime_EVCU2" SG_ 263 R_SHFT_LOCK_PT 0;
BA_ "GenSigTimeoutTime_ESL" SG_ 263 R_SHFT_LOCK_PT 0;
BA_ "GenSigTimeoutTime_ECM" SG_ 263 R_SHFT_LOCK_PT 0;
BA_ "GenSigTimeoutTime_DTCM" SG_ 263 R_SHFT_LOCK_PT 0;
BA_ "GenSigTimeoutTime_DMSM" SG_ 263 R_SHFT_LOCK_PT 0;
BA_ "GenSigTimeoutTime_BSM" SG_ 263 R_SHFT_LOCK_PT 0;
BA_ "GenSigTimeoutTime_BCM" SG_ 263 R_SHFT_LOCK_PT 0;
BA_ "GenSigTimeoutTime_ADCAM" SG_ 263 R_SHFT_LOCK_PT 0;
BA_ "GenSigTimeoutTime_GNMM" SG_ 263 PowertrainPrplsnActv_PT 0;
BA_ "GenSigTimeoutTime_ESL" SG_ 263 PowertrainPrplsnActv_PT 0;
BA_ "GenSigTimeoutTime_DTCM" SG_ 263 PowertrainPrplsnActv_PT 0;
BA_ "GenSigTimeoutTime_DMSM" SG_ 263 PowertrainPrplsnActv_PT 0;
BA_ "GenSigTimeoutTime_AGSM" SG_ 263 PowertrainPrplsnActv_PT 0;
BA_ "GenSigTimeoutTime_SGW" SG_ 263 PdlPosActual_PT 0;
BA_ "GenSigTimeoutTime_RFHM" SG_ 263 PdlPosActual_PT 0;
BA_ "GenSigTimeoutTime_IPC" SG_ 263 PdlPosActual_PT 0;
BA_ "GenSigTimeoutTime_GNMM" SG_ 263 PdlPosActual_PT 0;
BA_ "GenSigTimeoutTime_EVCU2" SG_ 263 PdlPosActual_PT 0;
BA_ "GenSigTimeoutTime_ESL" SG_ 263 PdlPosActual_PT 0;
BA_ "GenSigTimeoutTime_ECM" SG_ 263 PdlPosActual_PT 0;
BA_ "GenSigTimeoutTime_DTCM" SG_ 263 PdlPosActual_PT 0;
BA_ "GenSigTimeoutTime_DMSM" SG_ 263 PdlPosActual_PT 0;
BA_ "GenSigTimeoutTime_AGSM" SG_ 263 PdlPosActual_PT 0;
BA_ "GenSigTimeoutTime_SGW" SG_ 263 ParkingSts_PT 0;
BA_ "GenSigTimeoutTime_RFHM" SG_ 263 ParkingSts_PT 0;
BA_ "GenSigTimeoutTime_MPAD" SG_ 263 ParkingSts_PT 0;
BA_ "GenSigTimeoutTime_IPC" SG_ 263 ParkingSts_PT 0;
BA_ "GenSigTimeoutTime_GNMM" SG_ 263 ParkingSts_PT 0;
BA_ "GenSigTimeoutTime_EVCU2" SG_ 263 ParkingSts_PT 0;
BA_ "GenSigTimeoutTime_ESL" SG_ 263 ParkingSts_PT 0;
BA_ "GenSigTimeoutTime_ECM" SG_ 263 ParkingSts_PT 0;
BA_ "GenSigTimeoutTime_DTCM" SG_ 263 ParkingSts_PT 0;
BA_ "GenSigTimeoutTime_DMSM" SG_ 263 ParkingSts_PT 0;
BA_ "GenSigTimeoutTime_BSM" SG_ 263 ParkingSts_PT 0;
BA_ "GenSigTimeoutTime_AGSM" SG_ 263 ParkingSts_PT 0;
BA_ "GenSigTimeoutTime_ADCAM" SG_ 263 ParkingSts_PT 0;
BA_ "GenSigTimeoutTime_SGW" SG_ 263 ParkingFailSts_PT 0;
BA_ "GenSigTimeoutTime_RFHM" SG_ 263 ParkingFailSts_PT 0;
BA_ "GenSigTimeoutTime_MPAD" SG_ 263 ParkingFailSts_PT 0;
BA_ "GenSigTimeoutTime_IPC" SG_ 263 ParkingFailSts_PT 0;
BA_ "GenSigTimeoutTime_GNMM" SG_ 263 ParkingFailSts_PT 0;
BA_ "GenSigTimeoutTime_EVCU2" SG_ 263 ParkingFailSts_PT 0;
BA_ "GenSigTimeoutTime_ESL" SG_ 263 ParkingFailSts_PT 0;
BA_ "GenSigTimeoutTime_ECM" SG_ 263 ParkingFailSts_PT 0;
BA_ "GenSigTimeoutTime_DTCM" SG_ 263 ParkingFailSts_PT 0;
BA_ "GenSigTimeoutTime_DMSM" SG_ 263 ParkingFailSts_PT 0;
BA_ "GenSigTimeoutTime_BSM" SG_ 263 ParkingFailSts_PT 0;
BA_ "GenSigTimeoutTime_AGSM" SG_ 263 ParkingFailSts_PT 0;
BA_ "GenSigTimeoutTime_ADCAM" SG_ 263 ParkingFailSts_PT 0;
BA_ "GenSigTimeoutTime_SGW" SG_ 263 ISASts_PT 0;
BA_ "GenSigTimeoutTime_RFHM" SG_ 263 ISASts_PT 0;
BA_ "GenSigTimeoutTime_MPAD" SG_ 263 ISASts_PT 0;
BA_ "GenSigTimeoutTime_GNMM" SG_ 263 ISASts_PT 0;
BA_ "GenSigTimeoutTime_EVCU2" SG_ 263 ISASts_PT 0;
BA_ "GenSigTimeoutTime_ESL" SG_ 263 ISASts_PT 0;
BA_ "GenSigTimeoutTime_ECM" SG_ 263 ISASts_PT 0;
BA_ "GenSigTimeoutTime_DTCM" SG_ 263 ISASts_PT 0;
BA_ "GenSigTimeoutTime_DMSM" SG_ 263 ISASts_PT 0;
BA_ "GenSigTimeoutTime_BSM" SG_ 263 ISASts_PT 0;
BA_ "GenSigTimeoutTime_BCM" SG_ 263 ISASts_PT 0;
BA_ "GenSigTimeoutTime_AGSM" SG_ 263 ISASts_PT 0;
BA_ "GenSigTimeoutTime_ADCAM" SG_ 263 ISASts_PT 0;
BA_ "GenSigTimeoutTime_SGW" SG_ 263 HAS_SoH_PT 0;
BA_ "GenSigTimeoutTime_RFHM" SG_ 263 HAS_SoH_PT 0;
BA_ "GenSigTimeoutTime_IPC" SG_ 263 HAS_SoH_PT 0;
BA_ "GenSigTimeoutTime_GNMM" SG_ 263 HAS_SoH_PT 0;
BA_ "GenSigTimeoutTime_EVCU2" SG_ 263 HAS_SoH_PT 0;
BA_ "GenSigTimeoutTime_ESL" SG_ 263 HAS_SoH_PT 0;
BA_ "GenSigTimeoutTime_ECM" SG_ 263 HAS_SoH_PT 0;
BA_ "GenSigTimeoutTime_DTCM" SG_ 263 HAS_SoH_PT 0;
BA_ "GenSigTimeoutTime_DMSM" SG_ 263 HAS_SoH_PT 0;
BA_ "GenSigTimeoutTime_BSM" SG_ 263 HAS_SoH_PT 0;
BA_ "GenSigTimeoutTime_AGSM" SG_ 263 HAS_SoH_PT 0;
BA_ "GenSigTimeoutTime_ADCAM" SG_ 263 HAS_SoH_PT 0;
BA_ "GenSigTimeoutTime_RFHM" SG_ 263 MessageCounter_PT_SYSTEM_FD_1 0;
BA_ "GenSigTimeoutTime_EVCU2" SG_ 263 MessageCounter_PT_SYSTEM_FD_1 0;
BA_ "GenSigTimeoutTime_ESL" SG_ 263 MessageCounter_PT_SYSTEM_FD_1 0;
BA_ "GenSigTimeoutTime_ECM" SG_ 263 MessageCounter_PT_SYSTEM_FD_1 0;
BA_ "GenSigTimeoutTime_DTCM" SG_ 263 MessageCounter_PT_SYSTEM_FD_1 0;
BA_ "GenSigTimeoutTime_DMSM" SG_ 263 MessageCounter_PT_SYSTEM_FD_1 0;
BA_ "GenSigTimeoutTime_BCM" SG_ 263 MessageCounter_PT_SYSTEM_FD_1 0;
BA_ "GenSigTimeoutTime_SGW" SG_ 263 GearIndicationSts_PT 0;
BA_ "GenSigTimeoutTime_RFHM" SG_ 263 GearIndicationSts_PT 0;
BA_ "GenSigTimeoutTime_MPAD" SG_ 263 GearIndicationSts_PT 0;
BA_ "GenSigTimeoutTime_GNMM" SG_ 263 GearIndicationSts_PT 0;
BA_ "GenSigTimeoutTime_EVCU2" SG_ 263 GearIndicationSts_PT 0;
BA_ "GenSigTimeoutTime_ESL" SG_ 263 GearIndicationSts_PT 0;
BA_ "GenSigTimeoutTime_ECM" SG_ 263 GearIndicationSts_PT 0;
BA_ "GenSigTimeoutTime_DTCM" SG_ 263 GearIndicationSts_PT 0;
BA_ "GenSigTimeoutTime_DMSM" SG_ 263 GearIndicationSts_PT 0;
BA_ "GenSigTimeoutTime_BCM" SG_ 263 GearIndicationSts_PT 0;
BA_ "GenSigTimeoutTime_ADCAM" SG_ 263 GearIndicationSts_PT 0;
BA_ "GenSigTimeoutTime_ESL" SG_ 263 GearEngagedForDisplay_PT 0;
BA_ "GenSigTimeoutTime_DMSM" SG_ 263 GearEngagedForDisplay_PT 0;
BA_ "GenSigTimeoutTime_GNMM" SG_ 263 GearEngaged_PT 0;
BA_ "GenSigTimeoutTime_EVCU2" SG_ 263 GearEngaged_PT 0;
BA_ "GenSigTimeoutTime_ESL" SG_ 263 GearEngaged_PT 0;
BA_ "GenSigTimeoutTime_AGSM" SG_ 263 GearEngaged_PT 0;
BA_ "GenSigTimeoutTime_SGW" SG_ 263 GasPedalPositionFailSts_PT 0;
BA_ "GenSigTimeoutTime_RFHM" SG_ 263 GasPedalPositionFailSts_PT 0;
BA_ "GenSigTimeoutTime_IPC" SG_ 263 GasPedalPositionFailSts_PT 0;
BA_ "GenSigTimeoutTime_GNMM" SG_ 263 GasPedalPositionFailSts_PT 0;
BA_ "GenSigTimeoutTime_EVCU2" SG_ 263 GasPedalPositionFailSts_PT 0;
BA_ "GenSigTimeoutTime_ESL" SG_ 263 GasPedalPositionFailSts_PT 0;
BA_ "GenSigTimeoutTime_ECM" SG_ 263 GasPedalPositionFailSts_PT 0;
BA_ "GenSigTimeoutTime_DMSM" SG_ 263 GasPedalPositionFailSts_PT 0;
BA_ "GenSigTimeoutTime_AGSM" SG_ 263 GasPedalPositionFailSts_PT 0;
BA_ "GenSigTimeoutTime_SGW" SG_ 263 GasPedalPosition_PT 0;
BA_ "GenSigTimeoutTime_RFHM" SG_ 263 GasPedalPosition_PT 0;
BA_ "GenSigTimeoutTime_IPC" SG_ 263 GasPedalPosition_PT 0;
BA_ "GenSigTimeoutTime_GNMM" SG_ 263 GasPedalPosition_PT 0;
BA_ "GenSigTimeoutTime_EVCU2" SG_ 263 GasPedalPosition_PT 0;
BA_ "GenSigTimeoutTime_ESL" SG_ 263 GasPedalPosition_PT 0;
BA_ "GenSigTimeoutTime_ECM" SG_ 263 GasPedalPosition_PT 0;
BA_ "GenSigTimeoutTime_DMSM" SG_ 263 GasPedalPosition_PT 0;
BA_ "GenSigTimeoutTime_AGSM" SG_ 263 GasPedalPosition_PT 0;
BA_ "GenSigTimeoutTime_ADCAM" SG_ 263 GasPedalPosition_PT 0;
BA_ "GenSigTimeoutTime_ECM" SG_ 263 ESS_RqShftPark_PT 0;
BA_ "GenSigTimeoutTime_DTCM" SG_ 263 ESS_RqShftPark_PT 0;
BA_ "GenSigTimeoutTime_DMSM" SG_ 263 ESS_RqShftPark_PT 0;
BA_ "GenSigTimeoutTime_BSM" SG_ 263 ESS_RqShftPark_PT 0;
BA_ "GenSigTimeoutTime_AGSM" SG_ 263 ESS_RqShftPark_PT 0;
BA_ "GenSigTimeoutTime_ADCAM" SG_ 263 ESS_RqShftPark_PT 0;
BA_ "GenSigTimeoutTime_SGW" SG_ 263 ESS_RqShftPark_PT 0;
BA_ "GenSigTimeoutTime_RFHM" SG_ 263 ESS_RqShftPark_PT 0;
BA_ "GenSigTimeoutTime_MPAD" SG_ 263 ESS_RqShftPark_PT 0;
BA_ "GenSigTimeoutTime_IPC" SG_ 263 ESS_RqShftPark_PT 0;
BA_ "GenSigTimeoutTime_GNMM" SG_ 263 ESS_RqShftPark_PT 0;
BA_ "GenSigTimeoutTime_EVCU2" SG_ 263 ESS_RqShftPark_PT 0;
BA_ "GenSigTimeoutTime_ESL" SG_ 263 ESS_RqShftPark_PT 0;
BA_ "GenSigTimeoutTime_SGW" SG_ 263 DrvAway_Inhibit_PT 0;
BA_ "GenSigTimeoutTime_RFHM" SG_ 263 DrvAway_Inhibit_PT 0;
BA_ "GenSigTimeoutTime_MPAD" SG_ 263 DrvAway_Inhibit_PT 0;
BA_ "GenSigTimeoutTime_GNMM" SG_ 263 DrvAway_Inhibit_PT 0;
BA_ "GenSigTimeoutTime_EVCU2" SG_ 263 DrvAway_Inhibit_PT 0;
BA_ "GenSigTimeoutTime_ESL" SG_ 263 DrvAway_Inhibit_PT 0;
BA_ "GenSigTimeoutTime_ECM" SG_ 263 DrvAway_Inhibit_PT 0;
BA_ "GenSigTimeoutTime_DTCM" SG_ 263 DrvAway_Inhibit_PT 0;
BA_ "GenSigTimeoutTime_DMSM" SG_ 263 DrvAway_Inhibit_PT 0;
BA_ "GenSigTimeoutTime_BSM" SG_ 263 DrvAway_Inhibit_PT 0;
BA_ "GenSigTimeoutTime_BCM" SG_ 263 DrvAway_Inhibit_PT 0;
BA_ "GenSigTimeoutTime_AGSM" SG_ 263 DrvAway_Inhibit_PT 0;
BA_ "GenSigTimeoutTime_ADCAM" SG_ 263 DrvAway_Inhibit_PT 0;
BA_ "GenSigTimeoutTime_SGW" SG_ 263 DrvAway_Alert_PT 0;
BA_ "GenSigTimeoutTime_RFHM" SG_ 263 DrvAway_Alert_PT 0;
BA_ "GenSigTimeoutTime_MPAD" SG_ 263 DrvAway_Alert_PT 0;
BA_ "GenSigTimeoutTime_GNMM" SG_ 263 DrvAway_Alert_PT 0;
BA_ "GenSigTimeoutTime_EVCU2" SG_ 263 DrvAway_Alert_PT 0;
BA_ "GenSigTimeoutTime_ESL" SG_ 263 DrvAway_Alert_PT 0;
BA_ "GenSigTimeoutTime_ECM" SG_ 263 DrvAway_Alert_PT 0;
BA_ "GenSigTimeoutTime_DTCM" SG_ 263 DrvAway_Alert_PT 0;
BA_ "GenSigTimeoutTime_DMSM" SG_ 263 DrvAway_Alert_PT 0;
BA_ "GenSigTimeoutTime_BSM" SG_ 263 DrvAway_Alert_PT 0;
BA_ "GenSigTimeoutTime_AGSM" SG_ 263 DrvAway_Alert_PT 0;
BA_ "GenSigTimeoutTime_ADCAM" SG_ 263 DrvAway_Alert_PT 0;
BA_ "GenSigTimeoutTime_SGW" SG_ 2654339142 CurrentCanNMState_FD05_BPCM 0;
BA_ "GenSigTimeoutTime_RFHM" SG_ 2654339142 CurrentCanNMState_FD05_BPCM 0;
BA_ "GenSigTimeoutTime_MPAD" SG_ 2654339142 CurrentCanNMState_FD05_BPCM 0;
BA_ "GenSigTimeoutTime_SGW" SG_ 2654339142 StayActiveSource_FD11_BPCM 0;
BA_ "GenSigTimeoutTime_RFHM" SG_ 2654339142 StayActiveSource_FD11_BPCM 0;
BA_ "GenSigTimeoutTime_MPAD" SG_ 2654339142 StayActiveSource_FD11_BPCM 0;
BA_ "GenSigTimeoutTime_IPC" SG_ 2654339142 StayActiveSource_FD11_BPCM 0;
BA_ "GenSigTimeoutTime_GNMM" SG_ 2654339142 StayActiveSource_FD11_BPCM 0;
BA_ "GenSigTimeoutTime_EVCU2" SG_ 2654339142 StayActiveSource_FD11_BPCM 0;
BA_ "GenSigTimeoutTime_ESL" SG_ 2654339142 StayActiveSource_FD11_BPCM 0;
BA_ "GenSigTimeoutTime_ECM" SG_ 2654339142 StayActiveSource_FD11_BPCM 0;
BA_ "GenSigTimeoutTime_DTCM" SG_ 2654339142 StayActiveSource_FD11_BPCM 0;
BA_ "GenSigTimeoutTime_DMSM" SG_ 2654339142 StayActiveSource_FD11_BPCM 0;
BA_ "GenSigTimeoutTime_BSM" SG_ 2654339142 StayActiveSource_FD11_BPCM 0;
BA_ "GenSigTimeoutTime_BCM" SG_ 2654339142 StayActiveSource_FD11_BPCM 0;
BA_ "GenSigTimeoutTime_AGSM" SG_ 2654339142 StayActiveSource_FD11_BPCM 0;
BA_ "GenSigTimeoutTime_ADCAM" SG_ 2654339142 StayActiveSource_FD11_BPCM 0;
BA_ "GenSigTimeoutTime_SGW" SG_ 2654339142 StayActiveSource_FD05_BPCM 0;
BA_ "GenSigTimeoutTime_RFHM" SG_ 2654339142 StayActiveSource_FD05_BPCM 0;
BA_ "GenSigTimeoutTime_MPAD" SG_ 2654339142 StayActiveSource_FD05_BPCM 0;
BA_ "GenSigTimeoutTime_IPC" SG_ 2654339142 StayActiveSource_FD05_BPCM 0;
BA_ "GenSigTimeoutTime_GNMM" SG_ 2654339142 StayActiveSource_FD05_BPCM 0;
BA_ "GenSigTimeoutTime_EVCU2" SG_ 2654339142 StayActiveSource_FD05_BPCM 0;
BA_ "GenSigTimeoutTime_ESL" SG_ 2654339142 StayActiveSource_FD05_BPCM 0;
BA_ "GenSigTimeoutTime_ECM" SG_ 2654339142 StayActiveSource_FD05_BPCM 0;
BA_ "GenSigTimeoutTime_DTCM" SG_ 2654339142 StayActiveSource_FD05_BPCM 0;
BA_ "GenSigTimeoutTime_DMSM" SG_ 2654339142 StayActiveSource_FD05_BPCM 0;
BA_ "GenSigTimeoutTime_BSM" SG_ 2654339142 StayActiveSource_FD05_BPCM 0;
BA_ "GenSigTimeoutTime_BCM" SG_ 2654339142 StayActiveSource_FD05_BPCM 0;
BA_ "GenSigTimeoutTime_AGSM" SG_ 2654339142 StayActiveSource_FD05_BPCM 0;
BA_ "GenSigTimeoutTime_ADCAM" SG_ 2654339142 StayActiveSource_FD05_BPCM 0;
BA_ "GenSigTimeoutTime_SGW" SG_ 2654339142 PreviousCanNMState_FD05_BPCM 0;
BA_ "GenSigTimeoutTime_RFHM" SG_ 2654339142 PreviousCanNMState_FD05_BPCM 0;
BA_ "GenSigTimeoutTime_MPAD" SG_ 2654339142 PreviousCanNMState_FD05_BPCM 0;
BA_ "GenSigTimeoutTime_IPC" SG_ 2654339142 PreviousCanNMState_FD05_BPCM 0;
BA_ "GenSigTimeoutTime_GNMM" SG_ 2654339142 PreviousCanNMState_FD05_BPCM 0;
BA_ "GenSigTimeoutTime_EVCU2" SG_ 2654339142 PreviousCanNMState_FD05_BPCM 0;
BA_ "GenSigTimeoutTime_ESL" SG_ 2654339142 PreviousCanNMState_FD05_BPCM 0;
BA_ "GenSigTimeoutTime_ECM" SG_ 2654339142 PreviousCanNMState_FD05_BPCM 0;
BA_ "GenSigTimeoutTime_DTCM" SG_ 2654339142 PreviousCanNMState_FD05_BPCM 0;
BA_ "GenSigTimeoutTime_DMSM" SG_ 2654339142 PreviousCanNMState_FD05_BPCM 0;
BA_ "GenSigTimeoutTime_BSM" SG_ 2654339142 PreviousCanNMState_FD05_BPCM 0;
BA_ "GenSigTimeoutTime_BCM" SG_ 2654339142 PreviousCanNMState_FD05_BPCM 0;
BA_ "GenSigTimeoutTime_AGSM" SG_ 2654339142 PreviousCanNMState_FD05_BPCM 0;
BA_ "GenSigTimeoutTime_ADCAM" SG_ 2654339142 PreviousCanNMState_FD05_BPCM 0;
BA_ "GenSigTimeoutTime_SGW" SG_ 2654339142 GenericFailSts_FD05_BPCM 0;
BA_ "GenSigTimeoutTime_RFHM" SG_ 2654339142 GenericFailSts_FD05_BPCM 0;
BA_ "GenSigTimeoutTime_MPAD" SG_ 2654339142 GenericFailSts_FD05_BPCM 0;
BA_ "GenSigTimeoutTime_IPC" SG_ 2654339142 GenericFailSts_FD05_BPCM 0;
BA_ "GenSigTimeoutTime_GNMM" SG_ 2654339142 GenericFailSts_FD05_BPCM 0;
BA_ "GenSigTimeoutTime_EVCU2" SG_ 2654339142 GenericFailSts_FD05_BPCM 0;
BA_ "GenSigTimeoutTime_ESL" SG_ 2654339142 GenericFailSts_FD05_BPCM 0;
BA_ "GenSigTimeoutTime_ECM" SG_ 2654339142 GenericFailSts_FD05_BPCM 0;
BA_ "GenSigTimeoutTime_DTCM" SG_ 2654339142 GenericFailSts_FD05_BPCM 0;
BA_ "GenSigTimeoutTime_DMSM" SG_ 2654339142 GenericFailSts_FD05_BPCM 0;
BA_ "GenSigTimeoutTime_BSM" SG_ 2654339142 GenericFailSts_FD05_BPCM 0;
BA_ "GenSigTimeoutTime_AGSM" SG_ 2654339142 GenericFailSts_FD05_BPCM 0;
BA_ "GenSigTimeoutTime_ADCAM" SG_ 2654339142 GenericFailSts_FD05_BPCM 0;
BA_ "GenSigTimeoutTime_SGW" SG_ 2654339142 EOL_FD05_BPCM 0;
BA_ "GenSigTimeoutTime_RFHM" SG_ 2654339142 EOL_FD05_BPCM 0;
BA_ "GenSigTimeoutTime_MPAD" SG_ 2654339142 EOL_FD05_BPCM 0;
BA_ "GenSigTimeoutTime_IPC" SG_ 2654339142 EOL_FD05_BPCM 0;
BA_ "GenSigTimeoutTime_GNMM" SG_ 2654339142 EOL_FD05_BPCM 0;
BA_ "GenSigTimeoutTime_EVCU2" SG_ 2654339142 EOL_FD05_BPCM 0;
BA_ "GenSigTimeoutTime_ESL" SG_ 2654339142 EOL_FD05_BPCM 0;
BA_ "GenSigTimeoutTime_ECM" SG_ 2654339142 EOL_FD05_BPCM 0;
BA_ "GenSigTimeoutTime_DTCM" SG_ 2654339142 EOL_FD05_BPCM 0;
BA_ "GenSigTimeoutTime_DMSM" SG_ 2654339142 EOL_FD05_BPCM 0;
BA_ "GenSigTimeoutTime_BSM" SG_ 2654339142 EOL_FD05_BPCM 0;
BA_ "GenSigTimeoutTime_AGSM" SG_ 2654339142 EOL_FD05_BPCM 0;
BA_ "GenSigTimeoutTime_ADCAM" SG_ 2654339142 EOL_FD05_BPCM 0;
BA_ "GenSigTimeoutTime_SGW" SG_ 2654339142 DES_FD05_BPCM 0;
BA_ "GenSigTimeoutTime_RFHM" SG_ 2654339142 DES_FD05_BPCM 0;
BA_ "GenSigTimeoutTime_MPAD" SG_ 2654339142 DES_FD05_BPCM 0;
BA_ "GenSigTimeoutTime_IPC" SG_ 2654339142 DES_FD05_BPCM 0;
BA_ "GenSigTimeoutTime_GNMM" SG_ 2654339142 DES_FD05_BPCM 0;
BA_ "GenSigTimeoutTime_EVCU2" SG_ 2654339142 DES_FD05_BPCM 0;
BA_ "GenSigTimeoutTime_ESL" SG_ 2654339142 DES_FD05_BPCM 0;
BA_ "GenSigTimeoutTime_ECM" SG_ 2654339142 DES_FD05_BPCM 0;
BA_ "GenSigTimeoutTime_DTCM" SG_ 2654339142 DES_FD05_BPCM 0;
BA_ "GenSigTimeoutTime_DMSM" SG_ 2654339142 DES_FD05_BPCM 0;
BA_ "GenSigTimeoutTime_BSM" SG_ 2654339142 DES_FD05_BPCM 0;
BA_ "GenSigTimeoutTime_BCM" SG_ 2654339142 DES_FD05_BPCM 0;
BA_ "GenSigTimeoutTime_AGSM" SG_ 2654339142 DES_FD05_BPCM 0;
BA_ "GenSigTimeoutTime_ADCAM" SG_ 2654339142 DES_FD05_BPCM 0;
BA_ "GenSigTimeoutTime_ADCAM" SG_ 2654339142 CurrentFailSts_FD11_BPCM 0;
BA_ "GenSigTimeoutTime_SGW" SG_ 2654339142 CurrentFailSts_FD11_BPCM 0;
BA_ "GenSigTimeoutTime_RFHM" SG_ 2654339142 CurrentFailSts_FD11_BPCM 0;
BA_ "GenSigTimeoutTime_MPAD" SG_ 2654339142 CurrentFailSts_FD11_BPCM 0;
BA_ "GenSigTimeoutTime_IPC" SG_ 2654339142 CurrentFailSts_FD11_BPCM 0;
BA_ "GenSigTimeoutTime_GNMM" SG_ 2654339142 CurrentFailSts_FD11_BPCM 0;
BA_ "GenSigTimeoutTime_EVCU2" SG_ 2654339142 CurrentFailSts_FD11_BPCM 0;
BA_ "GenSigTimeoutTime_ESL" SG_ 2654339142 CurrentFailSts_FD11_BPCM 0;
BA_ "GenSigTimeoutTime_ECM" SG_ 2654339142 CurrentFailSts_FD11_BPCM 0;
BA_ "GenSigTimeoutTime_DTCM" SG_ 2654339142 CurrentFailSts_FD11_BPCM 0;
BA_ "GenSigTimeoutTime_DMSM" SG_ 2654339142 CurrentFailSts_FD11_BPCM 0;
BA_ "GenSigTimeoutTime_BSM" SG_ 2654339142 CurrentFailSts_FD11_BPCM 0;
BA_ "GenSigTimeoutTime_BCM" SG_ 2654339142 CurrentFailSts_FD11_BPCM 0;
BA_ "GenSigTimeoutTime_AGSM" SG_ 2654339142 CurrentFailSts_FD11_BPCM 0;
BA_ "GenSigTimeoutTime_SGW" SG_ 2654339142 CurrentFailSts_FD05_BPCM 0;
BA_ "GenSigTimeoutTime_RFHM" SG_ 2654339142 CurrentFailSts_FD05_BPCM 0;
BA_ "GenSigTimeoutTime_MPAD" SG_ 2654339142 CurrentFailSts_FD05_BPCM 0;
BA_ "GenSigTimeoutTime_IPC" SG_ 2654339142 CurrentFailSts_FD05_BPCM 0;
BA_ "GenSigTimeoutTime_GNMM" SG_ 2654339142 CurrentFailSts_FD05_BPCM 0;
BA_ "GenSigTimeoutTime_EVCU2" SG_ 2654339142 CurrentFailSts_FD05_BPCM 0;
BA_ "GenSigTimeoutTime_ESL" SG_ 2654339142 CurrentFailSts_FD05_BPCM 0;
BA_ "GenSigTimeoutTime_ECM" SG_ 2654339142 CurrentFailSts_FD05_BPCM 0;
BA_ "GenSigTimeoutTime_DTCM" SG_ 2654339142 CurrentFailSts_FD05_BPCM 0;
BA_ "GenSigTimeoutTime_DMSM" SG_ 2654339142 CurrentFailSts_FD05_BPCM 0;
BA_ "GenSigTimeoutTime_BSM" SG_ 2654339142 CurrentFailSts_FD05_BPCM 0;
BA_ "GenSigTimeoutTime_AGSM" SG_ 2654339142 CurrentFailSts_FD05_BPCM 0;
BA_ "GenSigTimeoutTime_ADCAM" SG_ 2654339142 CurrentFailSts_FD05_BPCM 0;
BA_ "GenSigTimeoutTime_SGW" SG_ 2654339142 WakeupSource_FD05_BPCM 0;
BA_ "GenSigTimeoutTime_RFHM" SG_ 2654339142 WakeupSource_FD05_BPCM 0;
BA_ "GenSigTimeoutTime_MPAD" SG_ 2654339142 WakeupSource_FD05_BPCM 0;
BA_ "GenSigTimeoutTime_IPC" SG_ 2654339142 WakeupSource_FD05_BPCM 0;
BA_ "GenSigTimeoutTime_GNMM" SG_ 2654339142 WakeupSource_FD05_BPCM 0;
BA_ "GenSigTimeoutTime_EVCU2" SG_ 2654339142 WakeupSource_FD05_BPCM 0;
BA_ "GenSigTimeoutTime_ESL" SG_ 2654339142 WakeupSource_FD05_BPCM 0;
BA_ "GenSigTimeoutTime_ECM" SG_ 2654339142 WakeupSource_FD05_BPCM 0;
BA_ "GenSigTimeoutTime_DTCM" SG_ 2654339142 WakeupSource_FD05_BPCM 0;
BA_ "GenSigTimeoutTime_DMSM" SG_ 2654339142 WakeupSource_FD05_BPCM 0;
BA_ "GenSigTimeoutTime_BSM" SG_ 2654339142 WakeupSource_FD05_BPCM 0;
BA_ "GenSigTimeoutTime_BCM" SG_ 2654339142 WakeupSource_FD05_BPCM 0;
BA_ "GenSigTimeoutTime_AGSM" SG_ 2654339142 WakeupSource_FD05_BPCM 0;
BA_ "GenSigTimeoutTime_ADCAM" SG_ 2654339142 WakeupSource_FD05_BPCM 0;
BA_ "GenSigTimeoutTime_SGW" SG_ 2654339142 PreviousCanNMState_FD11_BPCM 0;
BA_ "GenSigTimeoutTime_RFHM" SG_ 2654339142 PreviousCanNMState_FD11_BPCM 0;
BA_ "GenSigTimeoutTime_MPAD" SG_ 2654339142 PreviousCanNMState_FD11_BPCM 0;
BA_ "GenSigTimeoutTime_IPC" SG_ 2654339142 PreviousCanNMState_FD11_BPCM 0;
BA_ "GenSigTimeoutTime_GNMM" SG_ 2654339142 PreviousCanNMState_FD11_BPCM 0;
BA_ "GenSigTimeoutTime_EVCU2" SG_ 2654339142 PreviousCanNMState_FD11_BPCM 0;
BA_ "GenSigTimeoutTime_ESL" SG_ 2654339142 PreviousCanNMState_FD11_BPCM 0;
BA_ "GenSigTimeoutTime_ECM" SG_ 2654339142 PreviousCanNMState_FD11_BPCM 0;
BA_ "GenSigTimeoutTime_DTCM" SG_ 2654339142 PreviousCanNMState_FD11_BPCM 0;
BA_ "GenSigTimeoutTime_DMSM" SG_ 2654339142 PreviousCanNMState_FD11_BPCM 0;
BA_ "GenSigTimeoutTime_BSM" SG_ 2654339142 PreviousCanNMState_FD11_BPCM 0;
BA_ "GenSigTimeoutTime_BCM" SG_ 2654339142 PreviousCanNMState_FD11_BPCM 0;
BA_ "GenSigTimeoutTime_AGSM" SG_ 2654339142 PreviousCanNMState_FD11_BPCM 0;
BA_ "GenSigTimeoutTime_ADCAM" SG_ 2654339142 PreviousCanNMState_FD11_BPCM 0;
BA_ "GenSigTimeoutTime_SGW" SG_ 2654339142 DES_FD11_BPCM 0;
BA_ "GenSigTimeoutTime_RFHM" SG_ 2654339142 DES_FD11_BPCM 0;
BA_ "GenSigTimeoutTime_MPAD" SG_ 2654339142 DES_FD11_BPCM 0;
BA_ "GenSigTimeoutTime_IPC" SG_ 2654339142 DES_FD11_BPCM 0;
BA_ "GenSigTimeoutTime_GNMM" SG_ 2654339142 DES_FD11_BPCM 0;
BA_ "GenSigTimeoutTime_EVCU2" SG_ 2654339142 DES_FD11_BPCM 0;
BA_ "GenSigTimeoutTime_ESL" SG_ 2654339142 DES_FD11_BPCM 0;
BA_ "GenSigTimeoutTime_ECM" SG_ 2654339142 DES_FD11_BPCM 0;
BA_ "GenSigTimeoutTime_DTCM" SG_ 2654339142 DES_FD11_BPCM 0;
BA_ "GenSigTimeoutTime_DMSM" SG_ 2654339142 DES_FD11_BPCM 0;
BA_ "GenSigTimeoutTime_BSM" SG_ 2654339142 DES_FD11_BPCM 0;
BA_ "GenSigTimeoutTime_BCM" SG_ 2654339142 DES_FD11_BPCM 0;
BA_ "GenSigTimeoutTime_AGSM" SG_ 2654339142 DES_FD11_BPCM 0;
BA_ "GenSigTimeoutTime_ADCAM" SG_ 2654339142 DES_FD11_BPCM 0;
BA_ "GenSigTimeoutTime_SGW" SG_ 2654339142 WakeupSource_FD11_BPCM 0;
BA_ "GenSigTimeoutTime_RFHM" SG_ 2654339142 WakeupSource_FD11_BPCM 0;
BA_ "GenSigTimeoutTime_MPAD" SG_ 2654339142 WakeupSource_FD11_BPCM 0;
BA_ "GenSigTimeoutTime_IPC" SG_ 2654339142 WakeupSource_FD11_BPCM 0;
BA_ "GenSigTimeoutTime_GNMM" SG_ 2654339142 WakeupSource_FD11_BPCM 0;
BA_ "GenSigTimeoutTime_EVCU2" SG_ 2654339142 WakeupSource_FD11_BPCM 0;
BA_ "GenSigTimeoutTime_ESL" SG_ 2654339142 WakeupSource_FD11_BPCM 0;
BA_ "GenSigTimeoutTime_ECM" SG_ 2654339142 WakeupSource_FD11_BPCM 0;
BA_ "GenSigTimeoutTime_DTCM" SG_ 2654339142 WakeupSource_FD11_BPCM 0;
BA_ "GenSigTimeoutTime_DMSM" SG_ 2654339142 WakeupSource_FD11_BPCM 0;
BA_ "GenSigTimeoutTime_BSM" SG_ 2654339142 WakeupSource_FD11_BPCM 0;
BA_ "GenSigTimeoutTime_BCM" SG_ 2654339142 WakeupSource_FD11_BPCM 0;
BA_ "GenSigTimeoutTime_AGSM" SG_ 2654339142 WakeupSource_FD11_BPCM 0;
BA_ "GenSigTimeoutTime_ADCAM" SG_ 2654339142 WakeupSource_FD11_BPCM 0;
BA_ "GenSigTimeoutTime_SGW" SG_ 2654339142 CurrentCanNMState_FD11_BPCM 0;
BA_ "GenSigTimeoutTime_RFHM" SG_ 2654339142 CurrentCanNMState_FD11_BPCM 0;
BA_ "GenSigTimeoutTime_MPAD" SG_ 2654339142 CurrentCanNMState_FD11_BPCM 0;
BA_ "GenSigTimeoutTime_IPC" SG_ 2654339142 CurrentCanNMState_FD11_BPCM 0;
BA_ "GenSigTimeoutTime_GNMM" SG_ 2654339142 CurrentCanNMState_FD11_BPCM 0;
BA_ "GenSigTimeoutTime_EVCU2" SG_ 2654339142 CurrentCanNMState_FD11_BPCM 0;
BA_ "GenSigTimeoutTime_ESL" SG_ 2654339142 CurrentCanNMState_FD11_BPCM 0;
BA_ "GenSigTimeoutTime_ECM" SG_ 2654339142 CurrentCanNMState_FD11_BPCM 0;
BA_ "GenSigTimeoutTime_DTCM" SG_ 2654339142 CurrentCanNMState_FD11_BPCM 0;
BA_ "GenSigTimeoutTime_DMSM" SG_ 2654339142 CurrentCanNMState_FD11_BPCM 0;
BA_ "GenSigTimeoutTime_BSM" SG_ 2654339142 CurrentCanNMState_FD11_BPCM 0;
BA_ "GenSigTimeoutTime_BCM" SG_ 2654339142 CurrentCanNMState_FD11_BPCM 0;
BA_ "GenSigTimeoutTime_AGSM" SG_ 2654339142 CurrentCanNMState_FD11_BPCM 0;
BA_ "GenSigTimeoutTime_ADCAM" SG_ 2654339142 CurrentCanNMState_FD11_BPCM 0;
BA_ "GenSigTimeoutTime_ADCAM" SG_ 2654339136 GenericFailSts_FD03_EVCU2 0;
BA_ "GenSigTimeoutTime_DTCM" SG_ 2654339136 CurrentCanNMState_FD03_EVCU2 0;
BA_ "GenSigTimeoutTime_DMSM" SG_ 2654339136 CurrentCanNMState_FD03_EVCU2 0;
BA_ "GenSigTimeoutTime_BSM" SG_ 2654339136 CurrentCanNMState_FD03_EVCU2 0;
BA_ "GenSigTimeoutTime_BCM" SG_ 2654339136 CurrentCanNMState_FD03_EVCU2 0;
BA_ "GenSigTimeoutTime_AGSM" SG_ 2654339136 CurrentCanNMState_FD03_EVCU2 0;
BA_ "GenSigTimeoutTime_ADCAM" SG_ 2654339136 CurrentCanNMState_FD03_EVCU2 0;
BA_ "GenSigTimeoutTime_RFHM" SG_ 2654339136 CurrentCanNMState_FD03_EVCU2 0;
BA_ "GenSigTimeoutTime_MPAD" SG_ 2654339136 CurrentCanNMState_FD03_EVCU2 0;
BA_ "GenSigTimeoutTime_IPC" SG_ 2654339136 CurrentCanNMState_FD03_EVCU2 0;
BA_ "GenSigTimeoutTime_GNMM" SG_ 2654339136 CurrentCanNMState_FD03_EVCU2 0;
BA_ "GenSigTimeoutTime_EVCU2" SG_ 2654339136 CurrentCanNMState_FD03_EVCU2 0;
BA_ "GenSigTimeoutTime_ESL" SG_ 2654339136 CurrentCanNMState_FD03_EVCU2 0;
BA_ "GenSigTimeoutTime_ECM" SG_ 2654339136 CurrentCanNMState_FD03_EVCU2 0;
BA_ "GenSigTimeoutTime_RFHM" SG_ 2654339136 CurrentFailSts_FD03_EVCU2 0;
BA_ "GenSigTimeoutTime_MPAD" SG_ 2654339136 CurrentFailSts_FD03_EVCU2 0;
BA_ "GenSigTimeoutTime_IPC" SG_ 2654339136 CurrentFailSts_FD03_EVCU2 0;
BA_ "GenSigTimeoutTime_GNMM" SG_ 2654339136 CurrentFailSts_FD03_EVCU2 0;
BA_ "GenSigTimeoutTime_EVCU2" SG_ 2654339136 CurrentFailSts_FD03_EVCU2 0;
BA_ "GenSigTimeoutTime_ESL" SG_ 2654339136 CurrentFailSts_FD03_EVCU2 0;
BA_ "GenSigTimeoutTime_ECM" SG_ 2654339136 CurrentFailSts_FD03_EVCU2 0;
BA_ "GenSigTimeoutTime_DTCM" SG_ 2654339136 CurrentFailSts_FD03_EVCU2 0;
BA_ "GenSigTimeoutTime_DMSM" SG_ 2654339136 CurrentFailSts_FD03_EVCU2 0;
BA_ "GenSigTimeoutTime_BSM" SG_ 2654339136 CurrentFailSts_FD03_EVCU2 0;
BA_ "GenSigTimeoutTime_AGSM" SG_ 2654339136 CurrentFailSts_FD03_EVCU2 0;
BA_ "GenSigTimeoutTime_ADCAM" SG_ 2654339136 CurrentFailSts_FD03_EVCU2 0;
BA_ "GenSigTimeoutTime_RFHM" SG_ 2654339136 CurrentCanNMState_FD16_EVCU2 0;
BA_ "GenSigTimeoutTime_MPAD" SG_ 2654339136 CurrentCanNMState_FD16_EVCU2 0;
BA_ "GenSigTimeoutTime_IPC" SG_ 2654339136 CurrentCanNMState_FD16_EVCU2 0;
BA_ "GenSigTimeoutTime_GNMM" SG_ 2654339136 CurrentCanNMState_FD16_EVCU2 0;
BA_ "GenSigTimeoutTime_EVCU2" SG_ 2654339136 CurrentCanNMState_FD16_EVCU2 0;
BA_ "GenSigTimeoutTime_ESL" SG_ 2654339136 CurrentCanNMState_FD16_EVCU2 0;
BA_ "GenSigTimeoutTime_ECM" SG_ 2654339136 CurrentCanNMState_FD16_EVCU2 0;
BA_ "GenSigTimeoutTime_DTCM" SG_ 2654339136 CurrentCanNMState_FD16_EVCU2 0;
BA_ "GenSigTimeoutTime_DMSM" SG_ 2654339136 CurrentCanNMState_FD16_EVCU2 0;
BA_ "GenSigTimeoutTime_BSM" SG_ 2654339136 CurrentCanNMState_FD16_EVCU2 0;
BA_ "GenSigTimeoutTime_BCM" SG_ 2654339136 CurrentCanNMState_FD16_EVCU2 0;
BA_ "GenSigTimeoutTime_AGSM" SG_ 2654339136 CurrentCanNMState_FD16_EVCU2 0;
BA_ "GenSigTimeoutTime_ADCAM" SG_ 2654339136 CurrentCanNMState_FD16_EVCU2 0;
BA_ "GenSigTimeoutTime_RFHM" SG_ 2654339136 CurrentCanNMState_FD11_EVCU2 0;
BA_ "GenSigTimeoutTime_MPAD" SG_ 2654339136 CurrentCanNMState_FD11_EVCU2 0;
BA_ "GenSigTimeoutTime_IPC" SG_ 2654339136 CurrentCanNMState_FD11_EVCU2 0;
BA_ "GenSigTimeoutTime_GNMM" SG_ 2654339136 CurrentCanNMState_FD11_EVCU2 0;
BA_ "GenSigTimeoutTime_EVCU2" SG_ 2654339136 CurrentCanNMState_FD11_EVCU2 0;
BA_ "GenSigTimeoutTime_ESL" SG_ 2654339136 CurrentCanNMState_FD11_EVCU2 0;
BA_ "GenSigTimeoutTime_ECM" SG_ 2654339136 CurrentCanNMState_FD11_EVCU2 0;
BA_ "GenSigTimeoutTime_DTCM" SG_ 2654339136 CurrentCanNMState_FD11_EVCU2 0;
BA_ "GenSigTimeoutTime_DMSM" SG_ 2654339136 CurrentCanNMState_FD11_EVCU2 0;
BA_ "GenSigTimeoutTime_BSM" SG_ 2654339136 CurrentCanNMState_FD11_EVCU2 0;
BA_ "GenSigTimeoutTime_BCM" SG_ 2654339136 CurrentCanNMState_FD11_EVCU2 0;
BA_ "GenSigTimeoutTime_AGSM" SG_ 2654339136 CurrentCanNMState_FD11_EVCU2 0;
BA_ "GenSigTimeoutTime_ADCAM" SG_ 2654339136 CurrentCanNMState_FD11_EVCU2 0;
BA_ "GenSigTimeoutTime_RFHM" SG_ 2654339136 CurrentCanNMState_FD05_EVCU2 0;
BA_ "GenSigTimeoutTime_MPAD" SG_ 2654339136 CurrentCanNMState_FD05_EVCU2 0;
BA_ "GenSigTimeoutTime_IPC" SG_ 2654339136 CurrentCanNMState_FD05_EVCU2 0;
BA_ "GenSigTimeoutTime_GNMM" SG_ 2654339136 CurrentCanNMState_FD05_EVCU2 0;
BA_ "GenSigTimeoutTime_EVCU2" SG_ 2654339136 CurrentCanNMState_FD05_EVCU2 0;
BA_ "GenSigTimeoutTime_ESL" SG_ 2654339136 CurrentCanNMState_FD05_EVCU2 0;
BA_ "GenSigTimeoutTime_ECM" SG_ 2654339136 CurrentCanNMState_FD05_EVCU2 0;
BA_ "GenSigTimeoutTime_DTCM" SG_ 2654339136 CurrentCanNMState_FD05_EVCU2 0;
BA_ "GenSigTimeoutTime_DMSM" SG_ 2654339136 CurrentCanNMState_FD05_EVCU2 0;
BA_ "GenSigTimeoutTime_BSM" SG_ 2654339136 CurrentCanNMState_FD05_EVCU2 0;
BA_ "GenSigTimeoutTime_BCM" SG_ 2654339136 CurrentCanNMState_FD05_EVCU2 0;
BA_ "GenSigTimeoutTime_AGSM" SG_ 2654339136 CurrentCanNMState_FD05_EVCU2 0;
BA_ "GenSigTimeoutTime_ADCAM" SG_ 2654339136 CurrentCanNMState_FD05_EVCU2 0;
BA_ "GenSigTimeoutTime_RFHM" SG_ 2654339136 EOL_FD03_EVCU2 0;
BA_ "GenSigTimeoutTime_MPAD" SG_ 2654339136 EOL_FD03_EVCU2 0;
BA_ "GenSigTimeoutTime_IPC" SG_ 2654339136 EOL_FD03_EVCU2 0;
BA_ "GenSigTimeoutTime_GNMM" SG_ 2654339136 EOL_FD03_EVCU2 0;
BA_ "GenSigTimeoutTime_EVCU2" SG_ 2654339136 EOL_FD03_EVCU2 0;
BA_ "GenSigTimeoutTime_ESL" SG_ 2654339136 EOL_FD03_EVCU2 0;
BA_ "GenSigTimeoutTime_ECM" SG_ 2654339136 EOL_FD03_EVCU2 0;
BA_ "GenSigTimeoutTime_DTCM" SG_ 2654339136 EOL_FD03_EVCU2 0;
BA_ "GenSigTimeoutTime_DMSM" SG_ 2654339136 EOL_FD03_EVCU2 0;
BA_ "GenSigTimeoutTime_BSM" SG_ 2654339136 EOL_FD03_EVCU2 0;
BA_ "GenSigTimeoutTime_AGSM" SG_ 2654339136 EOL_FD03_EVCU2 0;
BA_ "GenSigTimeoutTime_ADCAM" SG_ 2654339136 EOL_FD03_EVCU2 0;
BA_ "GenSigTimeoutTime_RFHM" SG_ 2654339136 DES_FD16_EVCU2 0;
BA_ "GenSigTimeoutTime_MPAD" SG_ 2654339136 DES_FD16_EVCU2 0;
BA_ "GenSigTimeoutTime_IPC" SG_ 2654339136 DES_FD16_EVCU2 0;
BA_ "GenSigTimeoutTime_GNMM" SG_ 2654339136 DES_FD16_EVCU2 0;
BA_ "GenSigTimeoutTime_EVCU2" SG_ 2654339136 DES_FD16_EVCU2 0;
BA_ "GenSigTimeoutTime_ESL" SG_ 2654339136 DES_FD16_EVCU2 0;
BA_ "GenSigTimeoutTime_ECM" SG_ 2654339136 DES_FD16_EVCU2 0;
BA_ "GenSigTimeoutTime_DTCM" SG_ 2654339136 DES_FD16_EVCU2 0;
BA_ "GenSigTimeoutTime_DMSM" SG_ 2654339136 DES_FD16_EVCU2 0;
BA_ "GenSigTimeoutTime_BSM" SG_ 2654339136 DES_FD16_EVCU2 0;
BA_ "GenSigTimeoutTime_BCM" SG_ 2654339136 DES_FD16_EVCU2 0;
BA_ "GenSigTimeoutTime_AGSM" SG_ 2654339136 DES_FD16_EVCU2 0;
BA_ "GenSigTimeoutTime_ADCAM" SG_ 2654339136 DES_FD16_EVCU2 0;
BA_ "GenSigTimeoutTime_RFHM" SG_ 2654339136 DES_FD11_EVCU2 0;
BA_ "GenSigTimeoutTime_MPAD" SG_ 2654339136 DES_FD11_EVCU2 0;
BA_ "GenSigTimeoutTime_IPC" SG_ 2654339136 DES_FD11_EVCU2 0;
BA_ "GenSigTimeoutTime_GNMM" SG_ 2654339136 DES_FD11_EVCU2 0;
BA_ "GenSigTimeoutTime_EVCU2" SG_ 2654339136 DES_FD11_EVCU2 0;
BA_ "GenSigTimeoutTime_ESL" SG_ 2654339136 DES_FD11_EVCU2 0;
BA_ "GenSigTimeoutTime_ECM" SG_ 2654339136 DES_FD11_EVCU2 0;
BA_ "GenSigTimeoutTime_DTCM" SG_ 2654339136 DES_FD11_EVCU2 0;
BA_ "GenSigTimeoutTime_DMSM" SG_ 2654339136 DES_FD11_EVCU2 0;
BA_ "GenSigTimeoutTime_BSM" SG_ 2654339136 DES_FD11_EVCU2 0;
BA_ "GenSigTimeoutTime_BCM" SG_ 2654339136 DES_FD11_EVCU2 0;
BA_ "GenSigTimeoutTime_AGSM" SG_ 2654339136 DES_FD11_EVCU2 0;
BA_ "GenSigTimeoutTime_ADCAM" SG_ 2654339136 DES_FD11_EVCU2 0;
BA_ "GenSigTimeoutTime_RFHM" SG_ 2654339136 DES_FD05_EVCU2 0;
BA_ "GenSigTimeoutTime_MPAD" SG_ 2654339136 DES_FD05_EVCU2 0;
BA_ "GenSigTimeoutTime_IPC" SG_ 2654339136 DES_FD05_EVCU2 0;
BA_ "GenSigTimeoutTime_GNMM" SG_ 2654339136 DES_FD05_EVCU2 0;
BA_ "GenSigTimeoutTime_EVCU2" SG_ 2654339136 DES_FD05_EVCU2 0;
BA_ "GenSigTimeoutTime_ESL" SG_ 2654339136 DES_FD05_EVCU2 0;
BA_ "GenSigTimeoutTime_ECM" SG_ 2654339136 DES_FD05_EVCU2 0;
BA_ "GenSigTimeoutTime_DTCM" SG_ 2654339136 DES_FD05_EVCU2 0;
BA_ "GenSigTimeoutTime_DMSM" SG_ 2654339136 DES_FD05_EVCU2 0;
BA_ "GenSigTimeoutTime_BSM" SG_ 2654339136 DES_FD05_EVCU2 0;
BA_ "GenSigTimeoutTime_BCM" SG_ 2654339136 DES_FD05_EVCU2 0;
BA_ "GenSigTimeoutTime_AGSM" SG_ 2654339136 DES_FD05_EVCU2 0;
BA_ "GenSigTimeoutTime_ADCAM" SG_ 2654339136 DES_FD05_EVCU2 0;
BA_ "GenSigTimeoutTime_RFHM" SG_ 2654339136 DES_FD03_EVCU2 0;
BA_ "GenSigTimeoutTime_MPAD" SG_ 2654339136 DES_FD03_EVCU2 0;
BA_ "GenSigTimeoutTime_IPC" SG_ 2654339136 DES_FD03_EVCU2 0;
BA_ "GenSigTimeoutTime_GNMM" SG_ 2654339136 DES_FD03_EVCU2 0;
BA_ "GenSigTimeoutTime_EVCU2" SG_ 2654339136 DES_FD03_EVCU2 0;
BA_ "GenSigTimeoutTime_ESL" SG_ 2654339136 DES_FD03_EVCU2 0;
BA_ "GenSigTimeoutTime_ECM" SG_ 2654339136 DES_FD03_EVCU2 0;
BA_ "GenSigTimeoutTime_DTCM" SG_ 2654339136 DES_FD03_EVCU2 0;
BA_ "GenSigTimeoutTime_DMSM" SG_ 2654339136 DES_FD03_EVCU2 0;
BA_ "GenSigTimeoutTime_BSM" SG_ 2654339136 DES_FD03_EVCU2 0;
BA_ "GenSigTimeoutTime_BCM" SG_ 2654339136 DES_FD03_EVCU2 0;
BA_ "GenSigTimeoutTime_AGSM" SG_ 2654339136 DES_FD03_EVCU2 0;
BA_ "GenSigTimeoutTime_ADCAM" SG_ 2654339136 DES_FD03_EVCU2 0;
BA_ "GenSigTimeoutTime_RFHM" SG_ 2654339136 CurrentFailSts_FD16_EVCU2 0;
BA_ "GenSigTimeoutTime_MPAD" SG_ 2654339136 CurrentFailSts_FD16_EVCU2 0;
BA_ "GenSigTimeoutTime_IPC" SG_ 2654339136 CurrentFailSts_FD16_EVCU2 0;
BA_ "GenSigTimeoutTime_GNMM" SG_ 2654339136 CurrentFailSts_FD16_EVCU2 0;
BA_ "GenSigTimeoutTime_EVCU2" SG_ 2654339136 CurrentFailSts_FD16_EVCU2 0;
BA_ "GenSigTimeoutTime_ESL" SG_ 2654339136 CurrentFailSts_FD16_EVCU2 0;
BA_ "GenSigTimeoutTime_ECM" SG_ 2654339136 CurrentFailSts_FD16_EVCU2 0;
BA_ "GenSigTimeoutTime_DTCM" SG_ 2654339136 CurrentFailSts_FD16_EVCU2 0;
BA_ "GenSigTimeoutTime_DMSM" SG_ 2654339136 CurrentFailSts_FD16_EVCU2 0;
BA_ "GenSigTimeoutTime_BSM" SG_ 2654339136 CurrentFailSts_FD16_EVCU2 0;
BA_ "GenSigTimeoutTime_BCM" SG_ 2654339136 CurrentFailSts_FD16_EVCU2 0;
BA_ "GenSigTimeoutTime_AGSM" SG_ 2654339136 CurrentFailSts_FD16_EVCU2 0;
BA_ "GenSigTimeoutTime_ADCAM" SG_ 2654339136 CurrentFailSts_FD16_EVCU2 0;
BA_ "GenSigTimeoutTime_RFHM" SG_ 2654339136 CurrentFailSts_FD11_EVCU2 0;
BA_ "GenSigTimeoutTime_MPAD" SG_ 2654339136 CurrentFailSts_FD11_EVCU2 0;
BA_ "GenSigTimeoutTime_IPC" SG_ 2654339136 CurrentFailSts_FD11_EVCU2 0;
BA_ "GenSigTimeoutTime_GNMM" SG_ 2654339136 CurrentFailSts_FD11_EVCU2 0;
BA_ "GenSigTimeoutTime_EVCU2" SG_ 2654339136 CurrentFailSts_FD11_EVCU2 0;
BA_ "GenSigTimeoutTime_ESL" SG_ 2654339136 CurrentFailSts_FD11_EVCU2 0;
BA_ "GenSigTimeoutTime_ECM" SG_ 2654339136 CurrentFailSts_FD11_EVCU2 0;
BA_ "GenSigTimeoutTime_DTCM" SG_ 2654339136 CurrentFailSts_FD11_EVCU2 0;
BA_ "GenSigTimeoutTime_DMSM" SG_ 2654339136 CurrentFailSts_FD11_EVCU2 0;
BA_ "GenSigTimeoutTime_BSM" SG_ 2654339136 CurrentFailSts_FD11_EVCU2 0;
BA_ "GenSigTimeoutTime_BCM" SG_ 2654339136 CurrentFailSts_FD11_EVCU2 0;
BA_ "GenSigTimeoutTime_AGSM" SG_ 2654339136 CurrentFailSts_FD11_EVCU2 0;
BA_ "GenSigTimeoutTime_ADCAM" SG_ 2654339136 CurrentFailSts_FD11_EVCU2 0;
BA_ "GenSigTimeoutTime_RFHM" SG_ 2654339136 CurrentFailSts_FD05_EVCU2 0;
BA_ "GenSigTimeoutTime_MPAD" SG_ 2654339136 CurrentFailSts_FD05_EVCU2 0;
BA_ "GenSigTimeoutTime_IPC" SG_ 2654339136 CurrentFailSts_FD05_EVCU2 0;
BA_ "GenSigTimeoutTime_GNMM" SG_ 2654339136 CurrentFailSts_FD05_EVCU2 0;
BA_ "GenSigTimeoutTime_EVCU2" SG_ 2654339136 CurrentFailSts_FD05_EVCU2 0;
BA_ "GenSigTimeoutTime_ESL" SG_ 2654339136 CurrentFailSts_FD05_EVCU2 0;
BA_ "GenSigTimeoutTime_ECM" SG_ 2654339136 CurrentFailSts_FD05_EVCU2 0;
BA_ "GenSigTimeoutTime_DTCM" SG_ 2654339136 CurrentFailSts_FD05_EVCU2 0;
BA_ "GenSigTimeoutTime_DMSM" SG_ 2654339136 CurrentFailSts_FD05_EVCU2 0;
BA_ "GenSigTimeoutTime_BSM" SG_ 2654339136 CurrentFailSts_FD05_EVCU2 0;
BA_ "GenSigTimeoutTime_BCM" SG_ 2654339136 CurrentFailSts_FD05_EVCU2 0;
BA_ "GenSigTimeoutTime_AGSM" SG_ 2654339136 CurrentFailSts_FD05_EVCU2 0;
BA_ "GenSigTimeoutTime_ADCAM" SG_ 2654339136 CurrentFailSts_FD05_EVCU2 0;
BA_ "GenSigTimeoutTime_RFHM" SG_ 2654339136 EOL_FD16_EVCU2 0;
BA_ "GenSigTimeoutTime_MPAD" SG_ 2654339136 EOL_FD16_EVCU2 0;
BA_ "GenSigTimeoutTime_IPC" SG_ 2654339136 EOL_FD16_EVCU2 0;
BA_ "GenSigTimeoutTime_GNMM" SG_ 2654339136 EOL_FD16_EVCU2 0;
BA_ "GenSigTimeoutTime_EVCU2" SG_ 2654339136 EOL_FD16_EVCU2 0;
BA_ "GenSigTimeoutTime_ESL" SG_ 2654339136 EOL_FD16_EVCU2 0;
BA_ "GenSigTimeoutTime_ECM" SG_ 2654339136 EOL_FD16_EVCU2 0;
BA_ "GenSigTimeoutTime_DTCM" SG_ 2654339136 EOL_FD16_EVCU2 0;
BA_ "GenSigTimeoutTime_DMSM" SG_ 2654339136 EOL_FD16_EVCU2 0;
BA_ "GenSigTimeoutTime_BSM" SG_ 2654339136 EOL_FD16_EVCU2 0;
BA_ "GenSigTimeoutTime_BCM" SG_ 2654339136 EOL_FD16_EVCU2 0;
BA_ "GenSigTimeoutTime_AGSM" SG_ 2654339136 EOL_FD16_EVCU2 0;
BA_ "GenSigTimeoutTime_ADCAM" SG_ 2654339136 EOL_FD16_EVCU2 0;
BA_ "GenSigTimeoutTime_RFHM" SG_ 2654339136 EOL_FD11_EVCU2 0;
BA_ "GenSigTimeoutTime_MPAD" SG_ 2654339136 EOL_FD11_EVCU2 0;
BA_ "GenSigTimeoutTime_IPC" SG_ 2654339136 EOL_FD11_EVCU2 0;
BA_ "GenSigTimeoutTime_GNMM" SG_ 2654339136 EOL_FD11_EVCU2 0;
BA_ "GenSigTimeoutTime_EVCU2" SG_ 2654339136 EOL_FD11_EVCU2 0;
BA_ "GenSigTimeoutTime_ESL" SG_ 2654339136 EOL_FD11_EVCU2 0;
BA_ "GenSigTimeoutTime_ECM" SG_ 2654339136 EOL_FD11_EVCU2 0;
BA_ "GenSigTimeoutTime_DTCM" SG_ 2654339136 EOL_FD11_EVCU2 0;
BA_ "GenSigTimeoutTime_DMSM" SG_ 2654339136 EOL_FD11_EVCU2 0;
BA_ "GenSigTimeoutTime_BSM" SG_ 2654339136 EOL_FD11_EVCU2 0;
BA_ "GenSigTimeoutTime_BCM" SG_ 2654339136 EOL_FD11_EVCU2 0;
BA_ "GenSigTimeoutTime_AGSM" SG_ 2654339136 EOL_FD11_EVCU2 0;
BA_ "GenSigTimeoutTime_ADCAM" SG_ 2654339136 EOL_FD11_EVCU2 0;
BA_ "GenSigTimeoutTime_RFHM" SG_ 2654339136 EOL_FD05_EVCU2 0;
BA_ "GenSigTimeoutTime_MPAD" SG_ 2654339136 EOL_FD05_EVCU2 0;
BA_ "GenSigTimeoutTime_IPC" SG_ 2654339136 EOL_FD05_EVCU2 0;
BA_ "GenSigTimeoutTime_GNMM" SG_ 2654339136 EOL_FD05_EVCU2 0;
BA_ "GenSigTimeoutTime_EVCU2" SG_ 2654339136 EOL_FD05_EVCU2 0;
BA_ "GenSigTimeoutTime_ESL" SG_ 2654339136 EOL_FD05_EVCU2 0;
BA_ "GenSigTimeoutTime_ECM" SG_ 2654339136 EOL_FD05_EVCU2 0;
BA_ "GenSigTimeoutTime_DTCM" SG_ 2654339136 EOL_FD05_EVCU2 0;
BA_ "GenSigTimeoutTime_DMSM" SG_ 2654339136 EOL_FD05_EVCU2 0;
BA_ "GenSigTimeoutTime_BSM" SG_ 2654339136 EOL_FD05_EVCU2 0;
BA_ "GenSigTimeoutTime_BCM" SG_ 2654339136 EOL_FD05_EVCU2 0;
BA_ "GenSigTimeoutTime_AGSM" SG_ 2654339136 EOL_FD05_EVCU2 0;
BA_ "GenSigTimeoutTime_ADCAM" SG_ 2654339136 EOL_FD05_EVCU2 0;
BA_ "GenSigTimeoutTime_SGW" SG_ 263 DriverPowerReq_PT 0;
BA_ "GenSigTimeoutTime_RFHM" SG_ 263 DriverPowerReq_PT 0;
BA_ "GenSigTimeoutTime_MPAD" SG_ 263 DriverPowerReq_PT 0;
BA_ "GenSigTimeoutTime_IPC" SG_ 263 DriverPowerReq_PT 0;
BA_ "GenSigTimeoutTime_GNMM" SG_ 263 DriverPowerReq_PT 0;
BA_ "GenSigTimeoutTime_EVCU2" SG_ 263 DriverPowerReq_PT 0;
BA_ "GenSigTimeoutTime_ESL" SG_ 263 DriverPowerReq_PT 0;
BA_ "GenSigTimeoutTime_ECM" SG_ 263 DriverPowerReq_PT 0;
BA_ "GenSigTimeoutTime_DTCM" SG_ 263 DriverPowerReq_PT 0;
BA_ "GenSigTimeoutTime_DMSM" SG_ 263 DriverPowerReq_PT 0;
BA_ "GenSigTimeoutTime_BSM" SG_ 263 DriverPowerReq_PT 0;
BA_ "GenSigTimeoutTime_BCM" SG_ 263 DriverPowerReq_PT 0;
BA_ "GenSigTimeoutTime_AGSM" SG_ 263 DriverPowerReq_PT 0;
BA_ "GenSigTimeoutTime_ADCAM" SG_ 263 DriverPowerReq_PT 0;
BA_ "GenSigTimeoutTime_RFHM" SG_ 263 CruiseControlSts_PT 0;
BA_ "GenSigTimeoutTime_MPAD" SG_ 263 CruiseControlSts_PT 0;
BA_ "GenSigTimeoutTime_IPC" SG_ 263 CruiseControlSts_PT 0;
BA_ "GenSigTimeoutTime_GNMM" SG_ 263 CruiseControlSts_PT 0;
BA_ "GenSigTimeoutTime_EVCU2" SG_ 263 CruiseControlSts_PT 0;
BA_ "GenSigTimeoutTime_ESL" SG_ 263 CruiseControlSts_PT 0;
BA_ "GenSigTimeoutTime_ECM" SG_ 263 CruiseControlSts_PT 0;
BA_ "GenSigTimeoutTime_DTCM" SG_ 263 CruiseControlSts_PT 0;
BA_ "GenSigTimeoutTime_DMSM" SG_ 263 CruiseControlSts_PT 0;
BA_ "GenSigTimeoutTime_BSM" SG_ 263 CruiseControlSts_PT 0;
BA_ "GenSigTimeoutTime_BCM" SG_ 263 CruiseControlSts_PT 0;
BA_ "GenSigTimeoutTime_AGSM" SG_ 263 CruiseControlSts_PT 0;
BA_ "GenSigTimeoutTime_ADCAM" SG_ 263 CruiseControlSts_PT 0;
BA_ "GenSigTimeoutTime_RFHM" SG_ 263 CruiseControlLampSts_PT 0;
BA_ "GenSigTimeoutTime_MPAD" SG_ 263 CruiseControlLampSts_PT 0;
BA_ "GenSigTimeoutTime_IPC" SG_ 263 CruiseControlLampSts_PT 0;
BA_ "GenSigTimeoutTime_GNMM" SG_ 263 CruiseControlLampSts_PT 0;
BA_ "GenSigTimeoutTime_EVCU2" SG_ 263 CruiseControlLampSts_PT 0;
BA_ "GenSigTimeoutTime_ESL" SG_ 263 CruiseControlLampSts_PT 0;
BA_ "GenSigTimeoutTime_ECM" SG_ 263 CruiseControlLampSts_PT 0;
BA_ "GenSigTimeoutTime_DTCM" SG_ 263 CruiseControlLampSts_PT 0;
BA_ "GenSigTimeoutTime_DMSM" SG_ 263 CruiseControlLampSts_PT 0;
BA_ "GenSigTimeoutTime_BSM" SG_ 263 CruiseControlLampSts_PT 0;
BA_ "GenSigTimeoutTime_BCM" SG_ 263 CruiseControlLampSts_PT 0;
BA_ "GenSigTimeoutTime_AGSM" SG_ 263 CruiseControlLampSts_PT 0;
BA_ "GenSigTimeoutTime_ADCAM" SG_ 263 CruiseControlLampSts_PT 0;
BA_ "GenSigTimeoutTime_SGW" SG_ 263 DriveReady_PT 0;
BA_ "GenSigTimeoutTime_RFHM" SG_ 263 DriveReady_PT 0;
BA_ "GenSigTimeoutTime_MPAD" SG_ 263 DriveReady_PT 0;
BA_ "GenSigTimeoutTime_GNMM" SG_ 263 DriveReady_PT 0;
BA_ "GenSigTimeoutTime_EVCU2" SG_ 263 DriveReady_PT 0;
BA_ "GenSigTimeoutTime_ESL" SG_ 263 DriveReady_PT 0;
BA_ "GenSigTimeoutTime_ECM" SG_ 263 DriveReady_PT 0;
BA_ "GenSigTimeoutTime_DTCM" SG_ 263 DriveReady_PT 0;
BA_ "GenSigTimeoutTime_DMSM" SG_ 263 DriveReady_PT 0;
BA_ "GenSigTimeoutTime_AGSM" SG_ 263 DriveReady_PT 0;
BA_ "GenSigTimeoutTime_ADCAM" SG_ 263 DriveReady_PT 0;
BA_ "GenSigTimeoutTime_RFHM" SG_ 263 CRC_PT_SYSTEM_FD_1 0;
BA_ "GenSigTimeoutTime_EVCU2" SG_ 263 CRC_PT_SYSTEM_FD_1 0;
BA_ "GenSigTimeoutTime_ESL" SG_ 263 CRC_PT_SYSTEM_FD_1 0;
BA_ "GenSigTimeoutTime_ECM" SG_ 263 CRC_PT_SYSTEM_FD_1 0;
BA_ "GenSigTimeoutTime_DTCM" SG_ 263 CRC_PT_SYSTEM_FD_1 0;
BA_ "GenSigTimeoutTime_DMSM" SG_ 263 CRC_PT_SYSTEM_FD_1 0;
BA_ "GenSigTimeoutTime_BCM" SG_ 263 CRC_PT_SYSTEM_FD_1 0;
BA_ "GenSigTimeoutTime_MPAD" SG_ 263 CrankEnable_PT 0;
BA_ "GenSigTimeoutTime_IPC" SG_ 263 CrankEnable_PT 0;
BA_ "GenSigTimeoutTime_GNMM" SG_ 263 CrankEnable_PT 0;
BA_ "GenSigTimeoutTime_EVCU2" SG_ 263 CrankEnable_PT 0;
BA_ "GenSigTimeoutTime_ESL" SG_ 263 CrankEnable_PT 0;
BA_ "GenSigTimeoutTime_ECM" SG_ 263 CrankEnable_PT 0;
BA_ "GenSigTimeoutTime_DTCM" SG_ 263 CrankEnable_PT 0;
BA_ "GenSigTimeoutTime_DMSM" SG_ 263 CrankEnable_PT 0;
BA_ "GenSigTimeoutTime_BSM" SG_ 263 CrankEnable_PT 0;
BA_ "GenSigTimeoutTime_BCM" SG_ 263 CrankEnable_PT 0;
BA_ "GenSigTimeoutTime_AGSM" SG_ 263 CrankEnable_PT 0;
BA_ "GenSigTimeoutTime_ADCAM" SG_ 263 CrankEnable_PT 0;
BA_ "GenSigTimeoutTime_SGW" SG_ 263 CC_SetSpdDspl_KPH_PT 0;
BA_ "GenSigTimeoutTime_RFHM" SG_ 263 CC_SetSpdDspl_KPH_PT 0;
BA_ "GenSigTimeoutTime_MPAD" SG_ 263 CC_SetSpdDspl_KPH_PT 0;
BA_ "GenSigTimeoutTime_GNMM" SG_ 263 CC_SetSpdDspl_KPH_PT 0;
BA_ "GenSigTimeoutTime_EVCU2" SG_ 263 CC_SetSpdDspl_KPH_PT 0;
BA_ "GenSigTimeoutTime_ESL" SG_ 263 CC_SetSpdDspl_KPH_PT 0;
BA_ "GenSigTimeoutTime_ECM" SG_ 263 CC_SetSpdDspl_KPH_PT 0;
BA_ "GenSigTimeoutTime_DTCM" SG_ 263 CC_SetSpdDspl_KPH_PT 0;
BA_ "GenSigTimeoutTime_DMSM" SG_ 263 CC_SetSpdDspl_KPH_PT 0;
BA_ "GenSigTimeoutTime_BSM" SG_ 263 CC_SetSpdDspl_KPH_PT 0;
BA_ "GenSigTimeoutTime_BCM" SG_ 263 CC_SetSpdDspl_KPH_PT 0;
BA_ "GenSigTimeoutTime_AGSM" SG_ 263 CC_SetSpdDspl_KPH_PT 0;
BA_ "GenSigTimeoutTime_ADCAM" SG_ 263 CC_SetSpdDspl_KPH_PT 0;
BA_ "GenSigTimeoutTime_SGW" SG_ 263 Braking_Mode_Sts 0;
BA_ "GenSigTimeoutTime_RFHM" SG_ 263 Braking_Mode_Sts 0;
BA_ "GenSigTimeoutTime_MPAD" SG_ 263 Braking_Mode_Sts 0;
BA_ "GenSigTimeoutTime_IPC" SG_ 263 Braking_Mode_Sts 0;
BA_ "GenSigTimeoutTime_GNMM" SG_ 263 Braking_Mode_Sts 0;
BA_ "GenSigTimeoutTime_EVCU2" SG_ 263 Braking_Mode_Sts 0;
BA_ "GenSigTimeoutTime_ESL" SG_ 263 Braking_Mode_Sts 0;
BA_ "GenSigTimeoutTime_ECM" SG_ 263 Braking_Mode_Sts 0;
BA_ "GenSigTimeoutTime_DTCM" SG_ 263 Braking_Mode_Sts 0;
BA_ "GenSigTimeoutTime_DMSM" SG_ 263 Braking_Mode_Sts 0;
BA_ "GenSigTimeoutTime_BSM" SG_ 263 Braking_Mode_Sts 0;
BA_ "GenSigTimeoutTime_AGSM" SG_ 263 Braking_Mode_Sts 0;
BA_ "GenSigTimeoutTime_ADCAM" SG_ 263 Braking_Mode_Sts 0;
BA_ "GenSigTimeoutTime_SGW" SG_ 263 Braking_Mode_Indication_Sts 0;
BA_ "GenSigTimeoutTime_RFHM" SG_ 263 Braking_Mode_Indication_Sts 0;
BA_ "GenSigTimeoutTime_MPAD" SG_ 263 Braking_Mode_Indication_Sts 0;
BA_ "GenSigTimeoutTime_GNMM" SG_ 263 Braking_Mode_Indication_Sts 0;
BA_ "GenSigTimeoutTime_EVCU2" SG_ 263 Braking_Mode_Indication_Sts 0;
BA_ "GenSigTimeoutTime_ESL" SG_ 263 Braking_Mode_Indication_Sts 0;
BA_ "GenSigTimeoutTime_ECM" SG_ 263 Braking_Mode_Indication_Sts 0;
BA_ "GenSigTimeoutTime_DTCM" SG_ 263 Braking_Mode_Indication_Sts 0;
BA_ "GenSigTimeoutTime_DMSM" SG_ 263 Braking_Mode_Indication_Sts 0;
BA_ "GenSigTimeoutTime_BSM" SG_ 263 Braking_Mode_Indication_Sts 0;
BA_ "GenSigTimeoutTime_AGSM" SG_ 263 Braking_Mode_Indication_Sts 0;
BA_ "GenSigTimeoutTime_ADCAM" SG_ 263 Braking_Mode_Indication_Sts 0;
BA_ "GenSigTimeoutTime_SGW" SG_ 263 BPCM_HV_SOC1 0;
BA_ "GenSigTimeoutTime_RFHM" SG_ 263 BPCM_HV_SOC1 0;
BA_ "GenSigTimeoutTime_MPAD" SG_ 263 BPCM_HV_SOC1 0;
BA_ "GenSigTimeoutTime_IPC" SG_ 263 BPCM_HV_SOC1 0;
BA_ "GenSigTimeoutTime_GNMM" SG_ 263 BPCM_HV_SOC1 0;
BA_ "GenSigTimeoutTime_EVCU2" SG_ 263 BPCM_HV_SOC1 0;
BA_ "GenSigTimeoutTime_ESL" SG_ 263 BPCM_HV_SOC1 0;
BA_ "GenSigTimeoutTime_ECM" SG_ 263 BPCM_HV_SOC1 0;
BA_ "GenSigTimeoutTime_DTCM" SG_ 263 BPCM_HV_SOC1 0;
BA_ "GenSigTimeoutTime_DMSM" SG_ 263 BPCM_HV_SOC1 0;
BA_ "GenSigTimeoutTime_BCM" SG_ 263 BPCM_HV_SOC1 0;
BA_ "GenSigTimeoutTime_AGSM" SG_ 263 BPCM_HV_SOC1 0;
BA_ "GenSigTimeoutTime_ADCAM" SG_ 263 BPCM_HV_SOC1 0;
BA_ "GenSigTimeoutTime_RFHM" SG_ 263 AWD_SysStat 0;
BA_ "GenSigTimeoutTime_MPAD" SG_ 263 AWD_SysStat 0;
BA_ "GenSigTimeoutTime_IPC" SG_ 263 AWD_SysStat 0;
BA_ "GenSigTimeoutTime_GNMM" SG_ 263 AWD_SysStat 0;
BA_ "GenSigTimeoutTime_EVCU2" SG_ 263 AWD_SysStat 0;
BA_ "GenSigTimeoutTime_ESL" SG_ 263 AWD_SysStat 0;
BA_ "GenSigTimeoutTime_ECM" SG_ 263 AWD_SysStat 0;
BA_ "GenSigTimeoutTime_DTCM" SG_ 263 AWD_SysStat 0;
BA_ "GenSigTimeoutTime_DMSM" SG_ 263 AWD_SysStat 0;
BA_ "GenSigTimeoutTime_BCM" SG_ 263 AWD_SysStat 0;
BA_ "GenSigTimeoutTime_AGSM" SG_ 263 AWD_SysStat 0;
BA_ "GenSigTimeoutTime_ADCAM" SG_ 263 AWD_SysStat 0;
BA_ "GenSigTimeoutTime_RFHM" SG_ 263 AWD_Status_PT 0;
BA_ "GenSigTimeoutTime_MPAD" SG_ 263 AWD_Status_PT 0;
BA_ "GenSigTimeoutTime_IPC" SG_ 263 AWD_Status_PT 0;
BA_ "GenSigTimeoutTime_GNMM" SG_ 263 AWD_Status_PT 0;
BA_ "GenSigTimeoutTime_EVCU2" SG_ 263 AWD_Status_PT 0;
BA_ "GenSigTimeoutTime_ESL" SG_ 263 AWD_Status_PT 0;
BA_ "GenSigTimeoutTime_ECM" SG_ 263 AWD_Status_PT 0;
BA_ "GenSigTimeoutTime_DTCM" SG_ 263 AWD_Status_PT 0;
BA_ "GenSigTimeoutTime_DMSM" SG_ 263 AWD_Status_PT 0;
BA_ "GenSigTimeoutTime_BSM" SG_ 263 AWD_Status_PT 0;
BA_ "GenSigTimeoutTime_AGSM" SG_ 263 AWD_Status_PT 0;
BA_ "GenSigTimeoutTime_ADCAM" SG_ 263 AWD_Status_PT 0;
BA_ "GenSigTimeoutTime_MPAD" SG_ 263 AtmosphericPressure_PT 0;
BA_ "GenSigTimeoutTime_IPC" SG_ 263 AtmosphericPressure_PT 0;
BA_ "GenSigTimeoutTime_GNMM" SG_ 263 AtmosphericPressure_PT 0;
BA_ "GenSigTimeoutTime_EVCU2" SG_ 263 AtmosphericPressure_PT 0;
BA_ "GenSigTimeoutTime_ESL" SG_ 263 AtmosphericPressure_PT 0;
BA_ "GenSigTimeoutTime_ECM" SG_ 263 AtmosphericPressure_PT 0;
BA_ "GenSigTimeoutTime_DTCM" SG_ 263 AtmosphericPressure_PT 0;
BA_ "GenSigTimeoutTime_DMSM" SG_ 263 AtmosphericPressure_PT 0;
BA_ "GenSigTimeoutTime_BSM" SG_ 263 AtmosphericPressure_PT 0;
BA_ "GenSigTimeoutTime_BCM" SG_ 263 AtmosphericPressure_PT 0;
BA_ "GenSigTimeoutTime_AGSM" SG_ 263 AtmosphericPressure_PT 0;
BA_ "GenSigTimeoutTime_ADCAM" SG_ 263 AtmosphericPressure_PT 0;
BA_ "GenSigTimeoutTime_SGW" SG_ 263 APCM_Rq_PT 0;
BA_ "GenSigTimeoutTime_RFHM" SG_ 263 APCM_Rq_PT 0;
BA_ "GenSigTimeoutTime_MPAD" SG_ 263 APCM_Rq_PT 0;
BA_ "GenSigTimeoutTime_IPC" SG_ 263 APCM_Rq_PT 0;
BA_ "GenSigTimeoutTime_GNMM" SG_ 263 APCM_Rq_PT 0;
BA_ "GenSigTimeoutTime_EVCU2" SG_ 263 APCM_Rq_PT 0;
BA_ "GenSigTimeoutTime_ESL" SG_ 263 APCM_Rq_PT 0;
BA_ "GenSigTimeoutTime_ECM" SG_ 263 APCM_Rq_PT 0;
BA_ "GenSigTimeoutTime_DTCM" SG_ 263 APCM_Rq_PT 0;
BA_ "GenSigTimeoutTime_DMSM" SG_ 263 APCM_Rq_PT 0;
BA_ "GenSigTimeoutTime_BSM" SG_ 263 APCM_Rq_PT 0;
BA_ "GenSigTimeoutTime_BCM" SG_ 263 APCM_Rq_PT 0;
BA_ "GenSigTimeoutTime_ADCAM" SG_ 263 APCM_Rq_PT 0;
BA_ "GenSigTimeoutTime_RFHM" SG_ 263 AlternatorFail_PT 0;
BA_ "GenSigTimeoutTime_MPAD" SG_ 263 AlternatorFail_PT 0;
BA_ "GenSigTimeoutTime_GNMM" SG_ 263 AlternatorFail_PT 0;
BA_ "GenSigTimeoutTime_EVCU2" SG_ 263 AlternatorFail_PT 0;
BA_ "GenSigTimeoutTime_ESL" SG_ 263 AlternatorFail_PT 0;
BA_ "GenSigTimeoutTime_ECM" SG_ 263 AlternatorFail_PT 0;
BA_ "GenSigTimeoutTime_DTCM" SG_ 263 AlternatorFail_PT 0;
BA_ "GenSigTimeoutTime_DMSM" SG_ 263 AlternatorFail_PT 0;
BA_ "GenSigTimeoutTime_BSM" SG_ 263 AlternatorFail_PT 0;
BA_ "GenSigTimeoutTime_BCM" SG_ 263 AlternatorFail_PT 0;
BA_ "GenSigTimeoutTime_AGSM" SG_ 263 AlternatorFail_PT 0;
BA_ "GenSigTimeoutTime_ADCAM" SG_ 263 AlternatorFail_PT 0;
BA_ "GenSigTimeoutTime_SGW" SG_ 263 AHH_Modify_Accel_Rq 0;
BA_ "GenSigTimeoutTime_RFHM" SG_ 263 AHH_Modify_Accel_Rq 0;
BA_ "GenSigTimeoutTime_MPAD" SG_ 263 AHH_Modify_Accel_Rq 0;
BA_ "GenSigTimeoutTime_IPC" SG_ 263 AHH_Modify_Accel_Rq 0;
BA_ "GenSigTimeoutTime_GNMM" SG_ 263 AHH_Modify_Accel_Rq 0;
BA_ "GenSigTimeoutTime_EVCU2" SG_ 263 AHH_Modify_Accel_Rq 0;
BA_ "GenSigTimeoutTime_ESL" SG_ 263 AHH_Modify_Accel_Rq 0;
BA_ "GenSigTimeoutTime_ECM" SG_ 263 AHH_Modify_Accel_Rq 0;
BA_ "GenSigTimeoutTime_DTCM" SG_ 263 AHH_Modify_Accel_Rq 0;
BA_ "GenSigTimeoutTime_DMSM" SG_ 263 AHH_Modify_Accel_Rq 0;
BA_ "GenSigTimeoutTime_BSM" SG_ 263 AHH_Modify_Accel_Rq 0;
BA_ "GenSigTimeoutTime_BCM" SG_ 263 AHH_Modify_Accel_Rq 0;
BA_ "GenSigTimeoutTime_AGSM" SG_ 263 AHH_Modify_Accel_Rq 0;
BA_ "GenSigTimeoutTime_ADCAM" SG_ 263 AHH_Modify_Accel_Rq 0;
BA_ "GenSigTimeoutTime_SGW" SG_ 263 AHH_Apply_Release_Rqst 0;
BA_ "GenSigTimeoutTime_RFHM" SG_ 263 AHH_Apply_Release_Rqst 0;
BA_ "GenSigTimeoutTime_MPAD" SG_ 263 AHH_Apply_Release_Rqst 0;
BA_ "GenSigTimeoutTime_IPC" SG_ 263 AHH_Apply_Release_Rqst 0;
BA_ "GenSigTimeoutTime_GNMM" SG_ 263 AHH_Apply_Release_Rqst 0;
BA_ "GenSigTimeoutTime_EVCU2" SG_ 263 AHH_Apply_Release_Rqst 0;
BA_ "GenSigTimeoutTime_ESL" SG_ 263 AHH_Apply_Release_Rqst 0;
BA_ "GenSigTimeoutTime_ECM" SG_ 263 AHH_Apply_Release_Rqst 0;
BA_ "GenSigTimeoutTime_DTCM" SG_ 263 AHH_Apply_Release_Rqst 0;
BA_ "GenSigTimeoutTime_DMSM" SG_ 263 AHH_Apply_Release_Rqst 0;
BA_ "GenSigTimeoutTime_BCM" SG_ 263 AHH_Apply_Release_Rqst 0;
BA_ "GenSigTimeoutTime_AGSM" SG_ 263 AHH_Apply_Release_Rqst 0;
BA_ "GenSigTimeoutTime_ADCAM" SG_ 263 AHH_Apply_Release_Rqst 0;
BA_ "GenSigTimeoutTime_RFHM" SG_ 263 CC_SetSpdDspl_MPH_PT 0;
BA_ "GenSigTimeoutTime_MPAD" SG_ 263 CC_SetSpdDspl_MPH_PT 0;
BA_ "GenSigTimeoutTime_GNMM" SG_ 263 CC_SetSpdDspl_MPH_PT 0;
BA_ "GenSigTimeoutTime_EVCU2" SG_ 263 CC_SetSpdDspl_MPH_PT 0;
BA_ "GenSigTimeoutTime_ESL" SG_ 263 CC_SetSpdDspl_MPH_PT 0;
BA_ "GenSigTimeoutTime_ECM" SG_ 263 CC_SetSpdDspl_MPH_PT 0;
BA_ "GenSigTimeoutTime_DTCM" SG_ 263 CC_SetSpdDspl_MPH_PT 0;
BA_ "GenSigTimeoutTime_DMSM" SG_ 263 CC_SetSpdDspl_MPH_PT 0;
BA_ "GenSigTimeoutTime_BSM" SG_ 263 CC_SetSpdDspl_MPH_PT 0;
BA_ "GenSigTimeoutTime_AGSM" SG_ 263 CC_SetSpdDspl_MPH_PT 0;
BA_ "GenSigTimeoutTime_ADCAM" SG_ 263 CC_SetSpdDspl_MPH_PT 0;
BA_ "GenSigTimeoutTime_BSM" SG_ 2654339073 EOL_FD03_ECM 0;
BA_ "GenSigTimeoutTime_AGSM" SG_ 2654339073 EOL_FD03_ECM 0;
BA_ "GenSigTimeoutTime_ADCAM" SG_ 2654339073 EOL_FD03_ECM 0;
BA_ "GenSigTimeoutTime_RFHM" SG_ 2654339073 DES_FD03_ECM 0;
BA_ "GenSigTimeoutTime_MPAD" SG_ 2654339073 DES_FD03_ECM 0;
BA_ "GenSigTimeoutTime_IPC" SG_ 2654339073 DES_FD03_ECM 0;
BA_ "GenSigTimeoutTime_GNMM" SG_ 2654339073 DES_FD03_ECM 0;
BA_ "GenSigTimeoutTime_EVCU2" SG_ 2654339073 DES_FD03_ECM 0;
BA_ "GenSigTimeoutTime_ESL" SG_ 2654339073 DES_FD03_ECM 0;
BA_ "GenSigTimeoutTime_ECM" SG_ 2654339073 DES_FD03_ECM 0;
BA_ "GenSigTimeoutTime_DTCM" SG_ 2654339073 DES_FD03_ECM 0;
BA_ "GenSigTimeoutTime_DMSM" SG_ 2654339073 DES_FD03_ECM 0;
BA_ "GenSigTimeoutTime_BSM" SG_ 2654339073 DES_FD03_ECM 0;
BA_ "GenSigTimeoutTime_BCM" SG_ 2654339073 DES_FD03_ECM 0;
BA_ "GenSigTimeoutTime_AGSM" SG_ 2654339073 DES_FD03_ECM 0;
BA_ "GenSigTimeoutTime_ADCAM" SG_ 2654339073 DES_FD03_ECM 0;
BA_ "GenSigTimeoutTime_RFHM" SG_ 2654339073 CurrentFailSts_FD03_ECM 0;
BA_ "GenSigTimeoutTime_MPAD" SG_ 2654339073 CurrentFailSts_FD03_ECM 0;
BA_ "GenSigTimeoutTime_IPC" SG_ 2654339073 CurrentFailSts_FD03_ECM 0;
BA_ "GenSigTimeoutTime_GNMM" SG_ 2654339073 CurrentFailSts_FD03_ECM 0;
BA_ "GenSigTimeoutTime_EVCU2" SG_ 2654339073 CurrentFailSts_FD03_ECM 0;
BA_ "GenSigTimeoutTime_ESL" SG_ 2654339073 CurrentFailSts_FD03_ECM 0;
BA_ "GenSigTimeoutTime_ECM" SG_ 2654339073 CurrentFailSts_FD03_ECM 0;
BA_ "GenSigTimeoutTime_DTCM" SG_ 2654339073 CurrentFailSts_FD03_ECM 0;
BA_ "GenSigTimeoutTime_DMSM" SG_ 2654339073 CurrentFailSts_FD03_ECM 0;
BA_ "GenSigTimeoutTime_BSM" SG_ 2654339073 CurrentFailSts_FD03_ECM 0;
BA_ "GenSigTimeoutTime_AGSM" SG_ 2654339073 CurrentFailSts_FD03_ECM 0;
BA_ "GenSigTimeoutTime_ADCAM" SG_ 2654339073 CurrentFailSts_FD03_ECM 0;
BA_ "GenSigTimeoutTime_RFHM" SG_ 2654339073 StayActiveSource_FD03_ECM 0;
BA_ "GenSigTimeoutTime_MPAD" SG_ 2654339073 StayActiveSource_FD03_ECM 0;
BA_ "GenSigTimeoutTime_IPC" SG_ 2654339073 StayActiveSource_FD03_ECM 0;
BA_ "GenSigTimeoutTime_GNMM" SG_ 2654339073 StayActiveSource_FD03_ECM 0;
BA_ "GenSigTimeoutTime_EVCU2" SG_ 2654339073 StayActiveSource_FD03_ECM 0;
BA_ "GenSigTimeoutTime_ESL" SG_ 2654339073 StayActiveSource_FD03_ECM 0;
BA_ "GenSigTimeoutTime_ECM" SG_ 2654339073 StayActiveSource_FD03_ECM 0;
BA_ "GenSigTimeoutTime_DTCM" SG_ 2654339073 StayActiveSource_FD03_ECM 0;
BA_ "GenSigTimeoutTime_DMSM" SG_ 2654339073 StayActiveSource_FD03_ECM 0;
BA_ "GenSigTimeoutTime_BSM" SG_ 2654339073 StayActiveSource_FD03_ECM 0;
BA_ "GenSigTimeoutTime_BCM" SG_ 2654339073 StayActiveSource_FD03_ECM 0;
BA_ "GenSigTimeoutTime_AGSM" SG_ 2654339073 StayActiveSource_FD03_ECM 0;
BA_ "GenSigTimeoutTime_ADCAM" SG_ 2654339073 StayActiveSource_FD03_ECM 0;
BA_ "GenSigTimeoutTime_AGSM" SG_ 2654339136 GenericFailSts_FD03_EVCU2 0;
BA_ "GenSigTimeoutTime_DMSM" SG_ 2654339073 StayActiveSource_FD05_ECM 0;
BA_ "GenSigTimeoutTime_BSM" SG_ 2654339073 StayActiveSource_FD05_ECM 0;
BA_ "GenSigTimeoutTime_BCM" SG_ 2654339073 StayActiveSource_FD05_ECM 0;
BA_ "GenSigTimeoutTime_AGSM" SG_ 2654339073 StayActiveSource_FD05_ECM 0;
BA_ "GenSigTimeoutTime_ADCAM" SG_ 2654339073 StayActiveSource_FD05_ECM 0;
BA_ "GenSigTimeoutTime_RFHM" SG_ 2654339073 PreviousCanNMState_FD11_ECM 0;
BA_ "GenSigTimeoutTime_MPAD" SG_ 2654339073 PreviousCanNMState_FD11_ECM 0;
BA_ "GenSigTimeoutTime_IPC" SG_ 2654339073 PreviousCanNMState_FD11_ECM 0;
BA_ "GenSigTimeoutTime_GNMM" SG_ 2654339073 PreviousCanNMState_FD11_ECM 0;
BA_ "GenSigTimeoutTime_EVCU2" SG_ 2654339073 PreviousCanNMState_FD11_ECM 0;
BA_ "GenSigTimeoutTime_DTCM" SG_ 2654339073 WakeupSource_FD11_ECM 0;
BA_ "GenSigTimeoutTime_DMSM" SG_ 2654339073 WakeupSource_FD11_ECM 0;
BA_ "GenSigTimeoutTime_BSM" SG_ 2654339073 WakeupSource_FD11_ECM 0;
BA_ "GenSigTimeoutTime_BCM" SG_ 2654339073 WakeupSource_FD11_ECM 0;
BA_ "GenSigTimeoutTime_AGSM" SG_ 2654339073 WakeupSource_FD11_ECM 0;
BA_ "GenSigTimeoutTime_ADCAM" SG_ 2654339073 WakeupSource_FD11_ECM 0;
BA_ "GenSigTimeoutTime_RFHM" SG_ 2654339073 WakeupSource_FD11_ECM 0;
BA_ "GenSigTimeoutTime_MPAD" SG_ 2654339073 WakeupSource_FD11_ECM 0;
BA_ "GenSigTimeoutTime_IPC" SG_ 2654339073 WakeupSource_FD11_ECM 0;
BA_ "GenSigTimeoutTime_GNMM" SG_ 2654339073 WakeupSource_FD11_ECM 0;
BA_ "GenSigTimeoutTime_EVCU2" SG_ 2654339073 WakeupSource_FD11_ECM 0;
BA_ "GenSigTimeoutTime_ESL" SG_ 2654339073 WakeupSource_FD11_ECM 0;
BA_ "GenSigTimeoutTime_ECM" SG_ 2654339073 WakeupSource_FD11_ECM 0;
BA_ "GenSigTimeoutTime_RFHM" SG_ 2654339073 WakeupSource_FD05_ECM 0;
BA_ "GenSigTimeoutTime_MPAD" SG_ 2654339073 WakeupSource_FD05_ECM 0;
BA_ "GenSigTimeoutTime_IPC" SG_ 2654339073 WakeupSource_FD05_ECM 0;
BA_ "GenSigTimeoutTime_GNMM" SG_ 2654339073 WakeupSource_FD05_ECM 0;
BA_ "GenSigTimeoutTime_RFHM" SG_ 2654339094 DES_FD03_AGSM 0;
BA_ "GenSigTimeoutTime_MPAD" SG_ 2654339094 DES_FD03_AGSM 0;
BA_ "GenSigTimeoutTime_IPC" SG_ 2654339094 DES_FD03_AGSM 0;
BA_ "GenSigTimeoutTime_GNMM" SG_ 2654339094 DES_FD03_AGSM 0;
BA_ "GenSigTimeoutTime_EVCU2" SG_ 2654339094 DES_FD03_AGSM 0;
BA_ "GenSigTimeoutTime_ESL" SG_ 2654339094 DES_FD03_AGSM 0;
BA_ "GenSigTimeoutTime_ECM" SG_ 2654339094 DES_FD03_AGSM 0;
BA_ "GenSigTimeoutTime_DTCM" SG_ 2654339094 DES_FD03_AGSM 0;
BA_ "GenSigTimeoutTime_DMSM" SG_ 2654339094 DES_FD03_AGSM 0;
BA_ "GenSigTimeoutTime_BSM" SG_ 2654339094 DES_FD03_AGSM 0;
BA_ "GenSigTimeoutTime_BCM" SG_ 2654339094 DES_FD03_AGSM 0;
BA_ "GenSigTimeoutTime_AGSM" SG_ 2654339094 DES_FD03_AGSM 0;
BA_ "GenSigTimeoutTime_ADCAM" SG_ 2654339094 DES_FD03_AGSM 0;
BA_ "GenSigTimeoutTime_IPC" SG_ 2654339094 WakeupSource_FD03_AGSM 0;
BA_ "GenSigTimeoutTime_GNMM" SG_ 2654339094 WakeupSource_FD03_AGSM 0;
BA_ "GenSigTimeoutTime_EVCU2" SG_ 2654339094 WakeupSource_FD03_AGSM 0;
BA_ "GenSigTimeoutTime_ESL" SG_ 2654339094 WakeupSource_FD03_AGSM 0;
BA_ "GenSigTimeoutTime_ECM" SG_ 2654339094 WakeupSource_FD03_AGSM 0;
BA_ "GenSigTimeoutTime_DTCM" SG_ 2654339094 WakeupSource_FD03_AGSM 0;
BA_ "GenSigTimeoutTime_DMSM" SG_ 2654339094 WakeupSource_FD03_AGSM 0;
BA_ "GenSigTimeoutTime_BSM" SG_ 2654339094 WakeupSource_FD03_AGSM 0;
BA_ "GenSigTimeoutTime_BCM" SG_ 2654339094 WakeupSource_FD03_AGSM 0;
BA_ "GenSigTimeoutTime_AGSM" SG_ 2654339094 WakeupSource_FD03_AGSM 0;
BA_ "GenSigTimeoutTime_ADCAM" SG_ 2654339094 WakeupSource_FD03_AGSM 0;
BA_ "GenSigTimeoutTime_RFHM" SG_ 2654339094 PreviousCanNMState_FD03_AGSM 0;
BA_ "GenSigTimeoutTime_MPAD" SG_ 2654339094 PreviousCanNMState_FD03_AGSM 0;
BA_ "GenSigTimeoutTime_IPC" SG_ 2654339094 PreviousCanNMState_FD03_AGSM 0;
BA_ "GenSigTimeoutTime_GNMM" SG_ 2654339094 PreviousCanNMState_FD03_AGSM 0;
BA_ "GenSigTimeoutTime_EVCU2" SG_ 2654339094 PreviousCanNMState_FD03_AGSM 0;
BA_ "GenSigTimeoutTime_ESL" SG_ 2654339094 PreviousCanNMState_FD03_AGSM 0;
BA_ "GenSigTimeoutTime_ECM" SG_ 2654339094 PreviousCanNMState_FD03_AGSM 0;
BA_ "GenSigTimeoutTime_DTCM" SG_ 2654339094 PreviousCanNMState_FD03_AGSM 0;
BA_ "GenSigTimeoutTime_DMSM" SG_ 2654339094 PreviousCanNMState_FD03_AGSM 0;
BA_ "GenSigTimeoutTime_BSM" SG_ 2654339094 PreviousCanNMState_FD03_AGSM 0;
BA_ "GenSigTimeoutTime_BCM" SG_ 2654339094 PreviousCanNMState_FD03_AGSM 0;
BA_ "GenSigTimeoutTime_AGSM" SG_ 2654339094 PreviousCanNMState_FD03_AGSM 0;
BA_ "GenSigTimeoutTime_ADCAM" SG_ 2654339094 PreviousCanNMState_FD03_AGSM 0;
BA_ "GenSigTimeoutTime_RFHM" SG_ 2654339094 CurrentFailSts_FD11_AGSM 0;
BA_ "GenSigTimeoutTime_MPAD" SG_ 2654339094 CurrentFailSts_FD11_AGSM 0;
BA_ "GenSigTimeoutTime_IPC" SG_ 2654339094 CurrentFailSts_FD11_AGSM 0;
BA_ "GenSigTimeoutTime_GNMM" SG_ 2654339094 CurrentFailSts_FD11_AGSM 0;
BA_ "GenSigTimeoutTime_EVCU2" SG_ 2654339094 CurrentFailSts_FD11_AGSM 0;
BA_ "GenSigTimeoutTime_ESL" SG_ 2654339094 CurrentFailSts_FD11_AGSM 0;
BA_ "GenSigTimeoutTime_ECM" SG_ 2654339094 CurrentFailSts_FD11_AGSM 0;
BA_ "GenSigTimeoutTime_DTCM" SG_ 2654339094 CurrentFailSts_FD11_AGSM 0;
BA_ "GenSigTimeoutTime_DMSM" SG_ 2654339094 CurrentFailSts_FD11_AGSM 0;
BA_ "GenSigTimeoutTime_BSM" SG_ 2654339094 CurrentFailSts_FD11_AGSM 0;
BA_ "GenSigTimeoutTime_BCM" SG_ 2654339094 CurrentFailSts_FD11_AGSM 0;
BA_ "GenSigTimeoutTime_AGSM" SG_ 2654339094 CurrentFailSts_FD11_AGSM 0;
BA_ "GenSigTimeoutTime_ADCAM" SG_ 2654339094 CurrentFailSts_FD11_AGSM 0;
BA_ "GenSigTimeoutTime_EVCU2" SG_ 2654339094 CurrentFailSts_FD16_AGSM 0;
BA_ "GenSigTimeoutTime_ESL" SG_ 2654339094 CurrentFailSts_FD16_AGSM 0;
BA_ "GenSigTimeoutTime_ECM" SG_ 2654339094 CurrentFailSts_FD16_AGSM 0;
BA_ "GenSigTimeoutTime_DTCM" SG_ 2654339094 CurrentFailSts_FD16_AGSM 0;
BA_ "GenSigTimeoutTime_DMSM" SG_ 2654339094 CurrentFailSts_FD16_AGSM 0;
BA_ "GenSigTimeoutTime_BSM" SG_ 2654339094 CurrentFailSts_FD16_AGSM 0;
BA_ "GenSigTimeoutTime_BCM" SG_ 2654339094 CurrentFailSts_FD16_AGSM 0;
BA_ "GenSigTimeoutTime_AGSM" SG_ 2654339094 CurrentFailSts_FD16_AGSM 0;
BA_ "GenSigTimeoutTime_ADCAM" SG_ 2654339094 CurrentFailSts_FD16_AGSM 0;
BA_ "GenSigTimeoutTime_RFHM" SG_ 2654339094 CurrentFailSts_FD16_AGSM 0;
BA_ "GenSigTimeoutTime_MPAD" SG_ 2654339094 CurrentFailSts_FD16_AGSM 0;
BA_ "GenSigTimeoutTime_IPC" SG_ 2654339094 CurrentFailSts_FD16_AGSM 0;
BA_ "GenSigTimeoutTime_GNMM" SG_ 2654339094 CurrentFailSts_FD16_AGSM 0;
BA_ "GenSigTimeoutTime_RFHM" SG_ 2654339094 DES_FD11_AGSM 0;
BA_ "GenSigTimeoutTime_MPAD" SG_ 2654339094 DES_FD11_AGSM 0;
BA_ "GenSigTimeoutTime_IPC" SG_ 2654339094 DES_FD11_AGSM 0;
BA_ "GenSigTimeoutTime_GNMM" SG_ 2654339094 DES_FD11_AGSM 0;
BA_ "GenSigTimeoutTime_EVCU2" SG_ 2654339094 DES_FD11_AGSM 0;
BA_ "GenSigTimeoutTime_ESL" SG_ 2654339094 DES_FD11_AGSM 0;
BA_ "GenSigTimeoutTime_ECM" SG_ 2654339094 DES_FD11_AGSM 0;
BA_ "GenSigTimeoutTime_DTCM" SG_ 2654339094 DES_FD11_AGSM 0;
BA_ "GenSigTimeoutTime_DMSM" SG_ 2654339094 DES_FD11_AGSM 0;
BA_ "GenSigTimeoutTime_BSM" SG_ 2654339094 DES_FD11_AGSM 0;
BA_ "GenSigTimeoutTime_BCM" SG_ 2654339094 DES_FD11_AGSM 0;
BA_ "GenSigTimeoutTime_AGSM" SG_ 2654339094 DES_FD11_AGSM 0;
BA_ "GenSigTimeoutTime_ADCAM" SG_ 2654339094 DES_FD11_AGSM 0;
BA_ "GenSigTimeoutTime_RFHM" SG_ 2654339094 DES_FD16_AGSM 0;
BA_ "GenSigTimeoutTime_MPAD" SG_ 2654339094 DES_FD16_AGSM 0;
BA_ "GenSigTimeoutTime_IPC" SG_ 2654339094 DES_FD16_AGSM 0;
BA_ "GenSigTimeoutTime_GNMM" SG_ 2654339094 DES_FD16_AGSM 0;
BA_ "GenSigTimeoutTime_EVCU2" SG_ 2654339094 DES_FD16_AGSM 0;
BA_ "GenSigTimeoutTime_ESL" SG_ 2654339094 DES_FD16_AGSM 0;
BA_ "GenSigTimeoutTime_ECM" SG_ 2654339094 DES_FD16_AGSM 0;
BA_ "GenSigTimeoutTime_DTCM" SG_ 2654339094 DES_FD16_AGSM 0;
BA_ "GenSigTimeoutTime_DMSM" SG_ 2654339094 DES_FD16_AGSM 0;
BA_ "GenSigTimeoutTime_BSM" SG_ 2654339094 DES_FD16_AGSM 0;
BA_ "GenSigTimeoutTime_BCM" SG_ 2654339094 DES_FD16_AGSM 0;
BA_ "GenSigTimeoutTime_AGSM" SG_ 2654339094 DES_FD16_AGSM 0;
BA_ "GenSigTimeoutTime_ADCAM" SG_ 2654339094 DES_FD16_AGSM 0;
BA_ "GenSigTimeoutTime_RFHM" SG_ 2654339094 EOL_FD11_AGSM 0;
BA_ "GenSigTimeoutTime_MPAD" SG_ 2654339094 EOL_FD11_AGSM 0;
BA_ "GenSigTimeoutTime_IPC" SG_ 2654339094 EOL_FD11_AGSM 0;
BA_ "GenSigTimeoutTime_GNMM" SG_ 2654339094 EOL_FD11_AGSM 0;
BA_ "GenSigTimeoutTime_EVCU2" SG_ 2654339094 EOL_FD11_AGSM 0;
BA_ "GenSigTimeoutTime_ESL" SG_ 2654339094 EOL_FD11_AGSM 0;
BA_ "GenSigTimeoutTime_ECM" SG_ 2654339094 EOL_FD11_AGSM 0;
BA_ "GenSigTimeoutTime_DTCM" SG_ 2654339094 EOL_FD11_AGSM 0;
BA_ "GenSigTimeoutTime_DMSM" SG_ 2654339094 EOL_FD11_AGSM 0;
BA_ "GenSigTimeoutTime_BSM" SG_ 2654339094 EOL_FD11_AGSM 0;
BA_ "GenSigTimeoutTime_BCM" SG_ 2654339094 EOL_FD11_AGSM 0;
BA_ "GenSigTimeoutTime_AGSM" SG_ 2654339094 EOL_FD11_AGSM 0;
BA_ "GenSigTimeoutTime_ADCAM" SG_ 2654339094 EOL_FD11_AGSM 0;
BA_ "GenSigTimeoutTime_RFHM" SG_ 2654339094 EOL_FD16_AGSM 0;
BA_ "GenSigTimeoutTime_MPAD" SG_ 2654339094 EOL_FD16_AGSM 0;
BA_ "GenSigTimeoutTime_IPC" SG_ 2654339094 EOL_FD16_AGSM 0;
BA_ "GenSigTimeoutTime_GNMM" SG_ 2654339094 EOL_FD16_AGSM 0;
BA_ "GenSigTimeoutTime_EVCU2" SG_ 2654339094 EOL_FD16_AGSM 0;
BA_ "GenSigTimeoutTime_ESL" SG_ 2654339094 EOL_FD16_AGSM 0;
BA_ "GenSigTimeoutTime_ECM" SG_ 2654339094 EOL_FD16_AGSM 0;
BA_ "GenSigTimeoutTime_DTCM" SG_ 2654339094 EOL_FD16_AGSM 0;
BA_ "GenSigTimeoutTime_DMSM" SG_ 2654339094 EOL_FD16_AGSM 0;
BA_ "GenSigTimeoutTime_BSM" SG_ 2654339094 EOL_FD16_AGSM 0;
BA_ "GenSigTimeoutTime_BCM" SG_ 2654339094 EOL_FD16_AGSM 0;
BA_ "GenSigTimeoutTime_AGSM" SG_ 2654339094 EOL_FD16_AGSM 0;
BA_ "GenSigTimeoutTime_ADCAM" SG_ 2654339094 EOL_FD16_AGSM 0;
BA_ "GenSigTimeoutTime_RFHM" SG_ 2654339094 GenericFailSts_FD11_AGSM 0;
BA_ "GenSigTimeoutTime_MPAD" SG_ 2654339094 GenericFailSts_FD11_AGSM 0;
BA_ "GenSigTimeoutTime_IPC" SG_ 2654339094 GenericFailSts_FD11_AGSM 0;
BA_ "GenSigTimeoutTime_GNMM" SG_ 2654339094 GenericFailSts_FD11_AGSM 0;
BA_ "GenSigTimeoutTime_EVCU2" SG_ 2654339094 GenericFailSts_FD11_AGSM 0;
BA_ "GenSigTimeoutTime_ESL" SG_ 2654339094 GenericFailSts_FD11_AGSM 0;
BA_ "GenSigTimeoutTime_ECM" SG_ 2654339094 GenericFailSts_FD11_AGSM 0;
BA_ "GenSigTimeoutTime_DTCM" SG_ 2654339094 GenericFailSts_FD11_AGSM 0;
BA_ "GenSigTimeoutTime_DMSM" SG_ 2654339094 GenericFailSts_FD11_AGSM 0;
BA_ "GenSigTimeoutTime_BSM" SG_ 2654339094 GenericFailSts_FD11_AGSM 0;
BA_ "GenSigTimeoutTime_BCM" SG_ 2654339094 GenericFailSts_FD11_AGSM 0;
BA_ "GenSigTimeoutTime_AGSM" SG_ 2654339094 GenericFailSts_FD11_AGSM 0;
BA_ "GenSigTimeoutTime_ADCAM" SG_ 2654339094 GenericFailSts_FD11_AGSM 0;
BA_ "GenSigTimeoutTime_RFHM" SG_ 2654339094 GenericFailSts_FD16_AGSM 0;
BA_ "GenSigTimeoutTime_MPAD" SG_ 2654339094 GenericFailSts_FD16_AGSM 0;
BA_ "GenSigTimeoutTime_IPC" SG_ 2654339094 GenericFailSts_FD16_AGSM 0;
BA_ "GenSigTimeoutTime_GNMM" SG_ 2654339094 GenericFailSts_FD16_AGSM 0;
BA_ "GenSigTimeoutTime_EVCU2" SG_ 2654339094 GenericFailSts_FD16_AGSM 0;
BA_ "GenSigTimeoutTime_ESL" SG_ 2654339094 GenericFailSts_FD16_AGSM 0;
BA_ "GenSigTimeoutTime_ECM" SG_ 2654339094 GenericFailSts_FD16_AGSM 0;
BA_ "GenSigTimeoutTime_DTCM" SG_ 2654339094 GenericFailSts_FD16_AGSM 0;
BA_ "GenSigTimeoutTime_DMSM" SG_ 2654339094 GenericFailSts_FD16_AGSM 0;
BA_ "GenSigTimeoutTime_BSM" SG_ 2654339094 GenericFailSts_FD16_AGSM 0;
BA_ "GenSigTimeoutTime_BCM" SG_ 2654339094 GenericFailSts_FD16_AGSM 0;
BA_ "GenSigTimeoutTime_AGSM" SG_ 2654339094 GenericFailSts_FD16_AGSM 0;
BA_ "GenSigTimeoutTime_ADCAM" SG_ 2654339094 GenericFailSts_FD16_AGSM 0;
BA_ "GenSigTimeoutTime_RFHM" SG_ 2654339094 PreviousCanNMState_FD11_AGSM 0;
BA_ "GenSigTimeoutTime_MPAD" SG_ 2654339094 PreviousCanNMState_FD11_AGSM 0;
BA_ "GenSigTimeoutTime_IPC" SG_ 2654339094 PreviousCanNMState_FD11_AGSM 0;
BA_ "GenSigTimeoutTime_GNMM" SG_ 2654339094 PreviousCanNMState_FD11_AGSM 0;
BA_ "GenSigTimeoutTime_EVCU2" SG_ 2654339094 PreviousCanNMState_FD11_AGSM 0;
BA_ "GenSigTimeoutTime_ESL" SG_ 2654339094 PreviousCanNMState_FD11_AGSM 0;
BA_ "GenSigTimeoutTime_ECM" SG_ 2654339094 PreviousCanNMState_FD11_AGSM 0;
BA_ "GenSigTimeoutTime_DTCM" SG_ 2654339094 PreviousCanNMState_FD11_AGSM 0;
BA_ "GenSigTimeoutTime_DMSM" SG_ 2654339094 PreviousCanNMState_FD11_AGSM 0;
BA_ "GenSigTimeoutTime_BSM" SG_ 2654339094 PreviousCanNMState_FD11_AGSM 0;
BA_ "GenSigTimeoutTime_BCM" SG_ 2654339094 PreviousCanNMState_FD11_AGSM 0;
BA_ "GenSigTimeoutTime_AGSM" SG_ 2654339094 PreviousCanNMState_FD11_AGSM 0;
BA_ "GenSigTimeoutTime_ADCAM" SG_ 2654339094 PreviousCanNMState_FD11_AGSM 0;
BA_ "GenSigTimeoutTime_RFHM" SG_ 2654339094 PreviousCanNMState_FD16_AGSM 0;
BA_ "GenSigTimeoutTime_MPAD" SG_ 2654339094 PreviousCanNMState_FD16_AGSM 0;
BA_ "GenSigTimeoutTime_IPC" SG_ 2654339094 PreviousCanNMState_FD16_AGSM 0;
BA_ "GenSigTimeoutTime_GNMM" SG_ 2654339094 PreviousCanNMState_FD16_AGSM 0;
BA_ "GenSigTimeoutTime_EVCU2" SG_ 2654339094 PreviousCanNMState_FD16_AGSM 0;
BA_ "GenSigTimeoutTime_ESL" SG_ 2654339094 PreviousCanNMState_FD16_AGSM 0;
BA_ "GenSigTimeoutTime_ECM" SG_ 2654339094 PreviousCanNMState_FD16_AGSM 0;
BA_ "GenSigTimeoutTime_DTCM" SG_ 2654339094 PreviousCanNMState_FD16_AGSM 0;
BA_ "GenSigTimeoutTime_DMSM" SG_ 2654339094 PreviousCanNMState_FD16_AGSM 0;
BA_ "GenSigTimeoutTime_BSM" SG_ 2654339094 PreviousCanNMState_FD16_AGSM 0;
BA_ "GenSigTimeoutTime_BCM" SG_ 2654339094 PreviousCanNMState_FD16_AGSM 0;
BA_ "GenSigTimeoutTime_AGSM" SG_ 2654339094 PreviousCanNMState_FD16_AGSM 0;
BA_ "GenSigTimeoutTime_ADCAM" SG_ 2654339094 PreviousCanNMState_FD16_AGSM 0;
BA_ "GenSigTimeoutTime_RFHM" SG_ 2654339094 StayActiveSource_FD03_AGSM 0;
BA_ "GenSigTimeoutTime_MPAD" SG_ 2654339094 StayActiveSource_FD03_AGSM 0;
BA_ "GenSigTimeoutTime_IPC" SG_ 2654339094 StayActiveSource_FD03_AGSM 0;
BA_ "GenSigTimeoutTime_GNMM" SG_ 2654339094 StayActiveSource_FD03_AGSM 0;
BA_ "GenSigTimeoutTime_EVCU2" SG_ 2654339094 StayActiveSource_FD03_AGSM 0;
BA_ "GenSigTimeoutTime_ESL" SG_ 2654339094 StayActiveSource_FD03_AGSM 0;
BA_ "GenSigTimeoutTime_ECM" SG_ 2654339094 StayActiveSource_FD03_AGSM 0;
BA_ "GenSigTimeoutTime_DTCM" SG_ 2654339094 StayActiveSource_FD03_AGSM 0;
BA_ "GenSigTimeoutTime_DMSM" SG_ 2654339094 StayActiveSource_FD03_AGSM 0;
BA_ "GenSigTimeoutTime_BSM" SG_ 2654339094 StayActiveSource_FD03_AGSM 0;
BA_ "GenSigTimeoutTime_BCM" SG_ 2654339094 StayActiveSource_FD03_AGSM 0;
BA_ "GenSigTimeoutTime_AGSM" SG_ 2654339094 StayActiveSource_FD03_AGSM 0;
BA_ "GenSigTimeoutTime_ADCAM" SG_ 2654339094 StayActiveSource_FD03_AGSM 0;
BA_ "GenSigTimeoutTime_RFHM" SG_ 2654339094 StayActiveSource_FD11_AGSM 0;
BA_ "GenSigTimeoutTime_MPAD" SG_ 2654339094 StayActiveSource_FD11_AGSM 0;
BA_ "GenSigTimeoutTime_IPC" SG_ 2654339094 StayActiveSource_FD11_AGSM 0;
BA_ "GenSigTimeoutTime_GNMM" SG_ 2654339094 StayActiveSource_FD11_AGSM 0;
BA_ "GenSigTimeoutTime_EVCU2" SG_ 2654339094 StayActiveSource_FD11_AGSM 0;
BA_ "GenSigTimeoutTime_ESL" SG_ 2654339094 StayActiveSource_FD11_AGSM 0;
BA_ "GenSigTimeoutTime_ECM" SG_ 2654339094 StayActiveSource_FD11_AGSM 0;
BA_ "GenSigTimeoutTime_DTCM" SG_ 2654339094 StayActiveSource_FD11_AGSM 0;
BA_ "GenSigTimeoutTime_DMSM" SG_ 2654339094 StayActiveSource_FD11_AGSM 0;
BA_ "GenSigTimeoutTime_BSM" SG_ 2654339094 StayActiveSource_FD11_AGSM 0;
BA_ "GenSigTimeoutTime_BCM" SG_ 2654339094 StayActiveSource_FD11_AGSM 0;
BA_ "GenSigTimeoutTime_AGSM" SG_ 2654339094 StayActiveSource_FD11_AGSM 0;
BA_ "GenSigTimeoutTime_ADCAM" SG_ 2654339094 StayActiveSource_FD11_AGSM 0;
BA_ "GenSigTimeoutTime_RFHM" SG_ 2654339094 StayActiveSource_FD16_AGSM 0;
BA_ "GenSigTimeoutTime_MPAD" SG_ 2654339094 StayActiveSource_FD16_AGSM 0;
BA_ "GenSigTimeoutTime_IPC" SG_ 2654339094 StayActiveSource_FD16_AGSM 0;
BA_ "GenSigTimeoutTime_GNMM" SG_ 2654339094 StayActiveSource_FD16_AGSM 0;
BA_ "GenSigTimeoutTime_EVCU2" SG_ 2654339094 StayActiveSource_FD16_AGSM 0;
BA_ "GenSigTimeoutTime_ESL" SG_ 2654339094 StayActiveSource_FD16_AGSM 0;
BA_ "GenSigTimeoutTime_ECM" SG_ 2654339094 StayActiveSource_FD16_AGSM 0;
BA_ "GenSigTimeoutTime_DTCM" SG_ 2654339094 StayActiveSource_FD16_AGSM 0;
BA_ "GenSigTimeoutTime_DMSM" SG_ 2654339094 StayActiveSource_FD16_AGSM 0;
BA_ "GenSigTimeoutTime_BSM" SG_ 2654339094 StayActiveSource_FD16_AGSM 0;
BA_ "GenSigTimeoutTime_BCM" SG_ 2654339094 StayActiveSource_FD16_AGSM 0;
BA_ "GenSigTimeoutTime_AGSM" SG_ 2654339094 StayActiveSource_FD16_AGSM 0;
BA_ "GenSigTimeoutTime_ADCAM" SG_ 2654339094 StayActiveSource_FD16_AGSM 0;
BA_ "GenSigTimeoutTime_RFHM" SG_ 2654339094 CurrentCanNMState_FD11_AGSM 0;
BA_ "GenSigTimeoutTime_MPAD" SG_ 2654339094 CurrentCanNMState_FD11_AGSM 0;
BA_ "GenSigTimeoutTime_IPC" SG_ 2654339094 CurrentCanNMState_FD11_AGSM 0;
BA_ "GenSigTimeoutTime_GNMM" SG_ 2654339094 CurrentCanNMState_FD11_AGSM 0;
BA_ "GenSigTimeoutTime_EVCU2" SG_ 2654339094 CurrentCanNMState_FD11_AGSM 0;
BA_ "GenSigTimeoutTime_ESL" SG_ 2654339094 CurrentCanNMState_FD11_AGSM 0;
BA_ "GenSigTimeoutTime_ECM" SG_ 2654339094 CurrentCanNMState_FD11_AGSM 0;
BA_ "GenSigTimeoutTime_DTCM" SG_ 2654339094 CurrentCanNMState_FD11_AGSM 0;
BA_ "GenSigTimeoutTime_DMSM" SG_ 2654339094 CurrentCanNMState_FD11_AGSM 0;
BA_ "GenSigTimeoutTime_BSM" SG_ 2654339094 CurrentCanNMState_FD11_AGSM 0;
BA_ "GenSigTimeoutTime_BCM" SG_ 2654339094 CurrentCanNMState_FD11_AGSM 0;
BA_ "GenSigTimeoutTime_AGSM" SG_ 2654339094 CurrentCanNMState_FD11_AGSM 0;
BA_ "GenSigTimeoutTime_ADCAM" SG_ 2654339094 CurrentCanNMState_FD11_AGSM 0;
BA_ "GenSigTimeoutTime_RFHM" SG_ 2654339094 CurrentCanNMState_FD16_AGSM 0;
BA_ "GenSigTimeoutTime_MPAD" SG_ 2654339094 CurrentCanNMState_FD16_AGSM 0;
BA_ "GenSigTimeoutTime_IPC" SG_ 2654339094 CurrentCanNMState_FD16_AGSM 0;
BA_ "GenSigTimeoutTime_GNMM" SG_ 2654339094 CurrentCanNMState_FD16_AGSM 0;
BA_ "GenSigTimeoutTime_EVCU2" SG_ 2654339094 CurrentCanNMState_FD16_AGSM 0;
BA_ "GenSigTimeoutTime_ESL" SG_ 2654339094 CurrentCanNMState_FD16_AGSM 0;
BA_ "GenSigTimeoutTime_ECM" SG_ 2654339094 CurrentCanNMState_FD16_AGSM 0;
BA_ "GenSigTimeoutTime_DTCM" SG_ 2654339094 CurrentCanNMState_FD16_AGSM 0;
BA_ "GenSigTimeoutTime_DMSM" SG_ 2654339094 CurrentCanNMState_FD16_AGSM 0;
BA_ "GenSigTimeoutTime_BSM" SG_ 2654339094 CurrentCanNMState_FD16_AGSM 0;
BA_ "GenSigTimeoutTime_BCM" SG_ 2654339094 CurrentCanNMState_FD16_AGSM 0;
BA_ "GenSigTimeoutTime_AGSM" SG_ 2654339094 CurrentCanNMState_FD16_AGSM 0;
BA_ "GenSigTimeoutTime_ADCAM" SG_ 2654339094 CurrentCanNMState_FD16_AGSM 0;
BA_ "GenSigTimeoutTime_RFHM" SG_ 2654339094 CurrentCanNMState_FD03_AGSM 0;
BA_ "GenSigTimeoutTime_MPAD" SG_ 2654339094 CurrentCanNMState_FD03_AGSM 0;
BA_ "GenSigTimeoutTime_IPC" SG_ 2654339094 CurrentCanNMState_FD03_AGSM 0;
BA_ "GenSigTimeoutTime_GNMM" SG_ 2654339094 CurrentCanNMState_FD03_AGSM 0;
BA_ "GenSigTimeoutTime_EVCU2" SG_ 2654339094 CurrentCanNMState_FD03_AGSM 0;
BA_ "GenSigTimeoutTime_ESL" SG_ 2654339094 CurrentCanNMState_FD03_AGSM 0;
BA_ "GenSigTimeoutTime_ECM" SG_ 2654339094 CurrentCanNMState_FD03_AGSM 0;
BA_ "GenSigTimeoutTime_DTCM" SG_ 2654339094 CurrentCanNMState_FD03_AGSM 0;
BA_ "GenSigTimeoutTime_DMSM" SG_ 2654339094 CurrentCanNMState_FD03_AGSM 0;
BA_ "GenSigTimeoutTime_BSM" SG_ 2654339094 CurrentCanNMState_FD03_AGSM 0;
BA_ "GenSigTimeoutTime_BCM" SG_ 2654339094 CurrentCanNMState_FD03_AGSM 0;
BA_ "GenSigTimeoutTime_AGSM" SG_ 2654339094 CurrentCanNMState_FD03_AGSM 0;
BA_ "GenSigTimeoutTime_ADCAM" SG_ 2654339094 CurrentCanNMState_FD03_AGSM 0;
BA_ "GenSigTimeoutTime_SGW" SG_ 2654339142 GenericFailSts_FD11_BPCM 0;
BA_ "GenSigTimeoutTime_RFHM" SG_ 2654339142 GenericFailSts_FD11_BPCM 0;
BA_ "GenSigTimeoutTime_MPAD" SG_ 2654339142 GenericFailSts_FD11_BPCM 0;
BA_ "GenSigTimeoutTime_IPC" SG_ 2654339142 GenericFailSts_FD11_BPCM 0;
BA_ "GenSigTimeoutTime_GNMM" SG_ 2654339142 GenericFailSts_FD11_BPCM 0;
BA_ "GenSigTimeoutTime_EVCU2" SG_ 2654339142 GenericFailSts_FD11_BPCM 0;
BA_ "GenSigTimeoutTime_ESL" SG_ 2654339142 GenericFailSts_FD11_BPCM 0;
BA_ "GenSigTimeoutTime_ECM" SG_ 2654339142 GenericFailSts_FD11_BPCM 0;
BA_ "GenSigTimeoutTime_DTCM" SG_ 2654339142 GenericFailSts_FD11_BPCM 0;
BA_ "GenSigTimeoutTime_DMSM" SG_ 2654339142 GenericFailSts_FD11_BPCM 0;
BA_ "GenSigTimeoutTime_BSM" SG_ 2654339142 GenericFailSts_FD11_BPCM 0;
BA_ "GenSigTimeoutTime_BCM" SG_ 2654339142 GenericFailSts_FD11_BPCM 0;
BA_ "GenSigTimeoutTime_AGSM" SG_ 2654339142 GenericFailSts_FD11_BPCM 0;
BA_ "GenSigTimeoutTime_ADCAM" SG_ 2654339142 GenericFailSts_FD11_BPCM 0;
BA_ "GenSigTimeoutTime_SGW" SG_ 2654339142 EOL_FD11_BPCM 0;
BA_ "GenSigTimeoutTime_RFHM" SG_ 2654339142 EOL_FD11_BPCM 0;
BA_ "GenSigTimeoutTime_MPAD" SG_ 2654339142 EOL_FD11_BPCM 0;
BA_ "GenSigTimeoutTime_IPC" SG_ 2654339142 EOL_FD11_BPCM 0;
BA_ "GenSigTimeoutTime_GNMM" SG_ 2654339142 EOL_FD11_BPCM 0;
BA_ "GenSigTimeoutTime_EVCU2" SG_ 2654339142 EOL_FD11_BPCM 0;
BA_ "GenSigTimeoutTime_ESL" SG_ 2654339142 EOL_FD11_BPCM 0;
BA_ "GenSigTimeoutTime_ECM" SG_ 2654339142 EOL_FD11_BPCM 0;
BA_ "GenSigTimeoutTime_DTCM" SG_ 2654339142 EOL_FD11_BPCM 0;
BA_ "GenSigTimeoutTime_DMSM" SG_ 2654339142 EOL_FD11_BPCM 0;
BA_ "GenSigTimeoutTime_BSM" SG_ 2654339142 EOL_FD11_BPCM 0;
BA_ "GenSigTimeoutTime_BCM" SG_ 2654339142 EOL_FD11_BPCM 0;
BA_ "GenSigTimeoutTime_AGSM" SG_ 2654339142 EOL_FD11_BPCM 0;
BA_ "GenSigTimeoutTime_ADCAM" SG_ 2654339142 EOL_FD11_BPCM 0;
BA_ "GenSigTimeoutTime_IPC" SG_ 2654339142 CurrentCanNMState_FD05_BPCM 0;
BA_ "GenSigTimeoutTime_GNMM" SG_ 2654339142 CurrentCanNMState_FD05_BPCM 0;
BA_ "GenSigTimeoutTime_EVCU2" SG_ 2654339142 CurrentCanNMState_FD05_BPCM 0;
BA_ "GenSigTimeoutTime_ESL" SG_ 2654339142 CurrentCanNMState_FD05_BPCM 0;
BA_ "GenSigTimeoutTime_ECM" SG_ 2654339142 CurrentCanNMState_FD05_BPCM 0;
BA_ "GenSigTimeoutTime_DTCM" SG_ 2654339142 CurrentCanNMState_FD05_BPCM 0;
BA_ "GenSigTimeoutTime_DMSM" SG_ 2654339142 CurrentCanNMState_FD05_BPCM 0;
BA_ "GenSigTimeoutTime_BSM" SG_ 2654339142 CurrentCanNMState_FD05_BPCM 0;
BA_ "GenSigTimeoutTime_BCM" SG_ 2654339142 CurrentCanNMState_FD05_BPCM 0;
BA_ "GenSigTimeoutTime_AGSM" SG_ 2654339142 CurrentCanNMState_FD05_BPCM 0;
BA_ "GenSigTimeoutTime_ADCAM" SG_ 2654339142 CurrentCanNMState_FD05_BPCM 0;
BA_ "GenSigTimeoutTime_RFHM" SG_ 2654339073 CurrentCanNMState_FD03_ECM 0;
BA_ "GenSigTimeoutTime_MPAD" SG_ 2654339073 CurrentCanNMState_FD03_ECM 0;
BA_ "GenSigTimeoutTime_IPC" SG_ 2654339073 CurrentCanNMState_FD03_ECM 0;
BA_ "GenSigTimeoutTime_GNMM" SG_ 2654339073 CurrentCanNMState_FD03_ECM 0;
BA_ "GenSigTimeoutTime_EVCU2" SG_ 2654339073 CurrentCanNMState_FD03_ECM 0;
BA_ "GenSigTimeoutTime_ESL" SG_ 2654339073 CurrentCanNMState_FD03_ECM 0;
BA_ "GenSigTimeoutTime_ECM" SG_ 2654339073 CurrentCanNMState_FD03_ECM 0;
BA_ "GenSigTimeoutTime_DTCM" SG_ 2654339073 CurrentCanNMState_FD03_ECM 0;
BA_ "GenSigTimeoutTime_DMSM" SG_ 2654339073 CurrentCanNMState_FD03_ECM 0;
BA_ "GenSigTimeoutTime_BSM" SG_ 2654339073 CurrentCanNMState_FD03_ECM 0;
BA_ "GenSigTimeoutTime_BCM" SG_ 2654339073 CurrentCanNMState_FD03_ECM 0;
BA_ "GenSigTimeoutTime_AGSM" SG_ 2654339073 CurrentCanNMState_FD03_ECM 0;
BA_ "GenSigTimeoutTime_ADCAM" SG_ 2654339073 CurrentCanNMState_FD03_ECM 0;
BA_ "GenSigTimeoutTime_RFHM" SG_ 2654339073 DES_FD11_ECM 0;
BA_ "GenSigTimeoutTime_MPAD" SG_ 2654339073 DES_FD11_ECM 0;
BA_ "GenSigTimeoutTime_IPC" SG_ 2654339073 DES_FD11_ECM 0;
BA_ "GenSigTimeoutTime_GNMM" SG_ 2654339073 DES_FD11_ECM 0;
BA_ "GenSigTimeoutTime_EVCU2" SG_ 2654339073 DES_FD11_ECM 0;
BA_ "GenSigTimeoutTime_ESL" SG_ 2654339073 DES_FD11_ECM 0;
BA_ "GenSigTimeoutTime_DTCM" SG_ 2654339073 DES_FD11_ECM 0;
BA_ "GenSigTimeoutTime_DMSM" SG_ 2654339073 DES_FD11_ECM 0;
BA_ "GenSigTimeoutTime_BSM" SG_ 2654339073 DES_FD11_ECM 0;
BA_ "GenSigTimeoutTime_BCM" SG_ 2654339073 DES_FD11_ECM 0;
BA_ "GenSigTimeoutTime_AGSM" SG_ 2654339073 DES_FD11_ECM 0;
BA_ "GenSigTimeoutTime_ADCAM" SG_ 2654339073 DES_FD11_ECM 0;
BA_ "GenSigTimeoutTime_RFHM" SG_ 2654339073 DES_FD05_ECM 0;
BA_ "GenSigTimeoutTime_MPAD" SG_ 2654339073 DES_FD05_ECM 0;
BA_ "GenSigTimeoutTime_IPC" SG_ 2654339073 DES_FD05_ECM 0;
BA_ "GenSigTimeoutTime_GNMM" SG_ 2654339073 DES_FD05_ECM 0;
BA_ "GenSigTimeoutTime_EVCU2" SG_ 2654339073 DES_FD05_ECM 0;
BA_ "GenSigTimeoutTime_ESL" SG_ 2654339073 DES_FD05_ECM 0;
BA_ "GenSigTimeoutTime_ECM" SG_ 2654339073 DES_FD05_ECM 0;
BA_ "GenSigTimeoutTime_DTCM" SG_ 2654339073 DES_FD05_ECM 0;
BA_ "GenSigTimeoutTime_DMSM" SG_ 2654339073 DES_FD05_ECM 0;
BA_ "GenSigTimeoutTime_BSM" SG_ 2654339073 DES_FD05_ECM 0;
BA_ "GenSigTimeoutTime_BCM" SG_ 2654339073 DES_FD05_ECM 0;
BA_ "GenSigTimeoutTime_AGSM" SG_ 2654339073 DES_FD05_ECM 0;
BA_ "GenSigTimeoutTime_ADCAM" SG_ 2654339073 DES_FD05_ECM 0;
BA_ "GenSigTimeoutTime_RFHM" SG_ 2654339073 CurrentFailSts_FD11_ECM 0;
BA_ "GenSigTimeoutTime_MPAD" SG_ 2654339073 CurrentFailSts_FD11_ECM 0;
BA_ "GenSigTimeoutTime_IPC" SG_ 2654339073 CurrentFailSts_FD11_ECM 0;
BA_ "GenSigTimeoutTime_GNMM" SG_ 2654339073 CurrentFailSts_FD11_ECM 0;
BA_ "GenSigTimeoutTime_EVCU2" SG_ 2654339073 CurrentFailSts_FD11_ECM 0;
BA_ "GenSigTimeoutTime_ESL" SG_ 2654339073 CurrentFailSts_FD11_ECM 0;
BA_ "GenSigTimeoutTime_ECM" SG_ 2654339073 CurrentFailSts_FD11_ECM 0;
BA_ "GenSigTimeoutTime_DTCM" SG_ 2654339073 CurrentFailSts_FD11_ECM 0;
BA_ "GenSigTimeoutTime_DMSM" SG_ 2654339073 CurrentFailSts_FD11_ECM 0;
BA_ "GenSigTimeoutTime_BSM" SG_ 2654339073 CurrentFailSts_FD11_ECM 0;
BA_ "GenSigTimeoutTime_BCM" SG_ 2654339073 CurrentFailSts_FD11_ECM 0;
BA_ "GenSigTimeoutTime_AGSM" SG_ 2654339073 CurrentFailSts_FD11_ECM 0;
BA_ "GenSigTimeoutTime_ADCAM" SG_ 2654339073 CurrentFailSts_FD11_ECM 0;
BA_ "GenSigTimeoutTime_RFHM" SG_ 2654339073 CurrentFailSts_FD05_ECM 0;
BA_ "GenSigTimeoutTime_MPAD" SG_ 2654339073 CurrentFailSts_FD05_ECM 0;
BA_ "GenSigTimeoutTime_IPC" SG_ 2654339073 CurrentFailSts_FD05_ECM 0;
BA_ "GenSigTimeoutTime_GNMM" SG_ 2654339073 CurrentFailSts_FD05_ECM 0;
BA_ "GenSigTimeoutTime_EVCU2" SG_ 2654339073 CurrentFailSts_FD05_ECM 0;
BA_ "GenSigTimeoutTime_ESL" SG_ 2654339073 CurrentFailSts_FD05_ECM 0;
BA_ "GenSigTimeoutTime_ECM" SG_ 2654339073 CurrentFailSts_FD05_ECM 0;
BA_ "GenSigTimeoutTime_DTCM" SG_ 2654339073 CurrentFailSts_FD05_ECM 0;
BA_ "GenSigTimeoutTime_DMSM" SG_ 2654339073 CurrentFailSts_FD05_ECM 0;
BA_ "GenSigTimeoutTime_BSM" SG_ 2654339073 CurrentFailSts_FD05_ECM 0;
BA_ "GenSigTimeoutTime_BCM" SG_ 2654339073 CurrentFailSts_FD05_ECM 0;
BA_ "GenSigTimeoutTime_AGSM" SG_ 2654339073 CurrentFailSts_FD05_ECM 0;
BA_ "GenSigTimeoutTime_ADCAM" SG_ 2654339073 CurrentFailSts_FD05_ECM 0;
BA_ "GenSigTimeoutTime_RFHM" SG_ 2654339073 CurrentCanNMState_FD11_ECM 0;
BA_ "GenSigTimeoutTime_MPAD" SG_ 2654339073 CurrentCanNMState_FD11_ECM 0;
BA_ "GenSigTimeoutTime_IPC" SG_ 2654339073 CurrentCanNMState_FD11_ECM 0;
BA_ "GenSigTimeoutTime_GNMM" SG_ 2654339073 CurrentCanNMState_FD11_ECM 0;
BA_ "GenSigTimeoutTime_EVCU2" SG_ 2654339073 CurrentCanNMState_FD11_ECM 0;
BA_ "GenSigTimeoutTime_ESL" SG_ 2654339073 CurrentCanNMState_FD11_ECM 0;
BA_ "GenSigTimeoutTime_ECM" SG_ 2654339073 CurrentCanNMState_FD11_ECM 0;
BA_ "GenSigTimeoutTime_DTCM" SG_ 2654339073 CurrentCanNMState_FD11_ECM 0;
BA_ "GenSigTimeoutTime_DMSM" SG_ 2654339073 CurrentCanNMState_FD11_ECM 0;
BA_ "GenSigTimeoutTime_BSM" SG_ 2654339073 CurrentCanNMState_FD11_ECM 0;
BA_ "GenSigTimeoutTime_BCM" SG_ 2654339073 CurrentCanNMState_FD11_ECM 0;
BA_ "GenSigTimeoutTime_AGSM" SG_ 2654339073 CurrentCanNMState_FD11_ECM 0;
BA_ "GenSigTimeoutTime_ADCAM" SG_ 2654339073 CurrentCanNMState_FD11_ECM 0;
BA_ "GenSigTimeoutTime_RFHM" SG_ 2654339073 CurrentCanNMState_FD05_ECM 0;
BA_ "GenSigTimeoutTime_MPAD" SG_ 2654339073 CurrentCanNMState_FD05_ECM 0;
BA_ "GenSigTimeoutTime_IPC" SG_ 2654339073 CurrentCanNMState_FD05_ECM 0;
BA_ "GenSigTimeoutTime_GNMM" SG_ 2654339073 CurrentCanNMState_FD05_ECM 0;
BA_ "GenSigTimeoutTime_EVCU2" SG_ 2654339073 CurrentCanNMState_FD05_ECM 0;
BA_ "GenSigTimeoutTime_ESL" SG_ 2654339073 CurrentCanNMState_FD05_ECM 0;
BA_ "GenSigTimeoutTime_ECM" SG_ 2654339073 CurrentCanNMState_FD05_ECM 0;
BA_ "GenSigTimeoutTime_DTCM" SG_ 2654339073 CurrentCanNMState_FD05_ECM 0;
BA_ "GenSigTimeoutTime_DMSM" SG_ 2654339073 CurrentCanNMState_FD05_ECM 0;
BA_ "GenSigTimeoutTime_BSM" SG_ 2654339073 CurrentCanNMState_FD05_ECM 0;
BA_ "GenSigTimeoutTime_BCM" SG_ 2654339073 CurrentCanNMState_FD05_ECM 0;
BA_ "GenSigTimeoutTime_AGSM" SG_ 2654339073 CurrentCanNMState_FD05_ECM 0;
BA_ "GenSigTimeoutTime_ADCAM" SG_ 2654339073 CurrentCanNMState_FD05_ECM 0;
BA_ "GenSigTimeoutTime_RFHM" SG_ 2654339073 EOL_FD03_ECM 0;
BA_ "GenSigTimeoutTime_MPAD" SG_ 2654339073 EOL_FD03_ECM 0;
BA_ "GenSigTimeoutTime_IPC" SG_ 2654339073 EOL_FD03_ECM 0;
BA_ "GenSigTimeoutTime_GNMM" SG_ 2654339073 EOL_FD03_ECM 0;
BA_ "GenSigTimeoutTime_EVCU2" SG_ 2654339073 EOL_FD03_ECM 0;
BA_ "GenSigTimeoutTime_ESL" SG_ 2654339073 EOL_FD03_ECM 0;
BA_ "GenSigTimeoutTime_ECM" SG_ 2654339073 EOL_FD03_ECM 0;
BA_ "GenSigTimeoutTime_RFHM" SG_ 2654339073 WakeupSource_FD03_ECM 0;
BA_ "GenSigTimeoutTime_MPAD" SG_ 2654339073 WakeupSource_FD03_ECM 0;
BA_ "GenSigTimeoutTime_IPC" SG_ 2654339073 WakeupSource_FD03_ECM 0;
BA_ "GenSigTimeoutTime_GNMM" SG_ 2654339073 WakeupSource_FD03_ECM 0;
BA_ "GenSigTimeoutTime_EVCU2" SG_ 2654339073 WakeupSource_FD03_ECM 0;
BA_ "GenSigTimeoutTime_ESL" SG_ 2654339073 WakeupSource_FD03_ECM 0;
BA_ "GenSigTimeoutTime_ECM" SG_ 2654339073 WakeupSource_FD03_ECM 0;
BA_ "GenSigTimeoutTime_DTCM" SG_ 2654339073 WakeupSource_FD03_ECM 0;
BA_ "GenSigTimeoutTime_DMSM" SG_ 2654339073 WakeupSource_FD03_ECM 0;
BA_ "GenSigTimeoutTime_BSM" SG_ 2654339073 WakeupSource_FD03_ECM 0;
BA_ "GenSigTimeoutTime_BCM" SG_ 2654339073 WakeupSource_FD03_ECM 0;
BA_ "GenSigTimeoutTime_AGSM" SG_ 2654339073 WakeupSource_FD03_ECM 0;
BA_ "GenSigTimeoutTime_ADCAM" SG_ 2654339073 WakeupSource_FD03_ECM 0;
BA_ "GenSigTimeoutTime_RFHM" SG_ 2654339073 PreviousCanNMState_FD03_ECM 0;
BA_ "GenSigTimeoutTime_MPAD" SG_ 2654339073 PreviousCanNMState_FD03_ECM 0;
BA_ "GenSigTimeoutTime_IPC" SG_ 2654339073 PreviousCanNMState_FD03_ECM 0;
BA_ "GenSigTimeoutTime_GNMM" SG_ 2654339073 PreviousCanNMState_FD03_ECM 0;
BA_ "GenSigTimeoutTime_EVCU2" SG_ 2654339073 PreviousCanNMState_FD03_ECM 0;
BA_ "GenSigTimeoutTime_ESL" SG_ 2654339073 PreviousCanNMState_FD03_ECM 0;
BA_ "GenSigTimeoutTime_ECM" SG_ 2654339073 PreviousCanNMState_FD03_ECM 0;
BA_ "GenSigTimeoutTime_DTCM" SG_ 2654339073 PreviousCanNMState_FD03_ECM 0;
BA_ "GenSigTimeoutTime_DMSM" SG_ 2654339073 PreviousCanNMState_FD03_ECM 0;
BA_ "GenSigTimeoutTime_BSM" SG_ 2654339073 PreviousCanNMState_FD03_ECM 0;
BA_ "GenSigTimeoutTime_BCM" SG_ 2654339073 PreviousCanNMState_FD03_ECM 0;
BA_ "GenSigTimeoutTime_AGSM" SG_ 2654339073 PreviousCanNMState_FD03_ECM 0;
BA_ "GenSigTimeoutTime_ADCAM" SG_ 2654339073 PreviousCanNMState_FD03_ECM 0;
BA_ "GenSigTimeoutTime_RFHM" SG_ 2654339136 WakeupSource_FD16_EVCU2 0;
BA_ "GenSigTimeoutTime_MPAD" SG_ 2654339136 WakeupSource_FD16_EVCU2 0;
BA_ "GenSigTimeoutTime_IPC" SG_ 2654339136 WakeupSource_FD16_EVCU2 0;
BA_ "GenSigTimeoutTime_GNMM" SG_ 2654339136 WakeupSource_FD16_EVCU2 0;
BA_ "GenSigTimeoutTime_EVCU2" SG_ 2654339073 WakeupSource_FD05_ECM 0;
BA_ "GenSigTimeoutTime_ESL" SG_ 2654339073 WakeupSource_FD05_ECM 0;
BA_ "GenSigTimeoutTime_ECM" SG_ 2654339073 WakeupSource_FD05_ECM 0;
BA_ "GenSigTimeoutTime_DTCM" SG_ 2654339073 WakeupSource_FD05_ECM 0;
BA_ "GenSigTimeoutTime_DMSM" SG_ 2654339073 WakeupSource_FD05_ECM 0;
BA_ "GenSigTimeoutTime_BSM" SG_ 2654339073 WakeupSource_FD05_ECM 0;
BA_ "GenSigTimeoutTime_BCM" SG_ 2654339073 WakeupSource_FD05_ECM 0;
BA_ "GenSigTimeoutTime_AGSM" SG_ 2654339073 WakeupSource_FD05_ECM 0;
BA_ "GenSigTimeoutTime_ADCAM" SG_ 2654339073 WakeupSource_FD05_ECM 0;
BA_ "GenSigTimeoutTime_ESL" SG_ 2654339073 PreviousCanNMState_FD11_ECM 0;
BA_ "GenSigTimeoutTime_ECM" SG_ 2654339073 PreviousCanNMState_FD11_ECM 0;
BA_ "GenSigTimeoutTime_DTCM" SG_ 2654339073 PreviousCanNMState_FD11_ECM 0;
BA_ "GenSigTimeoutTime_DMSM" SG_ 2654339073 PreviousCanNMState_FD11_ECM 0;
BA_ "GenSigTimeoutTime_BSM" SG_ 2654339073 PreviousCanNMState_FD11_ECM 0;
BA_ "GenSigTimeoutTime_BCM" SG_ 2654339073 PreviousCanNMState_FD11_ECM 0;
BA_ "GenSigTimeoutTime_AGSM" SG_ 2654339073 PreviousCanNMState_FD11_ECM 0;
BA_ "GenSigTimeoutTime_ADCAM" SG_ 2654339073 PreviousCanNMState_FD11_ECM 0;
BA_ "GenSigTimeoutTime_RFHM" SG_ 2654339073 PreviousCanNMState_FD05_ECM 0;
BA_ "GenSigTimeoutTime_MPAD" SG_ 2654339073 PreviousCanNMState_FD05_ECM 0;
BA_ "GenSigTimeoutTime_IPC" SG_ 2654339073 PreviousCanNMState_FD05_ECM 0;
BA_ "GenSigTimeoutTime_GNMM" SG_ 2654339073 PreviousCanNMState_FD05_ECM 0;
BA_ "GenSigTimeoutTime_EVCU2" SG_ 2654339073 PreviousCanNMState_FD05_ECM 0;
BA_ "GenSigTimeoutTime_ESL" SG_ 2654339073 PreviousCanNMState_FD05_ECM 0;
BA_ "GenSigTimeoutTime_ECM" SG_ 2654339073 PreviousCanNMState_FD05_ECM 0;
BA_ "GenSigTimeoutTime_DTCM" SG_ 2654339073 PreviousCanNMState_FD05_ECM 0;
BA_ "GenSigTimeoutTime_DMSM" SG_ 2654339073 PreviousCanNMState_FD05_ECM 0;
BA_ "GenSigTimeoutTime_BSM" SG_ 2654339073 PreviousCanNMState_FD05_ECM 0;
BA_ "GenSigTimeoutTime_BCM" SG_ 2654339073 PreviousCanNMState_FD05_ECM 0;
BA_ "GenSigTimeoutTime_AGSM" SG_ 2654339073 PreviousCanNMState_FD05_ECM 0;
BA_ "GenSigTimeoutTime_ADCAM" SG_ 2654339073 PreviousCanNMState_FD05_ECM 0;
BA_ "GenSigTimeoutTime_RFHM" SG_ 2654339073 StayActiveSource_FD11_ECM 0;
BA_ "GenSigTimeoutTime_MPAD" SG_ 2654339073 StayActiveSource_FD11_ECM 0;
BA_ "GenSigTimeoutTime_IPC" SG_ 2654339073 StayActiveSource_FD11_ECM 0;
BA_ "GenSigTimeoutTime_GNMM" SG_ 2654339073 StayActiveSource_FD11_ECM 0;
BA_ "GenSigTimeoutTime_EVCU2" SG_ 2654339073 StayActiveSource_FD11_ECM 0;
BA_ "GenSigTimeoutTime_ESL" SG_ 2654339073 StayActiveSource_FD11_ECM 0;
BA_ "GenSigTimeoutTime_ECM" SG_ 2654339073 StayActiveSource_FD11_ECM 0;
BA_ "GenSigTimeoutTime_DTCM" SG_ 2654339073 StayActiveSource_FD11_ECM 0;
BA_ "GenSigTimeoutTime_DMSM" SG_ 2654339073 StayActiveSource_FD11_ECM 0;
BA_ "GenSigTimeoutTime_BSM" SG_ 2654339073 StayActiveSource_FD11_ECM 0;
BA_ "GenSigTimeoutTime_BCM" SG_ 2654339073 StayActiveSource_FD11_ECM 0;
BA_ "GenSigTimeoutTime_AGSM" SG_ 2654339073 StayActiveSource_FD11_ECM 0;
BA_ "GenSigTimeoutTime_ADCAM" SG_ 2654339073 StayActiveSource_FD11_ECM 0;
BA_ "GenSigTimeoutTime_BSM" SG_ 2654339073 EOL_FD11_ECM 0;
BA_ "GenSigTimeoutTime_BCM" SG_ 2654339073 EOL_FD11_ECM 0;
BA_ "GenSigTimeoutTime_AGSM" SG_ 2654339073 EOL_FD11_ECM 0;
BA_ "GenSigTimeoutTime_ADCAM" SG_ 2654339073 EOL_FD11_ECM 0;
BA_ "GenSigTimeoutTime_RFHM" SG_ 2654339073 EOL_FD11_ECM 0;
BA_ "GenSigTimeoutTime_MPAD" SG_ 2654339073 EOL_FD11_ECM 0;
BA_ "GenSigTimeoutTime_IPC" SG_ 2654339073 EOL_FD11_ECM 0;
BA_ "GenSigTimeoutTime_GNMM" SG_ 2654339073 EOL_FD11_ECM 0;
BA_ "GenSigTimeoutTime_EVCU2" SG_ 2654339073 EOL_FD11_ECM 0;
BA_ "GenSigTimeoutTime_ESL" SG_ 2654339073 EOL_FD11_ECM 0;
BA_ "GenSigTimeoutTime_ECM" SG_ 2654339073 EOL_FD11_ECM 0;
BA_ "GenSigTimeoutTime_DTCM" SG_ 2654339073 EOL_FD11_ECM 0;
BA_ "GenSigTimeoutTime_DMSM" SG_ 2654339073 EOL_FD11_ECM 0;
BA_ "GenSigTimeoutTime_RFHM" SG_ 2654339073 EOL_FD05_ECM 0;
BA_ "GenSigTimeoutTime_MPAD" SG_ 2654339073 EOL_FD05_ECM 0;
BA_ "GenSigTimeoutTime_IPC" SG_ 2654339073 EOL_FD05_ECM 0;
BA_ "GenSigTimeoutTime_GNMM" SG_ 2654339073 EOL_FD05_ECM 0;
BA_ "GenSigTimeoutTime_EVCU2" SG_ 2654339073 EOL_FD05_ECM 0;
BA_ "GenSigTimeoutTime_ESL" SG_ 2654339073 EOL_FD05_ECM 0;
BA_ "GenSigTimeoutTime_ECM" SG_ 2654339073 EOL_FD05_ECM 0;
BA_ "GenSigTimeoutTime_DTCM" SG_ 2654339073 EOL_FD05_ECM 0;
BA_ "GenSigTimeoutTime_DMSM" SG_ 2654339073 EOL_FD05_ECM 0;
BA_ "GenSigTimeoutTime_BSM" SG_ 2654339073 EOL_FD05_ECM 0;
BA_ "GenSigTimeoutTime_BCM" SG_ 2654339073 EOL_FD05_ECM 0;
BA_ "GenSigTimeoutTime_AGSM" SG_ 2654339073 EOL_FD05_ECM 0;
BA_ "GenSigTimeoutTime_ADCAM" SG_ 2654339073 EOL_FD05_ECM 0;
BA_ "GenSigTimeoutTime_RFHM" SG_ 2654339073 GenericFailSts_FD11_ECM 0;
BA_ "GenSigTimeoutTime_MPAD" SG_ 2654339073 GenericFailSts_FD11_ECM 0;
BA_ "GenSigTimeoutTime_IPC" SG_ 2654339073 GenericFailSts_FD11_ECM 0;
BA_ "GenSigTimeoutTime_GNMM" SG_ 2654339073 GenericFailSts_FD11_ECM 0;
BA_ "GenSigTimeoutTime_EVCU2" SG_ 2654339073 GenericFailSts_FD11_ECM 0;
BA_ "GenSigTimeoutTime_ESL" SG_ 2654339073 GenericFailSts_FD11_ECM 0;
BA_ "GenSigTimeoutTime_ECM" SG_ 2654339073 GenericFailSts_FD11_ECM 0;
BA_ "GenSigTimeoutTime_DTCM" SG_ 2654339073 GenericFailSts_FD11_ECM 0;
BA_ "GenSigTimeoutTime_BSM" SG_ 2654339073 GenericFailSts_FD11_ECM 0;
BA_ "GenSigTimeoutTime_BCM" SG_ 2654339073 GenericFailSts_FD11_ECM 0;
BA_ "GenSigTimeoutTime_AGSM" SG_ 2654339073 GenericFailSts_FD11_ECM 0;
BA_ "GenSigTimeoutTime_ADCAM" SG_ 2654339073 GenericFailSts_FD11_ECM 0;
BA_ "GenSigTimeoutTime_RFHM" SG_ 2654339073 GenericFailSts_FD05_ECM 0;
BA_ "GenSigTimeoutTime_MPAD" SG_ 2654339073 GenericFailSts_FD05_ECM 0;
BA_ "GenSigTimeoutTime_IPC" SG_ 2654339073 GenericFailSts_FD05_ECM 0;
BA_ "GenSigTimeoutTime_GNMM" SG_ 2654339073 GenericFailSts_FD05_ECM 0;
BA_ "GenSigTimeoutTime_EVCU2" SG_ 2654339073 GenericFailSts_FD05_ECM 0;
BA_ "GenSigTimeoutTime_ESL" SG_ 2654339073 GenericFailSts_FD05_ECM 0;
BA_ "GenSigTimeoutTime_ECM" SG_ 2654339073 GenericFailSts_FD05_ECM 0;
BA_ "GenSigTimeoutTime_DTCM" SG_ 2654339073 GenericFailSts_FD05_ECM 0;
BA_ "GenSigTimeoutTime_DMSM" SG_ 2654339073 GenericFailSts_FD05_ECM 0;
BA_ "GenSigTimeoutTime_BSM" SG_ 2654339073 GenericFailSts_FD05_ECM 0;
BA_ "GenSigTimeoutTime_BCM" SG_ 2654339073 GenericFailSts_FD05_ECM 0;
BA_ "GenSigTimeoutTime_AGSM" SG_ 2654339073 GenericFailSts_FD05_ECM 0;
BA_ "GenSigTimeoutTime_ADCAM" SG_ 2654339073 GenericFailSts_FD05_ECM 0;
BA_ "GenSigTimeoutTime_RFHM" SG_ 2654339073 StayActiveSource_FD05_ECM 0;
BA_ "GenSigTimeoutTime_MPAD" SG_ 2654339073 StayActiveSource_FD05_ECM 0;
BA_ "GenSigTimeoutTime_IPC" SG_ 2654339073 StayActiveSource_FD05_ECM 0;
BA_ "GenSigTimeoutTime_GNMM" SG_ 2654339073 StayActiveSource_FD05_ECM 0;
BA_ "GenSigTimeoutTime_EVCU2" SG_ 2654339073 StayActiveSource_FD05_ECM 0;
BA_ "GenSigTimeoutTime_ESL" SG_ 2654339073 StayActiveSource_FD05_ECM 0;
BA_ "GenSigTimeoutTime_ECM" SG_ 2654339073 StayActiveSource_FD05_ECM 0;
BA_ "GenSigTimeoutTime_DTCM" SG_ 2654339073 EOL_FD03_ECM 0;
BA_ "GenSigTimeoutTime_DMSM" SG_ 2654339073 EOL_FD03_ECM 0;
BA_ "GenSigTimeoutTime_RFHM" SG_ 2654339073 GenericFailSts_FD03_ECM 0;
BA_ "GenSigTimeoutTime_MPAD" SG_ 2654339073 GenericFailSts_FD03_ECM 0;
BA_ "GenSigTimeoutTime_IPC" SG_ 2654339073 GenericFailSts_FD03_ECM 0;
BA_ "GenSigTimeoutTime_GNMM" SG_ 2654339073 GenericFailSts_FD03_ECM 0;
BA_ "GenSigTimeoutTime_EVCU2" SG_ 2654339073 GenericFailSts_FD03_ECM 0;
BA_ "GenSigTimeoutTime_ESL" SG_ 2654339073 GenericFailSts_FD03_ECM 0;
BA_ "GenSigTimeoutTime_ECM" SG_ 2654339073 GenericFailSts_FD03_ECM 0;
BA_ "GenSigTimeoutTime_DTCM" SG_ 2654339073 GenericFailSts_FD03_ECM 0;
BA_ "GenSigTimeoutTime_DMSM" SG_ 2654339073 GenericFailSts_FD03_ECM 0;
BA_ "GenSigTimeoutTime_BSM" SG_ 2654339073 GenericFailSts_FD03_ECM 0;
BA_ "GenSigTimeoutTime_AGSM" SG_ 2654339073 GenericFailSts_FD03_ECM 0;
BA_ "GenSigTimeoutTime_ADCAM" SG_ 2654339073 GenericFailSts_FD03_ECM 0;
BA_ "GenSigTimeoutTime_EVCU2" SG_ 2654339136 WakeupSource_FD16_EVCU2 0;
BA_ "GenSigTimeoutTime_ESL" SG_ 2654339136 WakeupSource_FD16_EVCU2 0;
BA_ "GenSigTimeoutTime_ECM" SG_ 2654339136 WakeupSource_FD16_EVCU2 0;
BA_ "GenSigTimeoutTime_DTCM" SG_ 2654339136 WakeupSource_FD16_EVCU2 0;
BA_ "GenSigTimeoutTime_DMSM" SG_ 2654339136 WakeupSource_FD16_EVCU2 0;
BA_ "GenSigTimeoutTime_BSM" SG_ 2654339136 WakeupSource_FD16_EVCU2 0;
BA_ "GenSigTimeoutTime_BCM" SG_ 2654339136 WakeupSource_FD16_EVCU2 0;
BA_ "GenSigTimeoutTime_AGSM" SG_ 2654339136 WakeupSource_FD16_EVCU2 0;
BA_ "GenSigTimeoutTime_ADCAM" SG_ 2654339136 WakeupSource_FD16_EVCU2 0;
BA_ "GenSigTimeoutTime_RFHM" SG_ 2654339136 WakeupSource_FD11_EVCU2 0;
BA_ "GenSigTimeoutTime_MPAD" SG_ 2654339136 WakeupSource_FD11_EVCU2 0;
BA_ "GenSigTimeoutTime_IPC" SG_ 2654339136 WakeupSource_FD11_EVCU2 0;
BA_ "GenSigTimeoutTime_GNMM" SG_ 2654339136 WakeupSource_FD11_EVCU2 0;
BA_ "GenSigTimeoutTime_EVCU2" SG_ 2654339136 WakeupSource_FD11_EVCU2 0;
BA_ "GenSigTimeoutTime_ESL" SG_ 2654339136 WakeupSource_FD11_EVCU2 0;
BA_ "GenSigTimeoutTime_ECM" SG_ 2654339136 WakeupSource_FD11_EVCU2 0;
BA_ "GenSigTimeoutTime_DTCM" SG_ 2654339136 WakeupSource_FD11_EVCU2 0;
BA_ "GenSigTimeoutTime_DMSM" SG_ 2654339136 WakeupSource_FD11_EVCU2 0;
BA_ "GenSigTimeoutTime_BSM" SG_ 2654339136 WakeupSource_FD11_EVCU2 0;
BA_ "GenSigTimeoutTime_BCM" SG_ 2654339136 WakeupSource_FD11_EVCU2 0;
BA_ "GenSigTimeoutTime_AGSM" SG_ 2654339136 WakeupSource_FD11_EVCU2 0;
BA_ "GenSigTimeoutTime_ADCAM" SG_ 2654339136 WakeupSource_FD11_EVCU2 0;
BA_ "GenSigTimeoutTime_RFHM" SG_ 2654339136 WakeupSource_FD05_EVCU2 0;
BA_ "GenSigTimeoutTime_MPAD" SG_ 2654339136 WakeupSource_FD05_EVCU2 0;
BA_ "GenSigTimeoutTime_IPC" SG_ 2654339136 WakeupSource_FD05_EVCU2 0;
BA_ "GenSigTimeoutTime_GNMM" SG_ 2654339136 WakeupSource_FD05_EVCU2 0;
BA_ "GenSigTimeoutTime_EVCU2" SG_ 2654339136 WakeupSource_FD05_EVCU2 0;
BA_ "GenSigTimeoutTime_ESL" SG_ 2654339136 WakeupSource_FD05_EVCU2 0;
BA_ "GenSigTimeoutTime_ECM" SG_ 2654339136 WakeupSource_FD05_EVCU2 0;
BA_ "GenSigTimeoutTime_DTCM" SG_ 2654339136 WakeupSource_FD05_EVCU2 0;
BA_ "GenSigTimeoutTime_DMSM" SG_ 2654339136 WakeupSource_FD05_EVCU2 0;
BA_ "GenSigTimeoutTime_BSM" SG_ 2654339136 WakeupSource_FD05_EVCU2 0;
BA_ "GenSigTimeoutTime_BCM" SG_ 2654339136 WakeupSource_FD05_EVCU2 0;
BA_ "GenSigTimeoutTime_AGSM" SG_ 2654339136 WakeupSource_FD05_EVCU2 0;
BA_ "GenSigTimeoutTime_ADCAM" SG_ 2654339136 WakeupSource_FD05_EVCU2 0;
BA_ "GenSigTimeoutTime_RFHM" SG_ 2654339136 WakeupSource_FD03_EVCU2 0;
BA_ "GenSigTimeoutTime_MPAD" SG_ 2654339136 WakeupSource_FD03_EVCU2 0;
BA_ "GenSigTimeoutTime_IPC" SG_ 2654339136 WakeupSource_FD03_EVCU2 0;
BA_ "GenSigTimeoutTime_GNMM" SG_ 2654339136 WakeupSource_FD03_EVCU2 0;
BA_ "GenSigTimeoutTime_EVCU2" SG_ 2654339136 WakeupSource_FD03_EVCU2 0;
BA_ "GenSigTimeoutTime_ESL" SG_ 2654339136 WakeupSource_FD03_EVCU2 0;
BA_ "GenSigTimeoutTime_ECM" SG_ 2654339136 WakeupSource_FD03_EVCU2 0;
BA_ "GenSigTimeoutTime_DTCM" SG_ 2654339136 WakeupSource_FD03_EVCU2 0;
BA_ "GenSigTimeoutTime_DMSM" SG_ 2654339136 WakeupSource_FD03_EVCU2 0;
BA_ "GenSigTimeoutTime_BSM" SG_ 2654339136 WakeupSource_FD03_EVCU2 0;
BA_ "GenSigTimeoutTime_BCM" SG_ 2654339136 WakeupSource_FD03_EVCU2 0;
BA_ "GenSigTimeoutTime_AGSM" SG_ 2654339136 WakeupSource_FD03_EVCU2 0;
BA_ "GenSigTimeoutTime_ADCAM" SG_ 2654339136 WakeupSource_FD03_EVCU2 0;
BA_ "GenSigTimeoutTime_RFHM" SG_ 2654339136 StayActiveSource_FD16_EVCU2 0;
BA_ "GenSigTimeoutTime_MPAD" SG_ 2654339136 StayActiveSource_FD16_EVCU2 0;
BA_ "GenSigTimeoutTime_IPC" SG_ 2654339136 StayActiveSource_FD16_EVCU2 0;
BA_ "GenSigTimeoutTime_GNMM" SG_ 2654339136 StayActiveSource_FD16_EVCU2 0;
BA_ "GenSigTimeoutTime_EVCU2" SG_ 2654339136 StayActiveSource_FD16_EVCU2 0;
BA_ "GenSigTimeoutTime_ESL" SG_ 2654339136 StayActiveSource_FD16_EVCU2 0;
BA_ "GenSigTimeoutTime_ECM" SG_ 2654339136 StayActiveSource_FD16_EVCU2 0;
BA_ "GenSigTimeoutTime_DTCM" SG_ 2654339136 StayActiveSource_FD16_EVCU2 0;
BA_ "GenSigTimeoutTime_DMSM" SG_ 2654339136 StayActiveSource_FD16_EVCU2 0;
BA_ "GenSigTimeoutTime_BSM" SG_ 2654339136 StayActiveSource_FD16_EVCU2 0;
BA_ "GenSigTimeoutTime_BCM" SG_ 2654339136 StayActiveSource_FD16_EVCU2 0;
BA_ "GenSigTimeoutTime_AGSM" SG_ 2654339136 StayActiveSource_FD16_EVCU2 0;
BA_ "GenSigTimeoutTime_ADCAM" SG_ 2654339136 StayActiveSource_FD16_EVCU2 0;
BA_ "GenSigTimeoutTime_RFHM" SG_ 2654339136 StayActiveSource_FD11_EVCU2 0;
BA_ "GenSigTimeoutTime_MPAD" SG_ 2654339136 StayActiveSource_FD11_EVCU2 0;
BA_ "GenSigTimeoutTime_IPC" SG_ 2654339136 StayActiveSource_FD11_EVCU2 0;
BA_ "GenSigTimeoutTime_GNMM" SG_ 2654339136 StayActiveSource_FD11_EVCU2 0;
BA_ "GenSigTimeoutTime_EVCU2" SG_ 2654339136 StayActiveSource_FD11_EVCU2 0;
BA_ "GenSigTimeoutTime_ESL" SG_ 2654339136 StayActiveSource_FD11_EVCU2 0;
BA_ "GenSigTimeoutTime_ECM" SG_ 2654339136 StayActiveSource_FD11_EVCU2 0;
BA_ "GenSigTimeoutTime_DTCM" SG_ 2654339136 StayActiveSource_FD11_EVCU2 0;
BA_ "GenSigTimeoutTime_DMSM" SG_ 2654339136 StayActiveSource_FD11_EVCU2 0;
BA_ "GenSigTimeoutTime_BSM" SG_ 2654339136 StayActiveSource_FD11_EVCU2 0;
BA_ "GenSigTimeoutTime_BCM" SG_ 2654339136 StayActiveSource_FD11_EVCU2 0;
BA_ "GenSigTimeoutTime_AGSM" SG_ 2654339136 StayActiveSource_FD11_EVCU2 0;
BA_ "GenSigTimeoutTime_ADCAM" SG_ 2654339136 StayActiveSource_FD11_EVCU2 0;
BA_ "GenSigTimeoutTime_RFHM" SG_ 2654339136 StayActiveSource_FD05_EVCU2 0;
BA_ "GenSigTimeoutTime_MPAD" SG_ 2654339136 StayActiveSource_FD05_EVCU2 0;
BA_ "GenSigTimeoutTime_IPC" SG_ 2654339136 StayActiveSource_FD05_EVCU2 0;
BA_ "GenSigTimeoutTime_GNMM" SG_ 2654339136 StayActiveSource_FD05_EVCU2 0;
BA_ "GenSigTimeoutTime_EVCU2" SG_ 2654339136 StayActiveSource_FD05_EVCU2 0;
BA_ "GenSigTimeoutTime_ESL" SG_ 2654339136 StayActiveSource_FD05_EVCU2 0;
BA_ "GenSigTimeoutTime_ECM" SG_ 2654339136 StayActiveSource_FD05_EVCU2 0;
BA_ "GenSigTimeoutTime_DTCM" SG_ 2654339136 StayActiveSource_FD05_EVCU2 0;
BA_ "GenSigTimeoutTime_DMSM" SG_ 2654339136 StayActiveSource_FD05_EVCU2 0;
BA_ "GenSigTimeoutTime_BSM" SG_ 2654339136 StayActiveSource_FD05_EVCU2 0;
BA_ "GenSigTimeoutTime_BCM" SG_ 2654339136 StayActiveSource_FD05_EVCU2 0;
BA_ "GenSigTimeoutTime_AGSM" SG_ 2654339136 StayActiveSource_FD05_EVCU2 0;
BA_ "GenSigTimeoutTime_ADCAM" SG_ 2654339136 StayActiveSource_FD05_EVCU2 0;
BA_ "GenSigTimeoutTime_RFHM" SG_ 2654339136 StayActiveSource_FD03_EVCU2 0;
BA_ "GenSigTimeoutTime_MPAD" SG_ 2654339136 StayActiveSource_FD03_EVCU2 0;
BA_ "GenSigTimeoutTime_IPC" SG_ 2654339136 StayActiveSource_FD03_EVCU2 0;
BA_ "GenSigTimeoutTime_GNMM" SG_ 2654339136 StayActiveSource_FD03_EVCU2 0;
BA_ "GenSigTimeoutTime_EVCU2" SG_ 2654339136 StayActiveSource_FD03_EVCU2 0;
BA_ "GenSigTimeoutTime_ESL" SG_ 2654339136 StayActiveSource_FD03_EVCU2 0;
BA_ "GenSigTimeoutTime_ECM" SG_ 2654339136 StayActiveSource_FD03_EVCU2 0;
BA_ "GenSigTimeoutTime_DTCM" SG_ 2654339136 StayActiveSource_FD03_EVCU2 0;
BA_ "GenSigTimeoutTime_DMSM" SG_ 2654339136 StayActiveSource_FD03_EVCU2 0;
BA_ "GenSigTimeoutTime_BSM" SG_ 2654339136 StayActiveSource_FD03_EVCU2 0;
BA_ "GenSigTimeoutTime_BCM" SG_ 2654339136 StayActiveSource_FD03_EVCU2 0;
BA_ "GenSigTimeoutTime_AGSM" SG_ 2654339136 StayActiveSource_FD03_EVCU2 0;
BA_ "GenSigTimeoutTime_ADCAM" SG_ 2654339136 StayActiveSource_FD03_EVCU2 0;
BA_ "GenSigTimeoutTime_RFHM" SG_ 2654339136 PreviousCanNMState_FD16_EVCU2 0;
BA_ "GenSigTimeoutTime_MPAD" SG_ 2654339136 PreviousCanNMState_FD16_EVCU2 0;
BA_ "GenSigTimeoutTime_IPC" SG_ 2654339136 PreviousCanNMState_FD16_EVCU2 0;
BA_ "GenSigTimeoutTime_GNMM" SG_ 2654339136 PreviousCanNMState_FD16_EVCU2 0;
BA_ "GenSigTimeoutTime_EVCU2" SG_ 2654339136 PreviousCanNMState_FD16_EVCU2 0;
BA_ "GenSigTimeoutTime_ESL" SG_ 2654339136 PreviousCanNMState_FD16_EVCU2 0;
BA_ "GenSigTimeoutTime_ECM" SG_ 2654339136 PreviousCanNMState_FD16_EVCU2 0;
BA_ "GenSigTimeoutTime_DTCM" SG_ 2654339136 PreviousCanNMState_FD16_EVCU2 0;
BA_ "GenSigTimeoutTime_DMSM" SG_ 2654339136 PreviousCanNMState_FD16_EVCU2 0;
BA_ "GenSigTimeoutTime_BSM" SG_ 2654339136 PreviousCanNMState_FD16_EVCU2 0;
BA_ "GenSigTimeoutTime_BCM" SG_ 2654339136 PreviousCanNMState_FD16_EVCU2 0;
BA_ "GenSigTimeoutTime_AGSM" SG_ 2654339136 PreviousCanNMState_FD16_EVCU2 0;
BA_ "GenSigTimeoutTime_ADCAM" SG_ 2654339136 PreviousCanNMState_FD16_EVCU2 0;
BA_ "GenSigTimeoutTime_RFHM" SG_ 2654339136 PreviousCanNMState_FD11_EVCU2 0;
BA_ "GenSigTimeoutTime_MPAD" SG_ 2654339136 PreviousCanNMState_FD11_EVCU2 0;
BA_ "GenSigTimeoutTime_IPC" SG_ 2654339136 PreviousCanNMState_FD11_EVCU2 0;
BA_ "GenSigTimeoutTime_GNMM" SG_ 2654339136 PreviousCanNMState_FD11_EVCU2 0;
BA_ "GenSigTimeoutTime_EVCU2" SG_ 2654339136 PreviousCanNMState_FD11_EVCU2 0;
BA_ "GenSigTimeoutTime_ESL" SG_ 2654339136 PreviousCanNMState_FD11_EVCU2 0;
BA_ "GenSigTimeoutTime_ECM" SG_ 2654339136 PreviousCanNMState_FD11_EVCU2 0;
BA_ "GenSigTimeoutTime_DTCM" SG_ 2654339136 PreviousCanNMState_FD11_EVCU2 0;
BA_ "GenSigTimeoutTime_DMSM" SG_ 2654339136 PreviousCanNMState_FD11_EVCU2 0;
BA_ "GenSigTimeoutTime_BSM" SG_ 2654339136 PreviousCanNMState_FD11_EVCU2 0;
BA_ "GenSigTimeoutTime_BCM" SG_ 2654339136 PreviousCanNMState_FD11_EVCU2 0;
BA_ "GenSigTimeoutTime_AGSM" SG_ 2654339136 PreviousCanNMState_FD11_EVCU2 0;
BA_ "GenSigTimeoutTime_ADCAM" SG_ 2654339136 PreviousCanNMState_FD11_EVCU2 0;
BA_ "GenSigTimeoutTime_RFHM" SG_ 2654339136 PreviousCanNMState_FD05_EVCU2 0;
BA_ "GenSigTimeoutTime_MPAD" SG_ 2654339136 PreviousCanNMState_FD05_EVCU2 0;
BA_ "GenSigTimeoutTime_IPC" SG_ 2654339136 PreviousCanNMState_FD05_EVCU2 0;
BA_ "GenSigTimeoutTime_GNMM" SG_ 2654339136 PreviousCanNMState_FD05_EVCU2 0;
BA_ "GenSigTimeoutTime_EVCU2" SG_ 2654339136 PreviousCanNMState_FD05_EVCU2 0;
BA_ "GenSigTimeoutTime_ESL" SG_ 2654339136 PreviousCanNMState_FD05_EVCU2 0;
BA_ "GenSigTimeoutTime_ECM" SG_ 2654339136 PreviousCanNMState_FD05_EVCU2 0;
BA_ "GenSigTimeoutTime_DTCM" SG_ 2654339136 PreviousCanNMState_FD05_EVCU2 0;
BA_ "GenSigTimeoutTime_DMSM" SG_ 2654339136 PreviousCanNMState_FD05_EVCU2 0;
BA_ "GenSigTimeoutTime_BSM" SG_ 2654339136 PreviousCanNMState_FD05_EVCU2 0;
BA_ "GenSigTimeoutTime_BCM" SG_ 2654339136 PreviousCanNMState_FD05_EVCU2 0;
BA_ "GenSigTimeoutTime_AGSM" SG_ 2654339136 PreviousCanNMState_FD05_EVCU2 0;
BA_ "GenSigTimeoutTime_ADCAM" SG_ 2654339136 PreviousCanNMState_FD05_EVCU2 0;
BA_ "GenSigTimeoutTime_RFHM" SG_ 2654339136 PreviousCanNMState_FD03_EVCU2 0;
BA_ "GenSigTimeoutTime_MPAD" SG_ 2654339136 PreviousCanNMState_FD03_EVCU2 0;
BA_ "GenSigTimeoutTime_IPC" SG_ 2654339136 PreviousCanNMState_FD03_EVCU2 0;
BA_ "GenSigTimeoutTime_GNMM" SG_ 2654339136 PreviousCanNMState_FD03_EVCU2 0;
BA_ "GenSigTimeoutTime_EVCU2" SG_ 2654339136 PreviousCanNMState_FD03_EVCU2 0;
BA_ "GenSigTimeoutTime_ESL" SG_ 2654339136 PreviousCanNMState_FD03_EVCU2 0;
BA_ "GenSigTimeoutTime_ECM" SG_ 2654339136 PreviousCanNMState_FD03_EVCU2 0;
BA_ "GenSigTimeoutTime_DTCM" SG_ 2654339136 PreviousCanNMState_FD03_EVCU2 0;
BA_ "GenSigTimeoutTime_DMSM" SG_ 2654339136 PreviousCanNMState_FD03_EVCU2 0;
BA_ "GenSigTimeoutTime_BSM" SG_ 2654339136 PreviousCanNMState_FD03_EVCU2 0;
BA_ "GenSigTimeoutTime_BCM" SG_ 2654339136 PreviousCanNMState_FD03_EVCU2 0;
BA_ "GenSigTimeoutTime_AGSM" SG_ 2654339136 PreviousCanNMState_FD03_EVCU2 0;
BA_ "GenSigTimeoutTime_ADCAM" SG_ 2654339136 PreviousCanNMState_FD03_EVCU2 0;
BA_ "GenSigTimeoutTime_RFHM" SG_ 2654339136 GenericFailSts_FD16_EVCU2 0;
BA_ "GenSigTimeoutTime_MPAD" SG_ 2654339136 GenericFailSts_FD16_EVCU2 0;
BA_ "GenSigTimeoutTime_IPC" SG_ 2654339136 GenericFailSts_FD16_EVCU2 0;
BA_ "GenSigTimeoutTime_GNMM" SG_ 2654339136 GenericFailSts_FD16_EVCU2 0;
BA_ "GenSigTimeoutTime_EVCU2" SG_ 2654339136 GenericFailSts_FD16_EVCU2 0;
BA_ "GenSigTimeoutTime_ESL" SG_ 2654339136 GenericFailSts_FD16_EVCU2 0;
BA_ "GenSigTimeoutTime_ECM" SG_ 2654339136 GenericFailSts_FD16_EVCU2 0;
BA_ "GenSigTimeoutTime_DTCM" SG_ 2654339136 GenericFailSts_FD16_EVCU2 0;
BA_ "GenSigTimeoutTime_DMSM" SG_ 2654339136 GenericFailSts_FD16_EVCU2 0;
BA_ "GenSigTimeoutTime_BSM" SG_ 2654339136 GenericFailSts_FD16_EVCU2 0;
BA_ "GenSigTimeoutTime_BCM" SG_ 2654339136 GenericFailSts_FD16_EVCU2 0;
BA_ "GenSigTimeoutTime_AGSM" SG_ 2654339136 GenericFailSts_FD16_EVCU2 0;
BA_ "GenSigTimeoutTime_ADCAM" SG_ 2654339136 GenericFailSts_FD16_EVCU2 0;
BA_ "GenSigTimeoutTime_IPC" SG_ 2654339136 GenericFailSts_FD11_EVCU2 0;
BA_ "GenSigTimeoutTime_GNMM" SG_ 2654339136 GenericFailSts_FD11_EVCU2 0;
BA_ "GenSigTimeoutTime_EVCU2" SG_ 2654339136 GenericFailSts_FD11_EVCU2 0;
BA_ "GenSigTimeoutTime_ESL" SG_ 2654339136 GenericFailSts_FD11_EVCU2 0;
BA_ "GenSigTimeoutTime_ECM" SG_ 2654339136 GenericFailSts_FD11_EVCU2 0;
BA_ "GenSigTimeoutTime_DTCM" SG_ 2654339136 GenericFailSts_FD11_EVCU2 0;
BA_ "GenSigTimeoutTime_DMSM" SG_ 2654339136 GenericFailSts_FD11_EVCU2 0;
BA_ "GenSigTimeoutTime_BSM" SG_ 2654339136 GenericFailSts_FD11_EVCU2 0;
BA_ "GenSigTimeoutTime_BCM" SG_ 2654339136 GenericFailSts_FD11_EVCU2 0;
BA_ "GenSigTimeoutTime_AGSM" SG_ 2654339136 GenericFailSts_FD11_EVCU2 0;
BA_ "GenSigTimeoutTime_ADCAM" SG_ 2654339136 GenericFailSts_FD11_EVCU2 0;
BA_ "GenSigTimeoutTime_RFHM" SG_ 2654339136 GenericFailSts_FD11_EVCU2 0;
BA_ "GenSigTimeoutTime_MPAD" SG_ 2654339136 GenericFailSts_FD11_EVCU2 0;
BA_ "GenSigTimeoutTime_RFHM" SG_ 2654339136 GenericFailSts_FD05_EVCU2 0;
BA_ "GenSigTimeoutTime_MPAD" SG_ 2654339136 GenericFailSts_FD05_EVCU2 0;
BA_ "GenSigTimeoutTime_IPC" SG_ 2654339136 GenericFailSts_FD05_EVCU2 0;
BA_ "GenSigTimeoutTime_GNMM" SG_ 2654339136 GenericFailSts_FD05_EVCU2 0;
BA_ "GenSigTimeoutTime_EVCU2" SG_ 2654339136 GenericFailSts_FD05_EVCU2 0;
BA_ "GenSigTimeoutTime_ESL" SG_ 2654339136 GenericFailSts_FD05_EVCU2 0;
BA_ "GenSigTimeoutTime_ECM" SG_ 2654339136 GenericFailSts_FD05_EVCU2 0;
BA_ "GenSigTimeoutTime_DTCM" SG_ 2654339136 GenericFailSts_FD05_EVCU2 0;
BA_ "GenSigTimeoutTime_DMSM" SG_ 2654339136 GenericFailSts_FD05_EVCU2 0;
BA_ "GenSigTimeoutTime_BSM" SG_ 2654339136 GenericFailSts_FD05_EVCU2 0;
BA_ "GenSigTimeoutTime_BCM" SG_ 2654339136 GenericFailSts_FD05_EVCU2 0;
BA_ "GenSigTimeoutTime_AGSM" SG_ 2654339136 GenericFailSts_FD05_EVCU2 0;
BA_ "GenSigTimeoutTime_ADCAM" SG_ 2654339136 GenericFailSts_FD05_EVCU2 0;
BA_ "GenSigTimeoutTime_RFHM" SG_ 2654339136 GenericFailSts_FD03_EVCU2 0;
BA_ "GenSigTimeoutTime_MPAD" SG_ 2654339136 GenericFailSts_FD03_EVCU2 0;
BA_ "GenSigTimeoutTime_IPC" SG_ 2654339136 GenericFailSts_FD03_EVCU2 0;
BA_ "GenSigTimeoutTime_GNMM" SG_ 2654339136 GenericFailSts_FD03_EVCU2 0;
BA_ "GenSigTimeoutTime_EVCU2" SG_ 2654339136 GenericFailSts_FD03_EVCU2 0;
BA_ "GenSigTimeoutTime_ESL" SG_ 2654339136 GenericFailSts_FD03_EVCU2 0;
BA_ "GenSigTimeoutTime_ECM" SG_ 2654339136 GenericFailSts_FD03_EVCU2 0;
BA_ "GenSigTimeoutTime_DTCM" SG_ 2654339136 GenericFailSts_FD03_EVCU2 0;
BA_ "GenSigTimeoutTime_DMSM" SG_ 2654339136 GenericFailSts_FD03_EVCU2 0;
BA_ "GenSigTimeoutTime_BSM" SG_ 2654339136 GenericFailSts_FD03_EVCU2 0;
BA_ "GenSigTimeoutTime_SGW" SG_ 263 WED_STATUS 0;
BA_ "GenSigTimeoutTime_RFHM" SG_ 263 WED_STATUS 0;
BA_ "GenSigTimeoutTime_MPAD" SG_ 263 WED_STATUS 0;
BA_ "GenSigTimeoutTime_IPC" SG_ 263 WED_STATUS 0;
BA_ "GenSigTimeoutTime_GNMM" SG_ 263 WED_STATUS 0;
BA_ "GenSigTimeoutTime_EVCU2" SG_ 263 WED_STATUS 0;
BA_ "GenSigTimeoutTime_ESL" SG_ 263 WED_STATUS 0;
BA_ "GenSigTimeoutTime_ECM" SG_ 263 WED_STATUS 0;
BA_ "GenSigTimeoutTime_DTCM" SG_ 263 WED_STATUS 0;
BA_ "GenSigTimeoutTime_DMSM" SG_ 263 WED_STATUS 0;
BA_ "GenSigTimeoutTime_BCM" SG_ 263 WED_STATUS 0;
BA_ "GenSigTimeoutTime_AGSM" SG_ 263 WED_STATUS 0;
BA_ "GenSigTimeoutTime_ADCAM" SG_ 263 WED_STATUS 0;
BA_ "GenSigTimeoutTime_SGW" SG_ 263 Warn_BTO_PT 0;
BA_ "GenSigTimeoutTime_RFHM" SG_ 263 Warn_BTO_PT 0;
BA_ "GenSigTimeoutTime_MPAD" SG_ 263 Warn_BTO_PT 0;
BA_ "GenSigTimeoutTime_GNMM" SG_ 263 Warn_BTO_PT 0;
BA_ "GenSigTimeoutTime_EVCU2" SG_ 263 Warn_BTO_PT 0;
BA_ "GenSigTimeoutTime_ESL" SG_ 263 Warn_BTO_PT 0;
BA_ "GenSigTimeoutTime_ECM" SG_ 263 Warn_BTO_PT 0;
BA_ "GenSigTimeoutTime_DTCM" SG_ 263 Warn_BTO_PT 0;
BA_ "GenSigTimeoutTime_DMSM" SG_ 263 Warn_BTO_PT 0;
BA_ "GenSigTimeoutTime_BSM" SG_ 263 Warn_BTO_PT 0;
BA_ "GenSigTimeoutTime_BCM" SG_ 263 Warn_BTO_PT 0;
BA_ "GenSigTimeoutTime_AGSM" SG_ 263 Warn_BTO_PT 0;
BA_ "GenSigTimeoutTime_ADCAM" SG_ 263 Warn_BTO_PT 0;
BA_ "GenSigTimeoutTime_SGW" SG_ 263 VehSpd_Overridden_PT 0;
BA_ "GenSigTimeoutTime_RFHM" SG_ 263 VehSpd_Overridden_PT 0;
BA_ "GenSigTimeoutTime_MPAD" SG_ 263 VehSpd_Overridden_PT 0;
BA_ "GenSigTimeoutTime_GNMM" SG_ 263 VehSpd_Overridden_PT 0;
BA_ "GenSigTimeoutTime_EVCU2" SG_ 263 VehSpd_Overridden_PT 0;
BA_ "GenSigTimeoutTime_ESL" SG_ 263 VehSpd_Overridden_PT 0;
BA_ "GenSigTimeoutTime_ECM" SG_ 263 VehSpd_Overridden_PT 0;
BA_ "GenSigTimeoutTime_DTCM" SG_ 263 VehSpd_Overridden_PT 0;
BA_ "GenSigTimeoutTime_DMSM" SG_ 263 VehSpd_Overridden_PT 0;
BA_ "GenSigTimeoutTime_BSM" SG_ 263 VehSpd_Overridden_PT 0;
BA_ "GenSigTimeoutTime_BCM" SG_ 263 VehSpd_Overridden_PT 0;
BA_ "GenSigTimeoutTime_AGSM" SG_ 263 VehSpd_Overridden_PT 0;
BA_ "GenSigTimeoutTime_ADCAM" SG_ 263 VehSpd_Overridden_PT 0;
BA_ "GenSigTimeoutTime_SGW" SG_ 263 Vehicle_Hold_Rq_PT 0;
BA_ "GenSigTimeoutTime_RFHM" SG_ 263 Vehicle_Hold_Rq_PT 0;
BA_ "GenSigTimeoutTime_MPAD" SG_ 263 Vehicle_Hold_Rq_PT 0;
BA_ "GenSigTimeoutTime_IPC" SG_ 263 Vehicle_Hold_Rq_PT 0;
BA_ "GenSigTimeoutTime_GNMM" SG_ 263 Vehicle_Hold_Rq_PT 0;
BA_ "GenSigTimeoutTime_EVCU2" SG_ 263 Vehicle_Hold_Rq_PT 0;
BA_ "GenSigTimeoutTime_ESL" SG_ 263 Vehicle_Hold_Rq_PT 0;
BA_ "GenSigTimeoutTime_ECM" SG_ 263 Vehicle_Hold_Rq_PT 0;
BA_ "GenSigTimeoutTime_DTCM" SG_ 263 Vehicle_Hold_Rq_PT 0;
BA_ "GenSigTimeoutTime_DMSM" SG_ 263 Vehicle_Hold_Rq_PT 0;
BA_ "GenSigTimeoutTime_BSM" SG_ 263 Vehicle_Hold_Rq_PT 0;
BA_ "GenSigTimeoutTime_BCM" SG_ 263 Vehicle_Hold_Rq_PT 0;
BA_ "GenSigTimeoutTime_AGSM" SG_ 263 Vehicle_Hold_Rq_PT 0;
BA_ "GenSigTimeoutTime_ADCAM" SG_ 263 Vehicle_Hold_Rq_PT 0;
BA_ "GenSigTimeoutTime_RFHM" SG_ 263 TurtleModeSts_PT 0;
BA_ "GenSigTimeoutTime_MPAD" SG_ 263 TurtleModeSts_PT 0;
BA_ "GenSigTimeoutTime_GNMM" SG_ 263 TurtleModeSts_PT 0;
BA_ "GenSigTimeoutTime_EVCU2" SG_ 263 TurtleModeSts_PT 0;
BA_ "GenSigTimeoutTime_ESL" SG_ 263 TurtleModeSts_PT 0;
BA_ "GenSigTimeoutTime_ECM" SG_ 263 TurtleModeSts_PT 0;
BA_ "GenSigTimeoutTime_DTCM" SG_ 263 TurtleModeSts_PT 0;
BA_ "GenSigTimeoutTime_DMSM" SG_ 263 TurtleModeSts_PT 0;
BA_ "GenSigTimeoutTime_BSM" SG_ 263 TurtleModeSts_PT 0;
BA_ "GenSigTimeoutTime_AGSM" SG_ 263 TurtleModeSts_PT 0;
BA_ "GenSigTimeoutTime_ADCAM" SG_ 263 TurtleModeSts_PT 0;
BA_ "GenSigTimeoutTime_RFHM" SG_ 263 TransmissionWarnings_PT 0;
BA_ "GenSigTimeoutTime_GNMM" SG_ 263 TransmissionWarnings_PT 0;
BA_ "GenSigTimeoutTime_EVCU2" SG_ 263 TransmissionWarnings_PT 0;
BA_ "GenSigTimeoutTime_ESL" SG_ 263 TransmissionWarnings_PT 0;
BA_ "GenSigTimeoutTime_ECM" SG_ 263 TransmissionWarnings_PT 0;
BA_ "GenSigTimeoutTime_DTCM" SG_ 263 TransmissionWarnings_PT 0;
BA_ "GenSigTimeoutTime_DMSM" SG_ 263 TransmissionWarnings_PT 0;
BA_ "GenSigTimeoutTime_AGSM" SG_ 263 TransmissionWarnings_PT 0;
BA_ "GenSigTimeoutTime_ADCAM" SG_ 263 TransmissionWarnings_PT 0;
BA_ "GenSigTimeoutTime_RFHM" SG_ 263 TransmissionFailSts_PT 0;
BA_ "GenSigTimeoutTime_MPAD" SG_ 263 TransmissionFailSts_PT 0;
BA_ "GenSigTimeoutTime_IPC" SG_ 263 TransmissionFailSts_PT 0;
BA_ "GenSigTimeoutTime_GNMM" SG_ 263 TransmissionFailSts_PT 0;
BA_ "GenSigTimeoutTime_EVCU2" SG_ 263 TransmissionFailSts_PT 0;
BA_ "GenSigTimeoutTime_ESL" SG_ 263 TransmissionFailSts_PT 0;
BA_ "GenSigTimeoutTime_DTCM" SG_ 263 TransmissionFailSts_PT 0;
BA_ "GenSigTimeoutTime_DMSM" SG_ 263 TransmissionFailSts_PT 0;
BA_ "GenSigTimeoutTime_ADCAM" SG_ 263 TransmissionFailSts_PT 0;
BA_ "GenSigTimeoutTime_RFHM" SG_ 263 TerrainModeStat_PT 0;
BA_ "GenSigTimeoutTime_GNMM" SG_ 263 TerrainModeStat_PT 0;
BA_ "GenSigTimeoutTime_EVCU2" SG_ 263 TerrainModeStat_PT 0;
BA_ "GenSigTimeoutTime_ESL" SG_ 263 TerrainModeStat_PT 0;
BA_ "GenSigTimeoutTime_DMSM" SG_ 263 TerrainModeStat_PT 0;
BA_ "GenSigTimeoutTime_AGSM" SG_ 263 TerrainModeStat_PT 0;
BA_ "GenSigTimeoutTime_SGW" SG_ 263 Terrain_HMI_Rq_PT 0;
BA_ "GenSigTimeoutTime_RFHM" SG_ 263 Terrain_HMI_Rq_PT 0;
BA_ "GenSigTimeoutTime_MPAD" SG_ 263 Terrain_HMI_Rq_PT 0;
BA_ "GenSigTimeoutTime_GNMM" SG_ 263 Terrain_HMI_Rq_PT 0;
BA_ "GenSigTimeoutTime_EVCU2" SG_ 263 Terrain_HMI_Rq_PT 0;
BA_ "GenSigTimeoutTime_ESL" SG_ 263 Terrain_HMI_Rq_PT 0;
BA_ "GenSigTimeoutTime_ECM" SG_ 263 Terrain_HMI_Rq_PT 0;
BA_ "GenSigTimeoutTime_DTCM" SG_ 263 Terrain_HMI_Rq_PT 0;
BA_ "GenSigTimeoutTime_DMSM" SG_ 263 Terrain_HMI_Rq_PT 0;
BA_ "GenSigTimeoutTime_BSM" SG_ 263 Terrain_HMI_Rq_PT 0;
BA_ "GenSigTimeoutTime_AGSM" SG_ 263 Terrain_HMI_Rq_PT 0;
BA_ "GenSigTimeoutTime_ADCAM" SG_ 263 Terrain_HMI_Rq_PT 0;
BA_ "GenSigTimeoutTime_SGW" SG_ 263 TerrainModeDesiredStat_PT 0;
BA_ "GenSigTimeoutTime_RFHM" SG_ 263 TerrainModeDesiredStat_PT 0;
BA_ "GenSigTimeoutTime_GNMM" SG_ 263 TerrainModeDesiredStat_PT 0;
BA_ "GenSigTimeoutTime_EVCU2" SG_ 263 TerrainModeDesiredStat_PT 0;
BA_ "GenSigTimeoutTime_ESL" SG_ 263 TerrainModeDesiredStat_PT 0;
BA_ "GenSigTimeoutTime_ECM" SG_ 263 TerrainModeDesiredStat_PT 0;
BA_ "GenSigTimeoutTime_DTCM" SG_ 263 TerrainModeDesiredStat_PT 0;
BA_ "GenSigTimeoutTime_DMSM" SG_ 263 TerrainModeDesiredStat_PT 0;
BA_ "GenSigTimeoutTime_BSM" SG_ 263 TerrainModeDesiredStat_PT 0;
BA_ "GenSigTimeoutTime_AGSM" SG_ 263 TerrainModeDesiredStat_PT 0;
BA_ "GenSigTimeoutTime_ADCAM" SG_ 263 TerrainModeDesiredStat_PT 0;
BA_ "GenSigTimeoutTime_RFHM" SG_ 263 TargetGear_PT 0;
BA_ "GenSigTimeoutTime_GNMM" SG_ 263 TargetGear_PT 0;
BA_ "GenSigTimeoutTime_EVCU2" SG_ 263 TargetGear_PT 0;
BA_ "GenSigTimeoutTime_ESL" SG_ 263 TargetGear_PT 0;
BA_ "GenSigTimeoutTime_DMSM" SG_ 263 TargetGear_PT 0;
BA_ "GenSigTimeoutTime_AGSM" SG_ 263 TargetGear_PT 0;
BA_ "GenSigTimeoutTime_ADCAM" SG_ 263 TargetGear_PT 0;
BA_ "GenSigTimeoutTime_SGW" SG_ 263 SpeedSyncAvailable 0;
BA_ "GenSigTimeoutTime_RFHM" SG_ 263 SpeedSyncAvailable 0;
BA_ "GenSigTimeoutTime_MPAD" SG_ 263 SpeedSyncAvailable 0;
BA_ "GenSigTimeoutTime_IPC" SG_ 263 SpeedSyncAvailable 0;
BA_ "GenSigTimeoutTime_GNMM" SG_ 263 SpeedSyncAvailable 0;
BA_ "GenSigTimeoutTime_EVCU2" SG_ 263 SpeedSyncAvailable 0;
BA_ "GenSigTimeoutTime_ESL" SG_ 263 SpeedSyncAvailable 0;
BA_ "GenSigTimeoutTime_ECM" SG_ 263 SpeedSyncAvailable 0;
BA_ "GenSigTimeoutTime_DMSM" SG_ 263 SpeedSyncAvailable 0;
BA_ "GenSigTimeoutTime_BSM" SG_ 263 SpeedSyncAvailable 0;
BA_ "GenSigTimeoutTime_BCM" SG_ 263 SpeedSyncAvailable 0;
BA_ "GenSigTimeoutTime_AGSM" SG_ 263 SpeedSyncAvailable 0;
BA_ "GenSigTimeoutTime_ADCAM" SG_ 263 SpeedSyncAvailable 0;
BA_ "GenSigTimeoutTime_DMSM" SG_ 2654339073 GenericFailSts_FD11_ECM 0;
BA_ "GenSigTimeoutTime_DTCM" SG_ 2654339073 StayActiveSource_FD05_ECM 0;
BA_ "GenSigTimeoutTime_ECM" SG_ 2654339073 DES_FD11_ECM 0;
BA_ "GenSigTimeoutTime_RFHM" SG_ 2654339094 WakeupSource_FD03_AGSM 0;
BA_ "GenSigTimeoutTime_MPAD" SG_ 2654339094 WakeupSource_FD03_AGSM 0;
BA_ "GenSigTimeoutTime_RFHM" SG_ 2654339094 WakeupSource_FD16_AGSM 0;
BA_ "GenSigTimeoutTime_MPAD" SG_ 2654339094 WakeupSource_FD16_AGSM 0;
BA_ "GenSigTimeoutTime_IPC" SG_ 2654339094 WakeupSource_FD16_AGSM 0;
BA_ "GenSigTimeoutTime_GNMM" SG_ 2654339094 WakeupSource_FD16_AGSM 0;
BA_ "GenSigTimeoutTime_EVCU2" SG_ 2654339094 WakeupSource_FD16_AGSM 0;
BA_ "GenSigTimeoutTime_ESL" SG_ 2654339094 WakeupSource_FD16_AGSM 0;
BA_ "GenSigTimeoutTime_ECM" SG_ 2654339094 WakeupSource_FD16_AGSM 0;
BA_ "GenSigTimeoutTime_DTCM" SG_ 2654339094 WakeupSource_FD16_AGSM 0;
BA_ "GenSigTimeoutTime_DMSM" SG_ 2654339094 WakeupSource_FD16_AGSM 0;
BA_ "GenSigTimeoutTime_BSM" SG_ 2654339094 WakeupSource_FD16_AGSM 0;
BA_ "GenSigTimeoutTime_BCM" SG_ 2654339094 WakeupSource_FD16_AGSM 0;
BA_ "GenSigTimeoutTime_AGSM" SG_ 2654339094 WakeupSource_FD16_AGSM 0;
BA_ "GenSigTimeoutTime_ADCAM" SG_ 2654339094 WakeupSource_FD16_AGSM 0;
BA_ "GenSigTimeoutTime_RFHM" SG_ 2654339094 WakeupSource_FD11_AGSM 0;
BA_ "GenSigTimeoutTime_MPAD" SG_ 2654339094 WakeupSource_FD11_AGSM 0;
BA_ "GenSigTimeoutTime_IPC" SG_ 2654339094 WakeupSource_FD11_AGSM 0;
BA_ "GenSigTimeoutTime_GNMM" SG_ 2654339094 WakeupSource_FD11_AGSM 0;
BA_ "GenSigTimeoutTime_EVCU2" SG_ 2654339094 WakeupSource_FD11_AGSM 0;
BA_ "GenSigTimeoutTime_ESL" SG_ 2654339094 WakeupSource_FD11_AGSM 0;
BA_ "GenSigTimeoutTime_ECM" SG_ 2654339094 WakeupSource_FD11_AGSM 0;
BA_ "GenSigTimeoutTime_DTCM" SG_ 2654339094 WakeupSource_FD11_AGSM 0;
BA_ "GenSigTimeoutTime_DMSM" SG_ 2654339094 WakeupSource_FD11_AGSM 0;
BA_ "GenSigTimeoutTime_BSM" SG_ 2654339094 WakeupSource_FD11_AGSM 0;
BA_ "GenSigTimeoutTime_BCM" SG_ 2654339094 WakeupSource_FD11_AGSM 0;
BA_ "GenSigTimeoutTime_AGSM" SG_ 2654339094 WakeupSource_FD11_AGSM 0;
BA_ "GenSigTimeoutTime_ADCAM" SG_ 2654339094 WakeupSource_FD11_AGSM 0;
BA_ "GenSigTimeoutTime_RFHM" SG_ 2654339094 EOL_FD03_AGSM 0;
BA_ "GenSigTimeoutTime_MPAD" SG_ 2654339094 EOL_FD03_AGSM 0;
BA_ "GenSigTimeoutTime_IPC" SG_ 2654339094 EOL_FD03_AGSM 0;
BA_ "GenSigTimeoutTime_GNMM" SG_ 2654339094 EOL_FD03_AGSM 0;
BA_ "GenSigTimeoutTime_EVCU2" SG_ 2654339094 EOL_FD03_AGSM 0;
BA_ "GenSigTimeoutTime_ESL" SG_ 2654339094 EOL_FD03_AGSM 0;
BA_ "GenSigTimeoutTime_ECM" SG_ 2654339094 EOL_FD03_AGSM 0;
BA_ "GenSigTimeoutTime_DTCM" SG_ 2654339094 EOL_FD03_AGSM 0;
BA_ "GenSigTimeoutTime_DMSM" SG_ 2654339094 EOL_FD03_AGSM 0;
BA_ "GenSigTimeoutTime_BSM" SG_ 2654339094 EOL_FD03_AGSM 0;
BA_ "GenSigTimeoutTime_AGSM" SG_ 2654339094 EOL_FD03_AGSM 0;
BA_ "GenSigTimeoutTime_ADCAM" SG_ 2654339094 EOL_FD03_AGSM 0;
BA_ "GenSigTimeoutTime_RFHM" SG_ 2654339094 GenericFailSts_FD03_AGSM 0;
BA_ "GenSigTimeoutTime_MPAD" SG_ 2654339094 GenericFailSts_FD03_AGSM 0;
BA_ "GenSigTimeoutTime_IPC" SG_ 2654339094 GenericFailSts_FD03_AGSM 0;
BA_ "GenSigTimeoutTime_GNMM" SG_ 2654339094 GenericFailSts_FD03_AGSM 0;
BA_ "GenSigTimeoutTime_EVCU2" SG_ 2654339094 GenericFailSts_FD03_AGSM 0;
BA_ "GenSigTimeoutTime_ESL" SG_ 2654339094 GenericFailSts_FD03_AGSM 0;
BA_ "GenSigTimeoutTime_ECM" SG_ 2654339094 GenericFailSts_FD03_AGSM 0;
BA_ "GenSigTimeoutTime_DTCM" SG_ 2654339094 GenericFailSts_FD03_AGSM 0;
BA_ "GenSigTimeoutTime_DMSM" SG_ 2654339094 GenericFailSts_FD03_AGSM 0;
BA_ "GenSigTimeoutTime_BSM" SG_ 2654339094 GenericFailSts_FD03_AGSM 0;
BA_ "GenSigTimeoutTime_AGSM" SG_ 2654339094 GenericFailSts_FD03_AGSM 0;
BA_ "GenSigTimeoutTime_ADCAM" SG_ 2654339094 GenericFailSts_FD03_AGSM 0;
BA_ "GenSigTimeoutTime_RFHM" SG_ 2654339094 CurrentFailSts_FD03_AGSM 0;
BA_ "GenSigTimeoutTime_MPAD" SG_ 2654339094 CurrentFailSts_FD03_AGSM 0;
BA_ "GenSigTimeoutTime_IPC" SG_ 2654339094 CurrentFailSts_FD03_AGSM 0;
BA_ "GenSigTimeoutTime_GNMM" SG_ 2654339094 CurrentFailSts_FD03_AGSM 0;
BA_ "GenSigTimeoutTime_EVCU2" SG_ 2654339094 CurrentFailSts_FD03_AGSM 0;
BA_ "GenSigTimeoutTime_ESL" SG_ 2654339094 CurrentFailSts_FD03_AGSM 0;
BA_ "GenSigTimeoutTime_ECM" SG_ 2654339094 CurrentFailSts_FD03_AGSM 0;
BA_ "GenSigTimeoutTime_DTCM" SG_ 2654339094 CurrentFailSts_FD03_AGSM 0;
BA_ "GenSigTimeoutTime_DMSM" SG_ 2654339094 CurrentFailSts_FD03_AGSM 0;
BA_ "GenSigTimeoutTime_BSM" SG_ 2654339094 CurrentFailSts_FD03_AGSM 0;
BA_ "GenSigTimeoutTime_AGSM" SG_ 2654339094 CurrentFailSts_FD03_AGSM 0;
BA_ "GenSigTimeoutTime_ADCAM" SG_ 2654339094 CurrentFailSts_FD03_AGSM 0;
VAL_ 2654339073 GenericFailSts_FD03_ECM 0 "No_Fail_Present" 1 "Fail_Present";
VAL_ 2654339073 EOL_FD03_ECM 0 "No_EOL_Programming" 1 "EOL_Programming";
VAL_ 2654339073 DES_FD03_ECM 0 "Error_Active_state" 1 "Error_passive_warning_state" 2 "Bus_off_state" 3 "Not_used";
VAL_ 2654339073 CurrentFailSts_FD03_ECM 0 "No_Fail_Present" 1 "Fail_Present";
VAL_ 2654339094 GenericFailSts_FD03_AGSM 0 "No_Fail_Present" 1 "Fail_Present";
VAL_ 2654339094 EOL_FD03_AGSM 0 "No_EOL_Programming" 1 "EOL_Programming";
VAL_ 2654339094 CurrentFailSts_FD03_AGSM 0 "No_Fail_Present" 1 "Fail_Present";
VAL_ 2654339142 GenericFailSts_FD11_BPCM 0 "No_Fail_Present" 1 "Fail_Present";
VAL_ 2654339142 EOL_FD11_BPCM 0 "No_EOL_Programming" 1 "EOL_Programming";
VAL_ 2654339073 WakeupSource_FD03_ECM 0 "No_Wakeup";
VAL_ 2654339073 PreviousCanNMState_FD03_ECM 0 "Uninitialized State" 1 "Bus-Sleep State" 2 "Prepare-Bus State" 3 "Ready-Sleep State" 4 "Normal Operation State" 5 "Repeat Message State" 6 "Synchronize State" 7 "Offline State";
VAL_ 2654339073 CurrentCanNMState_FD03_ECM 0 "Uninitialized State" 1 "Bus-Sleep State" 2 "Prepare-Bus State" 3 "Ready-Sleep State" 4 "Normal Operation State" 5 "Repeat Message State" 6 "Synchronize State" 7 "Offline State";
VAL_ 2654339142 WakeupSource_FD11_BPCM 0 "No_Wakeup";
VAL_ 2654339142 PreviousCanNMState_FD11_BPCM 0 "Uninitialized State" 1 "Bus-Sleep State" 2 "Prepare-Bus State" 3 "Ready-Sleep State" 4 "Normal Operation State" 5 "Repeat Message State" 6 "Synchronize State" 7 "Offline State";
VAL_ 2654339142 DES_FD11_BPCM 0 "Error_Active_state" 1 "Error_passive_warning_state" 2 "Bus_off_state" 3 "Not_used";
VAL_ 2654339142 CurrentCanNMState_FD11_BPCM 0 "Uninitialized State" 1 "Bus-Sleep State" 2 "Prepare-Bus State" 3 "Ready-Sleep State" 4 "Normal Operation State" 5 "Repeat Message State" 6 "Synchronize State" 7 "Offline State";
VAL_ 2654339094 WakeupSource_FD03_AGSM 0 "No_Wakeup" 1 "IGN_ON" 129 "FD1_Psv_WU" 130 "FD2_Psv_WU" 131 "FD3_Psv_WU" 132 "FD4_Psv_WU" 133 "FD5_Psv_WU" 134 "FD6_Psv_WU" 135 "FD7_Psv_WU" 136 "FD8_Psv_WU" 137 "FD9_Psv_WU" 138 "FD10_Psv_WU" 139 "FD11_Psv_WU" 140 "FD12_Psv_WU" 141 "FD13_Psv_WU" 142 "FD14_Psv_WU" 143 "FD15_Psv_WU" 144 "FD16_Psv_WU" 145 "FD17_Psv_WU" 146 "FD18_Psv_WU" 147 "FD19_Psv_WU" 148 "FD20_Psv_WU" 149 "FD21_Psv_WU" 150 "FD22_Psv_WU" 151 "FD23_Psv_WU" 152 "FD24_Psv_WU" 153 "FD25_Psv_WU" 154 "FD26_Psv_WU" 155 "FD27_Psv_WU" 156 "FD28_Psv_WU" 157 "FD29_Psv_WU" 158 "BHCAN_Psv_WU" 159 "CCAN_Psv_WU" 254 "WUSource_Not_Listed";
VAL_ 2654339094 PreviousCanNMState_FD03_AGSM 0 "Uninitialized State" 1 "Bus-Sleep State" 2 "Prepare-Bus State" 3 "Ready-Sleep State" 4 "Normal Operation State" 5 "Repeat Message State" 6 "Synchronize State" 7 "Offline State";
VAL_ 2654339094 DES_FD03_AGSM 0 "Error_Active_state" 1 "Error_passive_warning_state" 2 "Bus_off_state" 3 "Not_used";
VAL_ 2654339094 CurrentCanNMState_FD03_AGSM 0 "Uninitialized State" 1 "Bus-Sleep State" 2 "Prepare-Bus State" 3 "Ready-Sleep State" 4 "Normal Operation State" 5 "Repeat Message State" 6 "Synchronize State" 7 "Offline State";
VAL_ 263 Warn_BTO_PT 0 "Not_Active" 1 "Active";
VAL_ 263 TerrainModeDesiredStat_PT 0 "Auto" 1 "Auto_Fault" 2 "Rock" 3 "Track" 4 "Snow" 5 "Offroad" 6 "Eco" 7 "Corsa" 8 "Sport" 9 "Mud_Sand" 10 "Mud" 11 "Sand" 12 "Valet" 13 "Custom" 14 "Tow" 15 "DRAG" 16 "BAJA" 31 "SNA";
VAL_ 263 Terrain_HMI_Rq_PT 0 "No_Request" 1 "SCREEN_1" 2 "SCREEN_2" 3 "SCREEN_3" 4 "SCREEN_4" 5 "SCREEN_5" 6 "SCREEN_6" 7 "SCREEN_7" 8 "SCREEN_8" 9 "SCREEN_9" 10 "SCREEN_10" 11 "SCREEN_11" 12 "SCREEN_12" 13 "SCREEN_13" 14 "SCREEN_14" 15 "SCREEN_15" 16 "SCREEN_16" 17 "SCREEN_17" 18 "SCREEN_18" 19 "SCREEN_19" 20 "SCREEN_20" 21 "SCREEN_21" 22 "SCREEN_22" 23 "SCREEN_23" 24 "SCREEN_24" 25 "SCREEN_25" 26 "SCREEN_26" 27 "SCREEN_27" 28 "SCREEN_28" 29 "SCREEN_29" 30 "SCREEN_30" 31 "SNA";
VAL_ 263 Selector_SystemFailSts_PT 0 "Fail_Not_Present" 1 "Fail_Present";
VAL_ 2654339073 WakeupSource_FD11_ECM 0 "No_Wakeup";
VAL_ 2654339073 PreviousCanNMState_FD11_ECM 0 "Uninitialized State" 1 "Bus-Sleep State" 2 "Prepare-Bus State" 3 "Ready-Sleep State" 4 "Normal Operation State" 5 "Repeat Message State" 6 "Synchronize State" 7 "Offline State";
VAL_ 2654339073 GenericFailSts_FD11_ECM 0 "No_Fail_Present" 1 "Fail_Present";
VAL_ 2654339073 EOL_FD11_ECM 0 "No_EOL_Programming" 1 "EOL_Programming";
VAL_ 2654339073 DES_FD11_ECM 0 "Error_Active_state" 1 "Error_passive_warning_state" 2 "Bus_off_state" 3 "Not_used";
VAL_ 2654339073 CurrentFailSts_FD11_ECM 0 "No_Fail_Present" 1 "Fail_Present";
VAL_ 2654339073 CurrentCanNMState_FD11_ECM 0 "Uninitialized State" 1 "Bus-Sleep State" 2 "Prepare-Bus State" 3 "Ready-Sleep State" 4 "Normal Operation State" 5 "Repeat Message State" 6 "Synchronize State" 7 "Offline State";
VAL_ 2654339094 WakeupSource_FD11_AGSM 0 "No_Wakeup" 1 "IGN_ON" 129 "FD1_Psv_WU" 130 "FD2_Psv_WU" 131 "FD3_Psv_WU" 132 "FD4_Psv_WU" 133 "FD5_Psv_WU" 134 "FD6_Psv_WU" 135 "FD7_Psv_WU" 136 "FD8_Psv_WU" 137 "FD9_Psv_WU" 138 "FD10_Psv_WU" 139 "FD11_Psv_WU" 140 "FD12_Psv_WU" 141 "FD13_Psv_WU" 142 "FD14_Psv_WU" 143 "FD15_Psv_WU" 144 "FD16_Psv_WU" 145 "FD17_Psv_WU" 146 "FD18_Psv_WU" 147 "FD19_Psv_WU" 148 "FD20_Psv_WU" 149 "FD21_Psv_WU" 150 "FD22_Psv_WU" 151 "FD23_Psv_WU" 152 "FD24_Psv_WU" 153 "FD25_Psv_WU" 154 "FD26_Psv_WU" 155 "FD27_Psv_WU" 156 "FD28_Psv_WU" 157 "FD29_Psv_WU" 158 "BHCAN_Psv_WU" 159 "CCAN_Psv_WU" 254 "WUSource_Not_Listed";
VAL_ 2654339094 StayActiveSource_FD11_AGSM 0 "CANNM_Ready_Sleep" 1 "IGN_ON" 2 "NonDefault_Diag" 4 "ING_OFF_NormSt_RptSt" 1073741824 "SASource_Not_Listed";
VAL_ 2654339094 PreviousCanNMState_FD11_AGSM 0 "Uninitialized State" 1 "Bus-Sleep State" 2 "Prepare-Bus State" 3 "Ready-Sleep State" 4 "Normal Operation State" 5 "Repeat Message State" 6 "Synchronize State" 7 "Offline State";
VAL_ 2654339094 GenericFailSts_FD11_AGSM 0 "No_Fail_Present" 1 "Fail_Present";
VAL_ 2654339094 EOL_FD11_AGSM 0 "No_EOL_Programming" 1 "EOL_Programming";
VAL_ 2654339094 DES_FD11_AGSM 0 "Error_Active_state" 1 "Error_passive_warning_state" 2 "Bus_off_state" 3 "Not_used";
VAL_ 2654339094 CurrentFailSts_FD11_AGSM 0 "No_Fail_Present" 1 "Fail_Present";
VAL_ 2654339094 CurrentCanNMState_FD11_AGSM 0 "Uninitialized State" 1 "Bus-Sleep State" 2 "Prepare-Bus State" 3 "Ready-Sleep State" 4 "Normal Operation State" 5 "Repeat Message State" 6 "Synchronize State" 7 "Offline State";
VAL_ 263 WED_STATUS 0 "ENGAGED" 1 "ENGAGING" 2 "NOT_AVAILABLE" 3 "DISENGAGING" 4 "DISENGAGED" 5 "STUCK_OPEN" 6 "STUCK_CLOSE" 7 "SNA";
VAL_ 263 BPCM_HV_SOC1 1023 "SNA";
VAL_ 263 AWD_SysStat 0 "two_wheel_drive" 1 "all_wheel_drive" 3 "SNA";
VAL_ 263 SpeedSyncAvailable 0 "Not_Available" 1 "Available";
VAL_ 263 AHH_Modify_Accel_Rq 0 "Not_Active" 1 "Active" 3 "SNA";
VAL_ 263 AHH_Apply_Release_Rqst 0 "No_Active_Request" 1 "AHH_Apply_Hold" 2 "Blended_torque_Release" 4 "Fast_torque_release" 5 "AHH_EPB_Apply" 7 "SNA";
VAL_ 2654339142 StayActiveSource_FD11_BPCM 0 "CANNM_Ready_Sleep" 1 "IGN_ON" 2 "NonDefault_Diag" 4 "ING_OFF_NormSt_RptSt" 8 "HV_ON" 1073741824 "SASource_Not_Listed";
VAL_ 263 TransmissionWarnings_PT 0 "No_Warning" 1 "Press_Brake_Pedal" 2 "Tip_Not_Available" 3 "Lower_Gear_Shifts" 4 "Manual_Mode_Not_Available" 5 "Insert_N" 6 "Automatic_Mode_Not_Available" 7 "Press_Brk_Dlyd_Startup_Warning" 8 "Clutch_Overtemperature" 9 "Manoeuvre_Not_Allowed" 10 "Press_Brake_Pedal_Repeat" 11 "Gear_Not_Available" 12 "Shift_Not_Allowed" 13 "Shift_to_Neutral_Then_DR" 14 "Reduce_Gear_Changes" 15 "Clutch_Overheater_Must_Cool" 16 "Service_Transmission" 17 "Service_Shifter" 18 "Engage_Park_Brake" 19 "Trans_Too_Cold_Pls_Wait" 20 "Push_Button_to_Shift" 21 "Return_Shifter_To_Home" 22 "Press_Brake_Push_Button_Shift" 23 "Service_Trans_Shut_Off" 24 "Already_in_Des_Gear" 25 "Start_Engine_to_Shift" 26 "Service_Trans_Use_Pk_Brk" 27 "Vehicle_Speed_Too_High" 28 "Tow_Haul_Not_available" 29 "Tow_Haul_Disengaged" 30 "Trans_Cool_Ready_to_Drive" 31 "Veh_Speed_Too_High_to_Shift_P" 32 "Veh_Speed_Too_High_to_Shift_R" 33 "Veh_Speed_Too_High_to_Shift_D" 34 "Manual_Shift_Temp_Not_Available" 35 "Veh_Speed_Too_High_to_Shift_L_S" 36 "Shift_to_P_To_Obtain_Drivability" 37 "Shift_to_P_To_Start" 38 "APCM_in_Progress" 39 "Stop_Vehicle_To_Shift" 40 "Service_Trans_Stop_Veh_To_Shift" 41 "Serv_StpVeh_RestartInPark" 42 "Serv_StpVehShift_RestartInPark" 43 "Press_Brk_To_Prevent_Veh_Rolling" 45 "Trans_Recover_Mode_Warning" 46 "Press_Brake_To_Start" 47 "Unintended_park_disengagement" 48 "paddles_shift_not_available" 49 "M_mode_exit_hold_right_paddles" 50 "Veh_Spd_Too_High_to_Shift_M_gate" 51 "M_Mode_Active_Hold_Plus_to_Exit" 52 "Paddles_Disabled_by_User" 53 "Launch_Clutch_Over_Temp" 54 "Low_Gear_Temp_Not_Available" 55 "Low_Gear_Fault_Srv_Required" 56 "Low_Gear_Deactivated";
VAL_ 263 Braking_Mode_Sts 0 "Not_Active" 1 "Active" 3 "SNA";
VAL_ 263 Braking_Mode_Indication_Sts 0 "OFF" 1 "CONT" 2 "Blinking" 3 "SNA";
VAL_ 263 TransmissionFailSts_PT 0 "Fail_not_present" 1 "Fail_present";
VAL_ 263 TerrainModeStat_PT 0 "Auto" 1 "Auto_Fault" 2 "Rock" 3 "Track" 4 "Snow" 5 "Offroad" 6 "Eco" 7 "Corsa" 8 "Sport" 9 "Mud_Sand" 10 "Mud" 11 "Sand" 12 "Valet" 13 "Custom" 14 "Tow" 15 "DRAG" 16 "BAJA" 18 "Drift" 19 "Donut" 31 "SNA";
VAL_ 263 TargetGear_PT 0 "Neutral" 1 "ForwardGear_1" 2 "ForwardGear_2" 3 "ForwardGear_3" 4 "ForwardGear_4" 5 "ForwardGear_5" 6 "ForwardGear_6" 7 "ForwardGear_7" 8 "ForwardGear_8" 9 "ForwardGear_9" 13 "Parking" 14 "ReverseGear" 15 "SNA";
VAL_ 263 SpeedLimitSts_PT 0 "Standby" 1 "Activated" 2 "Not_Actuable" 3 "Override" 4 "Overspeed" 5 "Deactivated" 6 "Off" 7 "SNA";
VAL_ 2654339136 WakeupSource_FD03_EVCU2 0 "No_Wakeup";
VAL_ 2654339136 PreviousCanNMState_FD03_EVCU2 0 "Uninitialized State" 1 "Bus-Sleep State" 2 "Prepare-Bus State" 3 "Ready-Sleep State" 4 "Normal Operation State" 5 "Repeat Message State" 6 "Synchronize State" 7 "Offline State";
VAL_ 2654339136 GenericFailSts_FD03_EVCU2 0 "No_Fail_Present" 1 "Fail_Present";
VAL_ 2654339136 EOL_FD03_EVCU2 0 "No_EOL_Programming" 1 "EOL_Programming";
VAL_ 2654339136 DES_FD03_EVCU2 0 "Error_Active_state" 1 "Error_passive_warning_state" 2 "Bus_off_state" 3 "Not_used";
VAL_ 2654339136 CurrentFailSts_FD03_EVCU2 0 "No_Fail_Present" 1 "Fail_Present";
VAL_ 2654339136 CurrentCanNMState_FD03_EVCU2 0 "Uninitialized State" 1 "Bus-Sleep State" 2 "Prepare-Bus State" 3 "Ready-Sleep State" 4 "Normal Operation State" 5 "Repeat Message State" 6 "Synchronize State" 7 "Offline State";
VAL_ 2654339142 CurrentFailSts_FD11_BPCM 0 "No_Fail_Present" 1 "Fail_Present";
VAL_ 2654339094 StayActiveSource_FD03_AGSM 0 "CANNM_Ready_Sleep" 1 "IGN_ON" 2 "NonDefault_Diag" 4 "ING_OFF_NormSt_RptSt" 1073741824 "SASource_Not_Listed";
VAL_ 2654339136 WakeupSource_FD11_EVCU2 0 "None" 1 "Ignition_Active" 2 "CmdIgnSts_LK_to_ACC_RUN_START" 3 "HazardSwitch_ON" 4 "DrvDoorAjar" 5 "DrvDoor2Ajar" 6 "PsngrDoorAjar" 7 "LR_DoorAjar" 8 "RR_DoorAjar" 9 "TrunkAjar" 10 "BonnetAjar" 11 "RAPHandle_Req" 12 "MainLightSelector_Req_OFF" 13 "HiBmLvr_Stat_HIBM_FLASH_ON_PSD" 14 "LowBeamSts_SET" 15 "ParkingLightSts_SET" 16 "FlashToPass_SET" 17 "RemStActvSts_Active" 18 "Fuel_Door_Release_Switch" 19 "ENGINE_FD_8_RefuelEvent_Pending" 20 "OHC_1_Front_Int_LG_Sw_1" 21 "HFRM_1_RearKick" 22 "LeakCheckTimerExpired" 23 "Horn_Req_Not Pressed_to_Pressed" 24 "Comfort_Enable_Time_not_0" 25 "CmdIgnSts_ACC_RUN_START" 26 "ENGINE_FD_8_LeakTestSts_1" 27 "Non_Default_Diagnostic_Session" 28 "RL_Lk_Sw_LK_RQ_or_UNLK_RQ" 29 "RR_Lk_Sw_LK_RQ_or_UNLK_RQ" 30 "FD-CAN1" 31 "FD-CAN2" 32 "FD-CAN3" 33 "FD-CAN4" 34 "BH-CAN" 35 "C-CAN1" 36 "EVAP_SWC" 37 "FUEL_DR_REL_SWC" 38 "Other_Software_Factory_Component" 39 "OHC_1_Front_Map_LGT_RT_Sw" 40 "OHC_1_Front_Map_LGT_LT_Sw" 41 "Fog_Lights_Signal " 42 "DOME_ON_OR_DOME_DEFEAT " 43 "Screen_Open_Close_is_pressed" 44 "Diagnostic_Message_Routing_DMR" 45 "Reserved" 46 "Reserved" 47 "Reserved" 48 "Reserved" 49 "Reserved" 50 "Reserved" 51 "Reserved" 52 "Reserved" 53 "Reserved" 54 "Reserved" 55 "Reserved" 56 "Reserved" 57 "Reserved" 58 "Reserved" 59 "Reserved" 60 "Reserved" 61 "Reserved" 62 "Reserved" 63 "Reserved" 64 "Reserved" 65 "Reserved" 66 "Reserved" 67 "Reserved" 68 "Reserved" 69 "Reserved" 70 "Reserved" 71 "Reserved" 72 "Reserved" 73 "Reserved" 74 "Reserved" 75 "Reserved" 76 "Reserved" 77 "Reserved" 78 "Reserved" 79 "Reserved" 80 "Reserved" 81 "Reserved" 82 "Reserved" 83 "Reserved" 84 "Reserved" 85 "Reserved" 86 "Reserved" 87 "Reserved" 88 "Reserved" 89 "Reserved" 90 "Reserved" 91 "Reserved" 92 "Reserved" 93 "Reserved" 94 "Reserved" 95 "Reserved" 96 "Reserved" 97 "Reserved" 98 "Reserved" 99 "Reserved" 100 "Reserved" 101 "Reserved" 102 "Reserved" 103 "Reserved" 104 "Reserved" 105 "Reserved" 106 "Reserved" 107 "Reserved" 108 "Reserved" 109 "Reserved" 110 "Reserved" 111 "Reserved" 112 "Reserved" 113 "Reserved" 114 "Reserved" 115 "Reserved" 116 "Reserved" 117 "Reserved" 118 "Reserved" 119 "Reserved" 120 "Reserved" 121 "Reserved" 122 "Reserved" 123 "Reserved" 124 "Reserved" 125 "Reserved" 126 "Reserved" 127 "Reserved" 128 "Reserved" 129 "FD_CAN1" 130 "FD_CAN2" 131 "FD_CAN3" 132 "FD_CAN4" 133 "FD_CAN5" 134 "FD_CAN6" 135 "FD_CAN7" 136 "FD_CAN8" 137 "FD_CAN9" 138 "FD_CAN10" 139 "FD_CAN11" 140 "FD_CAN12" 141 "FD_CAN13" 142 "FD_CAN14" 143 "FD_CAN15" 144 "FD_CAN16" 145 "FD_CAN17" 146 "FD_CAN18" 147 "FD_CAN19" 148 "FD_CAN20" 149 "FD_CAN21" 150 "FD_CAN22" 151 "FD_CAN23" 152 "FD_CAN24" 153 "FD_CAN25" 154 "FD_CAN26" 155 "FD_CAN27" 156 "FD_CAN28" 157 "FD_CAN29" 158 "FD_CAN30" 159 "FD_CAN31" 160 "BH-CAN" 161 "BH-CAN1" 162 "BH-CAN2" 163 "C-CAN" 164 "C-CAN1" 165 "Reserved" 166 "Reserved" 167 "Reserved" 168 "Reserved" 169 "Reserved" 170 "Reserved" 171 "Reserved" 172 "Reserved" 173 "Reserved" 174 "Reserved" 175 "Reserved" 176 "Reserved" 177 "Reserved" 178 "Reserved" 179 "Reserved" 180 "Reserved" 181 "Reserved" 182 "Reserved" 183 "Reserved" 184 "Reserved" 185 "Reserved" 186 "Reserved" 187 "Reserved" 188 "Reserved" 189 "Reserved" 190 "Reserved" 191 "Reserved" 192 "Reserved" 193 "Reserved" 194 "Reserved" 195 "Reserved" 196 "Reserved" 197 "Reserved" 198 "Reserved" 199 "Reserved" 200 "Reserved" 201 "Reserved" 202 "Reserved" 203 "Reserved" 204 "Reserved" 205 "Reserved" 206 "Reserved" 207 "Reserved" 208 "Reserved" 209 "Reserved" 210 "Reserved" 211 "Reserved" 212 "Reserved" 213 "Reserved" 214 "Reserved" 215 "Reserved" 216 "Reserved" 217 "Reserved" 218 "Reserved" 219 "Reserved" 220 "Reserved" 221 "Reserved" 222 "Reserved" 223 "Reserved" 224 "Reserved" 225 "Reserved" 226 "Reserved" 227 "Reserved" 228 "Reserved" 229 "Reserved" 230 "Reserved" 231 "Reserved" 232 "Reserved" 233 "Reserved" 234 "Reserved" 235 "Reserved" 236 "Reserved" 237 "Reserved" 238 "Reserved" 239 "Reserved" 240 "Reserved" 241 "Reserved" 242 "Reserved" 243 "Reserved" 244 "Reserved" 245 "Reserved" 246 "Reserved" 247 "Reserved" 248 "Reserved" 249 "Reserved" 250 "Reserved" 251 "Reserved" 252 "Reserved" 253 "Reserved" 254 "Reserved" 255 "Reserved";
VAL_ 2654339136 StayActiveSource_FD11_EVCU2 0 "None" 1 "Ignition_Active" 2 "CmdIgnSts_LK_to_ACC_RUN_START" 4 "HazardSwitch_ON" 8 "DrvDoorAjar" 16 "DrvDoor2Ajar" 32 "PsngrDoorAjar" 64 "LR_DoorAjar" 128 "RR_DoorAjar" 256 "TrunkAjar" 512 "BonnetAjar" 1024 "RAPHandle_Req" 2048 "MainLightSelector_Req_OFF" 4096 "HiBmLvr_Stat_HIBM_FLASH_ON_PSD" 8192 "LowBeamSts_SET" 16384 "ParkingLightSts_SET" 32768 "FlashToPass_SET" 65536 "RemStActvSts_Active" 131072 "Fuel_Door_Release_Switch" 262144 "ENGINE_FD_8_RefuelEvent_Pending" 524288 "OHC_1_Front_Int_LG_Sw_1" 1048576 "HFRM_1_RearKick" 2097152 "LeakCheckTimerExpired" 4194304 "Horn_Req_Not_Pressed_to_Pressed" 8388608 "Comfort_Enable_Time_not_0" 16777216 "CmdIgnSts_ACC_RUN_START" 33554432 "ENGINE_FD_8_LeakTestSts_1" 67108864 "Non_Default_Diagnostic_Session" 134217728 "RL_Lk_Sw_LK_RQ_or_UNLK_RQ" 268435456 "RR_Lk_Sw_LK_RQ_or_UNLK_RQ" 536870912 "FD_CAN1" 1073741824 "FD_CAN2";
VAL_ 2654339136 PreviousCanNMState_FD11_EVCU2 0 "Uninitialized State" 1 "Bus-Sleep State" 2 "Prepare-Bus State" 3 "Ready-Sleep State" 4 "Normal Operation State" 5 "Repeat Message State" 6 "Synchronize State" 7 "Offline State";
VAL_ 2654339136 GenericFailSts_FD11_EVCU2 0 "No_Fail_Present" 1 "Fail_Present";
VAL_ 2654339136 EOL_FD11_EVCU2 0 "No_EOL_Programming" 1 "EOL_Programming";
VAL_ 2654339136 DES_FD11_EVCU2 0 "Error_Active_state" 1 "Error_passive_warning_state" 2 "Bus_off_state" 3 "Not_used";
VAL_ 2654339136 CurrentFailSts_FD11_EVCU2 0 "No_Fail_Present" 1 "Fail_Present";
VAL_ 2654339136 CurrentCanNMState_FD11_EVCU2 0 "Uninitialized State" 1 "Bus-Sleep State" 2 "Prepare-Bus State" 3 "Ready-Sleep State" 4 "Normal Operation State" 5 "Repeat Message State" 6 "Synchronize State" 7 "Offline State";
VAL_ 263 PowertrainPrplsnActv_PT 0 "Not_Active" 1 "Active";
VAL_ 263 GearEngagedForDisplay_PT 0 "Initialize" 1 "Gear_1st" 2 "Gear_2nd" 3 "Gear_3rd" 4 "Gear_4th" 5 "Gear_5th" 6 "Gear_6th" 7 "Gear_7th" 8 "Gear_8th" 9 "Gear_9th" 12 "Park" 13 "Neutral" 14 "Reverse" 15 "Drive" 16 "Low" 17 "Manual" 18 "Sport_Mode" 31 "SNA";
VAL_ 263 GearEngaged_PT 0 "Neutral" 1 "ForwardGear_1" 2 "ForwardGear_2" 3 "ForwardGear_3" 4 "ForwardGear_4" 5 "ForwardGear_5" 6 "ForwardGear_6" 7 "ForwardGear_7" 8 "ForwardGear_8" 9 "ForwardGear_9" 13 "Parking" 14 "ReverseGear" 15 "SNA";
VAL_ 263 DriveReady_PT 0 "Default" 1 "Veh_Allwd_Shift_Out_Of_P_Or_N";
VAL_ 2654339136 WakeupSource_FD16_EVCU2 0 "No_Wakeup";
VAL_ 2654339136 WakeupSource_FD05_EVCU2 0 "No_Wakeup";
VAL_ 2654339136 PreviousCanNMState_FD16_EVCU2 0 "Uninitialized State" 1 "Bus-Sleep State" 2 "Prepare-Bus State" 3 "Ready-Sleep State" 4 "Normal Operation State" 5 "Repeat Message State" 6 "Synchronize State" 7 "Offline State";
VAL_ 2654339136 PreviousCanNMState_FD05_EVCU2 0 "Uninitialized State" 1 "Bus-Sleep State" 2 "Prepare-Bus State" 3 "Ready-Sleep State" 4 "Normal Operation State" 5 "Repeat Message State" 6 "Synchronize State" 7 "Offline State";
VAL_ 2654339136 GenericFailSts_FD16_EVCU2 0 "No_Fail_Present" 1 "Fail_Present";
VAL_ 2654339136 GenericFailSts_FD05_EVCU2 0 "No_Fail_Present" 1 "Fail_Present";
VAL_ 2654339136 EOL_FD16_EVCU2 0 "No_EOL_Programming" 1 "EOL_Programming";
VAL_ 2654339136 EOL_FD05_EVCU2 0 "No_EOL_Programming" 1 "EOL_Programming";
VAL_ 2654339136 DES_FD16_EVCU2 0 "Error_Active_state" 1 "Error_passive_warning_state" 2 "Bus_off_state" 3 "Not_used";
VAL_ 2654339136 DES_FD05_EVCU2 0 "Error_Active_state" 1 "Error_passive_warning_state" 2 "Bus_off_state" 3 "Not_used";
VAL_ 2654339136 CurrentFailSts_FD16_EVCU2 0 "No_Fail_Present" 1 "Fail_Present";
VAL_ 2654339136 CurrentFailSts_FD05_EVCU2 0 "No_Fail_Present" 1 "Fail_Present";
VAL_ 2654339136 CurrentCanNMState_FD16_EVCU2 0 "Uninitialized State" 1 "Bus-Sleep State" 2 "Prepare-Bus State" 3 "Ready-Sleep State" 4 "Normal Operation State" 5 "Repeat Message State" 6 "Synchronize State" 7 "Offline State";
VAL_ 2654339136 CurrentCanNMState_FD05_EVCU2 0 "Uninitialized State" 1 "Bus-Sleep State" 2 "Prepare-Bus State" 3 "Ready-Sleep State" 4 "Normal Operation State" 5 "Repeat Message State" 6 "Synchronize State" 7 "Offline State";
VAL_ 2654339142 WakeupSource_FD05_BPCM 0 "No_Wakeup";
VAL_ 2654339142 PreviousCanNMState_FD05_BPCM 0 "Uninitialized State" 1 "Bus-Sleep State" 2 "Prepare-Bus State" 3 "Ready-Sleep State" 4 "Normal Operation State" 5 "Repeat Message State" 6 "Synchronize State" 7 "Offline State";
VAL_ 2654339142 GenericFailSts_FD05_BPCM 0 "No_Fail_Present" 1 "Fail_Present";
VAL_ 2654339142 EOL_FD05_BPCM 0 "No_EOL_Programming" 1 "EOL_Programming";
VAL_ 2654339142 DES_FD05_BPCM 0 "Error_Active_state" 1 "Error_passive_warning_state" 2 "Bus_off_state" 3 "Not_used";
VAL_ 2654339142 CurrentFailSts_FD05_BPCM 0 "No_Fail_Present" 1 "Fail_Present";
VAL_ 2654339142 CurrentCanNMState_FD05_BPCM 0 "Uninitialized State" 1 "Bus-Sleep State" 2 "Prepare-Bus State" 3 "Ready-Sleep State" 4 "Normal Operation State" 5 "Repeat Message State" 6 "Synchronize State" 7 "Offline State";
VAL_ 2654339094 WakeupSource_FD16_AGSM 0 "No_Wakeup";
VAL_ 2654339094 PreviousCanNMState_FD16_AGSM 0 "Uninitialized State" 1 "Bus-Sleep State" 2 "Prepare-Bus State" 3 "Ready-Sleep State" 4 "Normal Operation State" 5 "Repeat Message State" 6 "Synchronize State" 7 "Offline State";
VAL_ 2654339094 GenericFailSts_FD16_AGSM 0 "No_Fail_Present" 1 "Fail_Present";
VAL_ 2654339094 EOL_FD16_AGSM 0 "No_EOL_Programming" 1 "EOL_Programming";
VAL_ 2654339094 DES_FD16_AGSM 0 "Error_Active_state" 1 "Error_passive_warning_state" 2 "Bus_off_state" 3 "Not_used";
VAL_ 2654339094 CurrentFailSts_FD16_AGSM 0 "No_Fail_Present" 1 "Fail_Present";
VAL_ 2654339094 CurrentCanNMState_FD16_AGSM 0 "Uninitialized State" 1 "Bus-Sleep State" 2 "Prepare-Bus State" 3 "Ready-Sleep State" 4 "Normal Operation State" 5 "Repeat Message State" 6 "Synchronize State" 7 "Offline State";
VAL_ 263 VehSpd_Overridden_PT 0 "No_Request" 1 "HMI_PopUp_Turtle" 2 "HMI_Telltale_Turtle" 3 "HMI_PopUp_Camel" 4 "HMI_Telltale_Camel";
VAL_ 263 Vehicle_Hold_Rq_PT 0 "Not_Active" 1 "Active";
VAL_ 263 TurtleModeSts_PT 0 "No_Turtle_Mode" 1 "Turtle_Level1" 2 "Turtle_Level2" 3 "Turtle_Level3" 4 "Turtle_Level4" 7 "SNA";
VAL_ 263 ShiftLeverPosition_PT 0 "No_Selection_Active_Or_Available" 1 "Park" 2 "Reverse" 3 "Neutral" 4 "Drive" 5 "Low" 6 "TIP_Autostick" 7 "Plus" 8 "Minus" 9 "Sport" 15 "SNA";
VAL_ 263 ShiftLeverLockReq_PT 0 "Not_Active" 1 "Active";
VAL_ 263 R_SHFT_LOCK_PT 0 "Unlocked" 1 "Locked";
VAL_ 263 PdlPosActual_PT 255 "SNA";
VAL_ 263 ParkingSts_PT 0 "Not_Parking" 1 "Parking";
VAL_ 263 ParkingFailSts_PT 0 "Fail_not_present" 1 "Fail_present";
VAL_ 263 ISASts_PT 0 "Not_Active" 1 "Active";
VAL_ 263 HAS_SoH_PT 0 "No_Fault" 1 "Fault";
VAL_ 263 GearIndicationSts_PT 0 "Normal" 1 "Blinking";
VAL_ 263 GasPedalPositionFailSts_PT 0 "Fail_not_present" 1 "Fail_present";
VAL_ 263 GasPedalPosition_PT 255 "SNA";
VAL_ 263 ESS_RqShftPark_PT 0 "No_Request" 1 "Request";
VAL_ 263 DrvAway_Inhibit_PT 0 "False" 1 "True";
VAL_ 263 DrvAway_Alert_PT 0 "False" 1 "True";
VAL_ 263 DriverPowerReq_PT 2047 "SNA";
VAL_ 263 CruiseControlSts_PT 0 "Not_Active" 1 "Active";
VAL_ 263 CruiseControlLampSts_PT 0 "Not_Active" 1 "Active";
VAL_ 263 CrankEnable_PT 0 "Disabled" 1 "Enabled";
VAL_ 263 CC_SetSpdDspl_MPH_PT 255 "SNA";
VAL_ 263 CC_SetSpdDspl_KPH_PT 8191 "SNA";
VAL_ 263 AWD_Status_PT 0 "NOT_PRESENT" 1 "DISABLE" 2 "INIT" 3 "SOFT_ON" 4 "NORMAL" 5 "DEGRADED" 6 "SOFT_OFF";
VAL_ 263 AtmosphericPressure_PT 255 "SNA";
VAL_ 263 APCM_Rq_PT 0 "OFF" 1 "ON" 2 "Pending" 3 "SNA";
VAL_ 263 AlternatorFail_PT 0 "Alternator_Fail" 1 "Alternator_Not_In_Fail";
VAL_ 2654339073 WakeupSource_FD05_ECM 0 "No_Wakeup";
VAL_ 2654339073 PreviousCanNMState_FD05_ECM 0 "Uninitialized State" 1 "Bus-Sleep State" 2 "Prepare-Bus State" 3 "Ready-Sleep State" 4 "Normal Operation State" 5 "Repeat Message State" 6 "Synchronize State" 7 "Offline State";
VAL_ 2654339073 GenericFailSts_FD05_ECM 0 "No_Fail_Present" 1 "Fail_Present";
VAL_ 2654339073 EOL_FD05_ECM 0 "No_EOL_Programming" 1 "EOL_Programming";
VAL_ 2654339073 DES_FD05_ECM 0 "Error_Active_state" 1 "Error_passive_warning_state" 2 "Bus_off_state" 3 "Not_used";
VAL_ 2654339073 CurrentFailSts_FD05_ECM 0 "No_Fail_Present" 1 "Fail_Present";
VAL_ 2654339073 CurrentCanNMState_FD05_ECM 0 "Uninitialized State" 1 "Bus-Sleep State" 2 "Prepare-Bus State" 3 "Ready-Sleep State" 4 "Normal Operation State" 5 "Repeat Message State" 6 "Synchronize State" 7 "Offline State";
SIG_GROUP_ 263 PT_SYSTEM_FD_1_Pkt 1 : PowertrainPrplsnActv_PT GearEngagedForDisplay_PT GearEngaged_PT DriveReady_PT VehSpd_Overridden_PT Vehicle_Hold_Rq_PT TurtleModeSts_PT TransmissionFailSts_PT TerrainModeStat_PT TargetGear_PT SpeedLimitSts_PT ShiftLeverPosition_PT ShiftLeverLockReq_PT R_SHFT_LOCK_PT PdlPosActual_PT ParkingSts_PT ParkingFailSts_PT MessageCounter_PT_SYSTEM_FD_1 ISASts_PT HAS_SoH_PT GearIndicationSts_PT GasPedalPositionFailSts_PT GasPedalPosition_PT ESS_RqShftPark_PT DrvAway_Inhibit_PT DrvAway_Alert_PT DriverPowerReq_PT CruiseControlSts_PT CruiseControlLampSts_PT CRC_PT_SYSTEM_FD_1 CrankEnable_PT CC_SetSpdDspl_MPH_PT CC_SetSpdDspl_KPH_PT AWD_Status_PT AtmosphericPressure_PT APCM_Rq_PT AlternatorFail_PT Warn_BTO_PT TerrainModeDesiredStat_PT Terrain_HMI_Rq_PT Selector_SystemFailSts_PT RawPVS2_PT RawPVS1_PT WED_STATUS BPCM_HV_SOC1 AWD_SysStat SpeedSyncAvailable AHH_Modify_Accel_Rq AHH_Apply_Release_Rqst TransmissionWarnings_PT Braking_Mode_Sts Braking_Mode_Indication_Sts;

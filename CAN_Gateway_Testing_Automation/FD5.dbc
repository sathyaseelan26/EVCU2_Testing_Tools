VERSION ""

NS_ :

BS_:

BU_: SGCP MCPB MCPA IDCM EVCU2 ECM BPCM

BO_ 218 HYBRID_FD_LHOM: 64 EVCU2
 SG_ TransInpSpdPrfl_LHOM : 55|13@0+ (1,0) [0|8191] "rpm"  ECM
 SG_ MessageCounter_HYBRID_FD_LHOM : 435|4@0+ (1,0) [0|15] "" ECM
 SG_ InputSpdRaw_LHOM : 35|12@0+ (1,-2048) [-2048|2047] "rpm"  ECM
 SG_ IdleSpeedActiveSts_LHOM : 90|1@0+ (1,0) [0|1] "" ECM
 SG_ HybridEngineMaxTorqAllowed_LHOM : 71|12@0+ (0.32,-300.16) [-300.16|1010.24] "Nm"  ECM
 SG_ HybFeedback_Engine_LHOM : 92|1@0+ (1,0) [0|1] "-"  ECM
 SG_ HybEstEngTorqV_LHOM : 93|1@0+ (1,0) [0|1] "" ECM
 SG_ HybEstEngTorq_LHOM : 31|12@0+ (0.32,-300.16) [-300.16|1010.24] "Nm"  ECM
 SG_ HybCmndEngTorqRespTyp_LHOM : 58|2@0+ (1,0) [0|3] "-"  ECM
 SG_ HybCmndEngTorqPrdtd_LHOM : 7|12@0+ (0.32,-300.16) [-300.16|1010.24] "Nm"  ECM
 SG_ HybCmndEngTorqImmed_LHOM : 11|12@0+ (0.32,-300.16) [-300.16|1010.24] "Nm"  ECM
 SG_ EngTrqReserveCmd_LHOM : 87|8@0+ (0.32,0) [0|81.60] "Nm"  ECM
 SG_ EngCntrlMode_LHOM : 95|1@0+ (1,0) [0|1] "" ECM
 SG_ ECMPrepIdleRes_LHOM : 56|1@0+ (1,0) [0|1] "" ECM
 SG_ CRC_HYBRID_FD_LHOM : 447|8@0+ (1,0) [0|255] "-"  ECM

BO_ 217 ENGINE_FD_LHOM: 64 ECM
 SG_ Sum_FW_ID_Slw_LHOM : 263|5@0+ (1,0) [0|30] "" EVCU2
 SG_ Sum_FW_ID_Fst_LHOM : 255|5@0+ (1,0) [0|31] "-"  EVCU2
 SG_ MinPrdtdEngRunTorqCapV_LHOM : 243|1@0+ (1,0) [0|1] "" EVCU2
 SG_ MinPrdtdEngRunTorqCap_LHOM : 271|12@0+ (0.32,-300.16) [-300.16|1010.24] "Nm"  EVCU2
 SG_ MinImmedEngTorqCapV_LHOM : 232|1@0+ (1,0) [0|1] "-"  EVCU2
 SG_ MinImmedEngTorqCap_LHOM : 275|12@0+ (0.32,-300.16) [-300.16|1010.24] "Nm"  EVCU2
 SG_ MinEngTorqCapV_LHOM : 245|1@0+ (1,0) [0|1] "" EVCU2
 SG_ MinEngTorqCap_LHOM : 299|12@0+ (0.32,-300.16) [-300.16|1010.24] "Nm"  EVCU2
 SG_ MinAirFlowMinSparkTorqCapV_LHOM : 246|1@0+ (1,0) [0|1] "-"  EVCU2
 SG_ MinAirFlowMinSparkTorqCap_LHOM : 315|12@0+ (0.32,-300.16) [-300.16|1010.24] "Nm"  EVCU2
 SG_ MC_ENGINE_FD_LHOM : 435|4@0+ (1,0) [0|15] "-"  EVCU2
 SG_ MaxPrdtdEngTorqCapV_LHOM : 247|1@0+ (1,0) [0|1] "" EVCU2
 SG_ MaxPrdtdEngTorqCap_LHOM : 331|12@0+ (0.32,-300.16) [-300.16|1010.24] "Nm"  EVCU2
 SG_ MaxOffEngTorqCap_LHOM : 359|12@0+ (0.32,-300.16) [-300.16|1010.24] "Nm"  EVCU2
 SG_ LV12PwrFreeRq_LHOM : 335|1@0+ (1,0) [0|1] "-"  EVCU2
 SG_ HybActEngTorqRespTyp_LHOM : 319|2@0+ (1,0) [0|3] "-"  EVCU2
 SG_ Feedback_HCP_LHOM : 242|1@0+ (1,0) [0|1] "" EVCU2
 SG_ ETRQ_Mode_LHOM : 334|3@0+ (1,0) [0|7] "-"  EVCU2
 SG_ EssEngStrtIsNotAllwdID_LHOM : 258|3@0+ (1,0) [0|7] "" EVCU2
 SG_ EssEngStrtIsNotAllwd_LHOM : 240|1@0+ (1,0) [0|1] "" EVCU2
 SG_ EssEngStopIsNotAllwdID_LHOM : 399|4@0+ (1,0) [0|15] "" EVCU2
 SG_ EssEngStopIsNotAllwd_LHOM : 244|1@0+ (1,0) [0|1] "" EVCU2
 SG_ EssEngSt_LHOM : 250|3@0+ (1,0) [0|7] "" EVCU2
 SG_ EssEngModReq_LHOM : 382|3@0+ (1,0) [0|7] "" EVCU2
 SG_ EngTrqReserveReq_LHOM : 351|8@0+ (0.32,0) [0|81.60] "Nm"  EVCU2
 SG_ EngTrq_Enbl_Rq_TCM_LHOM : 241|1@0+ (1,0) [0|1] "-"  EVCU2
 SG_ EngineSts_LHOM : 317|2@0+ (1,0) [0|3] "-"  EVCU2
 SG_ EngineSpeed_LHOM : 413|14@0+ (1,0) [0|16383] "1/min"  EVCU2
 SG_ EngineIdleRefSpeed_LHOM : 395|12@0+ (1,0) [0|4095] "1/min"  EVCU2
 SG_ EngineFrictionTorque_LHOM : 295|9@0+ (1,0) [0|511] "Nm"  EVCU2
 SG_ EngAirFlwStdyStTorqV_LHOM : 302|1@0+ (1,0) [0|1] "" EVCU2
 SG_ EngAirFlwStdyStTorq_LHOM : 363|12@0+ (0.32,-300.16) [-300.16|1010.24] "Nm"  EVCU2
 SG_ EngActStdyStTorqV_LHOM : 301|1@0+ (1,0) [0|1] "-"  EVCU2
 SG_ EngActStdyStTorq_LHOM : 379|12@0+ (0.32,-300.16) [-300.16|1010.24] "Nm"  EVCU2
 SG_ ECM_LHOM_Trans : 415|2@0+ (1,0) [0|3] "-"  EVCU2
 SG_ ECM_LHOM : 383|1@0+ (1,0) [0|1] "" EVCU2
 SG_ CRC_ENGINE_FD_LHOM : 447|8@0+ (1,0) [0|255] "-"  EVCU2

BO_ 505 SGCP_STATUS: 32 SGCP
 SG_ SGCP_DerateReason_P : 7|4@0+ (1,0) [0|15] "" EVCU2
 SG_ SGCP_DC_Voltage_P : 1|10@0+ (1,0) [0|1023] "V"  EVCU2
 SG_ SGCP_DC_Volt_V_P : 3|1@0+ (1,0) [0|1] "" EVCU2
 SG_ SGCP_DC_Current_V_P : 2|1@0+ (1,0) [0|1] "" EVCU2
 SG_ SGCP_DC_Current_P : 38|15@0+ (0.1,-1638.4) [-1638.4|1638.3] "A"  EVCU2,BPCM
 SG_ SGCP_CoolantTemp_P : 18|11@0+ (0.1,-40) [-40|164.7] "°C"  EVCU2
 SG_ MC_SGCP_STATUS : 179|4@0+ (1,0) [0|15] "-"  EVCU2
 SG_ CRC_SGCP_STATUS : 191|8@0+ (1,0) [0|255] "-"  EVCU2
 SG_ SGCP_PIM_AC_Side_Busbar_Temp_P : 87|8@0+ (1,-40) [-40|215] "" EVCU2
 SG_ SGCP_PIM_DC_Side_Busbar_Temp_P : 79|8@0+ (1,-40) [-40|215] "°C"  EVCU2
 SG_ SGCP_Rotor_Temperature_P : 55|8@0+ (1,-40) [-40|215] "°C"  EVCU2
 SG_ SGCP_Service_Lamp_Request_P : 19|1@0+ (1,0) [0|1] "" EVCU2
 SG_ CLrDiagInfo_SGCP_P : 39|1@0+ (1,0) [0|1] "" EVCU2
 SG_ SGCP_Control_Board_Temperature_P : 63|8@0+ (1,-40) [-40|215] "°C"  EVCU2
 SG_ SGCP_Inverter_Temp_P : 71|8@0+ (1,-40) [-40|215] "°C"  EVCU2

BO_ 504 MCPB_STATUS: 32 MCPB
 SG_ MCPB_DerateReason_P : 7|4@0+ (1,0) [0|15] "-"  EVCU2
 SG_ MCPB_DC_Voltage_P : 1|10@0+ (1,0) [0|1022] "V"  EVCU2
 SG_ MCPB_DC_Volt_V_P : 3|1@0+ (1,0) [0|1] "" EVCU2
 SG_ MCPB_DC_Current_V_P : 2|1@0+ (1,0) [0|1] "" EVCU2
 SG_ MCPB_DC_Current_P : 38|15@0+ (0.1,-1638.4) [-1638.4|1638.3] "A"  EVCU2,BPCM
 SG_ MCPB_CoolantTemp_P : 18|11@0+ (0.1,-40) [-40|164.7] "°C"  EVCU2
 SG_ MC_MCPB_STATUS : 179|4@0+ (1,0) [0|15] "-"  EVCU2
 SG_ CRC_MCPB_STATUS : 191|8@0+ (1,0) [0|255] "-"  EVCU2
 SG_ MCPB_Inverter_Temp_P : 71|8@0+ (1,-40) [-40|215] "°C"  EVCU2
 SG_ MCPB_PIM_DC_Side_Busbar_Temp_P : 79|8@0+ (1,-40) [-40|215] "°C"  EVCU2
 SG_ MCPB_Rotor_Temperature_P : 55|8@0+ (1,-40) [-40|215] "ºC"  EVCU2
 SG_ MCPB_Service_Lamp_Request_P : 19|1@0+ (1,0) [0|1] "" EVCU2
 SG_ CLrDiagInfo_MCPB_P : 39|1@0+ (1,0) [0|1] "" EVCU2
 SG_ MCPB_Control_Board_Temperature_P : 63|8@0+ (1,-40) [-40|215] "" EVCU2

BO_ 503 MCPA_STATUS: 32 MCPA
 SG_ MCPA_DerateReason_P : 7|4@0+ (1,0) [0|15] "" EVCU2
 SG_ MCPA_DC_Voltage_P : 1|10@0+ (1,0) [0|1023] "V"  EVCU2
 SG_ MCPA_DC_Volt_V_P : 3|1@0+ (1,0) [0|1] "" EVCU2
 SG_ MCPA_DC_Current_V_P : 2|1@0+ (1,0) [0|1] "" EVCU2
 SG_ MCPA_DC_Current_P : 38|15@0+ (0.1,-1638.4) [-1638.4|1638.3] "A"  EVCU2,BPCM
 SG_ MCPA_CoolantTemp_P : 18|11@0+ (0.1,-40) [-40|164.7] "C"  EVCU2
 SG_ MC_MCPA_STATUS : 179|4@0+ (1,0) [0|15] "-"  EVCU2
 SG_ CRC_MCPA_STATUS : 191|8@0+ (1,0) [0|255] "-"  EVCU2
 SG_ MCPA_Inverter_Temp_P : 71|8@0+ (1,-40) [-40|215] "ºC"  EVCU2
 SG_ MCPA_PIM_DC_Side_Busbar_Temp_P : 79|8@0+ (1,-40) [-40|215] "ºC"  EVCU2
 SG_ MCPA_Rotor_Temperature_P : 55|8@0+ (1,-40) [-40|215] "ºC"  EVCU2
 SG_ MCPA_Service_Lamp_Request_P : 19|1@0+ (1,0) [0|1] "" EVCU2
 SG_ CLrDiagInfo_MCPA_P : 39|1@0+ (1,0) [0|1] "" EVCU2
 SG_ MCPA_Control_Board_Temperature_P : 63|8@0+ (1,-40) [-40|215] "ºC"  EVCU2

BO_ 297 INVTARGET_PROPULSION2: 48 EVCU2
 SG_ UDCMin_Unlim_SGCP_P : 127|16@0+ (0.01,0) [0|655.35] "V"  SGCP
 SG_ UDCMin_Unlim_MCPB_P : 111|16@0+ (0.01,0) [0|655.35] "V"  MCPB
 SG_ UDCMin_Unlim_MCPA_P : 23|16@0+ (0.01,0) [0|655.35] "V"  MCPA
 SG_ UDCMax_Unlim_SGCP_P : 159|16@0+ (0.01,0) [0|655.35] "V"  SGCP
 SG_ UDCMax_Unlim_MCPB_P : 143|16@0+ (0.01,0) [0|655.35] "V"  MCPB
 SG_ UDCMax_Unlim_MCPA_P : 39|16@0+ (0.01,0) [0|655.35] "V"  MCPA
 SG_ TqGrdtLim_SGCP_P : 95|16@0+ (0.1,0) [0|6553.5] "Nm/s"  SGCP
 SG_ TqGrdtLim_MCPB_P : 79|16@0+ (0.1,0) [0|6553.5] "Nm/s"  MCPB
 SG_ TqGrdtLim_MCPA_P : 7|16@0+ (0.1,0) [0|6553.5] "Nm/s"  MCPA
 SG_ SpdGrdtLim_SGCP_P : 258|11@0+ (20,0) [0|40940] "rpm/s"  SGCP
 SG_ SpdGrdtLim_MCPB_P : 277|11@0+ (20,0) [0|40940] "rpm/s"  MCPB
 SG_ SpdGrdtLim_MCPA_P : 282|11@0+ (20,0) [0|40940] "rpm/s"  MCPA
 SG_ Pwr_Electr_Loop_FlwRate_SGCP_P : 71|8@0+ (0.1,0) [0|25.5] "LPM"  SGCP
 SG_ Pwr_Electr_Loop_FlwRate_MCPB_P : 63|8@0+ (0.1,0) [0|25.5] "LPM"  MCPB
 SG_ Pwr_Electr_Loop_FlwRate_MCPA_P : 55|8@0+ (0.1,0) [0|25.5] "LPM"  MCPA
 SG_ MC_INVTARGET_PROPULSION2 : 307|4@0+ (1,0) [0|15] "-"  SGCP,MCPB,MCPA
 SG_ EVCU_MotorC_Speed : 207|16@0+ (1,-32768) [-32768|32767] "rpm"  SGCP
 SG_ EVCU_MotorB_Speed : 191|16@0+ (1,-32768) [-32768|32767] "rpm"  MCPB
 SG_ EVCU_MotorA_Speed : 175|16@0+ (1,-32768) [-32768|32767] "rpm"  MCPA
 SG_ CRC_INVTARGET_PROPULSION2 : 319|8@0+ (1,0) [0|255] "-"  SGCP,MCPB,MCPA

BO_ 296 INVTARGET_PROPULSION1: 48 EVCU2
 SG_ VehicleSpeedVSOSig_P : 55|13@0+ (0.0625,0) [0|511.875] "Km/h"  SGCP,MCPB,MCPA
 SG_ TorqueCommand_SGCP_P : 175|14@0+ (0.125,-1023) [-1023|1024.875] "Nm"  SGCP
 SG_ TorqueCommand_MCPB_P : 157|14@0+ (0.125,-1023) [-1023|1024.875] "Nm"  MCPB
 SG_ TorqueCommand_MCPA_P : 139|14@0+ (0.125,-1023) [-1023|1024.875] "Nm"  MCPA
 SG_ TargetMotorRPM_SGCP_P : 39|16@0+ (0.5,-16384) [-16384|16383.5] "rpm"  SGCP
 SG_ TargetMotorRPM_MCPB_P : 23|16@0+ (0.5,-16384) [-16384|16383.5] "rpm"  MCPB
 SG_ TargetMotorRPM_MCPA_P : 7|16@0+ (0.5,-16384) [-16384|16383.5] "rpm"  MCPA
 SG_ ShiftLeverPosition_P : 273|4@0+ (1,0) [0|15] "" MCPB
 SG_ ParkCmd_PT_P : 259|2@0+ (1,0) [0|3] "" MCPB
 SG_ Mtr_6SO_Request_SGCP_P : 257|1@0+ (1,0) [0|1] "" SGCP
 SG_ Mtr_6SO_Request_MCPB_P : 248|1@0+ (1,0) [0|1] "" MCPB
 SG_ Mtr_6SO_Request_MCPA_P : 249|1@0+ (1,0) [0|1] "" MCPA
 SG_ ModeCommand_SGCP_P : 239|4@0+ (1,0) [0|15] "" SGCP
 SG_ ModeCommand_MCPB_P : 227|4@0+ (1,0) [0|15] "" MCPB
 SG_ ModeCommand_MCPA_P : 231|4@0+ (1,0) [0|15] "" MCPA
 SG_ MC_INVTARGET_PROPULSION1 : 307|4@0+ (1,0) [0|15] "" SGCP,MCPB,MCPA
 SG_ CRC_INVTARGET_PROPULSION1 : 319|8@0+ (1,0) [0|255] "-"  SGCP,MCPB,MCPA
 SG_ CmdIgnSts_P : 58|3@0+ (1,0) [0|7] "" SGCP,MCPB,MCPA
 SG_ BPCM_HV_TractionBusVoltage_P : 271|11@0+ (1,0) [0|2047] "V"  SGCP,MCPB,MCPA
 SG_ BPCM_HV_Trac_Main_Contac_Sts_P : 276|3@0+ (1,0) [0|7] "" SGCP,MCPB,MCPA
 SG_ AEMD_Sclr_Gn_SGCP_P : 263|4@0+ (1.683,0) [0|25.245] "" SGCP
 SG_ AEMD_MinOffset_SGCP_P : 285|14@0+ (0.125,-1023) [-1023|1024.875] "Nm"  SGCP
 SG_ AEMD_MinOffset_MCPB_P : 195|14@0+ (0.125,-1023) [-1023|1024.875] "Nm"  MCPB
 SG_ AEMD_MinOffset_MCPA_P : 119|14@0+ (0.125,-1023) [-1023|1024.875] "Nm"  MCPA
 SG_ AEMD_MaxOffset_SGCP_P : 177|14@0+ (0.125,-1023) [-1023|1024.875] "Nm"  SGCP
 SG_ AEMD_MaxOffset_MCPB_P : 213|14@0+ (0.125,-1023) [-1023|1024.875] "Nm"  MCPB
 SG_ AEMD_MaxOffset_MCPA_P : 121|14@0+ (0.125,-1023) [-1023|1024.875] "Nm"  MCPA
 SG_ AEMD_Cutoff_FreqLow_SGCP_P : 103|8@0+ (0.1,4.5) [4.5|30] "Hz"  SGCP
 SG_ AEMD_Cutoff_FreqLow_MCPB_P : 87|8@0+ (0.1,4.5) [4.5|30] "Hz"  MCPB
 SG_ AEMD_Cutoff_FreqLow_MCPA_P : 71|8@0+ (0.1,4.5) [4.5|30] "Hz"  MCPA
 SG_ AEMD_Cutoff_FreqHigh_SGCP_P : 111|8@0+ (0.1,0) [0|25.5] "Hz"  SGCP
 SG_ AEMD_Cutoff_FreqHigh_MCPB_P : 95|8@0+ (0.1,0) [0|25.5] "Hz"  MCPB
 SG_ AEMD_Cutoff_FreqHigh_MCPA_P : 79|8@0+ (0.1,0) [0|25.5] "Hz"  MCPA
 SG_ AEMD_Sclr_Gn_MCPB_P : 242|9@0+ (0.02,0) [0|10.22] "rad/s/Nm"  MCPB
 SG_ AEMD_Sclr_Gn_MCPA_P : 235|9@0+ (0.02,0) [0|10.22] "rad/s/Nm"  MCPA

BO_ 124 GLIWA_MCPB_TX: 8 MCPB
 SG_ N_PDU_7C : 7|64@0+ (1,0) [0|0] "" EVCU2

BO_ 127 GLIWA_MCPB_RX: 8 EVCU2
 SG_ N_PDU_7F : 7|64@0+ (1,0) [0|0] "" MCPB

BO_ 123 GLIWA_MCPA_TX: 8 MCPA
 SG_ N_PDU_7B : 7|64@0+ (1,0) [0|0] "" EVCU2

BO_ 126 GLIWA_MCPA_RX: 8 EVCU2
 SG_ N_PDU_7E : 7|64@0+ (1,0) [0|0] "" MCPA

BO_ 294 MCPB_PROPULSION: 64 MCPB
 SG_ PlockFailSts_P : 179|3@0+ (1,0) [0|6] "" EVCU2
 SG_ Plock_PosSensor_P : 196|3@0+ (1,0) [0|6] "" EVCU2
 SG_ Plock_MotorPosSts_P : 188|3@0+ (1,0) [0|6] "" EVCU2
 SG_ Plock_fdbk_sts_P : 191|3@0+ (1,0) [0|7] "" EVCU2
 SG_ MPR_PosSensor_P : 199|3@0+ (1,0) [0|6] "" EVCU2
 SG_ MCPB_Torque_Achieved_V_P : 54|1@0+ (1,0) [0|1] "" EVCU2
 SG_ MCPB_Torque_Achieved_P : 21|14@0+ (0.125,-1023) [-1023|1024.875] "Nm"  EVCU2
 SG_ MCPB_TorqAchieved_AEMD_V_P : 71|1@0+ (1,0) [0|1] "" EVCU2
 SG_ MCPB_TorqAchieved_AEMD_P : 85|14@0+ (0.125,-1023) [-1023|1024.875] "Nm"  EVCU2
 SG_ MCPB_SPT_Stat_P : 39|2@0+ (1,0) [0|3] "" EVCU2
 SG_ MCPB_Spd_Lim_P : 135|16@0+ (1,-32767) [-32767|32678] "rpm"  EVCU2
 SG_ MCPB_RPM_V_P : 70|1@0+ (1,0) [0|1] "" EVCU2
 SG_ MCPB_RPM_P : 7|16@0+ (1,-32768) [-32768|32767] "rpm"  EVCU2
 SG_ MCPB_MtrMinCpbltyTrq_P : 117|14@0+ (0.125,-1023) [-1023|1024.875] "Nm"  EVCU2
 SG_ MCPB_MtrMaxCpbltyTrq_P : 101|14@0+ (0.125,-1023) [-1023|1024.875] "Nm"  EVCU2
 SG_ MCPB_MtrIndex_P : 44|5@0+ (1,0) [0|31] "" EVCU2
 SG_ MCPB_MinTorq_P : 69|14@0+ (0.125,-1023) [-1023|1024.875] "Nm"  EVCU2
 SG_ MCPB_MaxTorq_P : 53|14@0+ (0.125,-1023) [-1023|1024.875] "Nm"  EVCU2
 SG_ MCPB_Invrtr_State_P : 183|4@0+ (1,0) [0|15] "" EVCU2
 SG_ MCPB_InterlockSts_P : 103|2@0+ (1,0) [0|3] "" EVCU2
 SG_ MCPB_HV_CnctrOpn_Req_P : 119|1@0+ (1,0) [0|1] "" EVCU2
 SG_ MCPB_Dschrge_Status_P : 87|2@0+ (1,0) [0|3] "" EVCU2
 SG_ MCPB_DeratingFactor_P : 37|6@0+ (0.02,0) [0|1.26] "" EVCU2
 SG_ MCPB_CpbltySpdDivVolt_P : 167|16@0+ (1,0) [0|65535] "V"  EVCU2
 SG_ MCPB_AccelRawV_P : 55|1@0+ (1,0) [0|1] "" EVCU2
 SG_ MCPB_6SO_Status_P : 23|2@0+ (1,0) [0|3] "" EVCU2
 SG_ MCPB_3PS_Pos_P : 118|1@0+ (1,0) [0|1] "" EVCU2
 SG_ MCPB_AccelRaw_P : 151|16@0+ (1,-32768) [-32768|32767] "RPM/s"  EVCU2
 SG_ MC_MCPB_PROPULSION : 435|4@0+ (1,0) [0|15] "-"  EVCU2
 SG_ CRC_MCPB_PROPULSION : 447|8@0+ (1,0) [0|255] "-"  EVCU2
 SG_ MCPB_AC_Isolation_Status_P : 193|2@0+ (1,0) [0|3] "" EVCU2
 SG_ MCPB_Temp_P : 207|8@0+ (1,-40) [-40|215] "ºC"  EVCU2

BO_ 293 MCPA_PROPULSION: 64 MCPA
 SG_ MCPA_Torque_Achieved_V_P : 54|1@0+ (1,0) [0|1] "" EVCU2
 SG_ MCPA_Torque_Achieved_P : 21|14@0+ (0.125,-1023) [-1023|1024.875] "Nm"  EVCU2
 SG_ MCPA_TorqAchieved_AEMD_V_P : 71|1@0+ (1,0) [0|1] "" EVCU2
 SG_ MCPA_TorqAchieved_AEMD_P : 85|14@0+ (0.125,-1023) [-1023|1024.875] "Nm"  EVCU2
 SG_ MCPA_SPT_Stat_P : 39|2@0+ (1,0) [0|3] "" EVCU2
 SG_ MCPA_Spd_Lim_P : 135|16@0+ (1,-32767) [-32767|32768] "rpm"  EVCU2
 SG_ MCPA_RPM_V_P : 70|1@0+ (1,0) [0|1] "" EVCU2
 SG_ MCPA_RPM_P : 7|16@0+ (1,-32768) [-32768|32767] "rpm"  EVCU2
 SG_ MCPA_MtrMinCpbltyTrq_P : 117|14@0+ (0.125,-1023) [-1023|1024.875] "Nm"  EVCU2
 SG_ MCPA_MtrMaxCpbltyTrq_P : 101|14@0+ (0.125,-1023) [-1023|1024.875] "Nm"  EVCU2
 SG_ MCPA_MtrIndex_P : 44|5@0+ (1,0) [0|31] "" EVCU2
 SG_ MCPA_MinTorq_P : 69|14@0+ (0.125,-1023) [-1023|1024.875] "Nm"  EVCU2
 SG_ MCPA_MaxTorq_P : 53|14@0+ (0.125,-1023) [-1023|1024.875] "Nm"  EVCU2
 SG_ MCPA_Invrtr_State_P : 183|4@0+ (1,0) [0|15] "" EVCU2
 SG_ MCPA_InterlockSts_P : 103|2@0+ (1,0) [0|3] "" EVCU2
 SG_ MCPA_HV_CnctrOpn_Req_P : 119|1@0+ (1,0) [0|1] "" EVCU2
 SG_ MCPA_Dschrge_Status_P : 87|2@0+ (1,0) [0|3] "" EVCU2
 SG_ MCPA_DeratingFactor_P : 37|6@0+ (0.02,0) [0|1.26] "" EVCU2
 SG_ MCPA_CpbltySpdDivVolt_P : 167|16@0+ (1,0) [0|65535] "rpm"  EVCU2
 SG_ MCPA_AccelRawV_P : 55|1@0+ (1,0) [0|1] "" EVCU2
 SG_ MCPA_6SO_Status_P : 23|2@0+ (1,0) [0|3] "" EVCU2
 SG_ MCPA_3PS_Pos_P : 118|1@0+ (1,0) [0|1] "" EVCU2
 SG_ MCPA_AccelRaw_P : 151|16@0+ (1,-32768) [-32768|32767] "RPM/s"  EVCU2
 SG_ MC_MCPA_PROPULSION : 435|4@0+ (1,0) [0|15] "-"  EVCU2
 SG_ CRC_MCPA_PROPULSION : 447|8@0+ (1,0) [0|255] "-"  EVCU2
 SG_ MCPA_Temp_P : 207|8@0+ (1,-40) [-40|215] "°C"  EVCU2
 SG_ MCPA_AC_Isolation_Status_P : 199|2@0+ (1,0) [0|3] "" EVCU2

BO_ 295 SGCP_PROPULSION: 48 SGCP
 SG_ SGCP_Torque_Achieved_V_P : 54|1@0+ (1,0) [0|1] "" EVCU2
 SG_ SGCP_Torque_Achieved_P : 21|14@0+ (0.125,-1023) [-1023|1024.875] "Nm"  EVCU2
 SG_ SGCP_TorqAchieved_AEMD_V_P : 71|1@0+ (1,0) [0|1] "" EVCU2
 SG_ SGCP_TorqAchieved_AEMD_P : 85|14@0+ (0.125,-1023) [-1023|1024.875] "Nm"  EVCU2
 SG_ SGCP_SPT_Stat_P : 39|2@0+ (1,0) [0|3] "" EVCU2
 SG_ SGCP_Spd_Lim_P : 135|16@0+ (1,-32767) [-32767|32768] "rpm"  EVCU2
 SG_ SGCP_RPM_V_P : 70|1@0+ (1,0) [0|1] "" EVCU2
 SG_ SGCP_RPM_P : 7|16@0+ (1,-32768) [-32768|32767] "rpm"  EVCU2
 SG_ SGCP_MtrMinCpbltyTrq_P : 117|14@0+ (0.125,-1023) [-1023|1024.875] "Nm"  EVCU2
 SG_ SGCP_MtrMaxCpbltyTrq_P : 101|14@0+ (0.125,-1023) [-1023|1024.875] "Nm"  EVCU2
 SG_ SGCP_MtrIndex_P : 44|5@0+ (1,0) [0|31] "-"  EVCU2
 SG_ SGCP_MinTorq_P : 69|14@0+ (0.125,-1023) [-1023|1024.875] "Nm"  EVCU2
 SG_ SGCP_MaxTorq_P : 53|14@0+ (0.125,-1023) [-1023|1024.875] "Nm"  EVCU2
 SG_ SGCP_Invrtr_State_P : 183|4@0+ (1,0) [0|15] "" EVCU2
 SG_ SGCP_InterlockSts_P : 103|2@0+ (1,0) [0|3] "-"  EVCU2
 SG_ SGCP_HV_CnctrOpn_Req_P : 119|1@0+ (1,0) [0|1] "" EVCU2
 SG_ SGCP_Dschrge_Status_P : 87|2@0+ (1,0) [0|3] "-"  EVCU2
 SG_ SGCP_DeratingFactor_P : 37|6@0+ (0.02,0) [0|1.26] "-"  EVCU2
 SG_ SGCP_CpbltySpdDivVolt_P : 167|16@0+ (1,0) [0|65535] "rpm"  EVCU2
 SG_ SGCP_AccelRawV_P : 55|1@0+ (1,0) [0|1] "" EVCU2
 SG_ SGCP_6SO_Status_P : 23|2@0+ (1,0) [0|3] "" EVCU2
 SG_ SGCP_3PS_Pos_P : 118|1@0+ (1,0) [0|1] "" EVCU2
 SG_ SGCP_AccelRaw_P : 151|16@0+ (1,-32768) [-32768|32767] "RPM/s"  EVCU2
 SG_ SGCP_Temp_P : 191|8@0+ (1,-40) [-40|215] "ºC"  EVCU2
 SG_ CRC_SGCP_PROPULSION : 319|8@0+ (1,0) [0|255] "-"  EVCU2
 SG_ MC_SGCP_PROPULSION : 307|4@0+ (1,0) [0|15] "-"  EVCU2
 SG_ SGCP_AC_Isolation_Status_P : 177|2@0+ (1,0) [0|3] "" EVCU2

CM_ SG_ 218 TransInpSpdPrfl_LHOM "Transmission Input Speed Profile";
CM_ SG_ 218 MessageCounter_HYBRID_FD_LHOM "This signal is a counter used for safety checks strategies. This counter is incremented of 1 (one) unit at each frame transmission.";
CM_ SG_ 218 InputSpdRaw_LHOM "Trans input speed from HCP.";
CM_ SG_ 218 IdleSpeedActiveSts_LHOM "Flag to indicate idle speed target [1] = TRUE";
CM_ SG_ 218 HybridEngineMaxTorqAllowed_LHOM "HCP maximum torque limit";
CM_ SG_ 218 HybFeedback_Engine_LHOM "Indication that the HCP is receiving valid data from the ECM. 0 - False; 1 - True.";
CM_ SG_ 218 HybEstEngTorqV_LHOM "Hybrid estimated engine torque validity. 0 = Valid, 1 = Invalid";
CM_ SG_ 218 HybEstEngTorq_LHOM "Hybrid estimated engine torque";
CM_ SG_ 218 HybCmndEngTorqRespTyp_LHOM "Hybrid Commanded Engine Torque Response Type";
CM_ SG_ 218 HybCmndEngTorqPrdtd_LHOM "Hybrid commanded engine torque predicted torque (slow path).";
CM_ SG_ 218 HybCmndEngTorqImmed_LHOM "Hybrid commanded engine torque immediate torque (fast path)";
CM_ SG_ 218 EngTrqReserveCmd_LHOM "Engine torque reserve command";
CM_ SG_ 218 EngCntrlMode_LHOM "EngCntrlMode, [0] = Torque Mode, [1] = Speed Mode";
CM_ SG_ 218 ECMPrepIdleRes_LHOM "ECM to prep for rolling idle reserve";
CM_ SG_ 218 CRC_HYBRID_FD_LHOM "CRC according to SAE J1850 standard at each frame transmission.";
CM_ SG_ 217 Sum_FW_ID_Slw_LHOM "Enumeration of system controlling combustion slow path";
CM_ SG_ 217 Sum_FW_ID_Fst_LHOM "Enumeration of system controlling combustion fast path";
CM_ SG_ 217 MinPrdtdEngRunTorqCapV_LHOM "Minimum predicted engine run torque capacity validity";
CM_ SG_ 217 MinPrdtdEngRunTorqCap_LHOM "Minimum predicted engine run torque capacity (minimum air flow, MBT spark)";
CM_ SG_ 217 MinImmedEngTorqCapV_LHOM "Minimum immediate engine torque capacity validity";
CM_ SG_ 217 MinImmedEngTorqCap_LHOM "Minimum immediate engine torque capacity (current air flow, minimum spark)";
CM_ SG_ 217 MinEngTorqCapV_LHOM "Minimum engine torque capacity validity";
CM_ SG_ 217 MinEngTorqCap_LHOM "Minimum engine torque capacity (min air flow, fuel off)";
CM_ SG_ 217 MinAirFlowMinSparkTorqCapV_LHOM "Engine Torque capacity at minimum air flow and  minimum spark validity; Invalid = [1]";
CM_ SG_ 217 MinAirFlowMinSparkTorqCap_LHOM "Engine Torque capacity at minimum air flow and  minimum spark";
CM_ SG_ 217 MC_ENGINE_FD_LHOM "Message counter according to SAE J1850 standard that has to be calculated from bit 63 to bit 8 at each frame transmission.";
CM_ SG_ 217 MaxPrdtdEngTorqCapV_LHOM "Maximum predicted engine torque capacity validity; Invalid = [1]";
CM_ SG_ 217 MaxPrdtdEngTorqCap_LHOM "Maximum predicted engine torque capacity";
CM_ SG_ 217 MaxOffEngTorqCap_LHOM "Capacity Max-off";
CM_ SG_ 217 LV12PwrFreeRq_LHOM "-";
CM_ SG_ 217 HybActEngTorqRespTyp_LHOM "Hybrid Actual Engine Torque Response Type";
CM_ SG_ 217 Feedback_HCP_LHOM "Indication that the ECM is receiving valid data from the HCP. 0 - False";
CM_ SG_ 217 ETRQ_Mode_LHOM "Enumeration of combustion torque mode";
CM_ SG_ 217 EssEngStrtIsNotAllwdID_LHOM "This is an enumerated interface that reports the reason why a Start is not allowed by the ECM";
CM_ SG_ 217 EssEngStrtIsNotAllwd_LHOM "This is a flag that signifies if a start is allowed by the ECM";
CM_ SG_ 217 EssEngStopIsNotAllwdID_LHOM "This is an enumerated interface that reports the reason why a Stop is not allowed by the ECM";
CM_ SG_ 217 EssEngStopIsNotAllwd_LHOM "This is a flag that signifies if a stop is allowed by the ECM";
CM_ SG_ 217 EssEngSt_LHOM "Signal that gives feedback on the current engine state";
CM_ SG_ 217 EssEngModReq_LHOM "Command signal from EssEveMgr that directs the engine actuators for turning On or Off the engine";
CM_ SG_ 217 EngTrqReserveReq_LHOM "Engine Torque Reserve Request";
CM_ SG_ 217 EngTrq_Enbl_Rq_TCM_LHOM "Allow TRANS torque request";
CM_ SG_ 217 EngineSts_LHOM "-";
CM_ SG_ 217 EngineSpeed_LHOM "It gives information on C-CAN network about  engine speed";
CM_ SG_ 217 EngineIdleRefSpeed_LHOM "This signal represents target of engine speed for the idle control function, at the end of dynamic transient conditions. It takes into account changes of idle speed due to temperature and auxiliary loads. It is updated even when the engine is ou(...)";
CM_ SG_ 217 EngAirFlwStdyStTorqV_LHOM "Engine airflow steady state torque validity";
CM_ SG_ 217 EngAirFlwStdyStTorq_LHOM "Engine airflow steady state torque (potential)";
CM_ SG_ 217 EngActStdyStTorqV_LHOM "Engine actual steady state torque validity";
CM_ SG_ 217 EngActStdyStTorq_LHOM "Engine actual steady state torque (current conditions)";
CM_ SG_ 217 ECM_LHOM_Trans "Indicates to the transmission the Limp Home Status of ECM and Torque Accuracy";
CM_ SG_ 217 ECM_LHOM "-";
CM_ SG_ 217 CRC_ENGINE_FD_LHOM "CRC according to SAE J1850 standard that has to be calculated from bit 63 to bit 8 at each frame transmission.";
CM_ SG_ 505 SGCP_DerateReason_P "Inverter Derating Reason";
CM_ SG_ 505 SGCP_DC_Voltage_P "Inverter Generator DC Voltage.";
CM_ SG_ 505 SGCP_DC_Volt_V_P "SGCP DC current  validity, [1] = True";
CM_ SG_ 505 SGCP_DC_Current_V_P "SGCP DC current  validity, [1] = True";
CM_ SG_ 505 SGCP_DC_Current_P "SGCP DC Current";
CM_ SG_ 505 SGCP_CoolantTemp_P "PIM Coolant Temperature";
CM_ SG_ 505 MC_SGCP_STATUS "Message counter according to SAE J1850 standard that has to be calculated from bit 63 to bit 8 at each frame transmission.";
CM_ SG_ 505 CRC_SGCP_STATUS "CRC according to SAE J1850 standard that has to be calculated from bit 63 to bit 8 at each frame transmission.";
CM_ SG_ 295 SGCP_Torque_Achieved_V_P "Achieved Torque value Validity, [1] = True";
CM_ SG_ 295 SGCP_Torque_Achieved_P "SGCP Torque Achieved";
CM_ SG_ 295 SGCP_TorqAchieved_AEMD_V_P "Motor Torque Achieved Validity";
CM_ SG_ 295 SGCP_TorqAchieved_AEMD_P "Motor Torque Achieved without AEMD";
CM_ SG_ 295 SGCP_SPT_Stat_P "Inverter Isolation Status";
CM_ SG_ 295 SGCP_Spd_Lim_P "Limited motor speed during reduced performance from SGCP";
CM_ SG_ 295 SGCP_RPM_V_P "SGCP Speed Validity, [1] = True";
CM_ SG_ 295 SGCP_RPM_P "Motor A Speed Raw";
CM_ SG_ 295 SGCP_MtrMinCpbltyTrq_P "Generator Min Capability Torque";
CM_ SG_ 295 SGCP_MtrMaxCpbltyTrq_P "Generator Max Capability Torque";
CM_ SG_ 295 SGCP_MtrIndex_P "Generator Capability Curve Array Index";
CM_ SG_ 295 SGCP_MinTorq_P "Generator Minimum Torque";
CM_ SG_ 295 SGCP_MaxTorq_P "Generator Maximum Torque";
CM_ SG_ 295 SGCP_Invrtr_State_P "Inverter State of Operation of SGCP";
CM_ SG_ 295 SGCP_InterlockSts_P "SGCP interlock state";
CM_ SG_ 295 SGCP_HV_CnctrOpn_Req_P "HV Battery pack contactor request";
CM_ SG_ 295 SGCP_Dschrge_Status_P "The active discharge status of SGCP";
CM_ SG_ 295 SGCP_DeratingFactor_P "Generator Derating Factor";
CM_ SG_ 295 SGCP_CpbltySpdDivVolt_P "Generator Speed at Capability Curve";
CM_ SG_ 295 SGCP_AccelRawV_P "Generator Acceleration Validity";
CM_ SG_ 295 SGCP_6SO_Status_P "SGCP 6SO Status";
CM_ SG_ 295 SGCP_3PS_Pos_P "3 phase motor short possible from SGCP; True = [1]";
CM_ SG_ 504 MCPB_DerateReason_P "Inverter Derating Reason.";
CM_ SG_ 504 MCPB_DC_Voltage_P "This signal indicates the Inverter Rear Right DC Voltage.";
CM_ SG_ 504 MCPB_DC_Volt_V_P "Achieved Torque value Validity, [1] = True";
CM_ SG_ 504 MCPB_DC_Current_V_P "Achieved Torque value Validity, [1] = True";
CM_ SG_ 504 MCPB_DC_Current_P "Motor B DC Current";
CM_ SG_ 504 MCPB_CoolantTemp_P "PIM Coolant Temperature";
CM_ SG_ 504 MC_MCPB_STATUS "Message counter according to SAE J1850 standard that has to be calculated from bit 63 to bit 8 at each frame transmission.";
CM_ SG_ 504 CRC_MCPB_STATUS "CRC according to SAE J1850 standard that has to be calculated from bit 63 to bit 8 at each frame transmission.";
CM_ SG_ 294 PlockFailSts_P "Park Lock Fail Sts";
CM_ SG_ 294 Plock_PosSensor_P "Par lock physical position sensor feedback";
CM_ SG_ 294 Plock_MotorPosSts_P "Park lock motor position status";
CM_ SG_ 294 Plock_fdbk_sts_P "Park lock status";
CM_ SG_ 294 MPR_PosSensor_P "Manual Park Release sensor feedback";
CM_ SG_ 294 MCPB_Torque_Achieved_V_P "Achieved Torque value Validity, [1] = True";
CM_ SG_ 294 MCPB_Torque_Achieved_P "Motr B Torque Achieved";
CM_ SG_ 294 MCPB_TorqAchieved_AEMD_V_P "Motor Torque Achieved Validity";
CM_ SG_ 294 MCPB_TorqAchieved_AEMD_P "Motor Torque Achieved";
CM_ SG_ 294 MCPB_SPT_Stat_P "Inverter Isolation Status";
CM_ SG_ 294 MCPB_Spd_Lim_P "Limited motor speed during reduced performance from MCP B";
CM_ SG_ 294 MCPB_RPM_V_P "Motor B Speed Validity, [1] = True";
CM_ SG_ 294 MCPB_RPM_P "Motor B Speed Raw";
CM_ SG_ 294 MCPB_MtrMinCpbltyTrq_P "Motor B Min Capability Torque";
CM_ SG_ 294 MCPB_MtrMaxCpbltyTrq_P "Motor B Max Capability Torque";
CM_ SG_ 294 MCPB_MtrIndex_P "Motor B Capability Curve Array Index";
CM_ SG_ 294 MCPB_MinTorq_P "Motor B Minimum Torque";
CM_ SG_ 294 MCPB_MaxTorq_P "Motor B Maximum Torque";
CM_ SG_ 294 MCPB_Invrtr_State_P "Inverter State of Operation of Motor B";
CM_ SG_ 294 MCPB_InterlockSts_P "Rear right inverter interlock state";
CM_ SG_ 294 MCPB_HV_CnctrOpn_Req_P "HV Battery pack contactor request";
CM_ SG_ 294 MCPB_Dschrge_Status_P "The active discharge status of MCPB";
CM_ SG_ 294 MCPB_DeratingFactor_P "Motor B Derating Factor";
CM_ SG_ 294 MCPB_CpbltySpdDivVolt_P "Motor B Speed at Capability Curve";
CM_ SG_ 294 MCPB_AccelRawV_P "Motor B Acceleration Validity";
CM_ SG_ 294 MCPB_6SO_Status_P "Motor B 6SO Status";
CM_ SG_ 294 MCPB_3PS_Pos_P "3 phase motor short possible from MCP B; True = [1]";
CM_ SG_ 503 MCPA_DerateReason_P "Inverter Derating Reason";
CM_ SG_ 503 MCPA_DC_Voltage_P "Inverter Front DC Voltage.";
CM_ SG_ 503 MCPA_DC_Volt_V_P "Motor A DC current validity, [1] = True";
CM_ SG_ 503 MCPA_DC_Current_V_P "Motor A DC current validity, [1] = True";
CM_ SG_ 503 MCPA_DC_Current_P "Motor A DC Current";
CM_ SG_ 503 MCPA_CoolantTemp_P "PIM Coolant Temperature";
CM_ SG_ 503 MC_MCPA_STATUS "Message counter according to SAE J1850 standard that has to be calculated from bit 63 to bit 8 at each frame transmission.";
CM_ SG_ 503 CRC_MCPA_STATUS "CRC according to SAE J1850 standard that has to be calculated from bit 63 to bit 8 at each frame transmission.";
CM_ SG_ 293 MCPA_Torque_Achieved_V_P "Achieved Torque value Validity, [1] = True";
CM_ SG_ 293 MCPA_Torque_Achieved_P "Motor A Torque Achieved";
CM_ SG_ 293 MCPA_TorqAchieved_AEMD_V_P "Motor Torque Achieved Validity";
CM_ SG_ 293 MCPA_TorqAchieved_AEMD_P "Motor Torque Achieved without AEMD";
CM_ SG_ 293 MCPA_SPT_Stat_P "Inverter Isolation Status";
CM_ SG_ 293 MCPA_Spd_Lim_P "Limited motor speed during reduced performance from MCPA";
CM_ SG_ 293 MCPA_RPM_V_P "Motor A Speed Validity, [1] = True";
CM_ SG_ 293 MCPA_RPM_P "Motor A Speed Raw";
CM_ SG_ 293 MCPA_MtrMinCpbltyTrq_P "Motor A Min Capability Torque";
CM_ SG_ 293 MCPA_MtrMaxCpbltyTrq_P "Motor A Max Capability Torque";
CM_ SG_ 293 MCPA_MtrIndex_P "Motor A Capability Curve Array Index";
CM_ SG_ 293 MCPA_MinTorq_P "Motor A Minimum Torque";
CM_ SG_ 293 MCPA_MaxTorq_P "Motor A Maximum Torque";
CM_ SG_ 293 MCPA_Invrtr_State_P "Inverter State of Operation of Motor A";
CM_ SG_ 293 MCPA_InterlockSts_P "Front inverter interlock state";
CM_ SG_ 293 MCPA_HV_CnctrOpn_Req_P "HV Battery pack contactor request";
CM_ SG_ 293 MCPA_Dschrge_Status_P "The active discharge status of MCPA";
CM_ SG_ 293 MCPA_DeratingFactor_P "Motor A Derating Factor";
CM_ SG_ 293 MCPA_CpbltySpdDivVolt_P "Motor A Speed at Capability Curve";
CM_ SG_ 293 MCPA_AccelRawV_P "Motor A Acceleration Validity";
CM_ SG_ 293 MCPA_6SO_Status_P "Motor A 6SO Status";
CM_ SG_ 293 MCPA_3PS_Pos_P "3 phase motor short possible from MCP B; True = [1]";
CM_ SG_ 297 UDCMin_Unlim_SGCP_P "Minimum DC voltage limit before linear generator derating Consider Max or Min torque. Default 36V";
CM_ SG_ 297 UDCMin_Unlim_MCPB_P "Minimum DC voltage limit before linear generator derating Consider Max or Min torque. Default 36V";
CM_ SG_ 297 UDCMin_Unlim_MCPA_P "Minimum DC voltage limit before linear generator derating Consider Max or Min torque. Default 36V";
CM_ SG_ 297 UDCMax_Unlim_SGCP_P "Maximum DC voltage limit before linear generator derating Consider Max or Min torque. Default 52V";
CM_ SG_ 297 UDCMax_Unlim_MCPB_P "Maximum DC voltage limit before linear generator derating Consider Max or Min torque. Default 52V";
CM_ SG_ 297 UDCMax_Unlim_MCPA_P "Maximum DC voltage limit before linear generator derating Consider Max or Min torque. Default 52V";
CM_ SG_ 297 TqGrdtLim_SGCP_P "Positive or Negative Torque Gradient applied for Torque Control Mode and Speed Control Mode. Default 1000Nm/s";
CM_ SG_ 297 TqGrdtLim_MCPB_P "Positive or Negative Torque Gradient applied for Torque Control Mode and Speed Control Mode. Default 1000Nm/s";
CM_ SG_ 297 TqGrdtLim_MCPA_P "Positive or Negative Torque Gradient applied for Torque Control Mode and Speed Control Mode. Default 1000Nm/s";
CM_ SG_ 297 SpdGrdtLim_SGCP_P "Positive or negative (symetric) Speed Request Gradient applicable on both sign only for Speed Control Mode. Default 25,000 rpm/s";
CM_ SG_ 297 SpdGrdtLim_MCPB_P "Positive or negative (symetric) Speed Request Gradient applicable on both sign only for Speed Control Mode. Default 25,000 rpm/s";
CM_ SG_ 297 SpdGrdtLim_MCPA_P "Positive or negative (symetric) Speed Request Gradient applicable on both sign only for Speed Control Mode. Default 25,000 rpm/s";
CM_ SG_ 297 Pwr_Electr_Loop_FlwRate_SGCP_P "Inverter cooling liquid flow rate information";
CM_ SG_ 297 Pwr_Electr_Loop_FlwRate_MCPB_P "Inverter cooling liquid flow rate information";
CM_ SG_ 297 Pwr_Electr_Loop_FlwRate_MCPA_P "Inverter cooling liquid flow rate information";
CM_ SG_ 297 MC_INVTARGET_PROPULSION2 "Message counter according to SAE J1850 standard that has to be calculated from bit 63 to bit 8 at each frame transmission.";
CM_ SG_ 297 EVCU_MotorC_Speed "Motor C Speed Calculted by Supervisory Controller";
CM_ SG_ 297 EVCU_MotorB_Speed "Motor B Speed Calculted by Supervisory Controller";
CM_ SG_ 297 EVCU_MotorA_Speed "Motor A Speed Calculted by Supervisory Controller";
CM_ SG_ 297 CRC_INVTARGET_PROPULSION2 "CRC according to SAE J1850 standard that has to be calculated from bit 63 to bit 8 at each frame transmission.";
CM_ SG_ 296 VehicleSpeedVSOSig_P "It is the average vehicle speed calculated.";
CM_ SG_ 296 TorqueCommand_SGCP_P "Torque command for SGCP";
CM_ SG_ 296 TorqueCommand_MCPB_P "Torque command for MCPB";
CM_ SG_ 296 TorqueCommand_MCPA_P "Torque command for MCPA";
CM_ SG_ 296 TargetMotorRPM_SGCP_P "Target Motor RPM for SGCP";
CM_ SG_ 296 TargetMotorRPM_MCPB_P "Target Motor RPM for MCPB";
CM_ SG_ 296 TargetMotorRPM_MCPA_P "Target Motor RPM for MCPA";
CM_ SG_ 296 ShiftLeverPosition_P "Shift Lever Position";
CM_ SG_ 296 ParkCmd_PT_P "Park Command for MCP.";
CM_ SG_ 296 Mtr_6SO_Request_SGCP_P "Six Switch Open Request  for SGCP (1=RequestActive; 0=RequestNotActive)";
CM_ SG_ 296 Mtr_6SO_Request_MCPB_P "Six Switch Open Request  for MCPB (1=RequestActive; 0=RequestNotActive)";
CM_ SG_ 296 Mtr_6SO_Request_MCPA_P "Six Switch Open Request  for MCPA (1=RequestActive; 0=RequestNotActive)";
CM_ SG_ 296 ModeCommand_SGCP_P "Mode command for SGCP";
CM_ SG_ 296 ModeCommand_MCPB_P "Mode command for MCPB";
CM_ SG_ 296 ModeCommand_MCPA_P "Mode command for MCPA";
CM_ SG_ 296 CRC_INVTARGET_PROPULSION1 "CRC according to SAE J1850 standard that has to be calculated from bit 63 to bit 8 at each frame transmission.";
CM_ SG_ 296 CmdIgnSts_P "Used to give information about the key selector position";
CM_ SG_ 296 BPCM_HV_TractionBusVoltage_P "Battery link traction bus voltage.";
CM_ SG_ 296 BPCM_HV_Trac_Main_Contac_Sts_P "Traction main contactor physical relay status";
CM_ SG_ 296 AEMD_Sclr_Gn_SGCP_P "SGCP AEMD Scalar Gain";
CM_ SG_ 296 AEMD_MinOffset_SGCP_P "MCPC AEMD Min Offset";
CM_ SG_ 296 AEMD_MinOffset_MCPB_P "MCPB AEMD Min Offset";
CM_ SG_ 296 AEMD_MinOffset_MCPA_P "MCPA AEMD Min Offset";
CM_ SG_ 296 AEMD_MaxOffset_SGCP_P "SGCP AEMD Max Offset";
CM_ SG_ 296 AEMD_MaxOffset_MCPB_P "MCPB AEMD Max Offset";
CM_ SG_ 296 AEMD_MaxOffset_MCPA_P "MCPA AEMD Max Offset";
CM_ SG_ 296 AEMD_Cutoff_FreqLow_SGCP_P "AEMD cut-off Frequency Low for SGCP";
CM_ SG_ 296 AEMD_Cutoff_FreqLow_MCPB_P "AEMD cut-off Frequency Low for MCPB";
CM_ SG_ 296 AEMD_Cutoff_FreqLow_MCPA_P "AEMD cut-off Frequency Low for MCPA";
CM_ SG_ 296 AEMD_Cutoff_FreqHigh_SGCP_P "AEMD cut-off Frequency High for SGCP";
CM_ SG_ 296 AEMD_Cutoff_FreqHigh_MCPB_P "AEMD cut-off Frequency High for MCPB";
CM_ SG_ 296 AEMD_Cutoff_FreqHigh_MCPA_P "AEMD cut-off Frequency High for MCPA";
CM_ SG_ 294 MCPB_AccelRaw_P "Motor B Acceleration";
CM_ SG_ 294 MC_MCPB_PROPULSION "Message counter according to SAE J1850 standard that has to be calculated from bit 63 to bit 8 at each frame transmission.";
CM_ SG_ 294 CRC_MCPB_PROPULSION "CRC according to SAE J1850 standard that has to be calculated from bit 63 to bit 8 at each frame transmission.";
CM_ SG_ 293 MCPA_AccelRaw_P "Motor A Acceleration";
CM_ SG_ 293 MC_MCPA_PROPULSION "Message counter according to SAE J1850 standard that has to be calculated from bit 63 to bit 8 at each frame transmission.";
CM_ SG_ 293 CRC_MCPA_PROPULSION "CRC according to SAE J1850 standard that has to be calculated from bit 63 to bit 8 at each frame transmission.";
CM_ SG_ 296 AEMD_Sclr_Gn_MCPB_P "MCPB AEMD Scalar Gain";
CM_ SG_ 296 AEMD_Sclr_Gn_MCPA_P "MCPA AEMD Scalar Gain";
CM_ SG_ 505 SGCP_PIM_AC_Side_Busbar_Temp_P "SGCP busbar temperature in AC side";
CM_ SG_ 505 SGCP_PIM_DC_Side_Busbar_Temp_P "SGCP busbar temperature in DC side";
CM_ SG_ 505 SGCP_Rotor_Temperature_P "Rotor Temperature from Motor";
CM_ SG_ 505 SGCP_Service_Lamp_Request_P "The Service Light Request from the SGCP";
CM_ SG_ 505 CLrDiagInfo_SGCP_P "Legislative Diagnostic Clear information for SGCP";
CM_ SG_ 505 SGCP_Control_Board_Temperature_P "Motor Control Board temperature";
CM_ SG_ 505 SGCP_Inverter_Temp_P "Motor Inverter Temperature";
CM_ SG_ 295 SGCP_AccelRaw_P "Generator Acceleration";
CM_ SG_ 295 SGCP_Temp_P "Motor Stator Temperature";
CM_ SG_ 295 CRC_SGCP_PROPULSION "CRC according to SAE J1850 standard that has to be calculated from bit 63 to bit 8 at each frame transmission.";
CM_ SG_ 295 MC_SGCP_PROPULSION "Message counter according to SAE J1850 standard that has to be calculated from bit 63 to bit 8 at each frame transmission.";
CM_ SG_ 295 SGCP_AC_Isolation_Status_P "Motor AC Isolation Status";
CM_ SG_ 504 MCPB_Inverter_Temp_P "Motor Inverter Temperature";
CM_ SG_ 504 MCPB_PIM_DC_Side_Busbar_Temp_P "MCPB busbar temperature in DC side";
CM_ SG_ 504 MCPB_Rotor_Temperature_P "Rotor Temperature from Motor";
CM_ SG_ 504 MCPB_Service_Lamp_Request_P "The Service Light Request from the MCPB";
CM_ SG_ 504 CLrDiagInfo_MCPB_P "Legislative Diagnostic Clear information for MCPB";
CM_ SG_ 504 MCPB_Control_Board_Temperature_P "Motor Control Board temperature";
CM_ SG_ 294 MCPB_AC_Isolation_Status_P "Motor AC Isolation Status";
CM_ SG_ 294 MCPB_Temp_P "Motor Stator Temperature";
CM_ SG_ 503 MCPA_Inverter_Temp_P "Motor Inverter Temperature";
CM_ SG_ 503 MCPA_PIM_DC_Side_Busbar_Temp_P "MCPA busbar temperature in DC side";
CM_ SG_ 503 MCPA_Rotor_Temperature_P "Rotor Temperature from Motor";
CM_ SG_ 503 MCPA_Service_Lamp_Request_P "The Service Light Request from the MCPA";
CM_ SG_ 503 CLrDiagInfo_MCPA_P "Legislative Diagnostic Clear information for MCPA";
CM_ SG_ 503 MCPA_Control_Board_Temperature_P "Motor Control Board temperature";
CM_ SG_ 293 MCPA_Temp_P "Motor Stator Temperature";
CM_ SG_ 293 MCPA_AC_Isolation_Status_P "Motor AC Isolation Status";
BA_DEF_ SG_ "GenSigStartValue" INT 0 2147483647;
BA_DEF_ SG_ "GenSigInactiveValue" INT 0 2147483647;
BA_DEF_ SG_ "GenSigSendType" ENUM "NotUsed","OnWrite","OnWriteWithRepetition","OnChange","OnChangeWithRepetition","IfActive","IfActiveWithRepetition","NoSigSendType";
BA_DEF_ SG_ "SystemSignalLongSymbol" STRING ;
BA_DEF_ SG_ "GenSigTimeoutTime_BPCM" INT 0 65535;
BA_DEF_ SG_ "GenSigTimeoutTime_ECM" INT 0 65535;
BA_DEF_ SG_ "GenSigTimeoutTime_EVCU2" INT 0 65535;
BA_DEF_ SG_ "GenSigTimeoutTime_IDCM" INT 0 65535;
BA_DEF_ SG_ "GenSigTimeoutTime_MCPA" INT 0 65535;
BA_DEF_ SG_ "GenSigTimeoutTime_MCPB" INT 0 65535;
BA_DEF_ SG_ "GenSigTimeoutTime_SGCP" INT 0 65535;
BA_DEF_ BO_ "DiagRequest" ENUM "No","Yes";
BA_DEF_ BO_ "Type" ENUM "P","C","PE","COC","PE_Cntrl","E","E_Cntrl","OC","S","BAF","DC","EM","MM","ISO-TP","-";
BA_DEF_ BO_ "DiagResponse" ENUM "No","Yes";
BA_DEF_ BO_ "NmMessage" ENUM "No","Yes";
BA_DEF_ BO_ "GenMsgSendType" ENUM "Cyclic","NotUsed","NotUsed","NotUsed","NotUsed","NotUsed","NotUsed","NotUsed","NoMsgSendType";
BA_DEF_ BO_ "GenMsgNrOfRepetition" INT 0 255;
BA_DEF_ BO_ "GenMsgILSupport" ENUM "No","Yes";
BA_DEF_ BO_ "GenMsgStartDelayTime" INT 0 65535;
BA_DEF_ BO_ "GenMsgCycleTimeFast" INT 0 65535;
BA_DEF_ BO_ "GenMsgCycleTime" INT 0 65535;
BA_DEF_ BO_ "GenMsgDelayTime" INT 0 65535;
BA_DEF_ BO_ "NmAsrMessage" ENUM "No","Yes";
BA_DEF_ BO_ "DiagState" ENUM "No","Yes";
BA_DEF_ BO_ "DiagConnection" HEX 0 65535;
BA_DEF_ BO_ "VFrameFormat" ENUM "StandardCAN","ExtendedCAN","reserved","reserved","reserved","reserved","reserved","reserved","reserved","reserved","reserved","reserved","reserved","reserved","StandardCAN_FD","ExtendedCAN_FD";
BA_DEF_ BO_ "CANFD_BRS" ENUM "0","1";
BA_DEF_DEF_ "GenSigStartValue" 0;
BA_DEF_DEF_ "GenSigInactiveValue" 0;
BA_DEF_DEF_ "GenSigSendType" "NoSigSendType";
BA_DEF_DEF_ "SystemSignalLongSymbol" "";
BA_DEF_DEF_ "GenSigTimeoutTime_BPCM" 2500;
BA_DEF_DEF_ "GenSigTimeoutTime_ECM" 2500;
BA_DEF_DEF_ "GenSigTimeoutTime_EVCU2" 2500;
BA_DEF_DEF_ "GenSigTimeoutTime_IDCM" 2500;
BA_DEF_DEF_ "GenSigTimeoutTime_MCPA" 2500;
BA_DEF_DEF_ "GenSigTimeoutTime_MCPB" 2500;
BA_DEF_DEF_ "GenSigTimeoutTime_SGCP" 2500;
BA_DEF_DEF_ "DiagRequest" "No";
BA_DEF_DEF_ "Type" "-";
BA_DEF_DEF_ "DiagResponse" "No";
BA_DEF_DEF_ "NmMessage" "No";
BA_DEF_DEF_ "GenMsgSendType" "NoMsgSendType";
BA_DEF_DEF_ "GenMsgNrOfRepetition" 0;
BA_DEF_DEF_ "GenMsgILSupport" "No";
BA_DEF_DEF_ "GenMsgStartDelayTime" 0;
BA_DEF_DEF_ "GenMsgCycleTimeFast" 0;
BA_DEF_DEF_ "GenMsgCycleTime" 0;
BA_DEF_DEF_ "GenMsgDelayTime" 0;
BA_DEF_DEF_ "NmAsrMessage" "No";
BA_DEF_DEF_ "DiagState" "No";
BA_DEF_DEF_ "DiagConnection" 0;
BA_DEF_DEF_ "VFrameFormat" "StandardCAN_FD";
BA_DEF_DEF_ "CANFD_BRS" "0";
BA_ "GenMsgILSupport" BO_ 218 1;
BA_ "GenMsgCycleTime" BO_ 218 10;
BA_ "GenMsgDelayTime" BO_ 218 20;
BA_ "CANFD_BRS" BO_ 218 1;
BA_ "Type" BO_ 218 1;
BA_ "GenMsgSendType" BO_ 218 0;
BA_ "Type" BO_ 217 1;
BA_ "GenMsgSendType" BO_ 217 0;
BA_ "GenMsgILSupport" BO_ 217 1;
BA_ "GenMsgCycleTime" BO_ 217 10;
BA_ "GenMsgDelayTime" BO_ 217 20;
BA_ "CANFD_BRS" BO_ 217 1;
BA_ "Type" BO_ 505 1;
BA_ "GenMsgSendType" BO_ 505 0;
BA_ "GenMsgILSupport" BO_ 505 1;
BA_ "GenMsgCycleTime" BO_ 505 20;
BA_ "CANFD_BRS" BO_ 505 1;
BA_ "Type" BO_ 504 1;
BA_ "GenMsgSendType" BO_ 504 0;
BA_ "GenMsgILSupport" BO_ 504 1;
BA_ "GenMsgCycleTime" BO_ 504 20;
BA_ "CANFD_BRS" BO_ 504 1;
BA_ "Type" BO_ 503 1;
BA_ "GenMsgSendType" BO_ 503 0;
BA_ "GenMsgILSupport" BO_ 503 1;
BA_ "GenMsgCycleTime" BO_ 503 20;
BA_ "CANFD_BRS" BO_ 503 1;
BA_ "Type" BO_ 297 1;
BA_ "GenMsgSendType" BO_ 297 0;
BA_ "GenMsgILSupport" BO_ 297 1;
BA_ "GenMsgCycleTime" BO_ 297 10;
BA_ "CANFD_BRS" BO_ 297 1;
BA_ "Type" BO_ 296 1;
BA_ "GenMsgSendType" BO_ 296 0;
BA_ "GenMsgILSupport" BO_ 296 1;
BA_ "GenMsgCycleTime" BO_ 296 10;
BA_ "CANFD_BRS" BO_ 296 1;
BA_ "Type" BO_ 124 8;
BA_ "GenMsgILSupport" BO_ 124 1;
BA_ "CANFD_BRS" BO_ 124 1;
BA_ "Type" BO_ 127 8;
BA_ "GenMsgILSupport" BO_ 127 1;
BA_ "CANFD_BRS" BO_ 127 1;
BA_ "Type" BO_ 123 8;
BA_ "GenMsgILSupport" BO_ 123 1;
BA_ "CANFD_BRS" BO_ 123 1;
BA_ "Type" BO_ 126 8;
BA_ "GenMsgILSupport" BO_ 126 1;
BA_ "CANFD_BRS" BO_ 126 1;
BA_ "Type" BO_ 294 1;
BA_ "GenMsgSendType" BO_ 294 0;
BA_ "GenMsgILSupport" BO_ 294 1;
BA_ "GenMsgCycleTime" BO_ 294 10;
BA_ "CANFD_BRS" BO_ 294 1;
BA_ "Type" BO_ 293 1;
BA_ "GenMsgSendType" BO_ 293 0;
BA_ "GenMsgILSupport" BO_ 293 1;
BA_ "GenMsgCycleTime" BO_ 293 10;
BA_ "CANFD_BRS" BO_ 293 1;
BA_ "Type" BO_ 295 1;
BA_ "GenMsgSendType" BO_ 295 0;
BA_ "GenMsgILSupport" BO_ 295 1;
BA_ "GenMsgCycleTime" BO_ 295 10;
BA_ "CANFD_BRS" BO_ 295 1;
BA_ "GenSigTimeoutTime_BPCM" SG_ 294 MCPB_AC_Isolation_Status_P 0;
BA_ "GenSigTimeoutTime_ECM" SG_ 294 MCPB_AC_Isolation_Status_P 0;
BA_ "GenSigTimeoutTime_IDCM" SG_ 294 MCPB_AC_Isolation_Status_P 0;
BA_ "GenSigTimeoutTime_MCPA" SG_ 294 MCPB_AC_Isolation_Status_P 0;
BA_ "GenSigTimeoutTime_MCPB" SG_ 294 MCPB_AC_Isolation_Status_P 0;
BA_ "GenSigTimeoutTime_SGCP" SG_ 294 MCPB_AC_Isolation_Status_P 0;
BA_ "GenSigStartValue" SG_ 294 MCPB_Temp_P 40;
BA_ "GenSigTimeoutTime_BPCM" SG_ 294 MCPB_Temp_P 0;
BA_ "GenSigTimeoutTime_ECM" SG_ 294 MCPB_Temp_P 0;
BA_ "GenSigTimeoutTime_IDCM" SG_ 294 MCPB_Temp_P 0;
BA_ "GenSigTimeoutTime_MCPA" SG_ 294 MCPB_Temp_P 0;
BA_ "GenSigTimeoutTime_MCPB" SG_ 294 MCPB_Temp_P 0;
BA_ "GenSigTimeoutTime_SGCP" SG_ 294 MCPB_Temp_P 0;
BA_ "GenSigTimeoutTime_BPCM" SG_ 124 N_PDU_7C 0;
BA_ "GenSigTimeoutTime_ECM" SG_ 124 N_PDU_7C 0;
BA_ "GenSigTimeoutTime_IDCM" SG_ 124 N_PDU_7C 0;
BA_ "GenSigTimeoutTime_MCPA" SG_ 124 N_PDU_7C 0;
BA_ "GenSigTimeoutTime_MCPB" SG_ 124 N_PDU_7C 0;
BA_ "GenSigTimeoutTime_SGCP" SG_ 124 N_PDU_7C 0;
BA_ "GenSigTimeoutTime_BPCM" SG_ 127 N_PDU_7F 0;
BA_ "GenSigTimeoutTime_ECM" SG_ 127 N_PDU_7F 0;
BA_ "GenSigTimeoutTime_EVCU2" SG_ 127 N_PDU_7F 0;
BA_ "GenSigTimeoutTime_IDCM" SG_ 127 N_PDU_7F 0;
BA_ "GenSigTimeoutTime_MCPA" SG_ 127 N_PDU_7F 0;
BA_ "GenSigTimeoutTime_SGCP" SG_ 127 N_PDU_7F 0;
BA_ "GenSigTimeoutTime_BPCM" SG_ 126 N_PDU_7E 0;
BA_ "GenSigTimeoutTime_ECM" SG_ 126 N_PDU_7E 0;
BA_ "GenSigTimeoutTime_EVCU2" SG_ 126 N_PDU_7E 0;
BA_ "GenSigTimeoutTime_IDCM" SG_ 126 N_PDU_7E 0;
BA_ "GenSigTimeoutTime_MCPB" SG_ 126 N_PDU_7E 0;
BA_ "GenSigTimeoutTime_SGCP" SG_ 126 N_PDU_7E 0;
BA_ "GenSigTimeoutTime_BPCM" SG_ 123 N_PDU_7B 0;
BA_ "GenSigTimeoutTime_ECM" SG_ 123 N_PDU_7B 0;
BA_ "GenSigTimeoutTime_IDCM" SG_ 123 N_PDU_7B 0;
BA_ "GenSigTimeoutTime_MCPA" SG_ 123 N_PDU_7B 0;
BA_ "GenSigTimeoutTime_MCPB" SG_ 123 N_PDU_7B 0;
BA_ "GenSigTimeoutTime_SGCP" SG_ 123 N_PDU_7B 0;
BA_ "GenSigStartValue" SG_ 294 MCPB_AccelRaw_P 32768;
BA_ "GenSigTimeoutTime_BPCM" SG_ 294 MCPB_AccelRaw_P 0;
BA_ "GenSigTimeoutTime_ECM" SG_ 294 MCPB_AccelRaw_P 0;
BA_ "GenSigTimeoutTime_IDCM" SG_ 294 MCPB_AccelRaw_P 0;
BA_ "GenSigTimeoutTime_MCPA" SG_ 294 MCPB_AccelRaw_P 0;
BA_ "GenSigTimeoutTime_MCPB" SG_ 294 MCPB_AccelRaw_P 0;
BA_ "GenSigTimeoutTime_SGCP" SG_ 294 MCPB_AccelRaw_P 0;
BA_ "GenSigTimeoutTime_BPCM" SG_ 294 CRC_MCPB_PROPULSION 0;
BA_ "GenSigTimeoutTime_ECM" SG_ 294 CRC_MCPB_PROPULSION 0;
BA_ "GenSigTimeoutTime_IDCM" SG_ 294 CRC_MCPB_PROPULSION 0;
BA_ "GenSigTimeoutTime_MCPA" SG_ 294 CRC_MCPB_PROPULSION 0;
BA_ "GenSigTimeoutTime_MCPB" SG_ 294 CRC_MCPB_PROPULSION 0;
BA_ "GenSigTimeoutTime_SGCP" SG_ 294 CRC_MCPB_PROPULSION 0;
BA_ "GenSigTimeoutTime_BPCM" SG_ 294 MC_MCPB_PROPULSION 0;
BA_ "GenSigTimeoutTime_ECM" SG_ 294 MC_MCPB_PROPULSION 0;
BA_ "GenSigTimeoutTime_IDCM" SG_ 294 MC_MCPB_PROPULSION 0;
BA_ "GenSigTimeoutTime_MCPA" SG_ 294 MC_MCPB_PROPULSION 0;
BA_ "GenSigTimeoutTime_MCPB" SG_ 294 MC_MCPB_PROPULSION 0;
BA_ "GenSigTimeoutTime_SGCP" SG_ 294 MC_MCPB_PROPULSION 0;
BA_ "GenSigTimeoutTime_BPCM" SG_ 294 PlockFailSts_P 0;
BA_ "GenSigTimeoutTime_ECM" SG_ 294 PlockFailSts_P 0;
BA_ "GenSigTimeoutTime_IDCM" SG_ 294 PlockFailSts_P 0;
BA_ "GenSigTimeoutTime_MCPA" SG_ 294 PlockFailSts_P 0;
BA_ "GenSigTimeoutTime_MCPB" SG_ 294 PlockFailSts_P 0;
BA_ "GenSigTimeoutTime_SGCP" SG_ 294 PlockFailSts_P 0;
BA_ "GenSigTimeoutTime_BPCM" SG_ 294 Plock_PosSensor_P 0;
BA_ "GenSigTimeoutTime_ECM" SG_ 294 Plock_PosSensor_P 0;
BA_ "GenSigTimeoutTime_IDCM" SG_ 294 Plock_PosSensor_P 0;
BA_ "GenSigTimeoutTime_MCPA" SG_ 294 Plock_PosSensor_P 0;
BA_ "GenSigTimeoutTime_MCPB" SG_ 294 Plock_PosSensor_P 0;
BA_ "GenSigTimeoutTime_SGCP" SG_ 294 Plock_PosSensor_P 0;
BA_ "GenSigTimeoutTime_BPCM" SG_ 294 Plock_MotorPosSts_P 0;
BA_ "GenSigTimeoutTime_ECM" SG_ 294 Plock_MotorPosSts_P 0;
BA_ "GenSigTimeoutTime_IDCM" SG_ 294 Plock_MotorPosSts_P 0;
BA_ "GenSigTimeoutTime_MCPA" SG_ 294 Plock_MotorPosSts_P 0;
BA_ "GenSigTimeoutTime_MCPB" SG_ 294 Plock_MotorPosSts_P 0;
BA_ "GenSigTimeoutTime_SGCP" SG_ 294 Plock_MotorPosSts_P 0;
BA_ "GenSigTimeoutTime_MCPB" SG_ 294 Plock_fdbk_sts_P 0;
BA_ "GenSigTimeoutTime_SGCP" SG_ 294 Plock_fdbk_sts_P 0;
BA_ "GenSigTimeoutTime_BPCM" SG_ 294 MCPB_TorqAchieved_AEMD_V_P 0;
BA_ "GenSigTimeoutTime_ECM" SG_ 294 MCPB_TorqAchieved_AEMD_V_P 0;
BA_ "GenSigTimeoutTime_IDCM" SG_ 294 MCPB_TorqAchieved_AEMD_V_P 0;
BA_ "GenSigTimeoutTime_MCPA" SG_ 294 MCPB_TorqAchieved_AEMD_V_P 0;
BA_ "GenSigTimeoutTime_MCPB" SG_ 294 MCPB_TorqAchieved_AEMD_V_P 0;
BA_ "GenSigTimeoutTime_SGCP" SG_ 294 MCPB_TorqAchieved_AEMD_V_P 0;
BA_ "GenSigStartValue" SG_ 294 MCPB_TorqAchieved_AEMD_P 8184;
BA_ "GenSigTimeoutTime_BPCM" SG_ 294 MCPB_TorqAchieved_AEMD_P 0;
BA_ "GenSigTimeoutTime_ECM" SG_ 294 MCPB_TorqAchieved_AEMD_P 0;
BA_ "GenSigTimeoutTime_IDCM" SG_ 294 MCPB_TorqAchieved_AEMD_P 0;
BA_ "GenSigTimeoutTime_MCPA" SG_ 294 MCPB_TorqAchieved_AEMD_P 0;
BA_ "GenSigTimeoutTime_MCPB" SG_ 294 MCPB_TorqAchieved_AEMD_P 0;
BA_ "GenSigTimeoutTime_SGCP" SG_ 294 MCPB_TorqAchieved_AEMD_P 0;
BA_ "GenSigTimeoutTime_BPCM" SG_ 294 MCPB_SPT_Stat_P 0;
BA_ "GenSigTimeoutTime_ECM" SG_ 294 MCPB_SPT_Stat_P 0;
BA_ "GenSigTimeoutTime_IDCM" SG_ 294 MCPB_SPT_Stat_P 0;
BA_ "GenSigTimeoutTime_MCPA" SG_ 294 MCPB_SPT_Stat_P 0;
BA_ "GenSigTimeoutTime_MCPB" SG_ 294 MCPB_SPT_Stat_P 0;
BA_ "GenSigTimeoutTime_SGCP" SG_ 294 MCPB_SPT_Stat_P 0;
BA_ "GenSigTimeoutTime_BPCM" SG_ 294 MCPB_Spd_Lim_P 0;
BA_ "GenSigTimeoutTime_ECM" SG_ 294 MCPB_Spd_Lim_P 0;
BA_ "GenSigTimeoutTime_IDCM" SG_ 294 MCPB_Spd_Lim_P 0;
BA_ "GenSigTimeoutTime_MCPA" SG_ 294 MCPB_Spd_Lim_P 0;
BA_ "GenSigTimeoutTime_MCPB" SG_ 294 MCPB_Spd_Lim_P 0;
BA_ "GenSigTimeoutTime_SGCP" SG_ 294 MCPB_Spd_Lim_P 0;
BA_ "GenSigTimeoutTime_BPCM" SG_ 294 MCPB_RPM_V_P 0;
BA_ "GenSigTimeoutTime_ECM" SG_ 294 MCPB_RPM_V_P 0;
BA_ "GenSigTimeoutTime_IDCM" SG_ 294 MCPB_RPM_V_P 0;
BA_ "GenSigTimeoutTime_MCPA" SG_ 294 MCPB_RPM_V_P 0;
BA_ "GenSigTimeoutTime_MCPB" SG_ 294 MCPB_RPM_V_P 0;
BA_ "GenSigTimeoutTime_SGCP" SG_ 294 MCPB_RPM_V_P 0;
BA_ "GenSigStartValue" SG_ 294 MCPB_RPM_P 32768;
BA_ "GenSigTimeoutTime_BPCM" SG_ 294 MCPB_RPM_P 0;
BA_ "GenSigTimeoutTime_ECM" SG_ 294 MCPB_RPM_P 0;
BA_ "GenSigTimeoutTime_IDCM" SG_ 294 MCPB_RPM_P 0;
BA_ "GenSigTimeoutTime_MCPA" SG_ 294 MCPB_RPM_P 0;
BA_ "GenSigTimeoutTime_MCPB" SG_ 294 MCPB_RPM_P 0;
BA_ "GenSigTimeoutTime_SGCP" SG_ 294 MCPB_RPM_P 0;
BA_ "GenSigStartValue" SG_ 294 MCPB_MtrMinCpbltyTrq_P 8184;
BA_ "GenSigTimeoutTime_BPCM" SG_ 294 MCPB_MtrMinCpbltyTrq_P 0;
BA_ "GenSigTimeoutTime_ECM" SG_ 294 MCPB_MtrMinCpbltyTrq_P 0;
BA_ "GenSigTimeoutTime_IDCM" SG_ 294 MCPB_MtrMinCpbltyTrq_P 0;
BA_ "GenSigTimeoutTime_MCPA" SG_ 294 MCPB_MtrMinCpbltyTrq_P 0;
BA_ "GenSigTimeoutTime_MCPB" SG_ 294 MCPB_MtrMinCpbltyTrq_P 0;
BA_ "GenSigTimeoutTime_SGCP" SG_ 294 MCPB_MtrMinCpbltyTrq_P 0;
BA_ "GenSigStartValue" SG_ 294 MCPB_MtrMaxCpbltyTrq_P 8184;
BA_ "GenSigTimeoutTime_BPCM" SG_ 294 MCPB_MtrMaxCpbltyTrq_P 0;
BA_ "GenSigTimeoutTime_ECM" SG_ 294 MCPB_MtrMaxCpbltyTrq_P 0;
BA_ "GenSigTimeoutTime_IDCM" SG_ 294 MCPB_MtrMaxCpbltyTrq_P 0;
BA_ "GenSigTimeoutTime_MCPA" SG_ 294 MCPB_MtrMaxCpbltyTrq_P 0;
BA_ "GenSigTimeoutTime_MCPB" SG_ 294 MCPB_MtrMaxCpbltyTrq_P 0;
BA_ "GenSigTimeoutTime_SGCP" SG_ 294 MCPB_MtrMaxCpbltyTrq_P 0;
BA_ "GenSigTimeoutTime_BPCM" SG_ 294 MCPB_MtrIndex_P 0;
BA_ "GenSigTimeoutTime_ECM" SG_ 294 MCPB_MtrIndex_P 0;
BA_ "GenSigTimeoutTime_IDCM" SG_ 294 MCPB_MtrIndex_P 0;
BA_ "GenSigTimeoutTime_MCPA" SG_ 294 MCPB_MtrIndex_P 0;
BA_ "GenSigTimeoutTime_MCPB" SG_ 294 MCPB_MtrIndex_P 0;
BA_ "GenSigTimeoutTime_SGCP" SG_ 294 MCPB_MtrIndex_P 0;
BA_ "GenSigStartValue" SG_ 294 MCPB_MinTorq_P 8184;
BA_ "GenSigTimeoutTime_BPCM" SG_ 294 MCPB_MinTorq_P 0;
BA_ "GenSigTimeoutTime_ECM" SG_ 294 MCPB_MinTorq_P 0;
BA_ "GenSigTimeoutTime_IDCM" SG_ 294 MCPB_MinTorq_P 0;
BA_ "GenSigTimeoutTime_MCPA" SG_ 294 MCPB_MinTorq_P 0;
BA_ "GenSigTimeoutTime_MCPB" SG_ 294 MCPB_MinTorq_P 0;
BA_ "GenSigTimeoutTime_SGCP" SG_ 294 MCPB_MinTorq_P 0;
BA_ "GenSigStartValue" SG_ 294 MCPB_MaxTorq_P 8184;
BA_ "GenSigTimeoutTime_BPCM" SG_ 294 MCPB_MaxTorq_P 0;
BA_ "GenSigTimeoutTime_ECM" SG_ 294 MCPB_MaxTorq_P 0;
BA_ "GenSigTimeoutTime_IDCM" SG_ 294 MCPB_MaxTorq_P 0;
BA_ "GenSigTimeoutTime_MCPA" SG_ 294 MCPB_MaxTorq_P 0;
BA_ "GenSigTimeoutTime_MCPB" SG_ 294 MCPB_MaxTorq_P 0;
BA_ "GenSigTimeoutTime_SGCP" SG_ 294 MCPB_MaxTorq_P 0;
BA_ "GenSigTimeoutTime_BPCM" SG_ 294 MCPB_Invrtr_State_P 0;
BA_ "GenSigTimeoutTime_ECM" SG_ 294 MCPB_Invrtr_State_P 0;
BA_ "GenSigTimeoutTime_IDCM" SG_ 294 MCPB_Invrtr_State_P 0;
BA_ "GenSigTimeoutTime_MCPA" SG_ 294 MCPB_Invrtr_State_P 0;
BA_ "GenSigTimeoutTime_MCPB" SG_ 294 MCPB_Invrtr_State_P 0;
BA_ "GenSigTimeoutTime_SGCP" SG_ 294 MCPB_Invrtr_State_P 0;
BA_ "GenSigTimeoutTime_BPCM" SG_ 294 MCPB_InterlockSts_P 0;
BA_ "GenSigTimeoutTime_ECM" SG_ 294 MCPB_InterlockSts_P 0;
BA_ "GenSigTimeoutTime_IDCM" SG_ 294 MCPB_InterlockSts_P 0;
BA_ "GenSigTimeoutTime_MCPA" SG_ 294 MCPB_InterlockSts_P 0;
BA_ "GenSigTimeoutTime_MCPB" SG_ 294 MCPB_InterlockSts_P 0;
BA_ "GenSigTimeoutTime_SGCP" SG_ 294 MCPB_InterlockSts_P 0;
BA_ "GenSigTimeoutTime_BPCM" SG_ 294 MCPB_HV_CnctrOpn_Req_P 0;
BA_ "GenSigTimeoutTime_ECM" SG_ 294 MCPB_HV_CnctrOpn_Req_P 0;
BA_ "GenSigTimeoutTime_IDCM" SG_ 294 MCPB_HV_CnctrOpn_Req_P 0;
BA_ "GenSigTimeoutTime_MCPA" SG_ 294 MCPB_HV_CnctrOpn_Req_P 0;
BA_ "GenSigTimeoutTime_MCPB" SG_ 294 MCPB_HV_CnctrOpn_Req_P 0;
BA_ "GenSigTimeoutTime_SGCP" SG_ 294 MCPB_HV_CnctrOpn_Req_P 0;
BA_ "GenSigTimeoutTime_BPCM" SG_ 294 MCPB_Dschrge_Status_P 0;
BA_ "GenSigTimeoutTime_ECM" SG_ 294 MCPB_Dschrge_Status_P 0;
BA_ "GenSigTimeoutTime_IDCM" SG_ 294 MCPB_Dschrge_Status_P 0;
BA_ "GenSigTimeoutTime_MCPA" SG_ 294 MCPB_Dschrge_Status_P 0;
BA_ "GenSigTimeoutTime_MCPB" SG_ 294 MCPB_Dschrge_Status_P 0;
BA_ "GenSigTimeoutTime_SGCP" SG_ 294 MCPB_Dschrge_Status_P 0;
BA_ "GenSigTimeoutTime_BPCM" SG_ 294 MCPB_DeratingFactor_P 0;
BA_ "GenSigTimeoutTime_ECM" SG_ 294 MCPB_DeratingFactor_P 0;
BA_ "GenSigTimeoutTime_IDCM" SG_ 294 MCPB_DeratingFactor_P 0;
BA_ "GenSigTimeoutTime_MCPA" SG_ 294 MCPB_DeratingFactor_P 0;
BA_ "GenSigTimeoutTime_MCPB" SG_ 294 MCPB_DeratingFactor_P 0;
BA_ "GenSigTimeoutTime_SGCP" SG_ 294 MCPB_DeratingFactor_P 0;
BA_ "GenSigTimeoutTime_BPCM" SG_ 294 MCPB_CpbltySpdDivVolt_P 0;
BA_ "GenSigTimeoutTime_ECM" SG_ 294 MCPB_CpbltySpdDivVolt_P 0;
BA_ "GenSigTimeoutTime_IDCM" SG_ 294 MCPB_CpbltySpdDivVolt_P 0;
BA_ "GenSigTimeoutTime_MCPA" SG_ 294 MCPB_CpbltySpdDivVolt_P 0;
BA_ "GenSigTimeoutTime_MCPB" SG_ 294 MCPB_CpbltySpdDivVolt_P 0;
BA_ "GenSigTimeoutTime_SGCP" SG_ 294 MCPB_CpbltySpdDivVolt_P 0;
BA_ "GenSigTimeoutTime_BPCM" SG_ 294 MCPB_AccelRawV_P 0;
BA_ "GenSigTimeoutTime_ECM" SG_ 294 MCPB_AccelRawV_P 0;
BA_ "GenSigTimeoutTime_IDCM" SG_ 294 MCPB_AccelRawV_P 0;
BA_ "GenSigTimeoutTime_MCPA" SG_ 294 MCPB_AccelRawV_P 0;
BA_ "GenSigTimeoutTime_MCPB" SG_ 294 MCPB_AccelRawV_P 0;
BA_ "GenSigTimeoutTime_SGCP" SG_ 294 MCPB_AccelRawV_P 0;
BA_ "GenSigTimeoutTime_BPCM" SG_ 294 MCPB_6SO_Status_P 0;
BA_ "GenSigTimeoutTime_ECM" SG_ 294 MCPB_6SO_Status_P 0;
BA_ "GenSigTimeoutTime_IDCM" SG_ 294 MCPB_6SO_Status_P 0;
BA_ "GenSigTimeoutTime_MCPA" SG_ 294 MCPB_6SO_Status_P 0;
BA_ "GenSigTimeoutTime_MCPB" SG_ 294 MCPB_6SO_Status_P 0;
BA_ "GenSigTimeoutTime_SGCP" SG_ 294 MCPB_6SO_Status_P 0;
BA_ "GenSigTimeoutTime_BPCM" SG_ 294 MCPB_3PS_Pos_P 0;
BA_ "GenSigTimeoutTime_ECM" SG_ 294 MCPB_3PS_Pos_P 0;
BA_ "GenSigTimeoutTime_IDCM" SG_ 294 MCPB_3PS_Pos_P 0;
BA_ "GenSigTimeoutTime_MCPA" SG_ 294 MCPB_3PS_Pos_P 0;
BA_ "GenSigTimeoutTime_MCPB" SG_ 294 MCPB_3PS_Pos_P 0;
BA_ "GenSigTimeoutTime_SGCP" SG_ 294 MCPB_3PS_Pos_P 0;
BA_ "GenSigTimeoutTime_BPCM" SG_ 296 Mtr_6SO_Request_MCPA_P 0;
BA_ "GenSigTimeoutTime_ECM" SG_ 296 Mtr_6SO_Request_MCPA_P 0;
BA_ "GenSigTimeoutTime_IDCM" SG_ 293 MCPA_TorqAchieved_AEMD_V_P 0;
BA_ "GenSigTimeoutTime_MCPA" SG_ 293 MCPA_TorqAchieved_AEMD_V_P 0;
BA_ "GenSigTimeoutTime_MCPB" SG_ 293 MCPA_TorqAchieved_AEMD_V_P 0;
BA_ "GenSigTimeoutTime_SGCP" SG_ 293 MCPA_TorqAchieved_AEMD_V_P 0;
BA_ "GenSigStartValue" SG_ 293 MCPA_Torque_Achieved_P 8184;
BA_ "GenSigTimeoutTime_BPCM" SG_ 293 MCPA_Torque_Achieved_P 0;
BA_ "GenSigTimeoutTime_ECM" SG_ 293 MCPA_Torque_Achieved_P 0;
BA_ "GenSigTimeoutTime_IDCM" SG_ 293 MCPA_Torque_Achieved_P 0;
BA_ "GenSigTimeoutTime_MCPA" SG_ 293 MCPA_Torque_Achieved_P 0;
BA_ "GenSigTimeoutTime_MCPB" SG_ 293 MCPA_Torque_Achieved_P 0;
BA_ "GenSigTimeoutTime_SGCP" SG_ 293 MCPA_Torque_Achieved_P 0;
BA_ "GenSigTimeoutTime_BPCM" SG_ 293 MCPA_MtrIndex_P 0;
BA_ "GenSigTimeoutTime_ECM" SG_ 293 MCPA_MtrIndex_P 0;
BA_ "GenSigTimeoutTime_IDCM" SG_ 293 MCPA_MtrIndex_P 0;
BA_ "GenSigTimeoutTime_MCPA" SG_ 293 MCPA_MtrIndex_P 0;
BA_ "GenSigTimeoutTime_MCPB" SG_ 293 MCPA_MtrIndex_P 0;
BA_ "GenSigTimeoutTime_SGCP" SG_ 293 MCPA_MtrIndex_P 0;
BA_ "GenSigStartValue" SG_ 293 MCPA_MtrMaxCpbltyTrq_P 8184;
BA_ "GenSigTimeoutTime_BPCM" SG_ 293 MCPA_MtrMaxCpbltyTrq_P 0;
BA_ "GenSigTimeoutTime_ECM" SG_ 293 MCPA_MtrMaxCpbltyTrq_P 0;
BA_ "GenSigTimeoutTime_IDCM" SG_ 293 MCPA_MtrMaxCpbltyTrq_P 0;
BA_ "GenSigTimeoutTime_MCPA" SG_ 293 MCPA_MtrMaxCpbltyTrq_P 0;
BA_ "GenSigTimeoutTime_MCPB" SG_ 293 MCPA_MtrMaxCpbltyTrq_P 0;
BA_ "GenSigTimeoutTime_SGCP" SG_ 293 MCPA_MtrMaxCpbltyTrq_P 0;
BA_ "GenSigStartValue" SG_ 293 MCPA_MtrMinCpbltyTrq_P 8184;
BA_ "GenSigTimeoutTime_BPCM" SG_ 293 MCPA_MtrMinCpbltyTrq_P 0;
BA_ "GenSigTimeoutTime_ECM" SG_ 293 MCPA_MtrMinCpbltyTrq_P 0;
BA_ "GenSigTimeoutTime_IDCM" SG_ 293 MCPA_MtrMinCpbltyTrq_P 0;
BA_ "GenSigTimeoutTime_MCPA" SG_ 293 MCPA_MtrMinCpbltyTrq_P 0;
BA_ "GenSigTimeoutTime_MCPB" SG_ 293 MCPA_MtrMinCpbltyTrq_P 0;
BA_ "GenSigTimeoutTime_SGCP" SG_ 293 MCPA_MtrMinCpbltyTrq_P 0;
BA_ "GenSigStartValue" SG_ 293 MCPA_RPM_P 32768;
BA_ "GenSigTimeoutTime_BPCM" SG_ 293 MCPA_RPM_P 0;
BA_ "GenSigTimeoutTime_ECM" SG_ 293 MCPA_RPM_P 0;
BA_ "GenSigTimeoutTime_IDCM" SG_ 293 MCPA_RPM_P 0;
BA_ "GenSigTimeoutTime_MCPA" SG_ 293 MCPA_RPM_P 0;
BA_ "GenSigTimeoutTime_MCPB" SG_ 293 MCPA_RPM_P 0;
BA_ "GenSigTimeoutTime_SGCP" SG_ 293 MCPA_RPM_P 0;
BA_ "GenSigTimeoutTime_BPCM" SG_ 293 MCPA_RPM_V_P 0;
BA_ "GenSigTimeoutTime_ECM" SG_ 293 MCPA_RPM_V_P 0;
BA_ "GenSigTimeoutTime_IDCM" SG_ 293 MCPA_RPM_V_P 0;
BA_ "GenSigTimeoutTime_MCPA" SG_ 293 MCPA_RPM_V_P 0;
BA_ "GenSigTimeoutTime_MCPB" SG_ 293 MCPA_RPM_V_P 0;
BA_ "GenSigTimeoutTime_SGCP" SG_ 293 MCPA_RPM_V_P 0;
BA_ "GenSigStartValue" SG_ 293 MCPA_Spd_Lim_P 32767;
BA_ "GenSigTimeoutTime_BPCM" SG_ 293 MCPA_Spd_Lim_P 0;
BA_ "GenSigTimeoutTime_ECM" SG_ 293 MCPA_Spd_Lim_P 0;
BA_ "GenSigTimeoutTime_IDCM" SG_ 293 MCPA_Spd_Lim_P 0;
BA_ "GenSigTimeoutTime_MCPA" SG_ 293 MCPA_Spd_Lim_P 0;
BA_ "GenSigTimeoutTime_MCPB" SG_ 293 MCPA_Spd_Lim_P 0;
BA_ "GenSigTimeoutTime_SGCP" SG_ 293 MCPA_Spd_Lim_P 0;
BA_ "GenSigTimeoutTime_BPCM" SG_ 293 MCPA_SPT_Stat_P 0;
BA_ "GenSigTimeoutTime_ECM" SG_ 293 MCPA_SPT_Stat_P 0;
BA_ "GenSigTimeoutTime_IDCM" SG_ 293 MCPA_SPT_Stat_P 0;
BA_ "GenSigTimeoutTime_MCPA" SG_ 293 MCPA_SPT_Stat_P 0;
BA_ "GenSigTimeoutTime_MCPB" SG_ 293 MCPA_SPT_Stat_P 0;
BA_ "GenSigTimeoutTime_SGCP" SG_ 293 MCPA_SPT_Stat_P 0;
BA_ "GenSigStartValue" SG_ 293 MCPA_TorqAchieved_AEMD_P 8184;
BA_ "GenSigTimeoutTime_BPCM" SG_ 293 MCPA_TorqAchieved_AEMD_P 0;
BA_ "GenSigTimeoutTime_ECM" SG_ 293 MCPA_TorqAchieved_AEMD_P 0;
BA_ "GenSigTimeoutTime_IDCM" SG_ 293 MCPA_TorqAchieved_AEMD_P 0;
BA_ "GenSigTimeoutTime_MCPA" SG_ 293 MCPA_TorqAchieved_AEMD_P 0;
BA_ "GenSigTimeoutTime_MCPB" SG_ 293 MCPA_TorqAchieved_AEMD_P 0;
BA_ "GenSigTimeoutTime_SGCP" SG_ 293 MCPA_TorqAchieved_AEMD_P 0;
BA_ "GenSigTimeoutTime_BPCM" SG_ 293 MCPA_3PS_Pos_P 0;
BA_ "GenSigTimeoutTime_ECM" SG_ 293 MCPA_3PS_Pos_P 0;
BA_ "GenSigTimeoutTime_IDCM" SG_ 293 MCPA_3PS_Pos_P 0;
BA_ "GenSigTimeoutTime_MCPA" SG_ 293 MCPA_3PS_Pos_P 0;
BA_ "GenSigTimeoutTime_MCPB" SG_ 293 MCPA_3PS_Pos_P 0;
BA_ "GenSigTimeoutTime_SGCP" SG_ 293 MCPA_3PS_Pos_P 0;
BA_ "GenSigTimeoutTime_BPCM" SG_ 293 MCPA_6SO_Status_P 0;
BA_ "GenSigTimeoutTime_ECM" SG_ 293 MCPA_6SO_Status_P 0;
BA_ "GenSigTimeoutTime_IDCM" SG_ 293 MCPA_6SO_Status_P 0;
BA_ "GenSigTimeoutTime_MCPA" SG_ 293 MCPA_6SO_Status_P 0;
BA_ "GenSigTimeoutTime_MCPB" SG_ 293 MCPA_6SO_Status_P 0;
BA_ "GenSigTimeoutTime_SGCP" SG_ 293 MCPA_6SO_Status_P 0;
BA_ "GenSigTimeoutTime_BPCM" SG_ 293 MCPA_AccelRawV_P 0;
BA_ "GenSigTimeoutTime_ECM" SG_ 293 MCPA_AccelRawV_P 0;
BA_ "GenSigTimeoutTime_IDCM" SG_ 293 MCPA_AccelRawV_P 0;
BA_ "GenSigTimeoutTime_MCPA" SG_ 293 MCPA_AccelRawV_P 0;
BA_ "GenSigTimeoutTime_MCPB" SG_ 293 MCPA_AccelRawV_P 0;
BA_ "GenSigTimeoutTime_SGCP" SG_ 293 MCPA_AccelRawV_P 0;
BA_ "GenSigTimeoutTime_BPCM" SG_ 293 MCPA_CpbltySpdDivVolt_P 0;
BA_ "GenSigTimeoutTime_ECM" SG_ 293 MCPA_CpbltySpdDivVolt_P 0;
BA_ "GenSigTimeoutTime_IDCM" SG_ 293 MCPA_CpbltySpdDivVolt_P 0;
BA_ "GenSigTimeoutTime_MCPA" SG_ 293 MCPA_CpbltySpdDivVolt_P 0;
BA_ "GenSigTimeoutTime_MCPB" SG_ 293 MCPA_CpbltySpdDivVolt_P 0;
BA_ "GenSigTimeoutTime_SGCP" SG_ 293 MCPA_CpbltySpdDivVolt_P 0;
BA_ "GenSigTimeoutTime_BPCM" SG_ 293 MCPA_DeratingFactor_P 0;
BA_ "GenSigTimeoutTime_ECM" SG_ 293 MCPA_DeratingFactor_P 0;
BA_ "GenSigTimeoutTime_IDCM" SG_ 293 MCPA_DeratingFactor_P 0;
BA_ "GenSigTimeoutTime_MCPA" SG_ 293 MCPA_DeratingFactor_P 0;
BA_ "GenSigTimeoutTime_MCPB" SG_ 293 MCPA_DeratingFactor_P 0;
BA_ "GenSigTimeoutTime_SGCP" SG_ 293 MCPA_DeratingFactor_P 0;
BA_ "GenSigTimeoutTime_BPCM" SG_ 293 MCPA_Dschrge_Status_P 0;
BA_ "GenSigTimeoutTime_ECM" SG_ 293 MCPA_Dschrge_Status_P 0;
BA_ "GenSigTimeoutTime_IDCM" SG_ 293 MCPA_Dschrge_Status_P 0;
BA_ "GenSigTimeoutTime_MCPA" SG_ 293 MCPA_Dschrge_Status_P 0;
BA_ "GenSigTimeoutTime_MCPB" SG_ 293 MCPA_Dschrge_Status_P 0;
BA_ "GenSigTimeoutTime_SGCP" SG_ 293 MCPA_Dschrge_Status_P 0;
BA_ "GenSigTimeoutTime_BPCM" SG_ 293 MCPA_HV_CnctrOpn_Req_P 0;
BA_ "GenSigTimeoutTime_ECM" SG_ 293 MCPA_HV_CnctrOpn_Req_P 0;
BA_ "GenSigTimeoutTime_IDCM" SG_ 293 MCPA_HV_CnctrOpn_Req_P 0;
BA_ "GenSigTimeoutTime_MCPA" SG_ 293 MCPA_HV_CnctrOpn_Req_P 0;
BA_ "GenSigTimeoutTime_MCPB" SG_ 293 MCPA_HV_CnctrOpn_Req_P 0;
BA_ "GenSigTimeoutTime_SGCP" SG_ 293 MCPA_HV_CnctrOpn_Req_P 0;
BA_ "GenSigTimeoutTime_BPCM" SG_ 293 MCPA_InterlockSts_P 0;
BA_ "GenSigTimeoutTime_ECM" SG_ 293 MCPA_InterlockSts_P 0;
BA_ "GenSigTimeoutTime_IDCM" SG_ 293 MCPA_InterlockSts_P 0;
BA_ "GenSigTimeoutTime_MCPA" SG_ 293 MCPA_InterlockSts_P 0;
BA_ "GenSigTimeoutTime_MCPB" SG_ 293 MCPA_InterlockSts_P 0;
BA_ "GenSigTimeoutTime_SGCP" SG_ 293 MCPA_InterlockSts_P 0;
BA_ "GenSigTimeoutTime_BPCM" SG_ 293 MCPA_Invrtr_State_P 0;
BA_ "GenSigTimeoutTime_ECM" SG_ 293 MCPA_Invrtr_State_P 0;
BA_ "GenSigTimeoutTime_IDCM" SG_ 293 MCPA_Invrtr_State_P 0;
BA_ "GenSigTimeoutTime_MCPA" SG_ 293 MCPA_Invrtr_State_P 0;
BA_ "GenSigTimeoutTime_MCPB" SG_ 293 MCPA_Invrtr_State_P 0;
BA_ "GenSigTimeoutTime_SGCP" SG_ 293 MCPA_Invrtr_State_P 0;
BA_ "GenSigStartValue" SG_ 293 MCPA_MaxTorq_P 8184;
BA_ "GenSigTimeoutTime_BPCM" SG_ 293 MCPA_MaxTorq_P 0;
BA_ "GenSigTimeoutTime_ECM" SG_ 293 MCPA_MaxTorq_P 0;
BA_ "GenSigTimeoutTime_IDCM" SG_ 293 MCPA_MaxTorq_P 0;
BA_ "GenSigTimeoutTime_MCPA" SG_ 293 MCPA_MaxTorq_P 0;
BA_ "GenSigTimeoutTime_MCPB" SG_ 293 MCPA_MaxTorq_P 0;
BA_ "GenSigTimeoutTime_SGCP" SG_ 293 MCPA_MaxTorq_P 0;
BA_ "GenSigStartValue" SG_ 293 MCPA_MinTorq_P 8184;
BA_ "GenSigTimeoutTime_BPCM" SG_ 293 MCPA_MinTorq_P 0;
BA_ "GenSigTimeoutTime_ECM" SG_ 293 MCPA_MinTorq_P 0;
BA_ "GenSigTimeoutTime_IDCM" SG_ 293 MCPA_MinTorq_P 0;
BA_ "GenSigTimeoutTime_MCPA" SG_ 293 MCPA_MinTorq_P 0;
BA_ "GenSigTimeoutTime_MCPB" SG_ 293 MCPA_MinTorq_P 0;
BA_ "GenSigTimeoutTime_SGCP" SG_ 293 MCPA_MinTorq_P 0;
BA_ "GenSigTimeoutTime_BPCM" SG_ 295 SGCP_AC_Isolation_Status_P 0;
BA_ "GenSigTimeoutTime_ECM" SG_ 295 SGCP_AC_Isolation_Status_P 0;
BA_ "GenSigTimeoutTime_IDCM" SG_ 295 SGCP_AC_Isolation_Status_P 0;
BA_ "GenSigTimeoutTime_MCPA" SG_ 295 SGCP_AC_Isolation_Status_P 0;
BA_ "GenSigTimeoutTime_MCPB" SG_ 295 SGCP_AC_Isolation_Status_P 0;
BA_ "GenSigTimeoutTime_SGCP" SG_ 295 SGCP_AC_Isolation_Status_P 0;
BA_ "GenSigStartValue" SG_ 293 MCPA_AccelRaw_P 32768;
BA_ "GenSigTimeoutTime_BPCM" SG_ 293 MCPA_AccelRaw_P 0;
BA_ "GenSigTimeoutTime_ECM" SG_ 293 MCPA_AccelRaw_P 0;
BA_ "GenSigTimeoutTime_IDCM" SG_ 293 MCPA_AccelRaw_P 0;
BA_ "GenSigTimeoutTime_MCPA" SG_ 293 MCPA_AccelRaw_P 0;
BA_ "GenSigTimeoutTime_MCPB" SG_ 293 MCPA_AccelRaw_P 0;
BA_ "GenSigTimeoutTime_SGCP" SG_ 293 MCPA_AccelRaw_P 0;
BA_ "GenSigTimeoutTime_BPCM" SG_ 293 CRC_MCPA_PROPULSION 0;
BA_ "GenSigTimeoutTime_ECM" SG_ 293 CRC_MCPA_PROPULSION 0;
BA_ "GenSigTimeoutTime_IDCM" SG_ 293 CRC_MCPA_PROPULSION 0;
BA_ "GenSigTimeoutTime_MCPA" SG_ 293 CRC_MCPA_PROPULSION 0;
BA_ "GenSigTimeoutTime_MCPB" SG_ 293 CRC_MCPA_PROPULSION 0;
BA_ "GenSigTimeoutTime_SGCP" SG_ 293 CRC_MCPA_PROPULSION 0;
BA_ "GenSigTimeoutTime_BPCM" SG_ 293 MC_MCPA_PROPULSION 0;
BA_ "GenSigTimeoutTime_ECM" SG_ 293 MC_MCPA_PROPULSION 0;
BA_ "GenSigTimeoutTime_IDCM" SG_ 293 MC_MCPA_PROPULSION 0;
BA_ "GenSigTimeoutTime_MCPA" SG_ 293 MC_MCPA_PROPULSION 0;
BA_ "GenSigTimeoutTime_MCPB" SG_ 293 MC_MCPA_PROPULSION 0;
BA_ "GenSigTimeoutTime_SGCP" SG_ 293 MC_MCPA_PROPULSION 0;
BA_ "GenSigTimeoutTime_BPCM" SG_ 293 MCPA_AC_Isolation_Status_P 0;
BA_ "GenSigTimeoutTime_ECM" SG_ 293 MCPA_AC_Isolation_Status_P 0;
BA_ "GenSigTimeoutTime_IDCM" SG_ 293 MCPA_AC_Isolation_Status_P 0;
BA_ "GenSigTimeoutTime_MCPA" SG_ 293 MCPA_AC_Isolation_Status_P 0;
BA_ "GenSigTimeoutTime_MCPB" SG_ 293 MCPA_AC_Isolation_Status_P 0;
BA_ "GenSigTimeoutTime_SGCP" SG_ 293 MCPA_AC_Isolation_Status_P 0;
BA_ "GenSigStartValue" SG_ 293 MCPA_Temp_P 40;
BA_ "GenSigTimeoutTime_BPCM" SG_ 293 MCPA_Temp_P 0;
BA_ "GenSigTimeoutTime_ECM" SG_ 293 MCPA_Temp_P 0;
BA_ "GenSigTimeoutTime_IDCM" SG_ 293 MCPA_Temp_P 0;
BA_ "GenSigTimeoutTime_MCPA" SG_ 293 MCPA_Temp_P 0;
BA_ "GenSigTimeoutTime_MCPB" SG_ 293 MCPA_Temp_P 0;
BA_ "GenSigTimeoutTime_SGCP" SG_ 293 MCPA_Temp_P 0;
BA_ "GenSigTimeoutTime_BPCM" SG_ 296 AEMD_Sclr_Gn_MCPB_P 0;
BA_ "GenSigTimeoutTime_ECM" SG_ 296 AEMD_Sclr_Gn_MCPB_P 0;
BA_ "GenSigTimeoutTime_EVCU2" SG_ 296 AEMD_Sclr_Gn_MCPB_P 0;
BA_ "GenSigTimeoutTime_IDCM" SG_ 296 AEMD_Sclr_Gn_MCPB_P 0;
BA_ "GenSigTimeoutTime_MCPA" SG_ 296 AEMD_Sclr_Gn_MCPB_P 0;
BA_ "GenSigTimeoutTime_SGCP" SG_ 296 AEMD_Sclr_Gn_MCPB_P 0;
BA_ "GenSigTimeoutTime_BPCM" SG_ 296 AEMD_Sclr_Gn_MCPA_P 0;
BA_ "GenSigTimeoutTime_ECM" SG_ 296 AEMD_Sclr_Gn_MCPA_P 0;
BA_ "GenSigTimeoutTime_EVCU2" SG_ 296 AEMD_Sclr_Gn_MCPA_P 0;
BA_ "GenSigTimeoutTime_IDCM" SG_ 296 AEMD_Sclr_Gn_MCPA_P 0;
BA_ "GenSigTimeoutTime_MCPB" SG_ 296 AEMD_Sclr_Gn_MCPA_P 0;
BA_ "GenSigTimeoutTime_SGCP" SG_ 296 AEMD_Sclr_Gn_MCPA_P 0;
BA_ "GenSigTimeoutTime_BPCM" SG_ 296 VehicleSpeedVSOSig_P 0;
BA_ "GenSigTimeoutTime_EVCU2" SG_ 296 Mtr_6SO_Request_MCPA_P 0;
BA_ "GenSigTimeoutTime_IDCM" SG_ 296 Mtr_6SO_Request_MCPA_P 0;
BA_ "GenSigTimeoutTime_MCPB" SG_ 296 Mtr_6SO_Request_MCPA_P 0;
BA_ "GenSigTimeoutTime_SGCP" SG_ 296 Mtr_6SO_Request_MCPA_P 0;
BA_ "GenSigTimeoutTime_BPCM" SG_ 296 ModeCommand_SGCP_P 0;
BA_ "GenSigTimeoutTime_ECM" SG_ 296 ModeCommand_SGCP_P 0;
BA_ "GenSigTimeoutTime_EVCU2" SG_ 296 ModeCommand_SGCP_P 0;
BA_ "GenSigTimeoutTime_IDCM" SG_ 296 ModeCommand_SGCP_P 0;
BA_ "GenSigTimeoutTime_MCPA" SG_ 296 ModeCommand_SGCP_P 0;
BA_ "GenSigTimeoutTime_MCPB" SG_ 296 ModeCommand_SGCP_P 0;
BA_ "GenSigTimeoutTime_BPCM" SG_ 296 Mtr_6SO_Request_MCPB_P 0;
BA_ "GenSigTimeoutTime_ECM" SG_ 296 Mtr_6SO_Request_MCPB_P 0;
BA_ "GenSigTimeoutTime_EVCU2" SG_ 296 Mtr_6SO_Request_MCPB_P 0;
BA_ "GenSigTimeoutTime_IDCM" SG_ 296 Mtr_6SO_Request_MCPB_P 0;
BA_ "GenSigTimeoutTime_MCPA" SG_ 296 Mtr_6SO_Request_MCPB_P 0;
BA_ "GenSigTimeoutTime_SGCP" SG_ 296 Mtr_6SO_Request_MCPB_P 0;
BA_ "GenSigTimeoutTime_BPCM" SG_ 296 Mtr_6SO_Request_SGCP_P 0;
BA_ "GenSigTimeoutTime_ECM" SG_ 296 Mtr_6SO_Request_SGCP_P 0;
BA_ "GenSigTimeoutTime_EVCU2" SG_ 296 Mtr_6SO_Request_SGCP_P 0;
BA_ "GenSigTimeoutTime_IDCM" SG_ 296 Mtr_6SO_Request_SGCP_P 0;
BA_ "GenSigTimeoutTime_MCPA" SG_ 296 Mtr_6SO_Request_SGCP_P 0;
BA_ "GenSigTimeoutTime_MCPB" SG_ 296 Mtr_6SO_Request_SGCP_P 0;
BA_ "GenSigTimeoutTime_BPCM" SG_ 296 CRC_INVTARGET_PROPULSION1 0;
BA_ "GenSigTimeoutTime_ECM" SG_ 296 CRC_INVTARGET_PROPULSION1 0;
BA_ "GenSigTimeoutTime_EVCU2" SG_ 296 CRC_INVTARGET_PROPULSION1 0;
BA_ "GenSigTimeoutTime_IDCM" SG_ 296 CRC_INVTARGET_PROPULSION1 0;
BA_ "GenSigTimeoutTime_BPCM" SG_ 296 MC_INVTARGET_PROPULSION1 0;
BA_ "GenSigTimeoutTime_ECM" SG_ 296 MC_INVTARGET_PROPULSION1 0;
BA_ "GenSigTimeoutTime_EVCU2" SG_ 296 MC_INVTARGET_PROPULSION1 0;
BA_ "GenSigTimeoutTime_IDCM" SG_ 296 MC_INVTARGET_PROPULSION1 0;
BA_ "GenSigTimeoutTime_BPCM" SG_ 296 ModeCommand_MCPA_P 0;
BA_ "GenSigTimeoutTime_ECM" SG_ 296 ModeCommand_MCPA_P 0;
BA_ "GenSigTimeoutTime_EVCU2" SG_ 296 ModeCommand_MCPA_P 0;
BA_ "GenSigTimeoutTime_IDCM" SG_ 296 ModeCommand_MCPA_P 0;
BA_ "GenSigTimeoutTime_MCPB" SG_ 296 ModeCommand_MCPA_P 0;
BA_ "GenSigTimeoutTime_SGCP" SG_ 296 ModeCommand_MCPA_P 0;
BA_ "GenSigTimeoutTime_BPCM" SG_ 296 ModeCommand_MCPB_P 0;
BA_ "GenSigTimeoutTime_ECM" SG_ 296 ModeCommand_MCPB_P 0;
BA_ "GenSigTimeoutTime_EVCU2" SG_ 296 ModeCommand_MCPB_P 0;
BA_ "GenSigTimeoutTime_IDCM" SG_ 296 ModeCommand_MCPB_P 0;
BA_ "GenSigTimeoutTime_MCPA" SG_ 296 ModeCommand_MCPB_P 0;
BA_ "GenSigTimeoutTime_SGCP" SG_ 296 ModeCommand_MCPB_P 0;
BA_ "GenSigTimeoutTime_BPCM" SG_ 296 ParkCmd_PT_P 0;
BA_ "GenSigTimeoutTime_ECM" SG_ 296 ParkCmd_PT_P 0;
BA_ "GenSigTimeoutTime_EVCU2" SG_ 296 ParkCmd_PT_P 0;
BA_ "GenSigTimeoutTime_IDCM" SG_ 296 ParkCmd_PT_P 0;
BA_ "GenSigTimeoutTime_MCPA" SG_ 296 ParkCmd_PT_P 0;
BA_ "GenSigTimeoutTime_SGCP" SG_ 296 ParkCmd_PT_P 0;
BA_ "GenSigTimeoutTime_BPCM" SG_ 296 ShiftLeverPosition_P 0;
BA_ "GenSigTimeoutTime_ECM" SG_ 296 ShiftLeverPosition_P 0;
BA_ "GenSigTimeoutTime_EVCU2" SG_ 296 ShiftLeverPosition_P 0;
BA_ "GenSigTimeoutTime_IDCM" SG_ 296 ShiftLeverPosition_P 0;
BA_ "GenSigTimeoutTime_MCPA" SG_ 296 ShiftLeverPosition_P 0;
BA_ "GenSigTimeoutTime_SGCP" SG_ 296 ShiftLeverPosition_P 0;
BA_ "GenSigStartValue" SG_ 296 TargetMotorRPM_MCPA_P 32768;
BA_ "GenSigTimeoutTime_BPCM" SG_ 296 TargetMotorRPM_MCPA_P 0;
BA_ "GenSigTimeoutTime_ECM" SG_ 296 TargetMotorRPM_MCPA_P 0;
BA_ "GenSigTimeoutTime_EVCU2" SG_ 296 TargetMotorRPM_MCPA_P 0;
BA_ "GenSigTimeoutTime_IDCM" SG_ 296 TargetMotorRPM_MCPA_P 0;
BA_ "GenSigTimeoutTime_MCPB" SG_ 296 TargetMotorRPM_MCPA_P 0;
BA_ "GenSigTimeoutTime_SGCP" SG_ 296 TargetMotorRPM_MCPA_P 0;
BA_ "GenSigStartValue" SG_ 296 TargetMotorRPM_MCPB_P 32768;
BA_ "GenSigTimeoutTime_BPCM" SG_ 296 TargetMotorRPM_MCPB_P 0;
BA_ "GenSigTimeoutTime_ECM" SG_ 296 TargetMotorRPM_MCPB_P 0;
BA_ "GenSigTimeoutTime_EVCU2" SG_ 296 TargetMotorRPM_MCPB_P 0;
BA_ "GenSigTimeoutTime_IDCM" SG_ 296 TargetMotorRPM_MCPB_P 0;
BA_ "GenSigTimeoutTime_MCPA" SG_ 296 TargetMotorRPM_MCPB_P 0;
BA_ "GenSigTimeoutTime_SGCP" SG_ 296 TargetMotorRPM_MCPB_P 0;
BA_ "GenSigTimeoutTime_BPCM" SG_ 296 TargetMotorRPM_SGCP_P 0;
BA_ "GenSigTimeoutTime_ECM" SG_ 296 TargetMotorRPM_SGCP_P 0;
BA_ "GenSigTimeoutTime_EVCU2" SG_ 296 TargetMotorRPM_SGCP_P 0;
BA_ "GenSigTimeoutTime_IDCM" SG_ 296 TargetMotorRPM_SGCP_P 0;
BA_ "GenSigTimeoutTime_MCPA" SG_ 296 TargetMotorRPM_SGCP_P 0;
BA_ "GenSigTimeoutTime_MCPB" SG_ 296 TargetMotorRPM_SGCP_P 0;
BA_ "GenSigStartValue" SG_ 296 TargetMotorRPM_SGCP_P 32768;
BA_ "GenSigStartValue" SG_ 296 TorqueCommand_MCPA_P 8184;
BA_ "GenSigTimeoutTime_BPCM" SG_ 296 TorqueCommand_MCPA_P 0;
BA_ "GenSigTimeoutTime_ECM" SG_ 296 TorqueCommand_MCPA_P 0;
BA_ "GenSigTimeoutTime_EVCU2" SG_ 296 TorqueCommand_MCPA_P 0;
BA_ "GenSigTimeoutTime_IDCM" SG_ 296 TorqueCommand_MCPA_P 0;
BA_ "GenSigTimeoutTime_MCPB" SG_ 296 TorqueCommand_MCPA_P 0;
BA_ "GenSigTimeoutTime_SGCP" SG_ 296 TorqueCommand_MCPA_P 0;
BA_ "GenSigStartValue" SG_ 296 TorqueCommand_MCPB_P 8184;
BA_ "GenSigTimeoutTime_BPCM" SG_ 296 TorqueCommand_MCPB_P 0;
BA_ "GenSigTimeoutTime_ECM" SG_ 296 TorqueCommand_MCPB_P 0;
BA_ "GenSigTimeoutTime_EVCU2" SG_ 296 TorqueCommand_MCPB_P 0;
BA_ "GenSigTimeoutTime_IDCM" SG_ 296 TorqueCommand_MCPB_P 0;
BA_ "GenSigTimeoutTime_MCPA" SG_ 296 TorqueCommand_MCPB_P 0;
BA_ "GenSigTimeoutTime_SGCP" SG_ 296 TorqueCommand_MCPB_P 0;
BA_ "GenSigStartValue" SG_ 296 TorqueCommand_SGCP_P 8184;
BA_ "GenSigTimeoutTime_BPCM" SG_ 296 TorqueCommand_SGCP_P 0;
BA_ "GenSigTimeoutTime_ECM" SG_ 296 TorqueCommand_SGCP_P 0;
BA_ "GenSigTimeoutTime_EVCU2" SG_ 296 TorqueCommand_SGCP_P 0;
BA_ "GenSigTimeoutTime_IDCM" SG_ 296 TorqueCommand_SGCP_P 0;
BA_ "GenSigTimeoutTime_MCPA" SG_ 296 TorqueCommand_SGCP_P 0;
BA_ "GenSigTimeoutTime_MCPB" SG_ 296 TorqueCommand_SGCP_P 0;
BA_ "GenSigTimeoutTime_BPCM" SG_ 296 AEMD_Cutoff_FreqHigh_MCPA_P 0;
BA_ "GenSigTimeoutTime_ECM" SG_ 296 AEMD_Cutoff_FreqHigh_MCPA_P 0;
BA_ "GenSigTimeoutTime_EVCU2" SG_ 296 AEMD_Cutoff_FreqHigh_MCPA_P 0;
BA_ "GenSigTimeoutTime_IDCM" SG_ 296 AEMD_Cutoff_FreqHigh_MCPA_P 0;
BA_ "GenSigTimeoutTime_MCPB" SG_ 296 AEMD_Cutoff_FreqHigh_MCPA_P 0;
BA_ "GenSigTimeoutTime_SGCP" SG_ 296 AEMD_Cutoff_FreqHigh_MCPA_P 0;
BA_ "GenSigTimeoutTime_BPCM" SG_ 296 AEMD_Cutoff_FreqHigh_MCPB_P 0;
BA_ "GenSigTimeoutTime_ECM" SG_ 296 AEMD_Cutoff_FreqHigh_MCPB_P 0;
BA_ "GenSigTimeoutTime_EVCU2" SG_ 296 AEMD_Cutoff_FreqHigh_MCPB_P 0;
BA_ "GenSigTimeoutTime_IDCM" SG_ 296 AEMD_Cutoff_FreqHigh_MCPB_P 0;
BA_ "GenSigTimeoutTime_MCPA" SG_ 296 AEMD_Cutoff_FreqHigh_MCPB_P 0;
BA_ "GenSigTimeoutTime_SGCP" SG_ 296 AEMD_Cutoff_FreqHigh_MCPB_P 0;
BA_ "GenSigTimeoutTime_BPCM" SG_ 296 AEMD_Cutoff_FreqHigh_SGCP_P 0;
BA_ "GenSigTimeoutTime_ECM" SG_ 296 AEMD_Cutoff_FreqHigh_SGCP_P 0;
BA_ "GenSigTimeoutTime_EVCU2" SG_ 296 AEMD_Cutoff_FreqHigh_SGCP_P 0;
BA_ "GenSigTimeoutTime_IDCM" SG_ 296 AEMD_Cutoff_FreqHigh_SGCP_P 0;
BA_ "GenSigTimeoutTime_MCPA" SG_ 296 AEMD_Cutoff_FreqHigh_SGCP_P 0;
BA_ "GenSigTimeoutTime_MCPB" SG_ 296 AEMD_Cutoff_FreqHigh_SGCP_P 0;
BA_ "GenSigTimeoutTime_BPCM" SG_ 296 AEMD_Cutoff_FreqLow_MCPA_P 0;
BA_ "GenSigTimeoutTime_ECM" SG_ 296 AEMD_Cutoff_FreqLow_MCPA_P 0;
BA_ "GenSigTimeoutTime_EVCU2" SG_ 296 AEMD_Cutoff_FreqLow_MCPA_P 0;
BA_ "GenSigTimeoutTime_IDCM" SG_ 296 AEMD_Cutoff_FreqLow_MCPA_P 0;
BA_ "GenSigTimeoutTime_MCPB" SG_ 296 AEMD_Cutoff_FreqLow_MCPA_P 0;
BA_ "GenSigTimeoutTime_SGCP" SG_ 296 AEMD_Cutoff_FreqLow_MCPA_P 0;
BA_ "GenSigTimeoutTime_BPCM" SG_ 296 AEMD_Cutoff_FreqLow_MCPB_P 0;
BA_ "GenSigTimeoutTime_ECM" SG_ 296 AEMD_Cutoff_FreqLow_MCPB_P 0;
BA_ "GenSigTimeoutTime_EVCU2" SG_ 296 AEMD_Cutoff_FreqLow_MCPB_P 0;
BA_ "GenSigTimeoutTime_IDCM" SG_ 296 AEMD_Cutoff_FreqLow_MCPB_P 0;
BA_ "GenSigTimeoutTime_MCPA" SG_ 296 AEMD_Cutoff_FreqLow_MCPB_P 0;
BA_ "GenSigTimeoutTime_SGCP" SG_ 296 AEMD_Cutoff_FreqLow_MCPB_P 0;
BA_ "GenSigTimeoutTime_BPCM" SG_ 296 AEMD_Cutoff_FreqLow_SGCP_P 0;
BA_ "GenSigTimeoutTime_ECM" SG_ 296 AEMD_Cutoff_FreqLow_SGCP_P 0;
BA_ "GenSigTimeoutTime_EVCU2" SG_ 296 AEMD_Cutoff_FreqLow_SGCP_P 0;
BA_ "GenSigTimeoutTime_IDCM" SG_ 296 AEMD_Cutoff_FreqLow_SGCP_P 0;
BA_ "GenSigTimeoutTime_MCPA" SG_ 296 AEMD_Cutoff_FreqLow_SGCP_P 0;
BA_ "GenSigTimeoutTime_MCPB" SG_ 296 AEMD_Cutoff_FreqLow_SGCP_P 0;
BA_ "GenSigStartValue" SG_ 296 AEMD_MaxOffset_MCPA_P 8184;
BA_ "GenSigTimeoutTime_BPCM" SG_ 296 AEMD_MaxOffset_MCPA_P 0;
BA_ "GenSigTimeoutTime_ECM" SG_ 296 AEMD_MaxOffset_MCPA_P 0;
BA_ "GenSigTimeoutTime_EVCU2" SG_ 296 AEMD_MaxOffset_MCPA_P 0;
BA_ "GenSigTimeoutTime_IDCM" SG_ 296 AEMD_MaxOffset_MCPA_P 0;
BA_ "GenSigTimeoutTime_MCPB" SG_ 296 AEMD_MaxOffset_MCPA_P 0;
BA_ "GenSigTimeoutTime_SGCP" SG_ 296 AEMD_MaxOffset_MCPA_P 0;
BA_ "GenSigStartValue" SG_ 296 AEMD_MaxOffset_MCPB_P 8184;
BA_ "GenSigTimeoutTime_BPCM" SG_ 296 AEMD_MaxOffset_MCPB_P 0;
BA_ "GenSigTimeoutTime_ECM" SG_ 296 AEMD_MaxOffset_MCPB_P 0;
BA_ "GenSigTimeoutTime_EVCU2" SG_ 296 AEMD_MaxOffset_MCPB_P 0;
BA_ "GenSigTimeoutTime_IDCM" SG_ 296 AEMD_MaxOffset_MCPB_P 0;
BA_ "GenSigTimeoutTime_MCPA" SG_ 296 AEMD_MaxOffset_MCPB_P 0;
BA_ "GenSigTimeoutTime_SGCP" SG_ 296 AEMD_MaxOffset_MCPB_P 0;
BA_ "GenSigStartValue" SG_ 296 AEMD_MaxOffset_SGCP_P 8184;
BA_ "GenSigTimeoutTime_BPCM" SG_ 296 AEMD_MaxOffset_SGCP_P 0;
BA_ "GenSigTimeoutTime_ECM" SG_ 296 AEMD_MaxOffset_SGCP_P 0;
BA_ "GenSigTimeoutTime_EVCU2" SG_ 296 AEMD_MaxOffset_SGCP_P 0;
BA_ "GenSigTimeoutTime_IDCM" SG_ 296 AEMD_MaxOffset_SGCP_P 0;
BA_ "GenSigTimeoutTime_MCPA" SG_ 296 AEMD_MaxOffset_SGCP_P 0;
BA_ "GenSigTimeoutTime_MCPB" SG_ 296 AEMD_MaxOffset_SGCP_P 0;
BA_ "GenSigStartValue" SG_ 296 AEMD_MinOffset_MCPA_P 8184;
BA_ "GenSigTimeoutTime_BPCM" SG_ 296 AEMD_MinOffset_MCPA_P 0;
BA_ "GenSigTimeoutTime_ECM" SG_ 296 AEMD_MinOffset_MCPA_P 0;
BA_ "GenSigTimeoutTime_EVCU2" SG_ 296 AEMD_MinOffset_MCPA_P 0;
BA_ "GenSigTimeoutTime_IDCM" SG_ 296 AEMD_MinOffset_MCPA_P 0;
BA_ "GenSigTimeoutTime_MCPB" SG_ 296 AEMD_MinOffset_MCPA_P 0;
BA_ "GenSigTimeoutTime_SGCP" SG_ 296 AEMD_MinOffset_MCPA_P 0;
BA_ "GenSigStartValue" SG_ 296 AEMD_MinOffset_MCPB_P 8184;
BA_ "GenSigTimeoutTime_BPCM" SG_ 296 AEMD_MinOffset_MCPB_P 0;
BA_ "GenSigTimeoutTime_ECM" SG_ 296 AEMD_MinOffset_MCPB_P 0;
BA_ "GenSigTimeoutTime_EVCU2" SG_ 296 AEMD_MinOffset_MCPB_P 0;
BA_ "GenSigTimeoutTime_IDCM" SG_ 296 AEMD_MinOffset_MCPB_P 0;
BA_ "GenSigTimeoutTime_MCPA" SG_ 296 AEMD_MinOffset_MCPB_P 0;
BA_ "GenSigTimeoutTime_SGCP" SG_ 296 AEMD_MinOffset_MCPB_P 0;
BA_ "GenSigStartValue" SG_ 296 AEMD_MinOffset_SGCP_P 8184;
BA_ "GenSigTimeoutTime_BPCM" SG_ 296 AEMD_MinOffset_SGCP_P 0;
BA_ "GenSigTimeoutTime_ECM" SG_ 296 AEMD_MinOffset_SGCP_P 0;
BA_ "GenSigTimeoutTime_EVCU2" SG_ 296 AEMD_MinOffset_SGCP_P 0;
BA_ "GenSigTimeoutTime_IDCM" SG_ 296 AEMD_MinOffset_SGCP_P 0;
BA_ "GenSigTimeoutTime_MCPA" SG_ 296 AEMD_MinOffset_SGCP_P 0;
BA_ "GenSigTimeoutTime_MCPB" SG_ 296 AEMD_MinOffset_SGCP_P 0;
BA_ "GenSigTimeoutTime_BPCM" SG_ 296 AEMD_Sclr_Gn_SGCP_P 0;
BA_ "GenSigTimeoutTime_ECM" SG_ 296 AEMD_Sclr_Gn_SGCP_P 0;
BA_ "GenSigTimeoutTime_EVCU2" SG_ 296 AEMD_Sclr_Gn_SGCP_P 0;
BA_ "GenSigTimeoutTime_IDCM" SG_ 296 AEMD_Sclr_Gn_SGCP_P 0;
BA_ "GenSigTimeoutTime_MCPA" SG_ 296 AEMD_Sclr_Gn_SGCP_P 0;
BA_ "GenSigTimeoutTime_MCPB" SG_ 296 AEMD_Sclr_Gn_SGCP_P 0;
BA_ "GenSigTimeoutTime_BPCM" SG_ 296 BPCM_HV_Trac_Main_Contac_Sts_P 0;
BA_ "GenSigTimeoutTime_ECM" SG_ 296 BPCM_HV_Trac_Main_Contac_Sts_P 0;
BA_ "GenSigTimeoutTime_EVCU2" SG_ 296 BPCM_HV_Trac_Main_Contac_Sts_P 0;
BA_ "GenSigTimeoutTime_IDCM" SG_ 296 BPCM_HV_Trac_Main_Contac_Sts_P 0;
BA_ "GenSigTimeoutTime_BPCM" SG_ 296 BPCM_HV_TractionBusVoltage_P 0;
BA_ "GenSigTimeoutTime_ECM" SG_ 296 BPCM_HV_TractionBusVoltage_P 0;
BA_ "GenSigTimeoutTime_EVCU2" SG_ 296 BPCM_HV_TractionBusVoltage_P 0;
BA_ "GenSigTimeoutTime_IDCM" SG_ 296 BPCM_HV_TractionBusVoltage_P 0;
BA_ "GenSigTimeoutTime_BPCM" SG_ 296 CmdIgnSts_P 0;
BA_ "GenSigTimeoutTime_ECM" SG_ 296 CmdIgnSts_P 0;
BA_ "GenSigTimeoutTime_EVCU2" SG_ 296 CmdIgnSts_P 0;
BA_ "GenSigTimeoutTime_IDCM" SG_ 296 CmdIgnSts_P 0;
BA_ "GenSigTimeoutTime_ECM" SG_ 296 VehicleSpeedVSOSig_P 0;
BA_ "GenSigTimeoutTime_EVCU2" SG_ 296 VehicleSpeedVSOSig_P 0;
BA_ "GenSigTimeoutTime_IDCM" SG_ 296 VehicleSpeedVSOSig_P 0;
BA_ "GenSigTimeoutTime_BPCM" SG_ 297 CRC_INVTARGET_PROPULSION2 0;
BA_ "GenSigTimeoutTime_ECM" SG_ 297 CRC_INVTARGET_PROPULSION2 0;
BA_ "GenSigTimeoutTime_EVCU2" SG_ 297 CRC_INVTARGET_PROPULSION2 0;
BA_ "GenSigTimeoutTime_IDCM" SG_ 297 CRC_INVTARGET_PROPULSION2 0;
BA_ "GenSigStartValue" SG_ 297 EVCU_MotorA_Speed 32768;
BA_ "GenSigTimeoutTime_BPCM" SG_ 297 EVCU_MotorA_Speed 0;
BA_ "GenSigTimeoutTime_ECM" SG_ 297 EVCU_MotorA_Speed 0;
BA_ "GenSigTimeoutTime_EVCU2" SG_ 297 EVCU_MotorA_Speed 0;
BA_ "GenSigTimeoutTime_IDCM" SG_ 297 EVCU_MotorA_Speed 0;
BA_ "GenSigTimeoutTime_MCPB" SG_ 297 EVCU_MotorA_Speed 0;
BA_ "GenSigTimeoutTime_SGCP" SG_ 297 EVCU_MotorA_Speed 0;
BA_ "GenSigStartValue" SG_ 297 EVCU_MotorB_Speed 32768;
BA_ "GenSigTimeoutTime_BPCM" SG_ 297 EVCU_MotorB_Speed 0;
BA_ "GenSigTimeoutTime_ECM" SG_ 297 EVCU_MotorB_Speed 0;
BA_ "GenSigTimeoutTime_EVCU2" SG_ 297 EVCU_MotorB_Speed 0;
BA_ "GenSigTimeoutTime_IDCM" SG_ 297 EVCU_MotorB_Speed 0;
BA_ "GenSigTimeoutTime_MCPA" SG_ 297 EVCU_MotorB_Speed 0;
BA_ "GenSigTimeoutTime_SGCP" SG_ 297 EVCU_MotorB_Speed 0;
BA_ "GenSigStartValue" SG_ 297 EVCU_MotorC_Speed 32768;
BA_ "GenSigTimeoutTime_BPCM" SG_ 297 EVCU_MotorC_Speed 0;
BA_ "GenSigTimeoutTime_ECM" SG_ 297 EVCU_MotorC_Speed 0;
BA_ "GenSigTimeoutTime_EVCU2" SG_ 297 EVCU_MotorC_Speed 0;
BA_ "GenSigTimeoutTime_IDCM" SG_ 297 EVCU_MotorC_Speed 0;
BA_ "GenSigTimeoutTime_MCPA" SG_ 297 EVCU_MotorC_Speed 0;
BA_ "GenSigTimeoutTime_MCPB" SG_ 297 EVCU_MotorC_Speed 0;
BA_ "GenSigTimeoutTime_BPCM" SG_ 297 MC_INVTARGET_PROPULSION2 0;
BA_ "GenSigTimeoutTime_ECM" SG_ 297 MC_INVTARGET_PROPULSION2 0;
BA_ "GenSigTimeoutTime_EVCU2" SG_ 297 MC_INVTARGET_PROPULSION2 0;
BA_ "GenSigTimeoutTime_IDCM" SG_ 297 MC_INVTARGET_PROPULSION2 0;
BA_ "GenSigTimeoutTime_BPCM" SG_ 297 Pwr_Electr_Loop_FlwRate_MCPA_P 0;
BA_ "GenSigTimeoutTime_ECM" SG_ 297 Pwr_Electr_Loop_FlwRate_MCPA_P 0;
BA_ "GenSigTimeoutTime_EVCU2" SG_ 297 Pwr_Electr_Loop_FlwRate_MCPA_P 0;
BA_ "GenSigTimeoutTime_IDCM" SG_ 297 Pwr_Electr_Loop_FlwRate_MCPA_P 0;
BA_ "GenSigTimeoutTime_MCPB" SG_ 297 Pwr_Electr_Loop_FlwRate_MCPA_P 0;
BA_ "GenSigTimeoutTime_SGCP" SG_ 297 Pwr_Electr_Loop_FlwRate_MCPA_P 0;
BA_ "GenSigTimeoutTime_BPCM" SG_ 297 Pwr_Electr_Loop_FlwRate_MCPB_P 0;
BA_ "GenSigTimeoutTime_ECM" SG_ 297 Pwr_Electr_Loop_FlwRate_MCPB_P 0;
BA_ "GenSigTimeoutTime_EVCU2" SG_ 297 Pwr_Electr_Loop_FlwRate_MCPB_P 0;
BA_ "GenSigTimeoutTime_IDCM" SG_ 297 Pwr_Electr_Loop_FlwRate_MCPB_P 0;
BA_ "GenSigTimeoutTime_MCPA" SG_ 297 Pwr_Electr_Loop_FlwRate_MCPB_P 0;
BA_ "GenSigTimeoutTime_SGCP" SG_ 297 Pwr_Electr_Loop_FlwRate_MCPB_P 0;
BA_ "GenSigTimeoutTime_BPCM" SG_ 297 Pwr_Electr_Loop_FlwRate_SGCP_P 0;
BA_ "GenSigTimeoutTime_ECM" SG_ 297 Pwr_Electr_Loop_FlwRate_SGCP_P 0;
BA_ "GenSigTimeoutTime_EVCU2" SG_ 297 Pwr_Electr_Loop_FlwRate_SGCP_P 0;
BA_ "GenSigTimeoutTime_IDCM" SG_ 297 Pwr_Electr_Loop_FlwRate_SGCP_P 0;
BA_ "GenSigTimeoutTime_MCPA" SG_ 297 Pwr_Electr_Loop_FlwRate_SGCP_P 0;
BA_ "GenSigTimeoutTime_MCPB" SG_ 297 Pwr_Electr_Loop_FlwRate_SGCP_P 0;
BA_ "GenSigTimeoutTime_BPCM" SG_ 297 SpdGrdtLim_MCPA_P 0;
BA_ "GenSigTimeoutTime_ECM" SG_ 297 SpdGrdtLim_MCPA_P 0;
BA_ "GenSigTimeoutTime_EVCU2" SG_ 297 SpdGrdtLim_MCPA_P 0;
BA_ "GenSigTimeoutTime_IDCM" SG_ 297 SpdGrdtLim_MCPA_P 0;
BA_ "GenSigTimeoutTime_MCPB" SG_ 297 SpdGrdtLim_MCPA_P 0;
BA_ "GenSigTimeoutTime_SGCP" SG_ 297 SpdGrdtLim_MCPA_P 0;
BA_ "GenSigTimeoutTime_BPCM" SG_ 297 SpdGrdtLim_MCPB_P 0;
BA_ "GenSigTimeoutTime_ECM" SG_ 297 SpdGrdtLim_MCPB_P 0;
BA_ "GenSigTimeoutTime_EVCU2" SG_ 297 SpdGrdtLim_MCPB_P 0;
BA_ "GenSigTimeoutTime_IDCM" SG_ 297 SpdGrdtLim_MCPB_P 0;
BA_ "GenSigTimeoutTime_MCPA" SG_ 297 SpdGrdtLim_MCPB_P 0;
BA_ "GenSigTimeoutTime_SGCP" SG_ 297 SpdGrdtLim_MCPB_P 0;
BA_ "GenSigTimeoutTime_BPCM" SG_ 297 SpdGrdtLim_SGCP_P 0;
BA_ "GenSigTimeoutTime_ECM" SG_ 297 SpdGrdtLim_SGCP_P 0;
BA_ "GenSigTimeoutTime_EVCU2" SG_ 297 SpdGrdtLim_SGCP_P 0;
BA_ "GenSigTimeoutTime_IDCM" SG_ 297 SpdGrdtLim_SGCP_P 0;
BA_ "GenSigTimeoutTime_MCPA" SG_ 297 SpdGrdtLim_SGCP_P 0;
BA_ "GenSigTimeoutTime_MCPB" SG_ 297 SpdGrdtLim_SGCP_P 0;
BA_ "GenSigTimeoutTime_BPCM" SG_ 297 TqGrdtLim_MCPA_P 0;
BA_ "GenSigTimeoutTime_ECM" SG_ 297 TqGrdtLim_MCPA_P 0;
BA_ "GenSigTimeoutTime_EVCU2" SG_ 297 TqGrdtLim_MCPA_P 0;
BA_ "GenSigTimeoutTime_IDCM" SG_ 297 TqGrdtLim_MCPA_P 0;
BA_ "GenSigTimeoutTime_MCPB" SG_ 297 TqGrdtLim_MCPA_P 0;
BA_ "GenSigTimeoutTime_SGCP" SG_ 297 TqGrdtLim_MCPA_P 0;
BA_ "GenSigTimeoutTime_BPCM" SG_ 297 TqGrdtLim_MCPB_P 0;
BA_ "GenSigTimeoutTime_ECM" SG_ 297 TqGrdtLim_MCPB_P 0;
BA_ "GenSigTimeoutTime_EVCU2" SG_ 297 TqGrdtLim_MCPB_P 0;
BA_ "GenSigTimeoutTime_IDCM" SG_ 297 TqGrdtLim_MCPB_P 0;
BA_ "GenSigTimeoutTime_MCPA" SG_ 297 TqGrdtLim_MCPB_P 0;
BA_ "GenSigTimeoutTime_SGCP" SG_ 297 TqGrdtLim_MCPB_P 0;
BA_ "GenSigTimeoutTime_BPCM" SG_ 297 TqGrdtLim_SGCP_P 0;
BA_ "GenSigTimeoutTime_ECM" SG_ 297 TqGrdtLim_SGCP_P 0;
BA_ "GenSigTimeoutTime_EVCU2" SG_ 297 TqGrdtLim_SGCP_P 0;
BA_ "GenSigTimeoutTime_IDCM" SG_ 297 TqGrdtLim_SGCP_P 0;
BA_ "GenSigTimeoutTime_MCPA" SG_ 297 TqGrdtLim_SGCP_P 0;
BA_ "GenSigTimeoutTime_MCPB" SG_ 297 TqGrdtLim_SGCP_P 0;
BA_ "GenSigTimeoutTime_BPCM" SG_ 297 UDCMax_Unlim_MCPA_P 0;
BA_ "GenSigTimeoutTime_ECM" SG_ 297 UDCMax_Unlim_MCPA_P 0;
BA_ "GenSigTimeoutTime_EVCU2" SG_ 297 UDCMax_Unlim_MCPA_P 0;
BA_ "GenSigTimeoutTime_IDCM" SG_ 297 UDCMax_Unlim_MCPA_P 0;
BA_ "GenSigTimeoutTime_MCPB" SG_ 297 UDCMax_Unlim_MCPA_P 0;
BA_ "GenSigTimeoutTime_SGCP" SG_ 297 UDCMax_Unlim_MCPA_P 0;
BA_ "GenSigTimeoutTime_BPCM" SG_ 297 UDCMin_Unlim_SGCP_P 0;
BA_ "GenSigTimeoutTime_ECM" SG_ 297 UDCMin_Unlim_SGCP_P 0;
BA_ "GenSigTimeoutTime_EVCU2" SG_ 297 UDCMin_Unlim_SGCP_P 0;
BA_ "GenSigTimeoutTime_IDCM" SG_ 297 UDCMin_Unlim_SGCP_P 0;
BA_ "GenSigTimeoutTime_MCPA" SG_ 297 UDCMin_Unlim_SGCP_P 0;
BA_ "GenSigTimeoutTime_MCPB" SG_ 297 UDCMin_Unlim_SGCP_P 0;
BA_ "GenSigTimeoutTime_BPCM" SG_ 297 UDCMax_Unlim_MCPB_P 0;
BA_ "GenSigTimeoutTime_ECM" SG_ 297 UDCMax_Unlim_MCPB_P 0;
BA_ "GenSigTimeoutTime_EVCU2" SG_ 297 UDCMax_Unlim_MCPB_P 0;
BA_ "GenSigTimeoutTime_IDCM" SG_ 297 UDCMax_Unlim_MCPB_P 0;
BA_ "GenSigTimeoutTime_MCPA" SG_ 297 UDCMax_Unlim_MCPB_P 0;
BA_ "GenSigTimeoutTime_SGCP" SG_ 297 UDCMax_Unlim_MCPB_P 0;
BA_ "GenSigTimeoutTime_BPCM" SG_ 297 UDCMax_Unlim_SGCP_P 0;
BA_ "GenSigTimeoutTime_ECM" SG_ 297 UDCMax_Unlim_SGCP_P 0;
BA_ "GenSigTimeoutTime_EVCU2" SG_ 297 UDCMax_Unlim_SGCP_P 0;
BA_ "GenSigTimeoutTime_IDCM" SG_ 297 UDCMax_Unlim_SGCP_P 0;
BA_ "GenSigTimeoutTime_MCPA" SG_ 297 UDCMax_Unlim_SGCP_P 0;
BA_ "GenSigTimeoutTime_MCPB" SG_ 297 UDCMax_Unlim_SGCP_P 0;
BA_ "GenSigTimeoutTime_BPCM" SG_ 297 UDCMin_Unlim_MCPA_P 0;
BA_ "GenSigTimeoutTime_ECM" SG_ 297 UDCMin_Unlim_MCPA_P 0;
BA_ "GenSigTimeoutTime_EVCU2" SG_ 297 UDCMin_Unlim_MCPA_P 0;
BA_ "GenSigTimeoutTime_IDCM" SG_ 297 UDCMin_Unlim_MCPA_P 0;
BA_ "GenSigTimeoutTime_MCPB" SG_ 297 UDCMin_Unlim_MCPA_P 0;
BA_ "GenSigTimeoutTime_SGCP" SG_ 297 UDCMin_Unlim_MCPA_P 0;
BA_ "GenSigTimeoutTime_BPCM" SG_ 297 UDCMin_Unlim_MCPB_P 0;
BA_ "GenSigTimeoutTime_ECM" SG_ 297 UDCMin_Unlim_MCPB_P 0;
BA_ "GenSigTimeoutTime_EVCU2" SG_ 297 UDCMin_Unlim_MCPB_P 0;
BA_ "GenSigTimeoutTime_IDCM" SG_ 297 UDCMin_Unlim_MCPB_P 0;
BA_ "GenSigTimeoutTime_MCPA" SG_ 297 UDCMin_Unlim_MCPB_P 0;
BA_ "GenSigTimeoutTime_SGCP" SG_ 297 UDCMin_Unlim_MCPB_P 0;
BA_ "GenSigTimeoutTime_BPCM" SG_ 503 CRC_MCPA_STATUS 0;
BA_ "GenSigTimeoutTime_ECM" SG_ 503 CRC_MCPA_STATUS 0;
BA_ "GenSigTimeoutTime_IDCM" SG_ 503 CRC_MCPA_STATUS 0;
BA_ "GenSigTimeoutTime_MCPA" SG_ 503 CRC_MCPA_STATUS 0;
BA_ "GenSigTimeoutTime_MCPB" SG_ 503 CRC_MCPA_STATUS 0;
BA_ "GenSigTimeoutTime_SGCP" SG_ 503 CRC_MCPA_STATUS 0;
BA_ "GenSigTimeoutTime_BPCM" SG_ 503 MC_MCPA_STATUS 0;
BA_ "GenSigTimeoutTime_ECM" SG_ 503 MC_MCPA_STATUS 0;
BA_ "GenSigTimeoutTime_IDCM" SG_ 503 MC_MCPA_STATUS 0;
BA_ "GenSigTimeoutTime_MCPA" SG_ 503 MC_MCPA_STATUS 0;
BA_ "GenSigTimeoutTime_MCPB" SG_ 503 MC_MCPA_STATUS 0;
BA_ "GenSigTimeoutTime_SGCP" SG_ 503 MC_MCPA_STATUS 0;
BA_ "GenSigTimeoutTime_IDCM" SG_ 503 MCPA_CoolantTemp_P 0;
BA_ "GenSigTimeoutTime_MCPA" SG_ 503 MCPA_CoolantTemp_P 0;
BA_ "GenSigTimeoutTime_MCPB" SG_ 503 MCPA_CoolantTemp_P 0;
BA_ "GenSigTimeoutTime_SGCP" SG_ 503 MCPA_CoolantTemp_P 0;
BA_ "GenSigTimeoutTime_BPCM" SG_ 503 MCPA_CoolantTemp_P 0;
BA_ "GenSigTimeoutTime_ECM" SG_ 503 MCPA_CoolantTemp_P 0;
BA_ "GenSigStartValue" SG_ 503 MCPA_DC_Current_P 16384;
BA_ "GenSigTimeoutTime_ECM" SG_ 503 MCPA_DC_Current_P 0;
BA_ "GenSigTimeoutTime_IDCM" SG_ 503 MCPA_DC_Current_P 0;
BA_ "GenSigTimeoutTime_MCPA" SG_ 503 MCPA_DC_Current_P 0;
BA_ "GenSigTimeoutTime_MCPB" SG_ 503 MCPA_DC_Current_P 0;
BA_ "GenSigTimeoutTime_SGCP" SG_ 503 MCPA_DC_Current_P 0;
BA_ "GenSigTimeoutTime_BPCM" SG_ 503 MCPA_DC_Current_V_P 0;
BA_ "GenSigTimeoutTime_ECM" SG_ 503 MCPA_DC_Current_V_P 0;
BA_ "GenSigTimeoutTime_IDCM" SG_ 503 MCPA_DC_Current_V_P 0;
BA_ "GenSigTimeoutTime_MCPA" SG_ 503 MCPA_DC_Current_V_P 0;
BA_ "GenSigTimeoutTime_MCPB" SG_ 503 MCPA_DC_Current_V_P 0;
BA_ "GenSigTimeoutTime_SGCP" SG_ 503 MCPA_DC_Current_V_P 0;
BA_ "GenSigTimeoutTime_BPCM" SG_ 503 MCPA_DC_Volt_V_P 0;
BA_ "GenSigTimeoutTime_ECM" SG_ 503 MCPA_DC_Volt_V_P 0;
BA_ "GenSigTimeoutTime_IDCM" SG_ 503 MCPA_DC_Volt_V_P 0;
BA_ "GenSigTimeoutTime_MCPA" SG_ 503 MCPA_DC_Volt_V_P 0;
BA_ "GenSigTimeoutTime_MCPB" SG_ 503 MCPA_DC_Volt_V_P 0;
BA_ "GenSigTimeoutTime_SGCP" SG_ 503 MCPA_DC_Volt_V_P 0;
BA_ "GenSigTimeoutTime_BPCM" SG_ 503 MCPA_DC_Voltage_P 0;
BA_ "GenSigTimeoutTime_ECM" SG_ 503 MCPA_DC_Voltage_P 0;
BA_ "GenSigTimeoutTime_IDCM" SG_ 503 MCPA_DC_Voltage_P 0;
BA_ "GenSigTimeoutTime_MCPA" SG_ 503 MCPA_DC_Voltage_P 0;
BA_ "GenSigTimeoutTime_MCPB" SG_ 503 MCPA_DC_Voltage_P 0;
BA_ "GenSigTimeoutTime_SGCP" SG_ 503 MCPA_DC_Voltage_P 0;
BA_ "GenSigStartValue" SG_ 503 MCPA_Control_Board_Temperature_P 255;
BA_ "GenSigTimeoutTime_BPCM" SG_ 503 MCPA_Control_Board_Temperature_P 0;
BA_ "GenSigTimeoutTime_ECM" SG_ 503 MCPA_Control_Board_Temperature_P 0;
BA_ "GenSigTimeoutTime_IDCM" SG_ 503 MCPA_Control_Board_Temperature_P 0;
BA_ "GenSigTimeoutTime_MCPA" SG_ 503 MCPA_Control_Board_Temperature_P 0;
BA_ "GenSigTimeoutTime_MCPB" SG_ 503 MCPA_Control_Board_Temperature_P 0;
BA_ "GenSigTimeoutTime_SGCP" SG_ 503 MCPA_Control_Board_Temperature_P 0;
BA_ "GenSigTimeoutTime_BPCM" SG_ 503 CLrDiagInfo_MCPA_P 0;
BA_ "GenSigTimeoutTime_ECM" SG_ 503 CLrDiagInfo_MCPA_P 0;
BA_ "GenSigTimeoutTime_IDCM" SG_ 503 CLrDiagInfo_MCPA_P 0;
BA_ "GenSigTimeoutTime_MCPA" SG_ 503 CLrDiagInfo_MCPA_P 0;
BA_ "GenSigTimeoutTime_MCPB" SG_ 503 CLrDiagInfo_MCPA_P 0;
BA_ "GenSigTimeoutTime_SGCP" SG_ 503 CLrDiagInfo_MCPA_P 0;
BA_ "GenSigTimeoutTime_BPCM" SG_ 503 MCPA_Service_Lamp_Request_P 0;
BA_ "GenSigTimeoutTime_ECM" SG_ 503 MCPA_Service_Lamp_Request_P 0;
BA_ "GenSigTimeoutTime_IDCM" SG_ 503 MCPA_Service_Lamp_Request_P 0;
BA_ "GenSigTimeoutTime_MCPA" SG_ 503 MCPA_Service_Lamp_Request_P 0;
BA_ "GenSigTimeoutTime_MCPB" SG_ 503 MCPA_Service_Lamp_Request_P 0;
BA_ "GenSigTimeoutTime_SGCP" SG_ 503 MCPA_Service_Lamp_Request_P 0;
BA_ "GenSigStartValue" SG_ 503 MCPA_Rotor_Temperature_P 255;
BA_ "GenSigTimeoutTime_BPCM" SG_ 503 MCPA_Rotor_Temperature_P 0;
BA_ "GenSigTimeoutTime_ECM" SG_ 503 MCPA_Rotor_Temperature_P 0;
BA_ "GenSigTimeoutTime_IDCM" SG_ 503 MCPA_Rotor_Temperature_P 0;
BA_ "GenSigTimeoutTime_MCPA" SG_ 503 MCPA_Rotor_Temperature_P 0;
BA_ "GenSigTimeoutTime_MCPB" SG_ 503 MCPA_Rotor_Temperature_P 0;
BA_ "GenSigTimeoutTime_SGCP" SG_ 503 MCPA_Rotor_Temperature_P 0;
BA_ "GenSigTimeoutTime_BPCM" SG_ 503 MCPA_PIM_DC_Side_Busbar_Temp_P 0;
BA_ "GenSigTimeoutTime_ECM" SG_ 503 MCPA_PIM_DC_Side_Busbar_Temp_P 0;
BA_ "GenSigTimeoutTime_IDCM" SG_ 503 MCPA_PIM_DC_Side_Busbar_Temp_P 0;
BA_ "GenSigTimeoutTime_MCPA" SG_ 503 MCPA_PIM_DC_Side_Busbar_Temp_P 0;
BA_ "GenSigTimeoutTime_MCPB" SG_ 503 MCPA_PIM_DC_Side_Busbar_Temp_P 0;
BA_ "GenSigTimeoutTime_SGCP" SG_ 503 MCPA_PIM_DC_Side_Busbar_Temp_P 0;
BA_ "GenSigStartValue" SG_ 503 MCPA_Inverter_Temp_P 40;
BA_ "GenSigTimeoutTime_BPCM" SG_ 503 MCPA_Inverter_Temp_P 0;
BA_ "GenSigTimeoutTime_ECM" SG_ 503 MCPA_Inverter_Temp_P 0;
BA_ "GenSigTimeoutTime_IDCM" SG_ 503 MCPA_Inverter_Temp_P 0;
BA_ "GenSigTimeoutTime_MCPA" SG_ 503 MCPA_Inverter_Temp_P 0;
BA_ "GenSigTimeoutTime_MCPB" SG_ 503 MCPA_Inverter_Temp_P 0;
BA_ "GenSigTimeoutTime_SGCP" SG_ 503 MCPA_Inverter_Temp_P 0;
BA_ "GenSigTimeoutTime_BPCM" SG_ 504 CLrDiagInfo_MCPB_P 0;
BA_ "GenSigTimeoutTime_ECM" SG_ 504 CLrDiagInfo_MCPB_P 0;
BA_ "GenSigTimeoutTime_IDCM" SG_ 504 CLrDiagInfo_MCPB_P 0;
BA_ "GenSigTimeoutTime_MCPA" SG_ 504 CLrDiagInfo_MCPB_P 0;
BA_ "GenSigTimeoutTime_MCPB" SG_ 504 CLrDiagInfo_MCPB_P 0;
BA_ "GenSigTimeoutTime_SGCP" SG_ 504 CLrDiagInfo_MCPB_P 0;
BA_ "GenSigTimeoutTime_BPCM" SG_ 504 MCPB_Service_Lamp_Request_P 0;
BA_ "GenSigTimeoutTime_ECM" SG_ 504 MCPB_Service_Lamp_Request_P 0;
BA_ "GenSigTimeoutTime_IDCM" SG_ 504 MCPB_Service_Lamp_Request_P 0;
BA_ "GenSigTimeoutTime_MCPA" SG_ 504 MCPB_Service_Lamp_Request_P 0;
BA_ "GenSigTimeoutTime_MCPB" SG_ 504 MCPB_Service_Lamp_Request_P 0;
BA_ "GenSigTimeoutTime_SGCP" SG_ 504 MCPB_Service_Lamp_Request_P 0;
BA_ "GenSigTimeoutTime_BPCM" SG_ 504 MCPB_Control_Board_Temperature_P 0;
BA_ "GenSigTimeoutTime_ECM" SG_ 504 MCPB_Control_Board_Temperature_P 0;
BA_ "GenSigTimeoutTime_IDCM" SG_ 504 MCPB_Control_Board_Temperature_P 0;
BA_ "GenSigTimeoutTime_MCPA" SG_ 504 MCPB_Control_Board_Temperature_P 0;
BA_ "GenSigTimeoutTime_MCPB" SG_ 504 MCPB_Control_Board_Temperature_P 0;
BA_ "GenSigTimeoutTime_SGCP" SG_ 504 MCPB_Control_Board_Temperature_P 0;
BA_ "GenSigTimeoutTime_BPCM" SG_ 505 SGCP_PIM_AC_Side_Busbar_Temp_P 0;
BA_ "GenSigTimeoutTime_ECM" SG_ 505 SGCP_PIM_AC_Side_Busbar_Temp_P 0;
BA_ "GenSigTimeoutTime_IDCM" SG_ 505 SGCP_PIM_AC_Side_Busbar_Temp_P 0;
BA_ "GenSigTimeoutTime_MCPA" SG_ 505 SGCP_PIM_AC_Side_Busbar_Temp_P 0;
BA_ "GenSigTimeoutTime_MCPB" SG_ 505 SGCP_PIM_AC_Side_Busbar_Temp_P 0;
BA_ "GenSigTimeoutTime_SGCP" SG_ 505 SGCP_PIM_AC_Side_Busbar_Temp_P 0;
BA_ "GenSigStartValue" SG_ 505 SGCP_Rotor_Temperature_P 255;
BA_ "GenSigTimeoutTime_BPCM" SG_ 505 SGCP_Rotor_Temperature_P 0;
BA_ "GenSigTimeoutTime_ECM" SG_ 505 SGCP_Rotor_Temperature_P 0;
BA_ "GenSigTimeoutTime_IDCM" SG_ 505 SGCP_Rotor_Temperature_P 0;
BA_ "GenSigTimeoutTime_MCPA" SG_ 505 SGCP_Rotor_Temperature_P 0;
BA_ "GenSigTimeoutTime_MCPB" SG_ 505 SGCP_Rotor_Temperature_P 0;
BA_ "GenSigTimeoutTime_SGCP" SG_ 505 SGCP_Rotor_Temperature_P 0;
BA_ "GenSigTimeoutTime_BPCM" SG_ 505 SGCP_PIM_DC_Side_Busbar_Temp_P 0;
BA_ "GenSigTimeoutTime_ECM" SG_ 505 SGCP_PIM_DC_Side_Busbar_Temp_P 0;
BA_ "GenSigTimeoutTime_IDCM" SG_ 505 SGCP_PIM_DC_Side_Busbar_Temp_P 0;
BA_ "GenSigTimeoutTime_MCPA" SG_ 505 SGCP_PIM_DC_Side_Busbar_Temp_P 0;
BA_ "GenSigTimeoutTime_MCPB" SG_ 505 SGCP_PIM_DC_Side_Busbar_Temp_P 0;
BA_ "GenSigTimeoutTime_SGCP" SG_ 505 SGCP_PIM_DC_Side_Busbar_Temp_P 0;
BA_ "GenSigStartValue" SG_ 505 SGCP_Inverter_Temp_P 40;
BA_ "GenSigTimeoutTime_BPCM" SG_ 505 SGCP_Inverter_Temp_P 0;
BA_ "GenSigTimeoutTime_ECM" SG_ 505 SGCP_Inverter_Temp_P 0;
BA_ "GenSigTimeoutTime_IDCM" SG_ 505 SGCP_Inverter_Temp_P 0;
BA_ "GenSigTimeoutTime_MCPA" SG_ 505 SGCP_Inverter_Temp_P 0;
BA_ "GenSigTimeoutTime_MCPB" SG_ 505 SGCP_Inverter_Temp_P 0;
BA_ "GenSigTimeoutTime_SGCP" SG_ 505 SGCP_Inverter_Temp_P 0;
BA_ "GenSigStartValue" SG_ 505 SGCP_Control_Board_Temperature_P 255;
BA_ "GenSigTimeoutTime_BPCM" SG_ 505 SGCP_Control_Board_Temperature_P 0;
BA_ "GenSigTimeoutTime_ECM" SG_ 505 SGCP_Control_Board_Temperature_P 0;
BA_ "GenSigTimeoutTime_IDCM" SG_ 505 SGCP_Control_Board_Temperature_P 0;
BA_ "GenSigTimeoutTime_MCPA" SG_ 505 SGCP_Control_Board_Temperature_P 0;
BA_ "GenSigTimeoutTime_MCPB" SG_ 505 SGCP_Control_Board_Temperature_P 0;
BA_ "GenSigTimeoutTime_SGCP" SG_ 505 SGCP_Control_Board_Temperature_P 0;
BA_ "GenSigTimeoutTime_BPCM" SG_ 505 CLrDiagInfo_SGCP_P 0;
BA_ "GenSigTimeoutTime_ECM" SG_ 505 CLrDiagInfo_SGCP_P 0;
BA_ "GenSigTimeoutTime_IDCM" SG_ 505 CLrDiagInfo_SGCP_P 0;
BA_ "GenSigTimeoutTime_MCPA" SG_ 505 CLrDiagInfo_SGCP_P 0;
BA_ "GenSigTimeoutTime_MCPB" SG_ 505 CLrDiagInfo_SGCP_P 0;
BA_ "GenSigTimeoutTime_SGCP" SG_ 505 CLrDiagInfo_SGCP_P 0;
BA_ "GenSigTimeoutTime_BPCM" SG_ 505 SGCP_Service_Lamp_Request_P 0;
BA_ "GenSigTimeoutTime_ECM" SG_ 505 SGCP_Service_Lamp_Request_P 0;
BA_ "GenSigTimeoutTime_IDCM" SG_ 505 SGCP_Service_Lamp_Request_P 0;
BA_ "GenSigTimeoutTime_MCPA" SG_ 505 SGCP_Service_Lamp_Request_P 0;
BA_ "GenSigTimeoutTime_MCPB" SG_ 505 SGCP_Service_Lamp_Request_P 0;
BA_ "GenSigTimeoutTime_SGCP" SG_ 505 SGCP_Service_Lamp_Request_P 0;
BA_ "GenSigStartValue" SG_ 504 MCPB_Inverter_Temp_P 40;
BA_ "GenSigTimeoutTime_BPCM" SG_ 504 MCPB_Inverter_Temp_P 0;
BA_ "GenSigTimeoutTime_ECM" SG_ 504 MCPB_Inverter_Temp_P 0;
BA_ "GenSigTimeoutTime_IDCM" SG_ 504 MCPB_Inverter_Temp_P 0;
BA_ "GenSigTimeoutTime_MCPA" SG_ 504 MCPB_Inverter_Temp_P 0;
BA_ "GenSigTimeoutTime_MCPB" SG_ 504 MCPB_Inverter_Temp_P 0;
BA_ "GenSigTimeoutTime_SGCP" SG_ 504 MCPB_Inverter_Temp_P 0;
BA_ "GenSigStartValue" SG_ 504 MCPB_Rotor_Temperature_P 255;
BA_ "GenSigTimeoutTime_BPCM" SG_ 504 MCPB_Rotor_Temperature_P 0;
BA_ "GenSigTimeoutTime_ECM" SG_ 504 MCPB_Rotor_Temperature_P 0;
BA_ "GenSigTimeoutTime_IDCM" SG_ 504 MCPB_Rotor_Temperature_P 0;
BA_ "GenSigTimeoutTime_MCPA" SG_ 504 MCPB_Rotor_Temperature_P 0;
BA_ "GenSigTimeoutTime_MCPB" SG_ 504 MCPB_Rotor_Temperature_P 0;
BA_ "GenSigTimeoutTime_SGCP" SG_ 504 MCPB_Rotor_Temperature_P 0;
BA_ "GenSigTimeoutTime_BPCM" SG_ 504 MCPB_PIM_DC_Side_Busbar_Temp_P 0;
BA_ "GenSigTimeoutTime_ECM" SG_ 504 MCPB_PIM_DC_Side_Busbar_Temp_P 0;
BA_ "GenSigTimeoutTime_IDCM" SG_ 504 MCPB_PIM_DC_Side_Busbar_Temp_P 0;
BA_ "GenSigTimeoutTime_MCPA" SG_ 504 MCPB_PIM_DC_Side_Busbar_Temp_P 0;
BA_ "GenSigTimeoutTime_MCPB" SG_ 504 MCPB_PIM_DC_Side_Busbar_Temp_P 0;
BA_ "GenSigTimeoutTime_SGCP" SG_ 504 MCPB_PIM_DC_Side_Busbar_Temp_P 0;
BA_ "GenSigTimeoutTime_BPCM" SG_ 503 MCPA_DerateReason_P 0;
BA_ "GenSigTimeoutTime_ECM" SG_ 503 MCPA_DerateReason_P 0;
BA_ "GenSigTimeoutTime_IDCM" SG_ 503 MCPA_DerateReason_P 0;
BA_ "GenSigTimeoutTime_MCPA" SG_ 503 MCPA_DerateReason_P 0;
BA_ "GenSigTimeoutTime_MCPB" SG_ 503 MCPA_DerateReason_P 0;
BA_ "GenSigTimeoutTime_SGCP" SG_ 503 MCPA_DerateReason_P 0;
BA_ "GenSigTimeoutTime_BPCM" SG_ 504 CRC_MCPB_STATUS 0;
BA_ "GenSigTimeoutTime_ECM" SG_ 504 CRC_MCPB_STATUS 0;
BA_ "GenSigTimeoutTime_IDCM" SG_ 504 CRC_MCPB_STATUS 0;
BA_ "GenSigTimeoutTime_MCPA" SG_ 504 CRC_MCPB_STATUS 0;
BA_ "GenSigTimeoutTime_MCPB" SG_ 504 CRC_MCPB_STATUS 0;
BA_ "GenSigTimeoutTime_SGCP" SG_ 504 CRC_MCPB_STATUS 0;
BA_ "GenSigTimeoutTime_BPCM" SG_ 504 MC_MCPB_STATUS 0;
BA_ "GenSigTimeoutTime_ECM" SG_ 504 MC_MCPB_STATUS 0;
BA_ "GenSigTimeoutTime_IDCM" SG_ 504 MC_MCPB_STATUS 0;
BA_ "GenSigTimeoutTime_MCPA" SG_ 504 MC_MCPB_STATUS 0;
BA_ "GenSigTimeoutTime_MCPB" SG_ 504 MC_MCPB_STATUS 0;
BA_ "GenSigTimeoutTime_SGCP" SG_ 504 MC_MCPB_STATUS 0;
BA_ "GenSigTimeoutTime_BPCM" SG_ 504 MCPB_DerateReason_P 0;
BA_ "GenSigTimeoutTime_ECM" SG_ 504 MCPB_DerateReason_P 0;
BA_ "GenSigTimeoutTime_IDCM" SG_ 504 MCPB_DerateReason_P 0;
BA_ "GenSigTimeoutTime_MCPA" SG_ 504 MCPB_DerateReason_P 0;
BA_ "GenSigTimeoutTime_MCPB" SG_ 504 MCPB_DerateReason_P 0;
BA_ "GenSigTimeoutTime_SGCP" SG_ 504 MCPB_DerateReason_P 0;
BA_ "GenSigTimeoutTime_BPCM" SG_ 504 MCPB_DC_Voltage_P 0;
BA_ "GenSigTimeoutTime_ECM" SG_ 504 MCPB_DC_Voltage_P 0;
BA_ "GenSigTimeoutTime_IDCM" SG_ 504 MCPB_DC_Voltage_P 0;
BA_ "GenSigTimeoutTime_MCPA" SG_ 504 MCPB_DC_Voltage_P 0;
BA_ "GenSigTimeoutTime_MCPB" SG_ 504 MCPB_DC_Voltage_P 0;
BA_ "GenSigTimeoutTime_SGCP" SG_ 504 MCPB_DC_Voltage_P 0;
BA_ "GenSigTimeoutTime_BPCM" SG_ 504 MCPB_CoolantTemp_P 0;
BA_ "GenSigTimeoutTime_ECM" SG_ 504 MCPB_CoolantTemp_P 0;
BA_ "GenSigTimeoutTime_IDCM" SG_ 504 MCPB_CoolantTemp_P 0;
BA_ "GenSigTimeoutTime_MCPA" SG_ 504 MCPB_CoolantTemp_P 0;
BA_ "GenSigTimeoutTime_MCPB" SG_ 504 MCPB_CoolantTemp_P 0;
BA_ "GenSigTimeoutTime_SGCP" SG_ 504 MCPB_CoolantTemp_P 0;
BA_ "GenSigStartValue" SG_ 504 MCPB_DC_Current_P 16384;
BA_ "GenSigTimeoutTime_ECM" SG_ 504 MCPB_DC_Current_P 0;
BA_ "GenSigTimeoutTime_IDCM" SG_ 504 MCPB_DC_Current_P 0;
BA_ "GenSigTimeoutTime_MCPA" SG_ 504 MCPB_DC_Current_P 0;
BA_ "GenSigTimeoutTime_MCPB" SG_ 504 MCPB_DC_Current_P 0;
BA_ "GenSigTimeoutTime_SGCP" SG_ 504 MCPB_DC_Current_P 0;
BA_ "GenSigTimeoutTime_BPCM" SG_ 504 MCPB_DC_Current_V_P 0;
BA_ "GenSigTimeoutTime_ECM" SG_ 504 MCPB_DC_Current_V_P 0;
BA_ "GenSigTimeoutTime_IDCM" SG_ 504 MCPB_DC_Current_V_P 0;
BA_ "GenSigTimeoutTime_MCPA" SG_ 504 MCPB_DC_Current_V_P 0;
BA_ "GenSigTimeoutTime_MCPB" SG_ 504 MCPB_DC_Current_V_P 0;
BA_ "GenSigTimeoutTime_SGCP" SG_ 504 MCPB_DC_Current_V_P 0;
BA_ "GenSigTimeoutTime_BPCM" SG_ 504 MCPB_DC_Volt_V_P 0;
BA_ "GenSigTimeoutTime_ECM" SG_ 504 MCPB_DC_Volt_V_P 0;
BA_ "GenSigTimeoutTime_IDCM" SG_ 504 MCPB_DC_Volt_V_P 0;
BA_ "GenSigTimeoutTime_MCPA" SG_ 504 MCPB_DC_Volt_V_P 0;
BA_ "GenSigTimeoutTime_MCPB" SG_ 504 MCPB_DC_Volt_V_P 0;
BA_ "GenSigTimeoutTime_SGCP" SG_ 504 MCPB_DC_Volt_V_P 0;
BA_ "GenSigTimeoutTime_BPCM" SG_ 505 CRC_SGCP_STATUS 0;
BA_ "GenSigTimeoutTime_ECM" SG_ 505 CRC_SGCP_STATUS 0;
BA_ "GenSigTimeoutTime_IDCM" SG_ 505 CRC_SGCP_STATUS 0;
BA_ "GenSigTimeoutTime_MCPA" SG_ 505 CRC_SGCP_STATUS 0;
BA_ "GenSigTimeoutTime_MCPB" SG_ 505 CRC_SGCP_STATUS 0;
BA_ "GenSigTimeoutTime_SGCP" SG_ 505 CRC_SGCP_STATUS 0;
BA_ "GenSigTimeoutTime_BPCM" SG_ 505 MC_SGCP_STATUS 0;
BA_ "GenSigTimeoutTime_ECM" SG_ 505 MC_SGCP_STATUS 0;
BA_ "GenSigTimeoutTime_IDCM" SG_ 505 MC_SGCP_STATUS 0;
BA_ "GenSigTimeoutTime_MCPA" SG_ 505 MC_SGCP_STATUS 0;
BA_ "GenSigTimeoutTime_MCPB" SG_ 505 MC_SGCP_STATUS 0;
BA_ "GenSigTimeoutTime_SGCP" SG_ 505 MC_SGCP_STATUS 0;
BA_ "GenSigTimeoutTime_BPCM" SG_ 505 SGCP_CoolantTemp_P 0;
BA_ "GenSigTimeoutTime_ECM" SG_ 505 SGCP_CoolantTemp_P 0;
BA_ "GenSigTimeoutTime_IDCM" SG_ 505 SGCP_CoolantTemp_P 0;
BA_ "GenSigTimeoutTime_MCPA" SG_ 505 SGCP_CoolantTemp_P 0;
BA_ "GenSigTimeoutTime_MCPB" SG_ 505 SGCP_CoolantTemp_P 0;
BA_ "GenSigTimeoutTime_SGCP" SG_ 505 SGCP_CoolantTemp_P 0;
BA_ "GenSigStartValue" SG_ 505 SGCP_DC_Current_P 16384;
BA_ "GenSigTimeoutTime_ECM" SG_ 505 SGCP_DC_Current_P 0;
BA_ "GenSigTimeoutTime_IDCM" SG_ 505 SGCP_DC_Current_P 0;
BA_ "GenSigTimeoutTime_MCPA" SG_ 505 SGCP_DC_Current_P 0;
BA_ "GenSigTimeoutTime_MCPB" SG_ 505 SGCP_DC_Current_P 0;
BA_ "GenSigTimeoutTime_SGCP" SG_ 505 SGCP_DC_Current_P 0;
BA_ "GenSigTimeoutTime_BPCM" SG_ 505 SGCP_DC_Current_V_P 0;
BA_ "GenSigTimeoutTime_ECM" SG_ 505 SGCP_DC_Current_V_P 0;
BA_ "GenSigTimeoutTime_IDCM" SG_ 505 SGCP_DC_Current_V_P 0;
BA_ "GenSigTimeoutTime_MCPA" SG_ 505 SGCP_DC_Current_V_P 0;
BA_ "GenSigTimeoutTime_MCPB" SG_ 505 SGCP_DC_Current_V_P 0;
BA_ "GenSigTimeoutTime_SGCP" SG_ 505 SGCP_DC_Current_V_P 0;
BA_ "GenSigTimeoutTime_BPCM" SG_ 505 SGCP_DC_Volt_V_P 0;
BA_ "GenSigTimeoutTime_ECM" SG_ 505 SGCP_DC_Volt_V_P 0;
BA_ "GenSigTimeoutTime_IDCM" SG_ 505 SGCP_DC_Volt_V_P 0;
BA_ "GenSigTimeoutTime_MCPA" SG_ 505 SGCP_DC_Volt_V_P 0;
BA_ "GenSigTimeoutTime_MCPB" SG_ 505 SGCP_DC_Volt_V_P 0;
BA_ "GenSigTimeoutTime_SGCP" SG_ 505 SGCP_DC_Volt_V_P 0;
BA_ "GenSigTimeoutTime_MCPB" SG_ 505 SGCP_DC_Voltage_P 0;
BA_ "GenSigTimeoutTime_SGCP" SG_ 505 SGCP_DC_Voltage_P 0;
BA_ "GenSigTimeoutTime_BPCM" SG_ 505 SGCP_DC_Voltage_P 0;
BA_ "GenSigTimeoutTime_ECM" SG_ 505 SGCP_DC_Voltage_P 0;
BA_ "GenSigTimeoutTime_IDCM" SG_ 505 SGCP_DC_Voltage_P 0;
BA_ "GenSigTimeoutTime_MCPA" SG_ 505 SGCP_DC_Voltage_P 0;
BA_ "GenSigTimeoutTime_BPCM" SG_ 505 SGCP_DerateReason_P 0;
BA_ "GenSigTimeoutTime_ECM" SG_ 505 SGCP_DerateReason_P 0;
BA_ "GenSigTimeoutTime_IDCM" SG_ 505 SGCP_DerateReason_P 0;
BA_ "GenSigTimeoutTime_MCPA" SG_ 505 SGCP_DerateReason_P 0;
BA_ "GenSigTimeoutTime_MCPB" SG_ 505 SGCP_DerateReason_P 0;
BA_ "GenSigTimeoutTime_SGCP" SG_ 505 SGCP_DerateReason_P 0;
BA_ "GenSigTimeoutTime_BPCM" SG_ 217 MinPrdtdEngRunTorqCapV_LHOM 0;
BA_ "GenSigTimeoutTime_ECM" SG_ 217 MinPrdtdEngRunTorqCapV_LHOM 0;
BA_ "GenSigTimeoutTime_IDCM" SG_ 217 MinPrdtdEngRunTorqCapV_LHOM 0;
BA_ "GenSigTimeoutTime_MCPA" SG_ 217 MinPrdtdEngRunTorqCapV_LHOM 0;
BA_ "GenSigTimeoutTime_MCPB" SG_ 217 MinPrdtdEngRunTorqCapV_LHOM 0;
BA_ "GenSigTimeoutTime_SGCP" SG_ 217 MinPrdtdEngRunTorqCapV_LHOM 0;
BA_ "GenSigStartValue" SG_ 217 Sum_FW_ID_Fst_LHOM 1;
BA_ "GenSigTimeoutTime_BPCM" SG_ 217 Sum_FW_ID_Fst_LHOM 0;
BA_ "GenSigTimeoutTime_ECM" SG_ 217 Sum_FW_ID_Fst_LHOM 0;
BA_ "GenSigTimeoutTime_IDCM" SG_ 217 Sum_FW_ID_Fst_LHOM 0;
BA_ "GenSigTimeoutTime_MCPA" SG_ 217 Sum_FW_ID_Fst_LHOM 0;
BA_ "GenSigTimeoutTime_MCPB" SG_ 217 Sum_FW_ID_Fst_LHOM 0;
BA_ "GenSigTimeoutTime_SGCP" SG_ 217 Sum_FW_ID_Fst_LHOM 0;
BA_ "GenSigStartValue" SG_ 217 Sum_FW_ID_Slw_LHOM 1;
BA_ "GenSigTimeoutTime_BPCM" SG_ 217 Sum_FW_ID_Slw_LHOM 0;
BA_ "GenSigTimeoutTime_ECM" SG_ 217 Sum_FW_ID_Slw_LHOM 0;
BA_ "GenSigTimeoutTime_IDCM" SG_ 217 Sum_FW_ID_Slw_LHOM 0;
BA_ "GenSigTimeoutTime_MCPA" SG_ 217 Sum_FW_ID_Slw_LHOM 0;
BA_ "GenSigTimeoutTime_MCPB" SG_ 217 Sum_FW_ID_Slw_LHOM 0;
BA_ "GenSigTimeoutTime_SGCP" SG_ 217 Sum_FW_ID_Slw_LHOM 0;
BA_ "GenSigTimeoutTime_BPCM" SG_ 217 MinEngTorqCapV_LHOM 0;
BA_ "GenSigTimeoutTime_ECM" SG_ 217 MinEngTorqCapV_LHOM 0;
BA_ "GenSigTimeoutTime_IDCM" SG_ 217 MinEngTorqCapV_LHOM 0;
BA_ "GenSigTimeoutTime_MCPA" SG_ 217 MinEngTorqCapV_LHOM 0;
BA_ "GenSigTimeoutTime_MCPB" SG_ 217 MinEngTorqCapV_LHOM 0;
BA_ "GenSigTimeoutTime_SGCP" SG_ 217 MinEngTorqCapV_LHOM 0;
BA_ "GenSigStartValue" SG_ 217 MinImmedEngTorqCap_LHOM 938;
BA_ "GenSigTimeoutTime_BPCM" SG_ 217 MinImmedEngTorqCap_LHOM 0;
BA_ "GenSigTimeoutTime_ECM" SG_ 217 MinImmedEngTorqCap_LHOM 0;
BA_ "GenSigTimeoutTime_IDCM" SG_ 217 MinImmedEngTorqCap_LHOM 0;
BA_ "GenSigTimeoutTime_MCPA" SG_ 217 MinImmedEngTorqCap_LHOM 0;
BA_ "GenSigTimeoutTime_MCPB" SG_ 217 MinImmedEngTorqCap_LHOM 0;
BA_ "GenSigTimeoutTime_SGCP" SG_ 217 MinImmedEngTorqCap_LHOM 0;
BA_ "GenSigTimeoutTime_BPCM" SG_ 217 MinImmedEngTorqCapV_LHOM 0;
BA_ "GenSigTimeoutTime_ECM" SG_ 217 MinImmedEngTorqCapV_LHOM 0;
BA_ "GenSigTimeoutTime_IDCM" SG_ 217 MinImmedEngTorqCapV_LHOM 0;
BA_ "GenSigTimeoutTime_MCPA" SG_ 217 MinImmedEngTorqCapV_LHOM 0;
BA_ "GenSigTimeoutTime_MCPB" SG_ 217 MinImmedEngTorqCapV_LHOM 0;
BA_ "GenSigTimeoutTime_SGCP" SG_ 217 MinImmedEngTorqCapV_LHOM 0;
BA_ "GenSigStartValue" SG_ 217 MinPrdtdEngRunTorqCap_LHOM 938;
BA_ "GenSigTimeoutTime_BPCM" SG_ 217 MinPrdtdEngRunTorqCap_LHOM 0;
BA_ "GenSigTimeoutTime_ECM" SG_ 217 MinPrdtdEngRunTorqCap_LHOM 0;
BA_ "GenSigTimeoutTime_IDCM" SG_ 217 MinPrdtdEngRunTorqCap_LHOM 0;
BA_ "GenSigTimeoutTime_MCPA" SG_ 217 MinPrdtdEngRunTorqCap_LHOM 0;
BA_ "GenSigTimeoutTime_MCPB" SG_ 217 MinPrdtdEngRunTorqCap_LHOM 0;
BA_ "GenSigTimeoutTime_SGCP" SG_ 217 MinPrdtdEngRunTorqCap_LHOM 0;
BA_ "GenSigTimeoutTime_BPCM" SG_ 217 MinAirFlowMinSparkTorqCapV_LHOM 0;
BA_ "GenSigTimeoutTime_ECM" SG_ 217 MinAirFlowMinSparkTorqCapV_LHOM 0;
BA_ "GenSigTimeoutTime_IDCM" SG_ 217 MinAirFlowMinSparkTorqCapV_LHOM 0;
BA_ "GenSigTimeoutTime_MCPA" SG_ 217 MinAirFlowMinSparkTorqCapV_LHOM 0;
BA_ "GenSigTimeoutTime_MCPB" SG_ 217 MinAirFlowMinSparkTorqCapV_LHOM 0;
BA_ "GenSigTimeoutTime_SGCP" SG_ 217 MinAirFlowMinSparkTorqCapV_LHOM 0;
BA_ "GenSigStartValue" SG_ 217 MinEngTorqCap_LHOM 938;
BA_ "GenSigTimeoutTime_BPCM" SG_ 217 MinEngTorqCap_LHOM 0;
BA_ "GenSigTimeoutTime_ECM" SG_ 217 MinEngTorqCap_LHOM 0;
BA_ "GenSigTimeoutTime_IDCM" SG_ 217 MinEngTorqCap_LHOM 0;
BA_ "GenSigTimeoutTime_MCPA" SG_ 217 MinEngTorqCap_LHOM 0;
BA_ "GenSigTimeoutTime_MCPB" SG_ 217 MinEngTorqCap_LHOM 0;
BA_ "GenSigTimeoutTime_SGCP" SG_ 217 MinEngTorqCap_LHOM 0;
BA_ "GenSigTimeoutTime_BPCM" SG_ 217 MC_ENGINE_FD_LHOM 0;
BA_ "GenSigTimeoutTime_ECM" SG_ 217 MC_ENGINE_FD_LHOM 0;
BA_ "GenSigTimeoutTime_IDCM" SG_ 217 MC_ENGINE_FD_LHOM 0;
BA_ "GenSigTimeoutTime_MCPA" SG_ 217 MC_ENGINE_FD_LHOM 0;
BA_ "GenSigTimeoutTime_MCPB" SG_ 217 MC_ENGINE_FD_LHOM 0;
BA_ "GenSigTimeoutTime_SGCP" SG_ 217 MC_ENGINE_FD_LHOM 0;
BA_ "GenSigStartValue" SG_ 217 MinAirFlowMinSparkTorqCap_LHOM 938;
BA_ "GenSigTimeoutTime_BPCM" SG_ 217 MinAirFlowMinSparkTorqCap_LHOM 0;
BA_ "GenSigTimeoutTime_ECM" SG_ 217 MinAirFlowMinSparkTorqCap_LHOM 0;
BA_ "GenSigTimeoutTime_IDCM" SG_ 217 MinAirFlowMinSparkTorqCap_LHOM 0;
BA_ "GenSigTimeoutTime_MCPA" SG_ 217 MinAirFlowMinSparkTorqCap_LHOM 0;
BA_ "GenSigTimeoutTime_MCPB" SG_ 217 MinAirFlowMinSparkTorqCap_LHOM 0;
BA_ "GenSigTimeoutTime_SGCP" SG_ 217 MinAirFlowMinSparkTorqCap_LHOM 0;
BA_ "GenSigTimeoutTime_BPCM" SG_ 217 LV12PwrFreeRq_LHOM 0;
BA_ "GenSigTimeoutTime_ECM" SG_ 217 LV12PwrFreeRq_LHOM 0;
BA_ "GenSigTimeoutTime_IDCM" SG_ 217 LV12PwrFreeRq_LHOM 0;
BA_ "GenSigTimeoutTime_MCPA" SG_ 217 LV12PwrFreeRq_LHOM 0;
BA_ "GenSigTimeoutTime_MCPB" SG_ 217 LV12PwrFreeRq_LHOM 0;
BA_ "GenSigTimeoutTime_SGCP" SG_ 217 LV12PwrFreeRq_LHOM 0;
BA_ "GenSigStartValue" SG_ 217 MaxOffEngTorqCap_LHOM 938;
BA_ "GenSigTimeoutTime_BPCM" SG_ 217 MaxOffEngTorqCap_LHOM 0;
BA_ "GenSigTimeoutTime_ECM" SG_ 217 MaxOffEngTorqCap_LHOM 0;
BA_ "GenSigTimeoutTime_IDCM" SG_ 217 MaxOffEngTorqCap_LHOM 0;
BA_ "GenSigTimeoutTime_MCPA" SG_ 217 MaxOffEngTorqCap_LHOM 0;
BA_ "GenSigTimeoutTime_MCPB" SG_ 217 MaxOffEngTorqCap_LHOM 0;
BA_ "GenSigTimeoutTime_SGCP" SG_ 217 MaxOffEngTorqCap_LHOM 0;
BA_ "GenSigStartValue" SG_ 217 MaxPrdtdEngTorqCap_LHOM 938;
BA_ "GenSigTimeoutTime_BPCM" SG_ 217 MaxPrdtdEngTorqCap_LHOM 0;
BA_ "GenSigTimeoutTime_ECM" SG_ 217 MaxPrdtdEngTorqCap_LHOM 0;
BA_ "GenSigTimeoutTime_IDCM" SG_ 217 MaxPrdtdEngTorqCap_LHOM 0;
BA_ "GenSigTimeoutTime_MCPA" SG_ 217 MaxPrdtdEngTorqCap_LHOM 0;
BA_ "GenSigTimeoutTime_MCPB" SG_ 217 MaxPrdtdEngTorqCap_LHOM 0;
BA_ "GenSigTimeoutTime_SGCP" SG_ 217 MaxPrdtdEngTorqCap_LHOM 0;
BA_ "GenSigTimeoutTime_BPCM" SG_ 217 MaxPrdtdEngTorqCapV_LHOM 0;
BA_ "GenSigTimeoutTime_ECM" SG_ 217 MaxPrdtdEngTorqCapV_LHOM 0;
BA_ "GenSigTimeoutTime_IDCM" SG_ 217 MaxPrdtdEngTorqCapV_LHOM 0;
BA_ "GenSigTimeoutTime_MCPA" SG_ 217 MaxPrdtdEngTorqCapV_LHOM 0;
BA_ "GenSigTimeoutTime_MCPB" SG_ 217 MaxPrdtdEngTorqCapV_LHOM 0;
BA_ "GenSigTimeoutTime_SGCP" SG_ 217 MaxPrdtdEngTorqCapV_LHOM 0;
BA_ "GenSigTimeoutTime_BPCM" SG_ 217 ECM_LHOM_Trans 0;
BA_ "GenSigTimeoutTime_ECM" SG_ 217 ECM_LHOM_Trans 0;
BA_ "GenSigTimeoutTime_IDCM" SG_ 217 ECM_LHOM_Trans 0;
BA_ "GenSigTimeoutTime_MCPA" SG_ 217 ECM_LHOM_Trans 0;
BA_ "GenSigTimeoutTime_MCPB" SG_ 217 ECM_LHOM_Trans 0;
BA_ "GenSigTimeoutTime_SGCP" SG_ 217 ECM_LHOM_Trans 0;
BA_ "GenSigStartValue" SG_ 217 EngActStdyStTorq_LHOM 938;
BA_ "GenSigTimeoutTime_BPCM" SG_ 217 EngActStdyStTorqV_LHOM 0;
BA_ "GenSigTimeoutTime_ECM" SG_ 217 EngActStdyStTorqV_LHOM 0;
BA_ "GenSigTimeoutTime_IDCM" SG_ 217 EngActStdyStTorqV_LHOM 0;
BA_ "GenSigTimeoutTime_MCPA" SG_ 217 EngActStdyStTorqV_LHOM 0;
BA_ "GenSigTimeoutTime_MCPB" SG_ 217 EngActStdyStTorqV_LHOM 0;
BA_ "GenSigTimeoutTime_SGCP" SG_ 217 EngActStdyStTorqV_LHOM 0;
BA_ "GenSigStartValue" SG_ 217 EngAirFlwStdyStTorq_LHOM 938;
BA_ "GenSigTimeoutTime_BPCM" SG_ 217 EngAirFlwStdyStTorq_LHOM 0;
BA_ "GenSigTimeoutTime_ECM" SG_ 217 EngAirFlwStdyStTorq_LHOM 0;
BA_ "GenSigTimeoutTime_IDCM" SG_ 217 EngAirFlwStdyStTorq_LHOM 0;
BA_ "GenSigTimeoutTime_MCPA" SG_ 217 EngAirFlwStdyStTorq_LHOM 0;
BA_ "GenSigTimeoutTime_MCPB" SG_ 217 EngAirFlwStdyStTorq_LHOM 0;
BA_ "GenSigTimeoutTime_SGCP" SG_ 217 EngAirFlwStdyStTorq_LHOM 0;
BA_ "GenSigTimeoutTime_BPCM" SG_ 217 CRC_ENGINE_FD_LHOM 0;
BA_ "GenSigTimeoutTime_ECM" SG_ 217 CRC_ENGINE_FD_LHOM 0;
BA_ "GenSigTimeoutTime_IDCM" SG_ 217 CRC_ENGINE_FD_LHOM 0;
BA_ "GenSigTimeoutTime_MCPA" SG_ 217 CRC_ENGINE_FD_LHOM 0;
BA_ "GenSigTimeoutTime_MCPB" SG_ 217 CRC_ENGINE_FD_LHOM 0;
BA_ "GenSigTimeoutTime_SGCP" SG_ 217 CRC_ENGINE_FD_LHOM 0;
BA_ "GenSigTimeoutTime_BPCM" SG_ 217 ECM_LHOM 0;
BA_ "GenSigTimeoutTime_ECM" SG_ 217 ECM_LHOM 0;
BA_ "GenSigTimeoutTime_IDCM" SG_ 217 ECM_LHOM 0;
BA_ "GenSigTimeoutTime_MCPA" SG_ 217 ECM_LHOM 0;
BA_ "GenSigTimeoutTime_MCPB" SG_ 217 ECM_LHOM 0;
BA_ "GenSigTimeoutTime_SGCP" SG_ 217 ECM_LHOM 0;
BA_ "GenSigTimeoutTime_BPCM" SG_ 217 EngAirFlwStdyStTorqV_LHOM 0;
BA_ "GenSigTimeoutTime_ECM" SG_ 217 EngAirFlwStdyStTorqV_LHOM 0;
BA_ "GenSigTimeoutTime_IDCM" SG_ 217 EngAirFlwStdyStTorqV_LHOM 0;
BA_ "GenSigTimeoutTime_MCPA" SG_ 217 EngAirFlwStdyStTorqV_LHOM 0;
BA_ "GenSigTimeoutTime_MCPB" SG_ 217 EngAirFlwStdyStTorqV_LHOM 0;
BA_ "GenSigTimeoutTime_SGCP" SG_ 217 EngAirFlwStdyStTorqV_LHOM 0;
BA_ "GenSigTimeoutTime_BPCM" SG_ 217 EngineFrictionTorque_LHOM 0;
BA_ "GenSigTimeoutTime_ECM" SG_ 217 EngineFrictionTorque_LHOM 0;
BA_ "GenSigTimeoutTime_IDCM" SG_ 217 EngineFrictionTorque_LHOM 0;
BA_ "GenSigTimeoutTime_MCPA" SG_ 217 EngineFrictionTorque_LHOM 0;
BA_ "GenSigTimeoutTime_MCPB" SG_ 217 EngineFrictionTorque_LHOM 0;
BA_ "GenSigTimeoutTime_SGCP" SG_ 217 EngineFrictionTorque_LHOM 0;
BA_ "GenSigTimeoutTime_MCPA" SG_ 217 EngineIdleRefSpeed_LHOM 0;
BA_ "GenSigTimeoutTime_MCPB" SG_ 217 EngineIdleRefSpeed_LHOM 0;
BA_ "GenSigTimeoutTime_SGCP" SG_ 217 EngineIdleRefSpeed_LHOM 0;
BA_ "GenSigTimeoutTime_BPCM" SG_ 217 EngineIdleRefSpeed_LHOM 0;
BA_ "GenSigTimeoutTime_ECM" SG_ 217 EngineIdleRefSpeed_LHOM 0;
BA_ "GenSigTimeoutTime_IDCM" SG_ 217 EngineIdleRefSpeed_LHOM 0;
BA_ "GenSigTimeoutTime_BPCM" SG_ 217 EngineSpeed_LHOM 0;
BA_ "GenSigTimeoutTime_ECM" SG_ 217 EngineSpeed_LHOM 0;
BA_ "GenSigTimeoutTime_IDCM" SG_ 217 EngineSpeed_LHOM 0;
BA_ "GenSigTimeoutTime_MCPA" SG_ 217 EngineSpeed_LHOM 0;
BA_ "GenSigTimeoutTime_MCPB" SG_ 217 EngineSpeed_LHOM 0;
BA_ "GenSigTimeoutTime_SGCP" SG_ 217 EngineSpeed_LHOM 0;
BA_ "GenSigStartValue" SG_ 217 EngineSts_LHOM 3;
BA_ "GenSigTimeoutTime_BPCM" SG_ 217 EngineSts_LHOM 0;
BA_ "GenSigTimeoutTime_ECM" SG_ 217 EngineSts_LHOM 0;
BA_ "GenSigTimeoutTime_IDCM" SG_ 217 EngineSts_LHOM 0;
BA_ "GenSigTimeoutTime_MCPA" SG_ 217 EngineSts_LHOM 0;
BA_ "GenSigTimeoutTime_MCPB" SG_ 217 EngineSts_LHOM 0;
BA_ "GenSigTimeoutTime_SGCP" SG_ 217 EngineSts_LHOM 0;
BA_ "GenSigTimeoutTime_BPCM" SG_ 217 EngTrq_Enbl_Rq_TCM_LHOM 0;
BA_ "GenSigTimeoutTime_ECM" SG_ 217 EngTrq_Enbl_Rq_TCM_LHOM 0;
BA_ "GenSigTimeoutTime_IDCM" SG_ 217 EngTrq_Enbl_Rq_TCM_LHOM 0;
BA_ "GenSigTimeoutTime_MCPA" SG_ 217 EngTrq_Enbl_Rq_TCM_LHOM 0;
BA_ "GenSigTimeoutTime_MCPB" SG_ 217 EngTrq_Enbl_Rq_TCM_LHOM 0;
BA_ "GenSigTimeoutTime_SGCP" SG_ 217 EngTrq_Enbl_Rq_TCM_LHOM 0;
BA_ "GenSigTimeoutTime_BPCM" SG_ 217 EngTrqReserveReq_LHOM 0;
BA_ "GenSigTimeoutTime_ECM" SG_ 217 EngTrqReserveReq_LHOM 0;
BA_ "GenSigTimeoutTime_IDCM" SG_ 217 EngTrqReserveReq_LHOM 0;
BA_ "GenSigTimeoutTime_MCPA" SG_ 217 EngTrqReserveReq_LHOM 0;
BA_ "GenSigTimeoutTime_MCPB" SG_ 217 EngTrqReserveReq_LHOM 0;
BA_ "GenSigTimeoutTime_SGCP" SG_ 217 EngTrqReserveReq_LHOM 0;
BA_ "GenSigTimeoutTime_BPCM" SG_ 217 EssEngModReq_LHOM 0;
BA_ "GenSigTimeoutTime_ECM" SG_ 217 EssEngModReq_LHOM 0;
BA_ "GenSigTimeoutTime_IDCM" SG_ 217 EssEngModReq_LHOM 0;
BA_ "GenSigTimeoutTime_MCPA" SG_ 217 EssEngModReq_LHOM 0;
BA_ "GenSigTimeoutTime_MCPB" SG_ 217 EssEngModReq_LHOM 0;
BA_ "GenSigTimeoutTime_SGCP" SG_ 217 EssEngModReq_LHOM 0;
BA_ "GenSigTimeoutTime_BPCM" SG_ 217 EssEngSt_LHOM 0;
BA_ "GenSigTimeoutTime_ECM" SG_ 217 EssEngSt_LHOM 0;
BA_ "GenSigTimeoutTime_IDCM" SG_ 217 EssEngSt_LHOM 0;
BA_ "GenSigTimeoutTime_MCPA" SG_ 217 EssEngSt_LHOM 0;
BA_ "GenSigTimeoutTime_MCPB" SG_ 217 EssEngSt_LHOM 0;
BA_ "GenSigTimeoutTime_SGCP" SG_ 217 EssEngSt_LHOM 0;
BA_ "GenSigTimeoutTime_BPCM" SG_ 217 EssEngStopIsNotAllwd_LHOM 0;
BA_ "GenSigTimeoutTime_ECM" SG_ 217 EssEngStopIsNotAllwd_LHOM 0;
BA_ "GenSigTimeoutTime_IDCM" SG_ 217 EssEngStopIsNotAllwd_LHOM 0;
BA_ "GenSigTimeoutTime_MCPA" SG_ 217 EssEngStopIsNotAllwd_LHOM 0;
BA_ "GenSigTimeoutTime_MCPB" SG_ 217 EssEngStopIsNotAllwd_LHOM 0;
BA_ "GenSigTimeoutTime_SGCP" SG_ 217 EssEngStopIsNotAllwd_LHOM 0;
BA_ "GenSigTimeoutTime_BPCM" SG_ 217 EssEngStopIsNotAllwdID_LHOM 0;
BA_ "GenSigTimeoutTime_ECM" SG_ 217 EssEngStopIsNotAllwdID_LHOM 0;
BA_ "GenSigTimeoutTime_IDCM" SG_ 217 EssEngStopIsNotAllwdID_LHOM 0;
BA_ "GenSigTimeoutTime_MCPA" SG_ 217 EssEngStopIsNotAllwdID_LHOM 0;
BA_ "GenSigTimeoutTime_MCPB" SG_ 217 EssEngStopIsNotAllwdID_LHOM 0;
BA_ "GenSigTimeoutTime_SGCP" SG_ 217 EssEngStopIsNotAllwdID_LHOM 0;
BA_ "GenSigTimeoutTime_BPCM" SG_ 217 EssEngStrtIsNotAllwd_LHOM 0;
BA_ "GenSigTimeoutTime_ECM" SG_ 217 EssEngStrtIsNotAllwd_LHOM 0;
BA_ "GenSigTimeoutTime_IDCM" SG_ 217 EssEngStrtIsNotAllwd_LHOM 0;
BA_ "GenSigTimeoutTime_MCPA" SG_ 217 EssEngStrtIsNotAllwd_LHOM 0;
BA_ "GenSigTimeoutTime_MCPB" SG_ 217 EssEngStrtIsNotAllwd_LHOM 0;
BA_ "GenSigTimeoutTime_SGCP" SG_ 217 EssEngStrtIsNotAllwd_LHOM 0;
BA_ "GenSigTimeoutTime_BPCM" SG_ 217 EssEngStrtIsNotAllwdID_LHOM 0;
BA_ "GenSigTimeoutTime_ECM" SG_ 217 EssEngStrtIsNotAllwdID_LHOM 0;
BA_ "GenSigTimeoutTime_IDCM" SG_ 217 EssEngStrtIsNotAllwdID_LHOM 0;
BA_ "GenSigTimeoutTime_MCPA" SG_ 217 EssEngStrtIsNotAllwdID_LHOM 0;
BA_ "GenSigTimeoutTime_MCPB" SG_ 217 EssEngStrtIsNotAllwdID_LHOM 0;
BA_ "GenSigTimeoutTime_SGCP" SG_ 217 EssEngStrtIsNotAllwdID_LHOM 0;
BA_ "GenSigTimeoutTime_BPCM" SG_ 217 ETRQ_Mode_LHOM 0;
BA_ "GenSigTimeoutTime_ECM" SG_ 217 ETRQ_Mode_LHOM 0;
BA_ "GenSigTimeoutTime_IDCM" SG_ 217 ETRQ_Mode_LHOM 0;
BA_ "GenSigTimeoutTime_MCPA" SG_ 217 ETRQ_Mode_LHOM 0;
BA_ "GenSigTimeoutTime_MCPB" SG_ 217 ETRQ_Mode_LHOM 0;
BA_ "GenSigTimeoutTime_SGCP" SG_ 217 ETRQ_Mode_LHOM 0;
BA_ "GenSigTimeoutTime_BPCM" SG_ 217 Feedback_HCP_LHOM 0;
BA_ "GenSigTimeoutTime_ECM" SG_ 217 Feedback_HCP_LHOM 0;
BA_ "GenSigTimeoutTime_IDCM" SG_ 217 Feedback_HCP_LHOM 0;
BA_ "GenSigTimeoutTime_MCPA" SG_ 217 Feedback_HCP_LHOM 0;
BA_ "GenSigTimeoutTime_MCPB" SG_ 217 Feedback_HCP_LHOM 0;
BA_ "GenSigTimeoutTime_SGCP" SG_ 217 Feedback_HCP_LHOM 0;
BA_ "GenSigTimeoutTime_BPCM" SG_ 217 HybActEngTorqRespTyp_LHOM 0;
BA_ "GenSigTimeoutTime_ECM" SG_ 217 HybActEngTorqRespTyp_LHOM 0;
BA_ "GenSigTimeoutTime_IDCM" SG_ 217 HybActEngTorqRespTyp_LHOM 0;
BA_ "GenSigTimeoutTime_MCPA" SG_ 217 HybActEngTorqRespTyp_LHOM 0;
BA_ "GenSigTimeoutTime_MCPB" SG_ 217 HybActEngTorqRespTyp_LHOM 0;
BA_ "GenSigTimeoutTime_SGCP" SG_ 217 HybActEngTorqRespTyp_LHOM 0;
BA_ "GenSigTimeoutTime_BPCM" SG_ 217 EngActStdyStTorq_LHOM 0;
BA_ "GenSigTimeoutTime_ECM" SG_ 217 EngActStdyStTorq_LHOM 0;
BA_ "GenSigTimeoutTime_IDCM" SG_ 217 EngActStdyStTorq_LHOM 0;
BA_ "GenSigTimeoutTime_MCPA" SG_ 217 EngActStdyStTorq_LHOM 0;
BA_ "GenSigTimeoutTime_MCPB" SG_ 217 EngActStdyStTorq_LHOM 0;
BA_ "GenSigTimeoutTime_SGCP" SG_ 217 EngActStdyStTorq_LHOM 0;
BA_ "GenSigTimeoutTime_BPCM" SG_ 218 CRC_HYBRID_FD_LHOM 0;
BA_ "GenSigTimeoutTime_EVCU2" SG_ 218 CRC_HYBRID_FD_LHOM 0;
BA_ "GenSigTimeoutTime_IDCM" SG_ 218 CRC_HYBRID_FD_LHOM 0;
BA_ "GenSigTimeoutTime_MCPA" SG_ 218 CRC_HYBRID_FD_LHOM 0;
BA_ "GenSigTimeoutTime_MCPB" SG_ 218 CRC_HYBRID_FD_LHOM 0;
BA_ "GenSigTimeoutTime_SGCP" SG_ 218 CRC_HYBRID_FD_LHOM 0;
BA_ "GenSigTimeoutTime_BPCM" SG_ 218 TransInpSpdPrfl_LHOM 0;
BA_ "GenSigTimeoutTime_EVCU2" SG_ 218 TransInpSpdPrfl_LHOM 0;
BA_ "GenSigTimeoutTime_IDCM" SG_ 218 TransInpSpdPrfl_LHOM 0;
BA_ "GenSigTimeoutTime_MCPA" SG_ 218 TransInpSpdPrfl_LHOM 0;
BA_ "GenSigTimeoutTime_MCPB" SG_ 218 TransInpSpdPrfl_LHOM 0;
BA_ "GenSigTimeoutTime_SGCP" SG_ 218 TransInpSpdPrfl_LHOM 0;
BA_ "GenSigTimeoutTime_BPCM" SG_ 218 MessageCounter_HYBRID_FD_LHOM 0;
BA_ "GenSigTimeoutTime_EVCU2" SG_ 218 MessageCounter_HYBRID_FD_LHOM 0;
BA_ "GenSigTimeoutTime_IDCM" SG_ 218 MessageCounter_HYBRID_FD_LHOM 0;
BA_ "GenSigTimeoutTime_MCPA" SG_ 218 MessageCounter_HYBRID_FD_LHOM 0;
BA_ "GenSigTimeoutTime_MCPB" SG_ 218 MessageCounter_HYBRID_FD_LHOM 0;
BA_ "GenSigTimeoutTime_SGCP" SG_ 218 MessageCounter_HYBRID_FD_LHOM 0;
BA_ "GenSigTimeoutTime_BPCM" SG_ 218 HybFeedback_Engine_LHOM 0;
BA_ "GenSigTimeoutTime_EVCU2" SG_ 218 HybFeedback_Engine_LHOM 0;
BA_ "GenSigTimeoutTime_IDCM" SG_ 218 HybFeedback_Engine_LHOM 0;
BA_ "GenSigTimeoutTime_MCPA" SG_ 218 HybFeedback_Engine_LHOM 0;
BA_ "GenSigTimeoutTime_MCPB" SG_ 218 HybFeedback_Engine_LHOM 0;
BA_ "GenSigTimeoutTime_SGCP" SG_ 218 HybFeedback_Engine_LHOM 0;
BA_ "GenSigStartValue" SG_ 218 HybridEngineMaxTorqAllowed_LHOM 938;
BA_ "GenSigTimeoutTime_BPCM" SG_ 218 HybridEngineMaxTorqAllowed_LHOM 0;
BA_ "GenSigTimeoutTime_EVCU2" SG_ 218 HybridEngineMaxTorqAllowed_LHOM 0;
BA_ "GenSigTimeoutTime_IDCM" SG_ 218 HybridEngineMaxTorqAllowed_LHOM 0;
BA_ "GenSigTimeoutTime_MCPA" SG_ 218 HybridEngineMaxTorqAllowed_LHOM 0;
BA_ "GenSigTimeoutTime_MCPB" SG_ 218 HybridEngineMaxTorqAllowed_LHOM 0;
BA_ "GenSigTimeoutTime_SGCP" SG_ 218 HybridEngineMaxTorqAllowed_LHOM 0;
BA_ "GenSigTimeoutTime_BPCM" SG_ 218 IdleSpeedActiveSts_LHOM 0;
BA_ "GenSigTimeoutTime_EVCU2" SG_ 218 IdleSpeedActiveSts_LHOM 0;
BA_ "GenSigTimeoutTime_IDCM" SG_ 218 IdleSpeedActiveSts_LHOM 0;
BA_ "GenSigTimeoutTime_MCPA" SG_ 218 IdleSpeedActiveSts_LHOM 0;
BA_ "GenSigTimeoutTime_MCPB" SG_ 218 IdleSpeedActiveSts_LHOM 0;
BA_ "GenSigTimeoutTime_SGCP" SG_ 218 IdleSpeedActiveSts_LHOM 0;
BA_ "GenSigTimeoutTime_BPCM" SG_ 218 InputSpdRaw_LHOM 0;
BA_ "GenSigTimeoutTime_EVCU2" SG_ 218 InputSpdRaw_LHOM 0;
BA_ "GenSigTimeoutTime_IDCM" SG_ 218 InputSpdRaw_LHOM 0;
BA_ "GenSigTimeoutTime_MCPA" SG_ 218 InputSpdRaw_LHOM 0;
BA_ "GenSigTimeoutTime_MCPB" SG_ 218 InputSpdRaw_LHOM 0;
BA_ "GenSigTimeoutTime_SGCP" SG_ 218 InputSpdRaw_LHOM 0;
BA_ "GenSigTimeoutTime_BPCM" SG_ 218 ECMPrepIdleRes_LHOM 0;
BA_ "GenSigTimeoutTime_EVCU2" SG_ 218 ECMPrepIdleRes_LHOM 0;
BA_ "GenSigTimeoutTime_IDCM" SG_ 218 ECMPrepIdleRes_LHOM 0;
BA_ "GenSigTimeoutTime_MCPA" SG_ 218 ECMPrepIdleRes_LHOM 0;
BA_ "GenSigTimeoutTime_MCPB" SG_ 218 ECMPrepIdleRes_LHOM 0;
BA_ "GenSigTimeoutTime_SGCP" SG_ 218 ECMPrepIdleRes_LHOM 0;
BA_ "GenSigTimeoutTime_BPCM" SG_ 218 EngCntrlMode_LHOM 0;
BA_ "GenSigTimeoutTime_EVCU2" SG_ 218 EngCntrlMode_LHOM 0;
BA_ "GenSigTimeoutTime_IDCM" SG_ 218 EngCntrlMode_LHOM 0;
BA_ "GenSigTimeoutTime_MCPA" SG_ 218 EngCntrlMode_LHOM 0;
BA_ "GenSigTimeoutTime_MCPB" SG_ 218 EngCntrlMode_LHOM 0;
BA_ "GenSigTimeoutTime_SGCP" SG_ 218 EngCntrlMode_LHOM 0;
BA_ "GenSigTimeoutTime_BPCM" SG_ 218 EngTrqReserveCmd_LHOM 0;
BA_ "GenSigTimeoutTime_EVCU2" SG_ 218 EngTrqReserveCmd_LHOM 0;
BA_ "GenSigTimeoutTime_IDCM" SG_ 218 EngTrqReserveCmd_LHOM 0;
BA_ "GenSigTimeoutTime_MCPA" SG_ 218 EngTrqReserveCmd_LHOM 0;
BA_ "GenSigTimeoutTime_MCPB" SG_ 218 EngTrqReserveCmd_LHOM 0;
BA_ "GenSigTimeoutTime_SGCP" SG_ 218 EngTrqReserveCmd_LHOM 0;
BA_ "GenSigStartValue" SG_ 218 HybCmndEngTorqImmed_LHOM 938;
BA_ "GenSigTimeoutTime_BPCM" SG_ 218 HybCmndEngTorqImmed_LHOM 0;
BA_ "GenSigTimeoutTime_EVCU2" SG_ 218 HybCmndEngTorqImmed_LHOM 0;
BA_ "GenSigTimeoutTime_IDCM" SG_ 218 HybCmndEngTorqImmed_LHOM 0;
BA_ "GenSigTimeoutTime_MCPA" SG_ 218 HybCmndEngTorqImmed_LHOM 0;
BA_ "GenSigTimeoutTime_MCPB" SG_ 218 HybCmndEngTorqImmed_LHOM 0;
BA_ "GenSigTimeoutTime_SGCP" SG_ 218 HybCmndEngTorqImmed_LHOM 0;
BA_ "GenSigStartValue" SG_ 218 HybCmndEngTorqPrdtd_LHOM 938;
BA_ "GenSigTimeoutTime_BPCM" SG_ 218 HybCmndEngTorqPrdtd_LHOM 0;
BA_ "GenSigTimeoutTime_EVCU2" SG_ 218 HybCmndEngTorqPrdtd_LHOM 0;
BA_ "GenSigTimeoutTime_IDCM" SG_ 218 HybCmndEngTorqPrdtd_LHOM 0;
BA_ "GenSigTimeoutTime_MCPA" SG_ 218 HybCmndEngTorqPrdtd_LHOM 0;
BA_ "GenSigTimeoutTime_MCPB" SG_ 218 HybCmndEngTorqPrdtd_LHOM 0;
BA_ "GenSigTimeoutTime_SGCP" SG_ 218 HybCmndEngTorqPrdtd_LHOM 0;
BA_ "GenSigTimeoutTime_BPCM" SG_ 218 HybCmndEngTorqRespTyp_LHOM 0;
BA_ "GenSigTimeoutTime_EVCU2" SG_ 218 HybCmndEngTorqRespTyp_LHOM 0;
BA_ "GenSigTimeoutTime_IDCM" SG_ 218 HybCmndEngTorqRespTyp_LHOM 0;
BA_ "GenSigTimeoutTime_MCPA" SG_ 218 HybCmndEngTorqRespTyp_LHOM 0;
BA_ "GenSigTimeoutTime_MCPB" SG_ 218 HybCmndEngTorqRespTyp_LHOM 0;
BA_ "GenSigTimeoutTime_SGCP" SG_ 218 HybCmndEngTorqRespTyp_LHOM 0;
BA_ "GenSigStartValue" SG_ 218 HybEstEngTorq_LHOM 938;
BA_ "GenSigTimeoutTime_BPCM" SG_ 218 HybEstEngTorq_LHOM 0;
BA_ "GenSigTimeoutTime_EVCU2" SG_ 218 HybEstEngTorq_LHOM 0;
BA_ "GenSigTimeoutTime_IDCM" SG_ 218 HybEstEngTorq_LHOM 0;
BA_ "GenSigTimeoutTime_MCPA" SG_ 218 HybEstEngTorq_LHOM 0;
BA_ "GenSigTimeoutTime_MCPB" SG_ 218 HybEstEngTorq_LHOM 0;
BA_ "GenSigTimeoutTime_SGCP" SG_ 218 HybEstEngTorq_LHOM 0;
BA_ "GenSigTimeoutTime_BPCM" SG_ 218 HybEstEngTorqV_LHOM 0;
BA_ "GenSigTimeoutTime_EVCU2" SG_ 218 HybEstEngTorqV_LHOM 0;
BA_ "GenSigTimeoutTime_IDCM" SG_ 218 HybEstEngTorqV_LHOM 0;
BA_ "GenSigTimeoutTime_MCPA" SG_ 218 HybEstEngTorqV_LHOM 0;
BA_ "GenSigTimeoutTime_MCPB" SG_ 218 HybEstEngTorqV_LHOM 0;
BA_ "GenSigTimeoutTime_SGCP" SG_ 218 HybEstEngTorqV_LHOM 0;
BA_ "GenSigTimeoutTime_MCPA" SG_ 295 SGCP_HV_CnctrOpn_Req_P 0;
BA_ "GenSigTimeoutTime_MCPB" SG_ 295 SGCP_HV_CnctrOpn_Req_P 0;
BA_ "GenSigTimeoutTime_SGCP" SG_ 295 SGCP_HV_CnctrOpn_Req_P 0;
BA_ "GenSigTimeoutTime_BPCM" SG_ 295 SGCP_HV_CnctrOpn_Req_P 0;
BA_ "GenSigTimeoutTime_ECM" SG_ 295 SGCP_HV_CnctrOpn_Req_P 0;
BA_ "GenSigTimeoutTime_IDCM" SG_ 295 SGCP_HV_CnctrOpn_Req_P 0;
BA_ "GenSigTimeoutTime_BPCM" SG_ 295 SGCP_InterlockSts_P 0;
BA_ "GenSigTimeoutTime_ECM" SG_ 295 SGCP_InterlockSts_P 0;
BA_ "GenSigTimeoutTime_IDCM" SG_ 295 SGCP_InterlockSts_P 0;
BA_ "GenSigTimeoutTime_MCPA" SG_ 295 SGCP_InterlockSts_P 0;
BA_ "GenSigTimeoutTime_MCPB" SG_ 295 SGCP_InterlockSts_P 0;
BA_ "GenSigTimeoutTime_SGCP" SG_ 295 SGCP_InterlockSts_P 0;
BA_ "GenSigTimeoutTime_BPCM" SG_ 295 SGCP_Invrtr_State_P 0;
BA_ "GenSigTimeoutTime_ECM" SG_ 295 SGCP_Invrtr_State_P 0;
BA_ "GenSigTimeoutTime_IDCM" SG_ 295 SGCP_Invrtr_State_P 0;
BA_ "GenSigTimeoutTime_MCPA" SG_ 295 SGCP_Invrtr_State_P 0;
BA_ "GenSigTimeoutTime_MCPB" SG_ 295 SGCP_Invrtr_State_P 0;
BA_ "GenSigTimeoutTime_SGCP" SG_ 295 SGCP_Invrtr_State_P 0;
BA_ "GenSigStartValue" SG_ 295 SGCP_MaxTorq_P 8184;
BA_ "GenSigTimeoutTime_BPCM" SG_ 295 SGCP_MaxTorq_P 0;
BA_ "GenSigTimeoutTime_ECM" SG_ 295 SGCP_MaxTorq_P 0;
BA_ "GenSigTimeoutTime_IDCM" SG_ 295 SGCP_MaxTorq_P 0;
BA_ "GenSigTimeoutTime_MCPA" SG_ 295 SGCP_MaxTorq_P 0;
BA_ "GenSigTimeoutTime_MCPB" SG_ 295 SGCP_MaxTorq_P 0;
BA_ "GenSigTimeoutTime_SGCP" SG_ 295 SGCP_MaxTorq_P 0;
BA_ "GenSigStartValue" SG_ 295 SGCP_MinTorq_P 8184;
BA_ "GenSigTimeoutTime_BPCM" SG_ 295 SGCP_MinTorq_P 0;
BA_ "GenSigTimeoutTime_ECM" SG_ 295 SGCP_MinTorq_P 0;
BA_ "GenSigTimeoutTime_IDCM" SG_ 295 SGCP_MinTorq_P 0;
BA_ "GenSigTimeoutTime_MCPA" SG_ 295 SGCP_MinTorq_P 0;
BA_ "GenSigTimeoutTime_MCPB" SG_ 295 SGCP_MinTorq_P 0;
BA_ "GenSigTimeoutTime_SGCP" SG_ 295 SGCP_MinTorq_P 0;
BA_ "GenSigTimeoutTime_BPCM" SG_ 295 SGCP_MtrIndex_P 0;
BA_ "GenSigTimeoutTime_ECM" SG_ 295 SGCP_MtrIndex_P 0;
BA_ "GenSigTimeoutTime_IDCM" SG_ 295 SGCP_MtrIndex_P 0;
BA_ "GenSigTimeoutTime_MCPA" SG_ 295 SGCP_MtrIndex_P 0;
BA_ "GenSigTimeoutTime_MCPB" SG_ 295 SGCP_MtrIndex_P 0;
BA_ "GenSigTimeoutTime_SGCP" SG_ 295 SGCP_MtrIndex_P 0;
BA_ "GenSigStartValue" SG_ 295 SGCP_MtrMaxCpbltyTrq_P 8184;
BA_ "GenSigTimeoutTime_BPCM" SG_ 295 SGCP_MtrMaxCpbltyTrq_P 0;
BA_ "GenSigTimeoutTime_ECM" SG_ 295 SGCP_MtrMaxCpbltyTrq_P 0;
BA_ "GenSigTimeoutTime_IDCM" SG_ 295 SGCP_MtrMaxCpbltyTrq_P 0;
BA_ "GenSigTimeoutTime_MCPA" SG_ 295 SGCP_MtrMaxCpbltyTrq_P 0;
BA_ "GenSigTimeoutTime_MCPB" SG_ 295 SGCP_MtrMaxCpbltyTrq_P 0;
BA_ "GenSigTimeoutTime_SGCP" SG_ 295 SGCP_MtrMaxCpbltyTrq_P 0;
BA_ "GenSigStartValue" SG_ 295 SGCP_MtrMinCpbltyTrq_P 8184;
BA_ "GenSigTimeoutTime_BPCM" SG_ 295 SGCP_MtrMinCpbltyTrq_P 0;
BA_ "GenSigTimeoutTime_ECM" SG_ 295 SGCP_MtrMinCpbltyTrq_P 0;
BA_ "GenSigTimeoutTime_IDCM" SG_ 295 SGCP_MtrMinCpbltyTrq_P 0;
BA_ "GenSigTimeoutTime_MCPA" SG_ 295 SGCP_MtrMinCpbltyTrq_P 0;
BA_ "GenSigTimeoutTime_MCPB" SG_ 295 SGCP_MtrMinCpbltyTrq_P 0;
BA_ "GenSigTimeoutTime_SGCP" SG_ 295 SGCP_MtrMinCpbltyTrq_P 0;
BA_ "GenSigStartValue" SG_ 295 SGCP_RPM_P 32768;
BA_ "GenSigTimeoutTime_BPCM" SG_ 295 SGCP_RPM_P 0;
BA_ "GenSigTimeoutTime_ECM" SG_ 295 SGCP_RPM_P 0;
BA_ "GenSigTimeoutTime_IDCM" SG_ 295 SGCP_RPM_P 0;
BA_ "GenSigTimeoutTime_MCPA" SG_ 295 SGCP_RPM_P 0;
BA_ "GenSigTimeoutTime_MCPB" SG_ 295 SGCP_RPM_P 0;
BA_ "GenSigTimeoutTime_SGCP" SG_ 295 SGCP_RPM_P 0;
BA_ "GenSigTimeoutTime_BPCM" SG_ 295 SGCP_RPM_V_P 0;
BA_ "GenSigTimeoutTime_ECM" SG_ 295 SGCP_RPM_V_P 0;
BA_ "GenSigTimeoutTime_IDCM" SG_ 295 SGCP_RPM_V_P 0;
BA_ "GenSigTimeoutTime_MCPA" SG_ 295 SGCP_RPM_V_P 0;
BA_ "GenSigTimeoutTime_MCPB" SG_ 295 SGCP_RPM_V_P 0;
BA_ "GenSigTimeoutTime_SGCP" SG_ 295 SGCP_RPM_V_P 0;
BA_ "GenSigStartValue" SG_ 295 SGCP_Spd_Lim_P 32767;
BA_ "GenSigTimeoutTime_BPCM" SG_ 295 SGCP_Spd_Lim_P 0;
BA_ "GenSigTimeoutTime_ECM" SG_ 295 SGCP_Spd_Lim_P 0;
BA_ "GenSigTimeoutTime_IDCM" SG_ 295 SGCP_Spd_Lim_P 0;
BA_ "GenSigTimeoutTime_MCPA" SG_ 295 SGCP_Spd_Lim_P 0;
BA_ "GenSigTimeoutTime_MCPB" SG_ 295 SGCP_Spd_Lim_P 0;
BA_ "GenSigTimeoutTime_SGCP" SG_ 295 SGCP_Spd_Lim_P 0;
BA_ "GenSigTimeoutTime_BPCM" SG_ 295 SGCP_SPT_Stat_P 0;
BA_ "GenSigTimeoutTime_ECM" SG_ 295 SGCP_SPT_Stat_P 0;
BA_ "GenSigTimeoutTime_IDCM" SG_ 295 SGCP_SPT_Stat_P 0;
BA_ "GenSigTimeoutTime_MCPA" SG_ 295 SGCP_SPT_Stat_P 0;
BA_ "GenSigTimeoutTime_MCPB" SG_ 295 SGCP_SPT_Stat_P 0;
BA_ "GenSigTimeoutTime_SGCP" SG_ 295 SGCP_SPT_Stat_P 0;
BA_ "GenSigStartValue" SG_ 295 SGCP_TorqAchieved_AEMD_P 8184;
BA_ "GenSigTimeoutTime_BPCM" SG_ 295 SGCP_TorqAchieved_AEMD_P 0;
BA_ "GenSigTimeoutTime_ECM" SG_ 295 SGCP_TorqAchieved_AEMD_P 0;
BA_ "GenSigTimeoutTime_IDCM" SG_ 295 SGCP_TorqAchieved_AEMD_P 0;
BA_ "GenSigTimeoutTime_MCPA" SG_ 295 SGCP_TorqAchieved_AEMD_P 0;
BA_ "GenSigTimeoutTime_MCPB" SG_ 295 SGCP_TorqAchieved_AEMD_P 0;
BA_ "GenSigTimeoutTime_SGCP" SG_ 295 SGCP_TorqAchieved_AEMD_P 0;
BA_ "GenSigTimeoutTime_BPCM" SG_ 295 SGCP_TorqAchieved_AEMD_V_P 0;
BA_ "GenSigTimeoutTime_ECM" SG_ 295 SGCP_TorqAchieved_AEMD_V_P 0;
BA_ "GenSigTimeoutTime_IDCM" SG_ 295 SGCP_TorqAchieved_AEMD_V_P 0;
BA_ "GenSigTimeoutTime_MCPA" SG_ 295 SGCP_TorqAchieved_AEMD_V_P 0;
BA_ "GenSigTimeoutTime_MCPB" SG_ 295 SGCP_TorqAchieved_AEMD_V_P 0;
BA_ "GenSigTimeoutTime_SGCP" SG_ 295 SGCP_TorqAchieved_AEMD_V_P 0;
BA_ "GenSigStartValue" SG_ 295 SGCP_Torque_Achieved_P 8184;
BA_ "GenSigTimeoutTime_BPCM" SG_ 295 SGCP_Torque_Achieved_P 0;
BA_ "GenSigTimeoutTime_ECM" SG_ 295 SGCP_Torque_Achieved_P 0;
BA_ "GenSigTimeoutTime_IDCM" SG_ 295 SGCP_Torque_Achieved_P 0;
BA_ "GenSigTimeoutTime_MCPA" SG_ 295 SGCP_Torque_Achieved_P 0;
BA_ "GenSigTimeoutTime_MCPB" SG_ 295 SGCP_Torque_Achieved_P 0;
BA_ "GenSigTimeoutTime_SGCP" SG_ 295 SGCP_Torque_Achieved_P 0;
BA_ "GenSigTimeoutTime_BPCM" SG_ 295 SGCP_Torque_Achieved_V_P 0;
BA_ "GenSigTimeoutTime_ECM" SG_ 295 SGCP_Torque_Achieved_V_P 0;
BA_ "GenSigTimeoutTime_IDCM" SG_ 295 SGCP_Torque_Achieved_V_P 0;
BA_ "GenSigTimeoutTime_MCPA" SG_ 295 SGCP_Torque_Achieved_V_P 0;
BA_ "GenSigTimeoutTime_MCPB" SG_ 295 SGCP_Torque_Achieved_V_P 0;
BA_ "GenSigTimeoutTime_SGCP" SG_ 295 SGCP_Torque_Achieved_V_P 0;
BA_ "GenSigTimeoutTime_BPCM" SG_ 295 MC_SGCP_PROPULSION 0;
BA_ "GenSigTimeoutTime_ECM" SG_ 295 MC_SGCP_PROPULSION 0;
BA_ "GenSigTimeoutTime_IDCM" SG_ 295 MC_SGCP_PROPULSION 0;
BA_ "GenSigTimeoutTime_MCPA" SG_ 295 MC_SGCP_PROPULSION 0;
BA_ "GenSigTimeoutTime_MCPB" SG_ 295 MC_SGCP_PROPULSION 0;
BA_ "GenSigTimeoutTime_SGCP" SG_ 295 MC_SGCP_PROPULSION 0;
BA_ "GenSigTimeoutTime_BPCM" SG_ 295 CRC_SGCP_PROPULSION 0;
BA_ "GenSigTimeoutTime_ECM" SG_ 295 CRC_SGCP_PROPULSION 0;
BA_ "GenSigTimeoutTime_IDCM" SG_ 295 CRC_SGCP_PROPULSION 0;
BA_ "GenSigTimeoutTime_MCPA" SG_ 295 CRC_SGCP_PROPULSION 0;
BA_ "GenSigTimeoutTime_MCPB" SG_ 295 CRC_SGCP_PROPULSION 0;
BA_ "GenSigTimeoutTime_SGCP" SG_ 295 CRC_SGCP_PROPULSION 0;
BA_ "GenSigStartValue" SG_ 295 SGCP_Temp_P 40;
BA_ "GenSigTimeoutTime_BPCM" SG_ 295 SGCP_Temp_P 0;
BA_ "GenSigTimeoutTime_ECM" SG_ 295 SGCP_Temp_P 0;
BA_ "GenSigTimeoutTime_IDCM" SG_ 295 SGCP_Temp_P 0;
BA_ "GenSigTimeoutTime_MCPA" SG_ 295 SGCP_Temp_P 0;
BA_ "GenSigTimeoutTime_MCPB" SG_ 295 SGCP_Temp_P 0;
BA_ "GenSigTimeoutTime_SGCP" SG_ 295 SGCP_Temp_P 0;
BA_ "GenSigStartValue" SG_ 295 SGCP_AccelRaw_P 32768;
BA_ "GenSigTimeoutTime_BPCM" SG_ 295 SGCP_AccelRaw_P 0;
BA_ "GenSigTimeoutTime_ECM" SG_ 295 SGCP_AccelRaw_P 0;
BA_ "GenSigTimeoutTime_IDCM" SG_ 295 SGCP_AccelRaw_P 0;
BA_ "GenSigTimeoutTime_MCPA" SG_ 295 SGCP_AccelRaw_P 0;
BA_ "GenSigTimeoutTime_MCPB" SG_ 295 SGCP_AccelRaw_P 0;
BA_ "GenSigTimeoutTime_SGCP" SG_ 295 SGCP_AccelRaw_P 0;
BA_ "GenSigTimeoutTime_BPCM" SG_ 295 SGCP_6SO_Status_P 0;
BA_ "GenSigTimeoutTime_ECM" SG_ 295 SGCP_6SO_Status_P 0;
BA_ "GenSigTimeoutTime_IDCM" SG_ 295 SGCP_6SO_Status_P 0;
BA_ "GenSigTimeoutTime_MCPA" SG_ 295 SGCP_6SO_Status_P 0;
BA_ "GenSigTimeoutTime_MCPB" SG_ 295 SGCP_6SO_Status_P 0;
BA_ "GenSigTimeoutTime_SGCP" SG_ 295 SGCP_6SO_Status_P 0;
BA_ "GenSigTimeoutTime_BPCM" SG_ 295 SGCP_AccelRawV_P 0;
BA_ "GenSigTimeoutTime_ECM" SG_ 295 SGCP_AccelRawV_P 0;
BA_ "GenSigTimeoutTime_IDCM" SG_ 295 SGCP_AccelRawV_P 0;
BA_ "GenSigTimeoutTime_MCPA" SG_ 295 SGCP_AccelRawV_P 0;
BA_ "GenSigTimeoutTime_MCPB" SG_ 295 SGCP_AccelRawV_P 0;
BA_ "GenSigTimeoutTime_SGCP" SG_ 295 SGCP_AccelRawV_P 0;
BA_ "GenSigTimeoutTime_BPCM" SG_ 295 SGCP_CpbltySpdDivVolt_P 0;
BA_ "GenSigTimeoutTime_ECM" SG_ 295 SGCP_CpbltySpdDivVolt_P 0;
BA_ "GenSigTimeoutTime_IDCM" SG_ 295 SGCP_CpbltySpdDivVolt_P 0;
BA_ "GenSigTimeoutTime_MCPA" SG_ 295 SGCP_CpbltySpdDivVolt_P 0;
BA_ "GenSigTimeoutTime_MCPB" SG_ 295 SGCP_CpbltySpdDivVolt_P 0;
BA_ "GenSigTimeoutTime_SGCP" SG_ 295 SGCP_CpbltySpdDivVolt_P 0;
BA_ "GenSigTimeoutTime_BPCM" SG_ 295 SGCP_DeratingFactor_P 0;
BA_ "GenSigTimeoutTime_ECM" SG_ 295 SGCP_DeratingFactor_P 0;
BA_ "GenSigTimeoutTime_IDCM" SG_ 295 SGCP_DeratingFactor_P 0;
BA_ "GenSigTimeoutTime_MCPA" SG_ 295 SGCP_DeratingFactor_P 0;
BA_ "GenSigTimeoutTime_MCPB" SG_ 295 SGCP_DeratingFactor_P 0;
BA_ "GenSigTimeoutTime_SGCP" SG_ 295 SGCP_DeratingFactor_P 0;
BA_ "GenSigTimeoutTime_BPCM" SG_ 295 SGCP_Dschrge_Status_P 0;
BA_ "GenSigTimeoutTime_ECM" SG_ 295 SGCP_Dschrge_Status_P 0;
BA_ "GenSigTimeoutTime_IDCM" SG_ 295 SGCP_Dschrge_Status_P 0;
BA_ "GenSigTimeoutTime_MCPA" SG_ 295 SGCP_Dschrge_Status_P 0;
BA_ "GenSigTimeoutTime_MCPB" SG_ 295 SGCP_Dschrge_Status_P 0;
BA_ "GenSigTimeoutTime_SGCP" SG_ 295 SGCP_Dschrge_Status_P 0;
BA_ "GenSigTimeoutTime_BPCM" SG_ 295 SGCP_3PS_Pos_P 0;
BA_ "GenSigTimeoutTime_ECM" SG_ 295 SGCP_3PS_Pos_P 0;
BA_ "GenSigTimeoutTime_IDCM" SG_ 295 SGCP_3PS_Pos_P 0;
BA_ "GenSigTimeoutTime_MCPA" SG_ 295 SGCP_3PS_Pos_P 0;
BA_ "GenSigTimeoutTime_MCPB" SG_ 295 SGCP_3PS_Pos_P 0;
BA_ "GenSigTimeoutTime_SGCP" SG_ 295 SGCP_3PS_Pos_P 0;
BA_ "GenSigTimeoutTime_BPCM" SG_ 294 MCPB_Torque_Achieved_V_P 0;
BA_ "GenSigTimeoutTime_ECM" SG_ 294 MCPB_Torque_Achieved_V_P 0;
BA_ "GenSigTimeoutTime_IDCM" SG_ 294 MCPB_Torque_Achieved_V_P 0;
BA_ "GenSigTimeoutTime_MCPA" SG_ 294 MCPB_Torque_Achieved_V_P 0;
BA_ "GenSigTimeoutTime_MCPB" SG_ 294 MCPB_Torque_Achieved_V_P 0;
BA_ "GenSigTimeoutTime_SGCP" SG_ 294 MCPB_Torque_Achieved_V_P 0;
BA_ "GenSigTimeoutTime_BPCM" SG_ 294 MPR_PosSensor_P 0;
BA_ "GenSigTimeoutTime_ECM" SG_ 294 MPR_PosSensor_P 0;
BA_ "GenSigTimeoutTime_IDCM" SG_ 294 MPR_PosSensor_P 0;
BA_ "GenSigTimeoutTime_MCPA" SG_ 294 MPR_PosSensor_P 0;
BA_ "GenSigTimeoutTime_MCPB" SG_ 294 MPR_PosSensor_P 0;
BA_ "GenSigTimeoutTime_SGCP" SG_ 294 MPR_PosSensor_P 0;
BA_ "GenSigTimeoutTime_BPCM" SG_ 294 Plock_fdbk_sts_P 0;
BA_ "GenSigTimeoutTime_ECM" SG_ 294 Plock_fdbk_sts_P 0;
BA_ "GenSigTimeoutTime_IDCM" SG_ 294 Plock_fdbk_sts_P 0;
BA_ "GenSigTimeoutTime_MCPA" SG_ 294 Plock_fdbk_sts_P 0;
BA_ "GenSigStartValue" SG_ 294 MCPB_Torque_Achieved_P 8184;
BA_ "GenSigTimeoutTime_BPCM" SG_ 294 MCPB_Torque_Achieved_P 0;
BA_ "GenSigTimeoutTime_ECM" SG_ 294 MCPB_Torque_Achieved_P 0;
BA_ "GenSigTimeoutTime_IDCM" SG_ 294 MCPB_Torque_Achieved_P 0;
BA_ "GenSigTimeoutTime_MCPA" SG_ 294 MCPB_Torque_Achieved_P 0;
BA_ "GenSigTimeoutTime_MCPB" SG_ 294 MCPB_Torque_Achieved_P 0;
BA_ "GenSigTimeoutTime_SGCP" SG_ 294 MCPB_Torque_Achieved_P 0;
BA_ "GenSigTimeoutTime_ECM" SG_ 293 MCPA_Torque_Achieved_V_P 0;
BA_ "GenSigTimeoutTime_IDCM" SG_ 293 MCPA_Torque_Achieved_V_P 0;
BA_ "GenSigTimeoutTime_MCPA" SG_ 293 MCPA_Torque_Achieved_V_P 0;
BA_ "GenSigTimeoutTime_MCPB" SG_ 293 MCPA_Torque_Achieved_V_P 0;
BA_ "GenSigTimeoutTime_SGCP" SG_ 293 MCPA_Torque_Achieved_V_P 0;
BA_ "GenSigTimeoutTime_BPCM" SG_ 293 MCPA_Torque_Achieved_V_P 0;
BA_ "GenSigTimeoutTime_BPCM" SG_ 293 MCPA_TorqAchieved_AEMD_V_P 0;
BA_ "GenSigTimeoutTime_ECM" SG_ 293 MCPA_TorqAchieved_AEMD_V_P 0;
VAL_ 218 InputSpdRaw_LHOM 4095 "SNA";
VAL_ 218 HybridEngineMaxTorqAllowed_LHOM 4095 "SNA";
VAL_ 218 HybEstEngTorq_LHOM 4095 "SNA";
VAL_ 218 HybCmndEngTorqRespTyp_LHOM 0 "Inactive" 1 "PL" 2 "MR" 3 "SNA";
VAL_ 218 HybCmndEngTorqPrdtd_LHOM 4095 "SNA";
VAL_ 218 HybCmndEngTorqImmed_LHOM 4095 "SNA";
VAL_ 218 EngTrqReserveCmd_LHOM 255 "SNA";
VAL_ 217 Sum_FW_ID_Slw_LHOM 31 "SNA";
VAL_ 217 Sum_FW_ID_Fst_LHOM 31 "SNA";
VAL_ 217 MinPrdtdEngRunTorqCapV_LHOM 0 "Valid" 1 "Not_Valid";
VAL_ 217 MinPrdtdEngRunTorqCap_LHOM 4095 "SNA";
VAL_ 217 MinImmedEngTorqCapV_LHOM 0 "Valid" 1 "Not_Valid";
VAL_ 217 MinImmedEngTorqCap_LHOM 4095 "SNA";
VAL_ 217 MinEngTorqCapV_LHOM 0 "Valid" 1 "Not_Valid";
VAL_ 217 MinEngTorqCap_LHOM 4095 "SNA";
VAL_ 217 MinAirFlowMinSparkTorqCapV_LHOM 0 "Valid" 1 "Not_Valid";
VAL_ 217 MinAirFlowMinSparkTorqCap_LHOM 4095 "SNA";
VAL_ 217 MaxPrdtdEngTorqCapV_LHOM 0 "Valid" 1 "Not_Valid";
VAL_ 217 MaxPrdtdEngTorqCap_LHOM 4095 "SNA";
VAL_ 217 MaxOffEngTorqCap_LHOM 4095 "SNA";
VAL_ 217 LV12PwrFreeRq_LHOM 0 "Level_1_or_2_Power_free_Mode_NOT_active" 1 "Level_1_or_2_Power_free_Mode_Active";
VAL_ 217 HybActEngTorqRespTyp_LHOM 0 "Inactive" 1 "Pleasability_Limited" 2 "Maximum_Range";
VAL_ 217 Feedback_HCP_LHOM 0 "FALSE" 1 "TRUE";
VAL_ 217 ETRQ_Mode_LHOM 7 "SNA";
VAL_ 217 EssEngStrtIsNotAllwdID_LHOM 0 "EssReady" 1 "ESSActive" 2 "Inhibit" 3 "Disarm" 4 "Disable" 7 "SNA";
VAL_ 217 EssEngStrtIsNotAllwd_LHOM 0 "Start_Allowed" 1 "Start_Not_Allowed";
VAL_ 217 EssEngStopIsNotAllwdID_LHOM 0 "Engine_OverridableID" 1 "Engine_NotOverridableID" 2 "Aftertreatment_NotOverridableID" 3 "Burnoff_NotOverridableID" 4 "OBD_NotOverridableID" 5 "Sparkfoul_NotOverridableID" 6 "Hood_NotOverridableID" 7 "StaleFuel_NotOverridableID" 8 "Temperatures_NotOverridable" 9 "Occupant_NotOverridable" 15 "SNA";
VAL_ 217 EssEngStopIsNotAllwd_LHOM 0 "Stop_Allowed" 1 "Stop_Not_Allowed";
VAL_ 217 EssEngSt_LHOM 0 "Stopped" 1 "Starting" 2 "Running" 3 "Spinning" 4 "Stopping" 5 "Reversing" 6 "Not_Used" 7 "SNA";
VAL_ 217 EssEngModReq_LHOM 0 "Do_Nothing" 1 "Prepare_for_Start" 2 "Start" 3 "Prepare_for_Stop" 4 "Stop" 7 "SNA";
VAL_ 217 EngTrqReserveReq_LHOM 255 "SNA";
VAL_ 217 EngTrq_Enbl_Rq_TCM_LHOM 0 "Not_Active" 1 "Active";
VAL_ 217 EngineSts_LHOM 0 "Engine_Off" 1 "Engine_Cranking" 2 "Engine_On" 3 "SNA";
VAL_ 217 EngineSpeed_LHOM 16383 "SNA";
VAL_ 217 EngineIdleRefSpeed_LHOM 4095 "SNA";
VAL_ 217 EngineFrictionTorque_LHOM 511 "SNA";
VAL_ 217 EngAirFlwStdyStTorqV_LHOM 0 "Valid" 1 "Not_Valid";
VAL_ 217 EngAirFlwStdyStTorq_LHOM 4095 "SNA";
VAL_ 217 EngActStdyStTorqV_LHOM 0 "Valid" 1 "Not_Valid";
VAL_ 217 EngActStdyStTorq_LHOM 4095 "SNA";
VAL_ 217 ECM_LHOM_Trans 0 "Limp_Home_not_Active" 1 "No_Redundant_Torque_Req" 2 "Precise_Torque" 3 "Imprecise_Torque";
VAL_ 217 ECM_LHOM 0 "Not_In_Limp_Home" 1 "In_Limp_Home";
VAL_ 505 SGCP_DerateReason_P 0 "Reason1" 1 "Reason2" 2 "Reason3" 3 "Reason4" 4 "Reason5" 5 "Reason6" 6 "Reason7" 7 "Reason8" 8 "Reason9" 9 "Reason10" 10 "Reason11" 11 "Reason12" 12 "Reason13" 13 "Reason14" 14 "Reason15" 15 "Reason16";
VAL_ 505 SGCP_DC_Voltage_P 1023 "SNA";
VAL_ 505 SGCP_DC_Volt_V_P 0 "Valid" 1 "Invalid";
VAL_ 505 SGCP_DC_Current_V_P 0 "Valid" 1 "Invalid";
VAL_ 505 SGCP_CoolantTemp_P 2047 "SNA";
VAL_ 295 SGCP_Torque_Achieved_V_P 0 "Valid" 1 "Invalid";
VAL_ 295 SGCP_Torque_Achieved_P 16383 "SNA";
VAL_ 295 SGCP_TorqAchieved_AEMD_V_P 0 "Valid" 1 "Invalid";
VAL_ 295 SGCP_TorqAchieved_AEMD_P 16383 "SNA";
VAL_ 295 SGCP_SPT_Stat_P 0 "Undetermined" 1 "Passed" 2 "Failed";
VAL_ 295 SGCP_RPM_V_P 0 "Valid" 1 "Invalid";
VAL_ 295 SGCP_RPM_P 65535 "SNA";
VAL_ 295 SGCP_MtrMinCpbltyTrq_P 16383 "SNA";
VAL_ 295 SGCP_MtrMaxCpbltyTrq_P 16383 "SNA";
VAL_ 295 SGCP_MtrIndex_P 31 "SNA";
VAL_ 295 SGCP_MinTorq_P 16383 "SNA";
VAL_ 295 SGCP_MaxTorq_P 16383 "SNA";
VAL_ 295 SGCP_Invrtr_State_P 0 "NORMAL_POWER_STAGE_OFF " 1 "NORMAL_POWER_STAGE_ON " 2 "NORMAL_POWER_STAGE_OVERRIDE" 3 "ACTIVE_DISCHARGE " 4 "INVERTER_FAULTED " 5 "NORMAL_POWER_STAGE_OFF_HV_RQD" 6 "NORMAL_VC_PRIMING" 7 "NORMAL_VC_ON";
VAL_ 295 SGCP_InterlockSts_P 0 "Not_Performed" 1 "OK" 2 "Fail" 3 "Invalid";
VAL_ 295 SGCP_HV_CnctrOpn_Req_P 0 "False" 1 "True";
VAL_ 295 SGCP_Dschrge_Status_P 0 "AD_INDETERMINATE" 1 "AD_INPROGRESSFail" 2 "AD_COMPLETE" 3 "AD_FAILED";
VAL_ 295 SGCP_DeratingFactor_P 63 "SNA";
VAL_ 295 SGCP_CpbltySpdDivVolt_P 65535 "SNA";
VAL_ 295 SGCP_AccelRawV_P 0 "Valid" 1 "Invalid";
VAL_ 295 SGCP_6SO_Status_P 0 "3PS" 1 "6SO" 2 "Switching" 3 "SNA";
VAL_ 295 SGCP_3PS_Pos_P 0 "False" 1 "True";
VAL_ 504 MCPB_DerateReason_P 0 "Reason1" 1 "Reason2" 2 "Reason3" 3 "Reason4" 4 "Reason5" 5 "Reason6" 6 "Reason7" 7 "Reason8" 8 "Reason9" 9 "Reason10" 10 "Reason11" 11 "Reason12" 12 "Reason13" 13 "Reason14" 14 "Reason15" 15 "Reason16";
VAL_ 504 MCPB_DC_Voltage_P 1023 "SNA";
VAL_ 504 MCPB_DC_Volt_V_P 0 "Valid" 1 "Invalid";
VAL_ 504 MCPB_DC_Current_V_P 0 "Valid" 1 "Invalid";
VAL_ 504 MCPB_CoolantTemp_P 2047 "SNA";
VAL_ 294 PlockFailSts_P 0 "Fault_Not_Present" 1 "Derating" 2 "Retrying" 3 "Non recoverable critical fault" 7 "SNA";
VAL_ 294 Plock_PosSensor_P 0 "Init" 1 "Unknown" 2 "Engaged" 3 "Between Engaged and Disengaged" 4 "Tooth to Tooth" 5 "Disengaged" 7 "SNA";
VAL_ 294 Plock_MotorPosSts_P 0 "Init" 1 "Unknown" 2 "Engaged Endstop" 3 "Engaged" 4 "Between Engaged and Disengaged" 5 "Disengaged" 6 "Disengaged Endstop" 7 "SNA";
VAL_ 294 Plock_fdbk_sts_P 0 "Init" 1 "Engaging" 2 "Engaged" 3 "Disengaging" 4 "Disengaged" 5 "Fault" 7 "SNA";
VAL_ 294 MPR_PosSensor_P 0 "Init" 1 "Unknown" 2 "Engaged" 3 "Disengaged" 7 "SNA";
VAL_ 294 MCPB_Torque_Achieved_V_P 0 "Valid" 1 "Invalid";
VAL_ 294 MCPB_Torque_Achieved_P 16383 "SNA";
VAL_ 294 MCPB_TorqAchieved_AEMD_V_P 0 "Valid" 1 "Invalid";
VAL_ 294 MCPB_TorqAchieved_AEMD_P 16383 "SNA";
VAL_ 294 MCPB_SPT_Stat_P 0 "Undetermined " 1 "Passed" 2 "Failed";
VAL_ 294 MCPB_RPM_V_P 0 "Valid" 1 "Invalid";
VAL_ 294 MCPB_RPM_P 65535 "SNA";
VAL_ 294 MCPB_MtrMinCpbltyTrq_P 16383 "SNA";
VAL_ 294 MCPB_MtrMaxCpbltyTrq_P 16383 "SNA";
VAL_ 294 MCPB_MtrIndex_P 31 "SNA";
VAL_ 294 MCPB_MinTorq_P 16383 "SNA";
VAL_ 294 MCPB_MaxTorq_P 16383 "SNA";
VAL_ 294 MCPB_Invrtr_State_P 0 "NORMAL_POWER_STAGE_OFF " 1 "NORMAL_POWER_STAGE_ON " 2 "NORMAL_POWER_STAGE_OVERRIDE" 3 "ACTIVE_DISCHARGE " 4 "INVERTER_FAULTED " 5 "NORMAL_POWER_STAGE_OFF_HV_RQD" 6 "NORMAL_VC_PRIMING" 7 "NORMAL_VC_ON";
VAL_ 294 MCPB_InterlockSts_P 0 "Not_Performed" 1 "OK" 2 "Fail" 3 "Invalid";
VAL_ 294 MCPB_HV_CnctrOpn_Req_P 0 "False" 1 "True";
VAL_ 294 MCPB_Dschrge_Status_P 0 "AD_INDETERMINATE" 1 "AD_INPROGRESS" 2 "AD_COMPLETE" 3 "AD_FAILED";
VAL_ 294 MCPB_DeratingFactor_P 63 "SNA";
VAL_ 294 MCPB_CpbltySpdDivVolt_P 65535 "SNA";
VAL_ 294 MCPB_AccelRawV_P 0 "Valid" 1 "Invalid";
VAL_ 294 MCPB_6SO_Status_P 0 "ThreePS" 1 "SixSO" 2 "Switching" 3 "SNA";
VAL_ 294 MCPB_3PS_Pos_P 0 "False" 1 "True";
VAL_ 503 MCPA_DerateReason_P 0 "Reason1" 1 "Reason2" 2 "Reason3" 3 "Reason4" 4 "Reason5" 5 "Reason6" 6 "Reason7" 7 "Reason8" 8 "Reason9" 9 "Reason10" 10 "Reason11" 11 "Reason12" 12 "Reason13" 13 "Reason14" 14 "Reason15" 15 "Reason16";
VAL_ 503 MCPA_DC_Voltage_P 1023 "SNA";
VAL_ 503 MCPA_DC_Volt_V_P 0 "Valid" 1 "Invalid";
VAL_ 503 MCPA_DC_Current_V_P 0 "Valid" 1 "Invalid";
VAL_ 503 MCPA_CoolantTemp_P 2047 "SNA";
VAL_ 293 MCPA_Torque_Achieved_V_P 0 "Valid" 1 "Invalid";
VAL_ 293 MCPA_Torque_Achieved_P 16383 "SNA";
VAL_ 293 MCPA_TorqAchieved_AEMD_V_P 0 "Valid" 1 "Invalid";
VAL_ 293 MCPA_TorqAchieved_AEMD_P 16383 "SNA";
VAL_ 293 MCPA_SPT_Stat_P 0 "Undetermined" 1 "Passed" 2 "Failed";
VAL_ 293 MCPA_RPM_V_P 0 "Valid" 1 "Invalid";
VAL_ 293 MCPA_RPM_P 65535 "SNA";
VAL_ 293 MCPA_MtrMinCpbltyTrq_P 16383 "SNA";
VAL_ 293 MCPA_MtrMaxCpbltyTrq_P 16383 "SNA";
VAL_ 293 MCPA_MtrIndex_P 31 "SNA";
VAL_ 293 MCPA_MinTorq_P 16383 "SNA";
VAL_ 293 MCPA_MaxTorq_P 16383 "SNA";
VAL_ 293 MCPA_Invrtr_State_P 0 "NORMAL_POWER_STAGE_OFF" 1 "NORMAL_POWER_STAGE_ON" 2 "NORMAL_POWER_STAGE_OVERRIDE" 3 "ACTIVE_DISCHARGE" 4 "INVERTER_FAULTED" 5 "NORMAL_POWER_STAGE_OFF_HV_RQD" 6 "NORMAL_VC_PRIMING" 7 "NORMAL_VC_ON";
VAL_ 293 MCPA_InterlockSts_P 0 "Not_Performed" 1 "OK" 2 "Fail" 3 "Invalid";
VAL_ 293 MCPA_HV_CnctrOpn_Req_P 0 "False" 1 "True";
VAL_ 293 MCPA_Dschrge_Status_P 0 "AD_INDETERMINATE" 1 "AD_INPROGRESS" 2 "AD_COMPLETE" 3 "AD_FAILED";
VAL_ 293 MCPA_DeratingFactor_P 63 "SNA";
VAL_ 293 MCPA_CpbltySpdDivVolt_P 65535 "SNA";
VAL_ 293 MCPA_AccelRawV_P 0 "Valid" 1 "Invalid";
VAL_ 293 MCPA_6SO_Status_P 0 "ThreePS" 1 "SixSO" 2 "Switching" 3 "SNA";
VAL_ 293 MCPA_3PS_Pos_P 0 "False" 1 "True";
VAL_ 297 Pwr_Electr_Loop_FlwRate_SGCP_P 255 "SNA";
VAL_ 297 Pwr_Electr_Loop_FlwRate_MCPB_P 255 "SNA";
VAL_ 297 Pwr_Electr_Loop_FlwRate_MCPA_P 255 "SNA";
VAL_ 297 EVCU_MotorC_Speed 65535 "SNA";
VAL_ 297 EVCU_MotorB_Speed 65535 "SNA";
VAL_ 297 EVCU_MotorA_Speed 65535 "SNA";
VAL_ 296 VehicleSpeedVSOSig_P 8191 "SNA";
VAL_ 296 TorqueCommand_SGCP_P 16383 "SNA";
VAL_ 296 TorqueCommand_MCPB_P 16383 "SNA";
VAL_ 296 TorqueCommand_MCPA_P 16383 "SNA";
VAL_ 296 ShiftLeverPosition_P 0 "No_Selection_Active_Or_Available" 1 "Park" 2 "Reverse" 3 "Neutral" 4 "Drive" 5 "Low" 6 "TIP_Autostick" 7 "Plus" 8 "Minus" 9 "Sport" 15 "SNA";
VAL_ 296 ParkCmd_PT_P 0 "No_Request" 1 "Disengage" 2 "Engage" 3 "SNA";
VAL_ 296 Mtr_6SO_Request_SGCP_P 0 "False" 1 "True";
VAL_ 296 Mtr_6SO_Request_MCPB_P 0 "False" 1 "True";
VAL_ 296 Mtr_6SO_Request_MCPA_P 0 "False" 1 "True";
VAL_ 296 ModeCommand_SGCP_P 0 "Inverter_Disabled" 1 "Torque_Control" 2 "Speed_Control" 3 "Active_Discharge" 4 "Disable_Immediate" 5 "Voltage_Control" 6 "0x6 Rapid_Shutdown" 7 "Shutdown_Initiated" 8 "ROL_Routine" 9 "Active_Short_Circuit" 15 "SNA";
VAL_ 296 ModeCommand_MCPB_P 0 "Inverter_Disabled" 1 "Torque_Control" 2 "Speed_Control" 3 "Active_Discharge" 4 "Disable_Immediate" 5 "Voltage_Control" 6 "0x6 Rapid_Shutdown" 7 "Shutdown_Initiated" 8 "ROL_Routine" 9 "Active_Short_Circuit" 15 "SNA";
VAL_ 296 ModeCommand_MCPA_P 0 "Inverter_Disabled" 1 "Torque_Control" 2 "Speed_Control" 3 "Active_Discharge" 4 "Disable_Immediate" 5 "Voltage_Control" 6 "0x6 Rapid_Shutdown" 7 "Shutdown_Initiated" 8 "ROL_Routine" 9 "Active_Short_Circuit" 15 "SNA";
VAL_ 296 CmdIgnSts_P 0 "Initialization" 1 "IGN_LK" 3 "ACC" 4 "RUN" 5 "START" 7 "SNA";
VAL_ 296 BPCM_HV_TractionBusVoltage_P 2047 "SNA";
VAL_ 296 BPCM_HV_Trac_Main_Contac_Sts_P 0 "Open" 1 "Closed" 3 "Error_Stuck_Open" 4 "Error_Stuck_Closed" 7 "SNA";
VAL_ 296 AEMD_MinOffset_SGCP_P 16383 "SNA";
VAL_ 296 AEMD_MinOffset_MCPB_P 16383 "SNA";
VAL_ 296 AEMD_MinOffset_MCPA_P 16383 "SNA";
VAL_ 296 AEMD_MaxOffset_SGCP_P 16383 "SNA";
VAL_ 296 AEMD_MaxOffset_MCPB_P 16383 "SNA";
VAL_ 296 AEMD_MaxOffset_MCPA_P 16383 "SNA";
VAL_ 294 MCPB_AccelRaw_P 65535 "SNA";
VAL_ 293 MCPA_AccelRaw_P 65535 "SNA";
VAL_ 296 AEMD_Sclr_Gn_MCPB_P 511 "SNA";
VAL_ 296 AEMD_Sclr_Gn_MCPA_P 511 "SNA";
VAL_ 505 SGCP_PIM_AC_Side_Busbar_Temp_P 255 "SNA";
VAL_ 505 SGCP_PIM_DC_Side_Busbar_Temp_P 255 "SNA";
VAL_ 505 SGCP_Rotor_Temperature_P 255 "SNA";
VAL_ 505 SGCP_Service_Lamp_Request_P 0 "False" 1 "True";
VAL_ 505 CLrDiagInfo_SGCP_P 0 "False" 1 "True";
VAL_ 505 SGCP_Control_Board_Temperature_P 255 "SNA";
VAL_ 505 SGCP_Inverter_Temp_P 255 "SNA";
VAL_ 295 SGCP_AccelRaw_P 65535 "SNA";
VAL_ 295 SGCP_Temp_P 255 "SNA";
VAL_ 295 SGCP_AC_Isolation_Status_P 0 "Not_Performed" 1 "Invalid" 2 "Fail" 3 "Pass";
VAL_ 504 MCPB_Inverter_Temp_P 255 "SNA";
VAL_ 504 MCPB_PIM_DC_Side_Busbar_Temp_P 255 "SNA";
VAL_ 504 MCPB_Rotor_Temperature_P 255 "SNA";
VAL_ 504 MCPB_Service_Lamp_Request_P 0 "False" 1 "True";
VAL_ 504 CLrDiagInfo_MCPB_P 0 "False" 1 "True";
VAL_ 504 MCPB_Control_Board_Temperature_P 255 "SNA";
VAL_ 294 MCPB_AC_Isolation_Status_P 0 "Not_Performed" 1 "Invalid" 2 "Fail" 3 "Pass";
VAL_ 294 MCPB_Temp_P 255 "SNA";
VAL_ 503 MCPA_Inverter_Temp_P 255 "SNA";
VAL_ 503 MCPA_PIM_DC_Side_Busbar_Temp_P 255 "SNA";
VAL_ 503 MCPA_Rotor_Temperature_P 255 "SNA";
VAL_ 503 MCPA_Service_Lamp_Request_P 0 "False" 1 "True";
VAL_ 503 CLrDiagInfo_MCPA_P 0 "False" 1 "True";
VAL_ 503 MCPA_Control_Board_Temperature_P 255 "SNA";
VAL_ 293 MCPA_Temp_P 255 "SNA";
VAL_ 293 MCPA_AC_Isolation_Status_P 0 "Not_Performed" 1 "Invalid" 2 "Fail" 3 "Pass";
SIG_GROUP_ 218 HYBRID_FD_LHOM_Pkt 1 : TransInpSpdPrfl_LHOM MessageCounter_HYBRID_FD_LHOM InputSpdRaw_LHOM IdleSpeedActiveSts_LHOM HybridEngineMaxTorqAllowed_LHOM HybFeedback_Engine_LHOM HybEstEngTorqV_LHOM HybEstEngTorq_LHOM HybCmndEngTorqRespTyp_LHOM HybCmndEngTorqPrdtd_LHOM HybCmndEngTorqImmed_LHOM EngTrqReserveCmd_LHOM EngCntrlMode_LHOM ECMPrepIdleRes_LHOM CRC_HYBRID_FD_LHOM;
SIG_GROUP_ 217 ENGINE_FD_LHOM_Pkt 1 : Sum_FW_ID_Slw_LHOM Sum_FW_ID_Fst_LHOM MinPrdtdEngRunTorqCapV_LHOM MinPrdtdEngRunTorqCap_LHOM MinImmedEngTorqCapV_LHOM MinImmedEngTorqCap_LHOM MinEngTorqCapV_LHOM MinEngTorqCap_LHOM MinAirFlowMinSparkTorqCapV_LHOM MinAirFlowMinSparkTorqCap_LHOM MC_ENGINE_FD_LHOM MaxPrdtdEngTorqCapV_LHOM MaxPrdtdEngTorqCap_LHOM MaxOffEngTorqCap_LHOM LV12PwrFreeRq_LHOM HybActEngTorqRespTyp_LHOM Feedback_HCP_LHOM ETRQ_Mode_LHOM EssEngStrtIsNotAllwdID_LHOM EssEngStrtIsNotAllwd_LHOM EssEngStopIsNotAllwdID_LHOM EssEngStopIsNotAllwd_LHOM EssEngSt_LHOM EssEngModReq_LHOM EngTrqReserveReq_LHOM EngTrq_Enbl_Rq_TCM_LHOM EngineSts_LHOM EngineSpeed_LHOM EngineIdleRefSpeed_LHOM EngineFrictionTorque_LHOM EngAirFlwStdyStTorqV_LHOM EngAirFlwStdyStTorq_LHOM EngActStdyStTorqV_LHOM EngActStdyStTorq_LHOM ECM_LHOM_Trans ECM_LHOM CRC_ENGINE_FD_LHOM;
SIG_GROUP_ 297 INVTARGET_PROPULSION2_Pkt 1 : UDCMin_Unlim_SGCP_P UDCMin_Unlim_MCPB_P UDCMin_Unlim_MCPA_P UDCMax_Unlim_SGCP_P UDCMax_Unlim_MCPB_P UDCMax_Unlim_MCPA_P TqGrdtLim_SGCP_P TqGrdtLim_MCPB_P TqGrdtLim_MCPA_P SpdGrdtLim_SGCP_P SpdGrdtLim_MCPB_P SpdGrdtLim_MCPA_P Pwr_Electr_Loop_FlwRate_SGCP_P Pwr_Electr_Loop_FlwRate_MCPB_P Pwr_Electr_Loop_FlwRate_MCPA_P MC_INVTARGET_PROPULSION2 EVCU_MotorC_Speed EVCU_MotorB_Speed EVCU_MotorA_Speed CRC_INVTARGET_PROPULSION2;
SIG_GROUP_ 296 INVTARGET_PROPULSION1_Pkt 1 : VehicleSpeedVSOSig_P TorqueCommand_SGCP_P TorqueCommand_MCPB_P TorqueCommand_MCPA_P TargetMotorRPM_SGCP_P TargetMotorRPM_MCPB_P TargetMotorRPM_MCPA_P ShiftLeverPosition_P ParkCmd_PT_P Mtr_6SO_Request_SGCP_P Mtr_6SO_Request_MCPB_P Mtr_6SO_Request_MCPA_P ModeCommand_SGCP_P ModeCommand_MCPB_P ModeCommand_MCPA_P MC_INVTARGET_PROPULSION1 CRC_INVTARGET_PROPULSION1 CmdIgnSts_P BPCM_HV_TractionBusVoltage_P BPCM_HV_Trac_Main_Contac_Sts_P AEMD_Sclr_Gn_SGCP_P AEMD_MinOffset_SGCP_P AEMD_MinOffset_MCPB_P AEMD_MinOffset_MCPA_P AEMD_MaxOffset_SGCP_P AEMD_MaxOffset_MCPB_P AEMD_MaxOffset_MCPA_P AEMD_Cutoff_FreqLow_SGCP_P AEMD_Cutoff_FreqLow_MCPB_P AEMD_Cutoff_FreqLow_MCPA_P AEMD_Cutoff_FreqHigh_SGCP_P AEMD_Cutoff_FreqHigh_MCPB_P AEMD_Cutoff_FreqHigh_MCPA_P AEMD_Sclr_Gn_MCPB_P AEMD_Sclr_Gn_MCPA_P;
SIG_GROUP_ 294 MCPB_PROPULSION_Pkt 1 : PlockFailSts_P Plock_PosSensor_P Plock_MotorPosSts_P Plock_fdbk_sts_P MPR_PosSensor_P MCPB_Torque_Achieved_V_P MCPB_Torque_Achieved_P MCPB_TorqAchieved_AEMD_V_P MCPB_TorqAchieved_AEMD_P MCPB_SPT_Stat_P MCPB_Spd_Lim_P MCPB_RPM_V_P MCPB_RPM_P MCPB_MtrMinCpbltyTrq_P MCPB_MtrMaxCpbltyTrq_P MCPB_MtrIndex_P MCPB_MinTorq_P MCPB_MaxTorq_P MCPB_Invrtr_State_P MCPB_InterlockSts_P MCPB_HV_CnctrOpn_Req_P MCPB_Dschrge_Status_P MCPB_DeratingFactor_P MCPB_CpbltySpdDivVolt_P MCPB_AccelRawV_P MCPB_6SO_Status_P MCPB_3PS_Pos_P MCPB_AccelRaw_P MC_MCPB_PROPULSION CRC_MCPB_PROPULSION MCPB_AC_Isolation_Status_P MCPB_Temp_P;
SIG_GROUP_ 293 MCPA_PROPULSION_Pkt 1 : MCPA_Torque_Achieved_V_P MCPA_Torque_Achieved_P MCPA_TorqAchieved_AEMD_V_P MCPA_TorqAchieved_AEMD_P MCPA_SPT_Stat_P MCPA_Spd_Lim_P MCPA_RPM_V_P MCPA_RPM_P MCPA_MtrMinCpbltyTrq_P MCPA_MtrMaxCpbltyTrq_P MCPA_MtrIndex_P MCPA_MinTorq_P MCPA_MaxTorq_P MCPA_Invrtr_State_P MCPA_InterlockSts_P MCPA_HV_CnctrOpn_Req_P MCPA_Dschrge_Status_P MCPA_DeratingFactor_P MCPA_CpbltySpdDivVolt_P MCPA_AccelRawV_P MCPA_6SO_Status_P MCPA_3PS_Pos_P MCPA_AccelRaw_P MC_MCPA_PROPULSION CRC_MCPA_PROPULSION MCPA_Temp_P MCPA_AC_Isolation_Status_P;
SIG_GROUP_ 295 SGCP_PROPULSION_Pkt 1 : SGCP_Torque_Achieved_V_P SGCP_Torque_Achieved_P SGCP_TorqAchieved_AEMD_V_P SGCP_TorqAchieved_AEMD_P SGCP_SPT_Stat_P SGCP_Spd_Lim_P SGCP_RPM_V_P SGCP_RPM_P SGCP_MtrMinCpbltyTrq_P SGCP_MtrMaxCpbltyTrq_P SGCP_MtrIndex_P SGCP_MinTorq_P SGCP_MaxTorq_P SGCP_Invrtr_State_P SGCP_InterlockSts_P SGCP_HV_CnctrOpn_Req_P SGCP_Dschrge_Status_P SGCP_DeratingFactor_P SGCP_CpbltySpdDivVolt_P SGCP_AccelRawV_P SGCP_6SO_Status_P SGCP_3PS_Pos_P SGCP_AccelRaw_P SGCP_Temp_P CRC_SGCP_PROPULSION MC_SGCP_PROPULSION SGCP_AC_Isolation_Status_P;

VERSION ""

NS_ :

BS_:

BU_: PPIM HCP VDCM APM2 SGW IDCM EVCU2 BPCM

BO_ 485 BATTERY_HV_VLIMITS: 64 BPCM
 SG_ MessageCounter_BATT_HV_VLIMITS : 435|4@0+ (1,0) [0|15] "-"  EVCU2
 SG_ CRC_BATT_HV_VLIMITS : 447|8@0+ (1,0) [0|255] "-"  EVCU2
 SG_ BPCM_HV_NumCellMinTemp : 224|9@0+ (1,0) [0|511] "" EVCU2
 SG_ BPCM_HV_NumCellMaxTemp : 192|9@0+ (1,0) [0|511] "" EVCU2
 SG_ BPCM_HV_NumCellMinVolt : 80|9@0+ (1,0) [0|511] "" EVCU2
 SG_ BPCM_HV_NumCellMaxVolt : 64|9@0+ (1,0) [0|511] "" EVCU2
 SG_ BPCM_Min_Pk_Volt_Allowed : 50|11@0+ (1,0) [0|2047] "V"  EVCU2
 SG_ BPCM_Max_Pk_Volt_Allowed : 18|11@0+ (1,0) [0|2047] "V"  EVCU2
 SG_ BPCM_OCV_Min_Cell_Volt : 180|13@0+ (0.001,0) [0|8.191] "V"  EVCU2
 SG_ BPCM_OCV_Max_Cell_Volt : 164|13@0+ (0.001,0) [0|8.191] "V"  EVCU2
 SG_ BPCM_OCV_Avg_Cell_Volt : 148|13@0+ (0.001,0) [0|8.191] "V"  EVCU2
 SG_ BPCM_Min_Cell_Volt_Allowed : 36|13@0+ (0.001,0) [0|8.191] "V"  EVCU2
 SG_ BPCM_Max_Cell_Volt_Allowed : 132|13@0+ (0.001,0) [0|8.191] "V"  EVCU2
 SG_ BPCM_HV_Insulation_Resistance : 215|16@0+ (1,0) [0|65535] "kOhm"  EVCU2
 SG_ BPCM_Cell_Volt_Min : 116|13@0+ (0.001,0) [0|8.191] "V"  EVCU2
 SG_ BPCM_Cell_Volt_Max : 100|13@0+ (0.001,0) [0|8.191] "V"  EVCU2
 SG_ BPCM_Cell_Volt_Avg : 4|13@0+ (0.001,0) [0|8.191] "V"  EVCU2

BO_ 288 BATTERY_HV_POWERLIMITS: 64 BPCM
 SG_ BPCM_HV_HVBatChargeStat : 215|3@0+ (1,0) [0|7] "" EVCU2
 SG_ BPCM_HV_PwrLmtInstDschg : 245|14@0+ (0.1,0) [0|1638.3] "" EVCU2
 SG_ BPCM_HV_PwrLmtInstChrg : 309|14@0+ (0.1,0) [0|1638.3] "" EVCU2
 SG_ BPCM_HV_Pwr_MaxDischrg_ShrTrm : 69|14@0+ (0.1,0) [0|1638.3] "kW"  EVCU2
 SG_ BPCM_HV_Power_MaxDischarge_MdTrm : 133|14@0+ (0.1,0) [0|1638.3] "kW"  EVCU2
 SG_ BPCM_HV_Power_MaxDischarge_LgTrm : 197|14@0+ (0.1,0) [0|1638.3] "kW"  EVCU2
 SG_ BPCM_HV_Power_MaxCharge_ShrTrm : 53|14@0+ (0.1,0) [0|1638.3] "kW"  EVCU2
 SG_ BPCM_HV_Power_MaxCharge_MdTrm : 117|14@0+ (0.1,0) [0|1638.3] "kW"  EVCU2
 SG_ BPCM_HV_Power_MaxCharge_LgTrm : 181|14@0+ (0.1,0) [0|1638.3] "kW"  EVCU2
 SG_ BPCM_HV_CrntLmtInstDschg : 374|15@0+ (0.1,0) [0|3276.7] "A"  EVCU2
 SG_ BPCM_HV_CrntLmtInstChrg : 390|15@0+ (0.1,0) [0|3276.7] "A"  EVCU2
 SG_ BPCM_HV_ChargingCurrentProfile : 6|15@0+ (0.1,0) [0|3276.7] "A"  EVCU2
 SG_ BPCM_HV_Cell_MinDischrg_Imped : 228|13@0+ (0.01,0) [0|81.91] "Ohm"  EVCU2
 SG_ BPCM_HV_Cell_MaxDischrg_Imped : 212|13@0+ (0.01,0) [0|81.91] "Ohm"  EVCU2
 SG_ BPCM_CntctrsShtTrmOpeningWarn : 417|1@0+ (1,0) [0|1] "" EVCU2,IDCM
 SG_ BPCM_CntctrsMidTrmOpeningWarn : 416|1@0+ (1,0) [0|1] "" EVCU2
 SG_ MessageCounter_BATT_HV_POWERLIMS : 435|4@0+ (1,0) [0|15] "-"  EVCU2
 SG_ CRC_BATT_HV_POWERLIMS : 447|8@0+ (1,0) [0|255] "-"  EVCU2

BO_ 2564682306 DIAGNOSTIC_ROE_FD_EVCU2: 64 EVCU2
 SG_ N_PDU_18DDF242 : 7|64@0+ (1,0) [0|0] "" SGW

BO_ 2564682050 DIAGNOSTIC_ROE_EVCU2: 8 EVCU2
 SG_ N_PDU_18DDF142 : 7|64@0+ (1,0) [0|0] "" SGW

BO_ 2564485698 DIAGNOSTIC_RESPONSE_FD_EVCU2: 64 EVCU2
 SG_ N_PDU_18DAF242 : 7|64@0+ (1,0) [0|0] "" SGW

BO_ 2564485442 DIAGNOSTIC_RESPONSE_EVCU2: 8 EVCU2
 SG_ N_PDU_18DAF142 : 7|64@0+ (1,0) [0|0] "" SGW

BO_ 2564440818 DIAGNOSTIC_REQUEST_FD_EVCU2: 64 SGW
 SG_ N_PDU_18DA42F2 : 455|64@0+ (1,0) [0|0] "" EVCU2

BO_ 2564440817 DIAGNOSTIC_REQUEST_EVCU2: 8 SGW
 SG_ N_PDU_18DA42F1 : 7|64@0+ (1,0) [0|0] "" EVCU2

BO_ 1965 HVBATTERY_RM_CELLS9: 64 BPCM
 SG_ HVBatCellVoltage_Cell232 : 244|13@0+ (0.001,0) [0|5] "V"  SGW
 SG_ HVBatCellVoltage_Cell231 : 228|13@0+ (0.001,0) [0|5] "V"  SGW
 SG_ HVBatCellVoltage_Cell230 : 212|13@0+ (0.001,0) [0|5] "V"  SGW
 SG_ HVBatCellVoltage_Cell229 : 196|13@0+ (0.001,0) [0|5] "V"  SGW
 SG_ HVBatCellVoltage_Cell228 : 180|13@0+ (0.001,0) [0|5] "V"  SGW
 SG_ HVBatCellVoltage_Cell227 : 164|13@0+ (0.001,0) [0|5] "V"  SGW
 SG_ HVBatCellVoltage_Cell226 : 148|13@0+ (0.001,0) [0|5] "V"  SGW
 SG_ HVBatCellVoltage_Cell225 : 132|13@0+ (0.001,0) [0|5] "V"  SGW
 SG_ HVBatCellVoltage_Cell224 : 116|13@0+ (0.001,0) [0|5] "V"  SGW
 SG_ HVBatCellVoltage_Cell223 : 100|13@0+ (0.001,0) [0|5] "V"  SGW
 SG_ HVBatCellVoltage_Cell222 : 84|13@0+ (0.001,0) [0|5] "V"  SGW
 SG_ HVBatCellVoltage_Cell221 : 68|13@0+ (0.001,0) [0|5] "V"  SGW
 SG_ HVBatCellVoltage_Cell220 : 52|13@0+ (0.001,0) [0|5] "V"  SGW
 SG_ HVBatCellVoltage_Cell219 : 36|13@0+ (0.001,0) [0|5] "V"  SGW
 SG_ HVBatCellVoltage_Cell218 : 20|13@0+ (0.001,0) [0|5] "V"  SGW
 SG_ HVBatCellVoltage_Cell217 : 4|13@0+ (0.001,0) [0|5] "V"  SGW

BO_ 1963 HVBATTERY_RM_CELLS15: 64 BPCM
 SG_ HVBatCellVoltage_Cell400 : 92|13@0+ (0.001,0) [0|5] "V"  SGW
 SG_ HVBatCellVoltage_Cell399 : 73|13@0+ (0.001,0) [0|5] "V"  SGW
 SG_ HVBatCellVoltage_Cell398 : 70|13@0+ (0.001,0) [0|5] "V"  SGW
 SG_ HVBatCellVoltage_Cell397 : 51|13@0+ (0.001,0) [0|5] "V"  SGW
 SG_ HVBatCellVoltage_Cell396 : 32|13@0+ (0.001,0) [0|5] "V"  SGW
 SG_ HVBatCellVoltage_Cell395 : 29|13@0+ (0.001,0) [0|5] "V"  SGW
 SG_ HVBatCellVoltage_Cell394 : 10|13@0+ (0.001,0) [0|5] "V"  SGW
 SG_ HVBatCellVoltage_Cell393 : 7|13@0+ (0.001,0) [0|5] "V"  SGW

BO_ 1962 HVBATTERY_RM_CELLS14: 64 BPCM
 SG_ HVBatCellVoltage_Cell392 : 404|13@0+ (0.001,0) [0|5] "V"  SGW
 SG_ HVBatCellVoltage_Cell391 : 385|13@0+ (0.001,0) [0|5] "V"  SGW
 SG_ HVBatCellVoltage_Cell390 : 382|13@0+ (0.001,0) [0|5] "V"  SGW
 SG_ HVBatCellVoltage_Cell389 : 363|13@0+ (0.001,0) [0|5] "V"  SGW
 SG_ HVBatCellVoltage_Cell388 : 344|13@0+ (0.001,0) [0|5] "V"  SGW
 SG_ HVBatCellVoltage_Cell387 : 341|13@0+ (0.001,0) [0|5] "V"  SGW
 SG_ HVBatCellVoltage_Cell386 : 322|13@0+ (0.001,0) [0|5] "V"  SGW
 SG_ HVBatCellVoltage_Cell385 : 319|13@0+ (0.001,0) [0|5] "V"  SGW
 SG_ HVBatCellVoltage_Cell384 : 300|13@0+ (0.001,0) [0|5] "V"  SGW
 SG_ HVBatCellVoltage_Cell383 : 281|13@0+ (0.001,0) [0|5] "V"  SGW
 SG_ HVBatCellVoltage_Cell382 : 278|13@0+ (0.001,0) [0|5] "V"  SGW
 SG_ HVBatCellVoltage_Cell381 : 259|13@0+ (0.001,0) [0|5] "V"  SGW
 SG_ HVBatCellVoltage_Cell380 : 240|13@0+ (0.001,0) [0|5] "V"  SGW
 SG_ HVBatCellVoltage_Cell379 : 237|13@0+ (0.001,0) [0|5] "V"  SGW
 SG_ HVBatCellVoltage_Cell378 : 218|13@0+ (0.001,0) [0|5] "V"  SGW
 SG_ HVBatCellVoltage_Cell377 : 215|13@0+ (0.001,0) [0|5] "V"  SGW
 SG_ HVBatCellVoltage_Cell376 : 196|13@0+ (0.001,0) [0|5] "V"  SGW
 SG_ HVBatCellVoltage_Cell375 : 177|13@0+ (0.001,0) [0|5] "V"  SGW
 SG_ HVBatCellVoltage_Cell374 : 174|13@0+ (0.001,0) [0|5] "V"  SGW
 SG_ HVBatCellVoltage_Cell373 : 155|13@0+ (0.001,0) [0|5] "V"  SGW
 SG_ HVBatCellVoltage_Cell372 : 136|13@0+ (0.001,0) [0|5] "V"  SGW
 SG_ HVBatCellVoltage_Cell371 : 133|13@0+ (0.001,0) [0|5] "V"  SGW
 SG_ HVBatCellVoltage_Cell370 : 114|13@0+ (0.001,0) [0|5] "V"  SGW
 SG_ HVBatCellVoltage_Cell369 : 111|13@0+ (0.001,0) [0|5] "V"  SGW
 SG_ HVBatCellVoltage_Cell368 : 92|13@0+ (0.001,0) [0|5] "V"  SGW
 SG_ HVBatCellVoltage_Cell367 : 73|13@0+ (0.001,0) [0|5] "V"  SGW
 SG_ HVBatCellVoltage_Cell366 : 70|13@0+ (0.001,0) [0|5] "V"  SGW
 SG_ HVBatCellVoltage_Cell365 : 51|13@0+ (0.001,0) [0|5] "V"  SGW
 SG_ HVBatCellVoltage_Cell364 : 32|13@0+ (0.001,0) [0|5] "V"  SGW
 SG_ HVBatCellVoltage_Cell363 : 29|13@0+ (0.001,0) [0|5] "V"  SGW
 SG_ HVBatCellVoltage_Cell362 : 10|13@0+ (0.001,0) [0|5] "V"  SGW
 SG_ HVBatCellVoltage_Cell361 : 7|13@0+ (0.001,0) [0|5] "V"  SGW

BO_ 1961 HVBATTERY_RM_CELLS13: 64 BPCM
 SG_ HVBatCellVoltage_Cell360 : 404|13@0+ (0.001,0) [0|5] "V"  SGW
 SG_ HVBatCellVoltage_Cell359 : 385|13@0+ (0.001,0) [0|5] "V"  SGW
 SG_ HVBatCellVoltage_Cell358 : 382|13@0+ (0.001,0) [0|5] "V"  SGW
 SG_ HVBatCellVoltage_Cell357 : 363|13@0+ (0.001,0) [0|5] "V"  SGW
 SG_ HVBatCellVoltage_Cell356 : 344|13@0+ (0.001,0) [0|5] "V"  SGW
 SG_ HVBatCellVoltage_Cell355 : 341|13@0+ (0.001,0) [0|5] "V"  SGW
 SG_ HVBatCellVoltage_Cell354 : 322|13@0+ (0.001,0) [0|5] "V"  SGW
 SG_ HVBatCellVoltage_Cell353 : 319|13@0+ (0.001,0) [0|5] "V"  SGW
 SG_ HVBatCellVoltage_Cell352 : 300|13@0+ (0.001,0) [0|5] "V"  SGW
 SG_ HVBatCellVoltage_Cell351 : 281|13@0+ (0.001,0) [0|5] "V"  SGW
 SG_ HVBatCellVoltage_Cell350 : 278|13@0+ (0.001,0) [0|5] "V"  SGW
 SG_ HVBatCellVoltage_Cell349 : 259|13@0+ (0.001,0) [0|5] "V"  SGW
 SG_ HVBatCellVoltage_Cell348 : 240|13@0+ (0.001,0) [0|5] "V"  SGW
 SG_ HVBatCellVoltage_Cell347 : 237|13@0+ (0.001,0) [0|5] "V"  SGW
 SG_ HVBatCellVoltage_Cell346 : 218|13@0+ (0.001,0) [0|5] "V"  SGW
 SG_ HVBatCellVoltage_Cell345 : 215|13@0+ (0.001,0) [0|5] "V"  SGW
 SG_ HVBatCellVoltage_Cell344 : 196|13@0+ (0.001,0) [0|5] "V"  SGW
 SG_ HVBatCellVoltage_Cell343 : 177|13@0+ (0.001,0) [0|5] "V"  SGW
 SG_ HVBatCellVoltage_Cell342 : 174|13@0+ (0.001,0) [0|5] "V"  SGW
 SG_ HVBatCellVoltage_Cell341 : 155|13@0+ (0.001,0) [0|5] "V"  SGW
 SG_ HVBatCellVoltage_Cell340 : 136|13@0+ (0.001,0) [0|5] "V"  SGW
 SG_ HVBatCellVoltage_Cell339 : 133|13@0+ (0.001,0) [0|5] "V"  SGW
 SG_ HVBatCellVoltage_Cell338 : 114|13@0+ (0.001,0) [0|5] "V"  SGW
 SG_ HVBatCellVoltage_Cell337 : 111|13@0+ (0.001,0) [0|5] "V"  SGW
 SG_ HVBatCellVoltage_Cell336 : 92|13@0+ (0.001,0) [0|5] "V"  SGW
 SG_ HVBatCellVoltage_Cell335 : 73|13@0+ (0.001,0) [0|5] "V"  SGW
 SG_ HVBatCellVoltage_Cell334 : 70|13@0+ (0.001,0) [0|5] "V"  SGW
 SG_ HVBatCellVoltage_Cell333 : 51|13@0+ (0.001,0) [0|5] "V"  SGW
 SG_ HVBatCellVoltage_Cell332 : 32|13@0+ (0.001,0) [0|5] "V"  SGW
 SG_ HVBatCellVoltage_Cell331 : 29|13@0+ (0.001,0) [0|5] "V"  SGW
 SG_ HVBatCellVoltage_Cell330 : 10|13@0+ (0.001,0) [0|5] "V"  SGW
 SG_ HVBatCellVoltage_Cell329 : 7|13@0+ (0.001,0) [0|5] "V"  SGW

BO_ 1960 HVBATTERY_RM_CELLS12: 64 BPCM
 SG_ HVBatCellVoltage_Cell328 : 404|13@0+ (0.001,0) [0|5] "V"  SGW
 SG_ HVBatCellVoltage_Cell327 : 385|13@0+ (0.001,0) [0|5] "V"  SGW
 SG_ HVBatCellVoltage_Cell326 : 382|13@0+ (0.001,0) [0|5] "V"  SGW
 SG_ HVBatCellVoltage_Cell325 : 363|13@0+ (0.001,0) [0|5] "V"  SGW
 SG_ HVBatCellVoltage_Cell324 : 344|13@0+ (0.001,0) [0|5] "V"  SGW
 SG_ HVBatCellVoltage_Cell323 : 341|13@0+ (0.001,0) [0|5] "V"  SGW
 SG_ HVBatCellVoltage_Cell322 : 322|13@0+ (0.001,0) [0|5] "V"  SGW
 SG_ HVBatCellVoltage_Cell321 : 319|13@0+ (0.001,0) [0|5] "V"  SGW
 SG_ HVBatCellVoltage_Cell320 : 300|13@0+ (0.001,0) [0|5] "V"  SGW
 SG_ HVBatCellVoltage_Cell319 : 281|13@0+ (0.001,0) [0|5] "V"  SGW
 SG_ HVBatCellVoltage_Cell318 : 278|13@0+ (0.001,0) [0|5] "V"  SGW
 SG_ HVBatCellVoltage_Cell317 : 259|13@0+ (0.001,0) [0|5] "V"  SGW
 SG_ HVBatCellVoltage_Cell316 : 240|13@0+ (0.001,0) [0|5] "V"  SGW
 SG_ HVBatCellVoltage_Cell315 : 237|13@0+ (0.001,0) [0|5] "V"  SGW
 SG_ HVBatCellVoltage_Cell314 : 218|13@0+ (0.001,0) [0|5] "V"  SGW
 SG_ HVBatCellVoltage_Cell313 : 215|13@0+ (0.001,0) [0|5] "V"  SGW
 SG_ HVBatCellVoltage_Cell312 : 196|13@0+ (0.001,0) [0|5] "V"  SGW
 SG_ HVBatCellVoltage_Cell311 : 177|13@0+ (0.001,0) [0|5] "V"  SGW
 SG_ HVBatCellVoltage_Cell310 : 174|13@0+ (0.001,0) [0|5] "V"  SGW
 SG_ HVBatCellVoltage_Cell309 : 155|13@0+ (0.001,0) [0|5] "V"  SGW
 SG_ HVBatCellVoltage_Cell308 : 136|13@0+ (0.001,0) [0|5] "V"  SGW
 SG_ HVBatCellVoltage_Cell307 : 133|13@0+ (0.001,0) [0|5] "V"  SGW
 SG_ HVBatCellVoltage_Cell306 : 114|13@0+ (0.001,0) [0|5] "V"  SGW
 SG_ HVBatCellVoltage_Cell305 : 111|13@0+ (0.001,0) [0|5] "V"  SGW
 SG_ HVBatCellVoltage_Cell304 : 92|13@0+ (0.001,0) [0|5] "V"  SGW
 SG_ HVBatCellVoltage_Cell303 : 73|13@0+ (0.001,0) [0|5] "V"  SGW
 SG_ HVBatCellVoltage_Cell302 : 70|13@0+ (0.001,0) [0|5] "V"  SGW
 SG_ HVBatCellVoltage_Cell301 : 51|13@0+ (0.001,0) [0|5] "V"  SGW
 SG_ HVBatCellVoltage_Cell300 : 32|13@0+ (0.001,0) [0|5] "V"  SGW
 SG_ HVBatCellVoltage_Cell299 : 29|13@0+ (0.001,0) [0|5] "V"  SGW
 SG_ HVBatCellVoltage_Cell298 : 10|13@0+ (0.001,0) [0|5] "V"  SGW
 SG_ HVBatCellVoltage_Cell297 : 7|13@0+ (0.001,0) [0|5] "V"  SGW

BO_ 1959 HVBATTERY_RM_CELLS11: 64 BPCM
 SG_ HVBatCellVoltage_Cell296 : 404|13@0+ (0.001,0) [0|5] "V"  SGW
 SG_ HVBatCellVoltage_Cell295 : 385|13@0+ (0.001,0) [0|5] "V"  SGW
 SG_ HVBatCellVoltage_Cell294 : 382|13@0+ (0.001,0) [0|5] "V"  SGW
 SG_ HVBatCellVoltage_Cell293 : 363|13@0+ (0.001,0) [0|5] "V"  SGW
 SG_ HVBatCellVoltage_Cell292 : 344|13@0+ (0.001,0) [0|5] "V"  SGW
 SG_ HVBatCellVoltage_Cell291 : 341|13@0+ (0.001,0) [0|5] "V"  SGW
 SG_ HVBatCellVoltage_Cell290 : 322|13@0+ (0.001,0) [0|5] "V"  SGW
 SG_ HVBatCellVoltage_Cell289 : 319|13@0+ (0.001,0) [0|5] "V"  SGW
 SG_ HVBatCellVoltage_Cell288 : 300|13@0+ (0.001,0) [0|5] "V"  SGW
 SG_ HVBatCellVoltage_Cell287 : 281|13@0+ (0.001,0) [0|5] "V"  SGW
 SG_ HVBatCellVoltage_Cell286 : 278|13@0+ (0.001,0) [0|5] "V"  SGW
 SG_ HVBatCellVoltage_Cell285 : 259|13@0+ (0.001,0) [0|5] "V"  SGW
 SG_ HVBatCellVoltage_Cell284 : 240|13@0+ (0.001,0) [0|5] "V"  SGW
 SG_ HVBatCellVoltage_Cell283 : 237|13@0+ (0.001,0) [0|5] "V"  SGW
 SG_ HVBatCellVoltage_Cell282 : 218|13@0+ (0.001,0) [0|5] "V"  SGW
 SG_ HVBatCellVoltage_Cell281 : 215|13@0+ (0.001,0) [0|5] "V"  SGW
 SG_ HVBatCellVoltage_Cell280 : 196|13@0+ (0.001,0) [0|5] "V"  SGW
 SG_ HVBatCellVoltage_Cell279 : 177|13@0+ (0.001,0) [0|5] "V"  SGW
 SG_ HVBatCellVoltage_Cell278 : 174|13@0+ (0.001,0) [0|5] "V"  SGW
 SG_ HVBatCellVoltage_Cell277 : 155|13@0+ (0.001,0) [0|5] "V"  SGW
 SG_ HVBatCellVoltage_Cell276 : 136|13@0+ (0.001,0) [0|5] "V"  SGW
 SG_ HVBatCellVoltage_Cell275 : 133|13@0+ (0.001,0) [0|5] "V"  SGW
 SG_ HVBatCellVoltage_Cell274 : 114|13@0+ (0.001,0) [0|5] "V"  SGW
 SG_ HVBatCellVoltage_Cell273 : 111|13@0+ (0.001,0) [0|5] "V"  SGW
 SG_ HVBatCellVoltage_Cell272 : 92|13@0+ (0.001,0) [0|5] "V"  SGW
 SG_ HVBatCellVoltage_Cell271 : 73|13@0+ (0.001,0) [0|5] "V"  SGW
 SG_ HVBatCellVoltage_Cell270 : 70|13@0+ (0.001,0) [0|5] "V"  SGW
 SG_ HVBatCellVoltage_Cell269 : 51|13@0+ (0.001,0) [0|5] "V"  SGW
 SG_ HVBatCellVoltage_Cell268 : 32|13@0+ (0.001,0) [0|5] "V"  SGW
 SG_ HVBatCellVoltage_Cell267 : 29|13@0+ (0.001,0) [0|5] "V"  SGW
 SG_ HVBatCellVoltage_Cell266 : 10|13@0+ (0.001,0) [0|5] "V"  SGW
 SG_ HVBatCellVoltage_Cell265 : 7|13@0+ (0.001,0) [0|5] "V"  SGW

BO_ 1958 HVBATTERY_RM_CELLS10: 64 BPCM
 SG_ HVBatCellVoltage_Cell264 : 404|13@0+ (0.001,0) [0|5] "V"  SGW
 SG_ HVBatCellVoltage_Cell263 : 385|13@0+ (0.001,0) [0|5] "V"  SGW
 SG_ HVBatCellVoltage_Cell262 : 382|13@0+ (0.001,0) [0|5] "V"  SGW
 SG_ HVBatCellVoltage_Cell261 : 341|13@0+ (0.001,0) [0|5] "V"  SGW
 SG_ HVBatCellVoltage_Cell260 : 319|13@0+ (0.001,0) [0|5] "V"  SGW
 SG_ HVBatCellVoltage_Cell259 : 363|13@0+ (0.001,0) [0|5] "V"  SGW
 SG_ HVBatCellVoltage_Cell258 : 322|13@0+ (0.001,0) [0|5] "V"  SGW
 SG_ HVBatCellVoltage_Cell257 : 344|13@0+ (0.001,0) [0|5] "V"  SGW
 SG_ HVBatCellVoltage_Cell256 : 300|13@0+ (0.001,0) [0|5] "V"  SGW
 SG_ HVBatCellVoltage_Cell255 : 281|13@0+ (0.001,0) [0|5] "V"  SGW
 SG_ HVBatCellVoltage_Cell254 : 278|13@0+ (0.001,0) [0|5] "V"  SGW
 SG_ HVBatCellVoltage_Cell253 : 259|13@0+ (0.001,0) [0|5] "V"  SGW
 SG_ HVBatCellVoltage_Cell252 : 240|13@0+ (0.001,0) [0|5] "V"  SGW
 SG_ HVBatCellVoltage_Cell251 : 237|13@0+ (0.001,0) [0|5] "V"  SGW
 SG_ HVBatCellVoltage_Cell250 : 218|13@0+ (0.001,0) [0|5] "V"  SGW
 SG_ HVBatCellVoltage_Cell249 : 215|13@0+ (0.001,0) [0|5] "V"  SGW
 SG_ HVBatCellVoltage_Cell248 : 196|13@0+ (0.001,0) [0|5] "V"  SGW
 SG_ HVBatCellVoltage_Cell247 : 177|13@0+ (0.001,0) [0|5] "V"  SGW
 SG_ HVBatCellVoltage_Cell246 : 174|13@0+ (0.001,0) [0|5] "V"  SGW
 SG_ HVBatCellVoltage_Cell245 : 155|13@0+ (0.001,0) [0|5] "V"  SGW
 SG_ HVBatCellVoltage_Cell244 : 136|13@0+ (0.001,0) [0|5] "V"  SGW
 SG_ HVBatCellVoltage_Cell243 : 133|13@0+ (0.001,0) [0|5] "V"  SGW
 SG_ HVBatCellVoltage_Cell242 : 114|13@0+ (0.001,0) [0|5] "V"  SGW
 SG_ HVBatCellVoltage_Cell241 : 111|13@0+ (0.001,0) [0|5] "V"  SGW
 SG_ HVBatCellVoltage_Cell240 : 92|13@0+ (0.001,0) [0|5] "V"  SGW
 SG_ HVBatCellVoltage_Cell239 : 73|13@0+ (0.001,0) [0|5] "V"  SGW
 SG_ HVBatCellVoltage_Cell238 : 70|13@0+ (0.001,0) [0|5] "V"  SGW
 SG_ HVBatCellVoltage_Cell237 : 51|13@0+ (0.001,0) [0|5] "V"  SGW
 SG_ HVBatCellVoltage_Cell236 : 32|13@0+ (0.001,0) [0|5] "V"  SGW
 SG_ HVBatCellVoltage_Cell235 : 29|13@0+ (0.001,0) [0|5] "V"  SGW
 SG_ HVBatCellVoltage_Cell234 : 10|13@0+ (0.001,0) [0|5] "V"  SGW
 SG_ HVBatCellVoltage_Cell233 : 7|13@0+ (0.001,0) [0|5] "V"  SGW

BO_ 2564486466 DIAGNOSTIC_RESPONSE_FOTA_EVCU2: 64 EVCU2
 SG_ N_PDU_18DAF542 : 7|64@0+ (1,0) [0|0] "" SGW

BO_ 2564440821 DIAGNOSTIC_REQUEST_FOTA_EVCU2: 64 SGW
 SG_ N_PDU_18DA42F5 : 455|64@0+ (1,0) [0|0] "" EVCU2

BO_ 2654339136 PDC_INFO_FD_EVCU2: 64 EVCU2
 SG_ WakeupSource_FD03_EVCU2 : 335|8@0+ (1,0) [0|255] "" SGW
 SG_ StayActiveSource_FD03_EVCU2 : 31|64@0+ (1,0) [0|0] "" SGW
 SG_ PreviousCanNMState_FD03_EVCU2 : 343|4@0+ (1,0) [0|15] "" SGW
 SG_ GenericFailSts_FD03_EVCU2 : 1|1@0+ (1,0) [0|1] "" SGW
 SG_ EOL_FD03_EVCU2 : 0|1@0+ (1,0) [0|1] "-"  SGW
 SG_ DES_FD03_EVCU2 : 23|2@0+ (1,0) [0|3] "" SGW
 SG_ CurrentFailSts_FD03_EVCU2 : 7|1@0+ (1,0) [0|1] "" SGW
 SG_ CurrentCanNMState_FD03_EVCU2 : 339|4@0+ (1,0) [0|15] "" SGW
 SG_ WakeupSource_FD11_EVCU2 : 175|8@0+ (1,0) [0|255] "" SGW
 SG_ StayActiveSource_FD11_EVCU2 : 271|64@0+ (1,0) [0|18446744073709551615] "" SGW
 SG_ PreviousCanNMState_FD11_EVCU2 : 11|4@0+ (1,0) [0|15] "" SGW
 SG_ GenericFailSts_FD11_EVCU2 : 5|1@0+ (1,0) [0|1] "" SGW
 SG_ EOL_FD11_EVCU2 : 20|1@0+ (1,0) [0|1] "-"  SGW
 SG_ DES_FD11_EVCU2 : 4|2@0+ (1,0) [0|3] "" SGW
 SG_ CurrentFailSts_FD11_EVCU2 : 2|1@0+ (1,0) [0|1] "" SGW
 SG_ CurrentCanNMState_FD11_EVCU2 : 15|4@0+ (1,0) [0|15] "" SGW
 SG_ WakeupSource_FD16_EVCU2 : 199|8@0+ (1,0) [0|255] "" SGW
 SG_ WakeupSource_FD05_EVCU2 : 95|8@0+ (1,0) [0|255] "" SGW
 SG_ StayActiveSource_FD16_EVCU2 : 207|64@0+ (1,0) [0|0] "" SGW
 SG_ StayActiveSource_FD05_EVCU2 : 111|64@0+ (1,0) [0|0] "" SGW
 SG_ PreviousCanNMState_FD16_EVCU2 : 191|4@0+ (1,0) [0|15] "" SGW
 SG_ PreviousCanNMState_FD05_EVCU2 : 103|4@0+ (1,0) [0|15] "" SGW
 SG_ GenericFailSts_FD16_EVCU2 : 184|1@0+ (1,0) [0|1] "" SGW
 SG_ GenericFailSts_FD05_EVCU2 : 180|1@0+ (1,0) [0|1] "" SGW
 SG_ EOL_FD16_EVCU2 : 19|1@0+ (1,0) [0|1] "-"  SGW
 SG_ EOL_FD05_EVCU2 : 21|1@0+ (1,0) [0|1] "-"  SGW
 SG_ DES_FD16_EVCU2 : 187|2@0+ (1,0) [0|1] "" SGW
 SG_ DES_FD05_EVCU2 : 183|2@0+ (1,0) [0|1] "" SGW
 SG_ CurrentFailSts_FD16_EVCU2 : 185|1@0+ (1,0) [0|1] "" SGW
 SG_ CurrentFailSts_FD05_EVCU2 : 181|1@0+ (1,0) [0|1] "" SGW
 SG_ CurrentCanNMState_FD16_EVCU2 : 179|4@0+ (1,0) [0|15] "" SGW
 SG_ CurrentCanNMState_FD05_EVCU2 : 99|4@0+ (1,0) [0|15] "" SGW

BO_ 2654339142 PDC_INFO_FD_BPCM: 32 BPCM
 SG_ GenericFailSts_FD11_BPCM : 5|1@0+ (1,0) [0|1] "" EVCU2,SGW,HCP
 SG_ EOL_FD11_BPCM : 7|1@0+ (1,0) [0|1] "-"  EVCU2,SGW,HCP
 SG_ WakeupSource_FD11_BPCM : 23|8@0+ (1,0) [0|255] "" EVCU2,SGW
 SG_ PreviousCanNMState_FD11_BPCM : 11|4@0+ (1,0) [0|15] "" EVCU2,SGW
 SG_ DES_FD11_BPCM : 4|2@0+ (1,0) [0|3] "" EVCU2,SGW
 SG_ CurrentCanNMState_FD11_BPCM : 15|4@0+ (1,0) [0|15] "" EVCU2,SGW
 SG_ CurrentFailSts_FD11_BPCM : 2|1@0+ (1,0) [0|1] "" EVCU2,SGW,HCP
 SG_ WakeupSource_FD05_BPCM : 175|8@0+ (1,0) [0|255] "" EVCU2,SGW
 SG_ StayActiveSource_FD05_BPCM : 99|64@0+ (1,0) [0|0] "" EVCU2,SGW
 SG_ PreviousCanNMState_FD05_BPCM : 103|4@0+ (1,0) [0|15] "" EVCU2,SGW
 SG_ GenericFailSts_FD05_BPCM : 89|1@0+ (1,0) [0|1] "" EVCU2,SGW
 SG_ EOL_FD05_BPCM : 1|1@0+ (1,0) [0|1] "-"  EVCU2,SGW
 SG_ DES_FD05_BPCM : 91|2@0+ (1,0) [0|3] "" EVCU2,SGW
 SG_ CurrentFailSts_FD05_BPCM : 6|1@0+ (1,0) [0|1] "" EVCU2,SGW
 SG_ CurrentCanNMState_FD05_BPCM : 95|4@0+ (1,0) [0|15] "" EVCU2,SGW
 SG_ StayActiveSource_FD11_BPCM : 31|64@0+ (1,0) [0|0] "" EVCU2,SGW

BO_ 2564485756 DIAGNOSTIC_RESPONSE_FD_SGCP: 64 EVCU2
 SG_ N_PDU_18DAF27C : 7|64@0+ (1,0) [0|0] "" SGW

CM_ SG_ 2654339142 GenericFailSts_FD11_BPCM "Indicates the presence/absent of at least one DTC in the System Memory";
CM_ SG_ 2654339142 EOL_FD11_BPCM "Indicates if the ECU requires configuration data at the assembly plant End Of Line";
CM_ SG_ 2654339142 WakeupSource_FD11_BPCM "Indicates the reason the ECU was most recently awakened";
CM_ SG_ 2654339142 PreviousCanNMState_FD11_BPCM "Indicates the last CanNM state that the ECU existed in";
CM_ SG_ 2654339142 DES_FD11_BPCM "Indicates whether the ECU?s CAN cell is in either ErrorActive, or ErrorPassive state OR has just now recovered from a BusOff condition";
CM_ SG_ 2654339142 CurrentCanNMState_FD11_BPCM "Indicates that CanNM state the ECU is currently executing";
CM_ SG_ 485 MessageCounter_BATT_HV_VLIMITS "This signal is a counter used for safety checks strategies. This counter is incremented of 1 (one) unit at each frame transmission.";
CM_ SG_ 485 CRC_BATT_HV_VLIMITS "CRC according to SAE J1850 standard at each frame transmission.";
CM_ SG_ 485 BPCM_HV_NumCellMinTemp "This signal indicates the Numner of the battery cell with the lowest temperature.";
CM_ SG_ 485 BPCM_HV_NumCellMaxTemp "This signal indicates the Number of the battery cell with the highest temperature.";
CM_ SG_ 485 BPCM_HV_NumCellMinVolt "This signal indicates the ID No. of cell with min. voltage";
CM_ SG_ 485 BPCM_HV_NumCellMaxVolt "This signal indicates the ID No. of cell with max. voltage";
CM_ SG_ 485 BPCM_Min_Pk_Volt_Allowed "This signal indicates the Minimum battery peak pack voltage.";
CM_ SG_ 485 BPCM_Max_Pk_Volt_Allowed "This signal indicates the Maximum battery pack voltage allowed.";
CM_ SG_ 485 BPCM_OCV_Min_Cell_Volt "This signal indicates the Cell open circuit minimum voltage.";
CM_ SG_ 485 BPCM_OCV_Max_Cell_Volt "This signal indicates the Cell open circuit  maximum voltage.";
CM_ SG_ 485 BPCM_OCV_Avg_Cell_Volt "This signal indicates the Cell open circuit average voltage .";
CM_ SG_ 485 BPCM_Min_Cell_Volt_Allowed "This signal indicates the Minimum battery pack voltage.";
CM_ SG_ 485 BPCM_Max_Cell_Volt_Allowed "This signal indicates the Max cell voltage allowed.";
CM_ SG_ 485 BPCM_HV_Insulation_Resistance "This signal indicates the Insulation resistance.";
CM_ SG_ 485 BPCM_Cell_Volt_Min "This signal indicates the Min cell voltage.";
CM_ SG_ 485 BPCM_Cell_Volt_Max "This signal indicates the Max cell voltage.";
CM_ SG_ 485 BPCM_Cell_Volt_Avg "This signal indicates the Cell average voltage.";
CM_ SG_ 288 BPCM_HV_PwrLmtInstDschg "Instantaneous power prediction limit in discharge";
CM_ SG_ 288 BPCM_HV_PwrLmtInstChrg "Instantaneous power prediction limit in charge";
CM_ SG_ 288 BPCM_HV_Pwr_MaxDischrg_ShrTrm "This signal indicates the Maximum discharge power available for the next short term.";
CM_ SG_ 288 BPCM_HV_Power_MaxDischarge_MdTrm "This signal indicates the Maximum discharge power available for the next mid term.";
CM_ SG_ 288 BPCM_HV_Power_MaxDischarge_LgTrm "This signal indicates the Maximum discharge power available for the next long term.";
CM_ SG_ 288 BPCM_HV_Power_MaxCharge_ShrTrm "This signal indicates the Maximum charge power available for the next short term.";
CM_ SG_ 288 BPCM_HV_Power_MaxCharge_MdTrm "This signal indicates the Maximum charge power available for the next mid term.";
CM_ SG_ 288 BPCM_HV_Power_MaxCharge_LgTrm "This signal indicates the Maximum charge power available for the next long term.";
CM_ SG_ 288 BPCM_HV_CrntLmtInstDschg "BPCM_HV_CrntLmtInstDschg";
CM_ SG_ 288 BPCM_HV_CrntLmtInstChrg "BPCM_HV_CrntLmtInstChrg";
CM_ SG_ 288 BPCM_HV_ChargingCurrentProfile "This signal indicates the Charging current profile.";
CM_ SG_ 288 BPCM_HV_Cell_MinDischrg_Imped "This signal indicates the Maximum cell discharge impedance.";
CM_ SG_ 288 BPCM_HV_Cell_MaxDischrg_Imped "This signal indicates the Maximum cell discharge impedance.";
CM_ SG_ 288 BPCM_CntctrsShtTrmOpeningWarn "This signal indicates the Battery warning imminent emergency contactors opening.";
CM_ SG_ 288 BPCM_CntctrsMidTrmOpeningWarn "This signal indicates the Battery warning mid term emergency contactors opening.";
CM_ SG_ 1965 HVBatCellVoltage_Cell232 "High voltage battery cell voltage for Cell 205";
CM_ SG_ 1965 HVBatCellVoltage_Cell231 "High voltage battery cell voltage for Cell 204";
CM_ SG_ 1965 HVBatCellVoltage_Cell230 "High voltage battery cell voltage for Cell 203";
CM_ SG_ 1965 HVBatCellVoltage_Cell229 "High voltage battery cell voltage for Cell 202";
CM_ SG_ 1965 HVBatCellVoltage_Cell228 "High voltage battery cell voltage for Cell 201";
CM_ SG_ 1965 HVBatCellVoltage_Cell227 "High voltage battery cell voltage for Cell 200";
CM_ SG_ 1965 HVBatCellVoltage_Cell226 "High voltage battery cell voltage for Cell 199";
CM_ SG_ 1965 HVBatCellVoltage_Cell225 "High voltage battery cell voltage for Cell 198";
CM_ SG_ 1965 HVBatCellVoltage_Cell224 "High voltage battery cell voltage for Cell 197";
CM_ SG_ 1965 HVBatCellVoltage_Cell223 "High voltage battery cell voltage for Cell 196";
CM_ SG_ 1965 HVBatCellVoltage_Cell222 "High voltage battery cell voltage for Cell 195";
CM_ SG_ 1965 HVBatCellVoltage_Cell221 "High voltage battery cell voltage for Cell 194";
CM_ SG_ 1965 HVBatCellVoltage_Cell220 "High voltage battery cell voltage for Cell 193";
CM_ SG_ 1965 HVBatCellVoltage_Cell219 "High voltage battery cell voltage for Cell 192";
CM_ SG_ 1965 HVBatCellVoltage_Cell218 "High voltage battery cell voltage for Cell 191";
CM_ SG_ 1965 HVBatCellVoltage_Cell217 "High voltage battery cell voltage for Cell 190";
CM_ SG_ 1963 HVBatCellVoltage_Cell400 "High voltage battery cell voltage for Cell 400";
CM_ SG_ 1963 HVBatCellVoltage_Cell399 "High voltage battery cell voltage for Cell 399";
CM_ SG_ 1963 HVBatCellVoltage_Cell398 "High voltage battery cell voltage for Cell 398";
CM_ SG_ 1963 HVBatCellVoltage_Cell397 "High voltage battery cell voltage for Cell 397";
CM_ SG_ 1963 HVBatCellVoltage_Cell396 "High voltage battery cell voltage for Cell 396";
CM_ SG_ 1963 HVBatCellVoltage_Cell395 "High voltage battery cell voltage for Cell 395";
CM_ SG_ 1963 HVBatCellVoltage_Cell394 "High voltage battery cell voltage for Cell 394";
CM_ SG_ 1963 HVBatCellVoltage_Cell393 "High voltage battery cell voltage for Cell 393";
CM_ SG_ 1962 HVBatCellVoltage_Cell392 "High voltage battery cell voltage for Cell 392";
CM_ SG_ 1962 HVBatCellVoltage_Cell391 "High voltage battery cell voltage for Cell 391";
CM_ SG_ 1962 HVBatCellVoltage_Cell390 "High voltage battery cell voltage for Cell 390";
CM_ SG_ 1962 HVBatCellVoltage_Cell389 "High voltage battery cell voltage for Cell 389";
CM_ SG_ 1962 HVBatCellVoltage_Cell388 "High voltage battery cell voltage for Cell 388";
CM_ SG_ 1962 HVBatCellVoltage_Cell387 "High voltage battery cell voltage for Cell 387";
CM_ SG_ 1962 HVBatCellVoltage_Cell386 "High voltage battery cell voltage for Cell 386";
CM_ SG_ 1962 HVBatCellVoltage_Cell385 "High voltage battery cell voltage for Cell 385";
CM_ SG_ 1962 HVBatCellVoltage_Cell384 "High voltage battery cell voltage for Cell 384";
CM_ SG_ 1962 HVBatCellVoltage_Cell383 "High voltage battery cell voltage for Cell 383";
CM_ SG_ 1962 HVBatCellVoltage_Cell382 "High voltage battery cell voltage for Cell 382";
CM_ SG_ 1962 HVBatCellVoltage_Cell381 "High voltage battery cell voltage for Cell 381";
CM_ SG_ 1962 HVBatCellVoltage_Cell380 "High voltage battery cell voltage for Cell 380";
CM_ SG_ 1962 HVBatCellVoltage_Cell379 "High voltage battery cell voltage for Cell 379";
CM_ SG_ 1962 HVBatCellVoltage_Cell378 "High voltage battery cell voltage for Cell 378";
CM_ SG_ 1962 HVBatCellVoltage_Cell377 "High voltage battery cell voltage for Cell 377";
CM_ SG_ 1962 HVBatCellVoltage_Cell376 "High voltage battery cell voltage for Cell 376";
CM_ SG_ 1962 HVBatCellVoltage_Cell375 "High voltage battery cell voltage for Cell 375";
CM_ SG_ 1962 HVBatCellVoltage_Cell374 "High voltage battery cell voltage for Cell 374";
CM_ SG_ 1962 HVBatCellVoltage_Cell373 "High voltage battery cell voltage for Cell 373";
CM_ SG_ 1962 HVBatCellVoltage_Cell372 "High voltage battery cell voltage for Cell 372";
CM_ SG_ 1962 HVBatCellVoltage_Cell371 "High voltage battery cell voltage for Cell 371";
CM_ SG_ 1962 HVBatCellVoltage_Cell370 "High voltage battery cell voltage for Cell 370";
CM_ SG_ 1962 HVBatCellVoltage_Cell369 "High voltage battery cell voltage for Cell 369";
CM_ SG_ 1962 HVBatCellVoltage_Cell368 "High voltage battery cell voltage for Cell 368";
CM_ SG_ 1962 HVBatCellVoltage_Cell367 "High voltage battery cell voltage for Cell 367";
CM_ SG_ 1962 HVBatCellVoltage_Cell366 "High voltage battery cell voltage for Cell 366";
CM_ SG_ 1962 HVBatCellVoltage_Cell365 "High voltage battery cell voltage for Cell 365";
CM_ SG_ 1962 HVBatCellVoltage_Cell364 "High voltage battery cell voltage for Cell 364";
CM_ SG_ 1962 HVBatCellVoltage_Cell363 "High voltage battery cell voltage for Cell 363";
CM_ SG_ 1962 HVBatCellVoltage_Cell362 "High voltage battery cell voltage for Cell 362";
CM_ SG_ 1962 HVBatCellVoltage_Cell361 "High voltage battery cell voltage for Cell 361";
CM_ SG_ 1961 HVBatCellVoltage_Cell360 "High voltage battery cell voltage for Cell 360";
CM_ SG_ 1961 HVBatCellVoltage_Cell359 "High voltage battery cell voltage for Cell 359";
CM_ SG_ 1961 HVBatCellVoltage_Cell358 "High voltage battery cell voltage for Cell 358";
CM_ SG_ 1961 HVBatCellVoltage_Cell357 "High voltage battery cell voltage for Cell 357";
CM_ SG_ 1961 HVBatCellVoltage_Cell356 "High voltage battery cell voltage for Cell 356";
CM_ SG_ 1961 HVBatCellVoltage_Cell355 "High voltage battery cell voltage for Cell 355";
CM_ SG_ 1961 HVBatCellVoltage_Cell354 "High voltage battery cell voltage for Cell 354";
CM_ SG_ 1961 HVBatCellVoltage_Cell353 "High voltage battery cell voltage for Cell 353";
CM_ SG_ 1961 HVBatCellVoltage_Cell352 "High voltage battery cell voltage for Cell 352";
CM_ SG_ 1961 HVBatCellVoltage_Cell351 "High voltage battery cell voltage for Cell 351";
CM_ SG_ 1961 HVBatCellVoltage_Cell350 "High voltage battery cell voltage for Cell 350";
CM_ SG_ 1961 HVBatCellVoltage_Cell349 "High voltage battery cell voltage for Cell 349";
CM_ SG_ 1961 HVBatCellVoltage_Cell348 "High voltage battery cell voltage for Cell 348";
CM_ SG_ 1961 HVBatCellVoltage_Cell347 "High voltage battery cell voltage for Cell 347";
CM_ SG_ 1961 HVBatCellVoltage_Cell346 "High voltage battery cell voltage for Cell 346";
CM_ SG_ 1961 HVBatCellVoltage_Cell345 "High voltage battery cell voltage for Cell 345";
CM_ SG_ 1961 HVBatCellVoltage_Cell344 "High voltage battery cell voltage for Cell 344";
CM_ SG_ 1961 HVBatCellVoltage_Cell343 "High voltage battery cell voltage for Cell 343";
CM_ SG_ 1961 HVBatCellVoltage_Cell342 "High voltage battery cell voltage for Cell 342";
CM_ SG_ 1961 HVBatCellVoltage_Cell341 "High voltage battery cell voltage for Cell 341";
CM_ SG_ 1961 HVBatCellVoltage_Cell340 "High voltage battery cell voltage for Cell 340";
CM_ SG_ 1961 HVBatCellVoltage_Cell339 "High voltage battery cell voltage for Cell 339";
CM_ SG_ 1961 HVBatCellVoltage_Cell338 "High voltage battery cell voltage for Cell 338";
CM_ SG_ 1961 HVBatCellVoltage_Cell337 "High voltage battery cell voltage for Cell 337";
CM_ SG_ 1961 HVBatCellVoltage_Cell336 "High voltage battery cell voltage for Cell 336";
CM_ SG_ 1961 HVBatCellVoltage_Cell335 "High voltage battery cell voltage for Cell 335";
CM_ SG_ 1961 HVBatCellVoltage_Cell334 "High voltage battery cell voltage for Cell 334";
CM_ SG_ 1961 HVBatCellVoltage_Cell333 "High voltage battery cell voltage for Cell 333";
CM_ SG_ 1961 HVBatCellVoltage_Cell332 "High voltage battery cell voltage for Cell 332";
CM_ SG_ 1961 HVBatCellVoltage_Cell331 "High voltage battery cell voltage for Cell 331";
CM_ SG_ 1961 HVBatCellVoltage_Cell330 "High voltage battery cell voltage for Cell 330";
CM_ SG_ 1961 HVBatCellVoltage_Cell329 "High voltage battery cell voltage for Cell 329";
CM_ SG_ 1960 HVBatCellVoltage_Cell328 "High voltage battery cell voltage for Cell 328";
CM_ SG_ 1960 HVBatCellVoltage_Cell327 "High voltage battery cell voltage for Cell 327";
CM_ SG_ 1960 HVBatCellVoltage_Cell326 "High voltage battery cell voltage for Cell 326";
CM_ SG_ 1960 HVBatCellVoltage_Cell325 "High voltage battery cell voltage for Cell 325";
CM_ SG_ 1960 HVBatCellVoltage_Cell324 "High voltage battery cell voltage for Cell 324";
CM_ SG_ 1960 HVBatCellVoltage_Cell323 "High voltage battery cell voltage for Cell 323";
CM_ SG_ 1960 HVBatCellVoltage_Cell322 "High voltage battery cell voltage for Cell 322";
CM_ SG_ 1960 HVBatCellVoltage_Cell321 "High voltage battery cell voltage for Cell 321";
CM_ SG_ 1960 HVBatCellVoltage_Cell320 "High voltage battery cell voltage for Cell 320";
CM_ SG_ 1960 HVBatCellVoltage_Cell319 "High voltage battery cell voltage for Cell 319";
CM_ SG_ 1960 HVBatCellVoltage_Cell318 "High voltage battery cell voltage for Cell 318";
CM_ SG_ 1960 HVBatCellVoltage_Cell317 "High voltage battery cell voltage for Cell 317";
CM_ SG_ 1960 HVBatCellVoltage_Cell316 "High voltage battery cell voltage for Cell 316";
CM_ SG_ 1960 HVBatCellVoltage_Cell315 "High voltage battery cell voltage for Cell 315";
CM_ SG_ 1960 HVBatCellVoltage_Cell314 "High voltage battery cell voltage for Cell 314";
CM_ SG_ 1960 HVBatCellVoltage_Cell313 "High voltage battery cell voltage for Cell 313";
CM_ SG_ 1960 HVBatCellVoltage_Cell312 "High voltage battery cell voltage for Cell 312";
CM_ SG_ 1960 HVBatCellVoltage_Cell311 "High voltage battery cell voltage for Cell 311";
CM_ SG_ 1960 HVBatCellVoltage_Cell310 "High voltage battery cell voltage for Cell 310";
CM_ SG_ 1960 HVBatCellVoltage_Cell309 "High voltage battery cell voltage for Cell 309";
CM_ SG_ 1960 HVBatCellVoltage_Cell308 "High voltage battery cell voltage for Cell 308";
CM_ SG_ 1960 HVBatCellVoltage_Cell307 "High voltage battery cell voltage for Cell 307";
CM_ SG_ 1960 HVBatCellVoltage_Cell306 "High voltage battery cell voltage for Cell 306";
CM_ SG_ 1960 HVBatCellVoltage_Cell305 "High voltage battery cell voltage for Cell 305";
CM_ SG_ 1960 HVBatCellVoltage_Cell304 "High voltage battery cell voltage for Cell 304";
CM_ SG_ 1960 HVBatCellVoltage_Cell303 "High voltage battery cell voltage for Cell 303";
CM_ SG_ 1960 HVBatCellVoltage_Cell302 "High voltage battery cell voltage for Cell 302";
CM_ SG_ 1960 HVBatCellVoltage_Cell301 "High voltage battery cell voltage for Cell 301";
CM_ SG_ 1960 HVBatCellVoltage_Cell300 "High voltage battery cell voltage for Cell 300";
CM_ SG_ 1960 HVBatCellVoltage_Cell299 "High voltage battery cell voltage for Cell 299";
CM_ SG_ 1960 HVBatCellVoltage_Cell298 "High voltage battery cell voltage for Cell 298";
CM_ SG_ 1960 HVBatCellVoltage_Cell297 "High voltage battery cell voltage for Cell 297";
CM_ SG_ 1959 HVBatCellVoltage_Cell296 "High voltage battery cell voltage for Cell 296";
CM_ SG_ 1959 HVBatCellVoltage_Cell295 "High voltage battery cell voltage for Cell 295";
CM_ SG_ 1959 HVBatCellVoltage_Cell294 "High voltage battery cell voltage for Cell 294";
CM_ SG_ 1959 HVBatCellVoltage_Cell293 "High voltage battery cell voltage for Cell 293";
CM_ SG_ 1959 HVBatCellVoltage_Cell292 "High voltage battery cell voltage for Cell 292";
CM_ SG_ 1959 HVBatCellVoltage_Cell291 "High voltage battery cell voltage for Cell 291";
CM_ SG_ 1959 HVBatCellVoltage_Cell290 "High voltage battery cell voltage for Cell 290";
CM_ SG_ 1959 HVBatCellVoltage_Cell289 "High voltage battery cell voltage for Cell 289";
CM_ SG_ 1959 HVBatCellVoltage_Cell288 "High voltage battery cell voltage for Cell 288";
CM_ SG_ 1959 HVBatCellVoltage_Cell287 "High voltage battery cell voltage for Cell 287";
CM_ SG_ 1959 HVBatCellVoltage_Cell286 "High voltage battery cell voltage for Cell 286";
CM_ SG_ 1959 HVBatCellVoltage_Cell285 "High voltage battery cell voltage for Cell 285";
CM_ SG_ 1959 HVBatCellVoltage_Cell284 "High voltage battery cell voltage for Cell 284";
CM_ SG_ 1959 HVBatCellVoltage_Cell283 "High voltage battery cell voltage for Cell 283";
CM_ SG_ 1959 HVBatCellVoltage_Cell282 "High voltage battery cell voltage for Cell 282";
CM_ SG_ 1959 HVBatCellVoltage_Cell281 "High voltage battery cell voltage for Cell 281";
CM_ SG_ 1959 HVBatCellVoltage_Cell280 "High voltage battery cell voltage for Cell 280";
CM_ SG_ 1959 HVBatCellVoltage_Cell279 "High voltage battery cell voltage for Cell 279";
CM_ SG_ 1959 HVBatCellVoltage_Cell278 "High voltage battery cell voltage for Cell 278";
CM_ SG_ 1959 HVBatCellVoltage_Cell277 "High voltage battery cell voltage for Cell 277";
CM_ SG_ 1959 HVBatCellVoltage_Cell276 "High voltage battery cell voltage for Cell 276";
CM_ SG_ 1959 HVBatCellVoltage_Cell275 "High voltage battery cell voltage for Cell 275";
CM_ SG_ 1959 HVBatCellVoltage_Cell274 "High voltage battery cell voltage for Cell 274";
CM_ SG_ 1959 HVBatCellVoltage_Cell273 "High voltage battery cell voltage for Cell 273";
CM_ SG_ 1959 HVBatCellVoltage_Cell272 "High voltage battery cell voltage for Cell 272";
CM_ SG_ 1959 HVBatCellVoltage_Cell271 "High voltage battery cell voltage for Cell 271";
CM_ SG_ 1959 HVBatCellVoltage_Cell270 "High voltage battery cell voltage for Cell 270";
CM_ SG_ 1959 HVBatCellVoltage_Cell269 "High voltage battery cell voltage for Cell 269";
CM_ SG_ 1959 HVBatCellVoltage_Cell268 "High voltage battery cell voltage for Cell 268";
CM_ SG_ 1959 HVBatCellVoltage_Cell267 "High voltage battery cell voltage for Cell 267";
CM_ SG_ 1959 HVBatCellVoltage_Cell266 "High voltage battery cell voltage for Cell 266";
CM_ SG_ 1959 HVBatCellVoltage_Cell265 "High voltage battery cell voltage for Cell 265";
CM_ SG_ 1958 HVBatCellVoltage_Cell264 "High voltage battery cell voltage for Cell 264";
CM_ SG_ 1958 HVBatCellVoltage_Cell263 "High voltage battery cell voltage for Cell 263";
CM_ SG_ 1958 HVBatCellVoltage_Cell262 "High voltage battery cell voltage for Cell 262";
CM_ SG_ 1958 HVBatCellVoltage_Cell261 "High voltage battery cell voltage for Cell 261";
CM_ SG_ 1958 HVBatCellVoltage_Cell260 "High voltage battery cell voltage for Cell 260";
CM_ SG_ 1958 HVBatCellVoltage_Cell259 "High voltage battery cell voltage for Cell 259";
CM_ SG_ 1958 HVBatCellVoltage_Cell258 "High voltage battery cell voltage for Cell 258";
CM_ SG_ 1958 HVBatCellVoltage_Cell257 "High voltage battery cell voltage for Cell 257";
CM_ SG_ 1958 HVBatCellVoltage_Cell256 "High voltage battery cell voltage for Cell 256";
CM_ SG_ 1958 HVBatCellVoltage_Cell255 "High voltage battery cell voltage for Cell 255";
CM_ SG_ 1958 HVBatCellVoltage_Cell254 "High voltage battery cell voltage for Cell 254";
CM_ SG_ 1958 HVBatCellVoltage_Cell253 "High voltage battery cell voltage for Cell 253";
CM_ SG_ 1958 HVBatCellVoltage_Cell252 "High voltage battery cell voltage for Cell 252";
CM_ SG_ 1958 HVBatCellVoltage_Cell251 "High voltage battery cell voltage for Cell 251";
CM_ SG_ 1958 HVBatCellVoltage_Cell250 "High voltage battery cell voltage for Cell 250";
CM_ SG_ 1958 HVBatCellVoltage_Cell249 "High voltage battery cell voltage for Cell 249";
CM_ SG_ 1958 HVBatCellVoltage_Cell248 "High voltage battery cell voltage for Cell 248";
CM_ SG_ 1958 HVBatCellVoltage_Cell247 "High voltage battery cell voltage for Cell 247";
CM_ SG_ 1958 HVBatCellVoltage_Cell246 "High voltage battery cell voltage for Cell 246";
CM_ SG_ 1958 HVBatCellVoltage_Cell245 "High voltage battery cell voltage for Cell 245";
CM_ SG_ 1958 HVBatCellVoltage_Cell244 "High voltage battery cell voltage for Cell 244";
CM_ SG_ 1958 HVBatCellVoltage_Cell243 "High voltage battery cell voltage for Cell 243";
CM_ SG_ 1958 HVBatCellVoltage_Cell242 "High voltage battery cell voltage for Cell 242";
CM_ SG_ 1958 HVBatCellVoltage_Cell241 "High voltage battery cell voltage for Cell 241";
CM_ SG_ 1958 HVBatCellVoltage_Cell240 "High voltage battery cell voltage for Cell 240";
CM_ SG_ 1958 HVBatCellVoltage_Cell239 "High voltage battery cell voltage for Cell 239";
CM_ SG_ 1958 HVBatCellVoltage_Cell238 "High voltage battery cell voltage for Cell 238";
CM_ SG_ 1958 HVBatCellVoltage_Cell237 "High voltage battery cell voltage for Cell 237";
CM_ SG_ 1958 HVBatCellVoltage_Cell236 "High voltage battery cell voltage for Cell 236";
CM_ SG_ 1958 HVBatCellVoltage_Cell235 "High voltage battery cell voltage for Cell 235";
CM_ SG_ 1958 HVBatCellVoltage_Cell234 "High voltage battery cell voltage for Cell 234";
CM_ SG_ 1958 HVBatCellVoltage_Cell233 "High voltage battery cell voltage for Cell 233";
CM_ SG_ 2654339136 WakeupSource_FD03_EVCU2 "Indicates the reason the ECU was most recently awakened";
CM_ SG_ 2654339136 StayActiveSource_FD03_EVCU2 "Indicates the source that requests the ECU to stay active";
CM_ SG_ 2654339136 PreviousCanNMState_FD03_EVCU2 "Indicates the last CanNM state that the ECU existed in";
CM_ SG_ 2654339136 GenericFailSts_FD03_EVCU2 "Indicates the presence/absent of at least one DTC in the System Memory";
CM_ SG_ 2654339136 EOL_FD03_EVCU2 "Indicates if the ECU requires configuration data at the assembly plant End Of Line";
CM_ SG_ 2654339136 DES_FD03_EVCU2 "Indicates whether the ECU?s CAN cell is in either ErrorActive, or ErrorPassive state OR has just now recovered from a BusOff condition";
CM_ SG_ 2654339136 CurrentFailSts_FD03_EVCU2 "Indicates the presence/absence of at least one DTC with DTCStatus = present in the System Memory";
CM_ SG_ 2654339136 CurrentCanNMState_FD03_EVCU2 "Indicates that CanNM state the ECU is currently executing";
CM_ SG_ 2654339142 CurrentFailSts_FD11_BPCM "Indicates the presence/absence of at least one DTC with DTCStatus = present in the System Memory";
CM_ SG_ 2654339136 WakeupSource_FD11_EVCU2 "Indicates the reason the ECU was most recently awakened";
CM_ SG_ 2654339136 StayActiveSource_FD11_EVCU2 "Indicates the source that requests the ECU to stay active";
CM_ SG_ 2654339136 PreviousCanNMState_FD11_EVCU2 "Indicates the last CanNM state that the ECU existed in";
CM_ SG_ 2654339136 GenericFailSts_FD11_EVCU2 "Indicates the presence/absent of at least one DTC in the System Memory";
CM_ SG_ 2654339136 EOL_FD11_EVCU2 "Indicates if the ECU requires configuration data at the assembly plant End Of Line";
CM_ SG_ 2654339136 DES_FD11_EVCU2 "Indicates whether the ECU?s CAN cell is in either ErrorActive, or ErrorPassive state OR has just now recovered from a BusOff condition";
CM_ SG_ 2654339136 CurrentFailSts_FD11_EVCU2 "Indicates the presence/absence of at least one DTC with DTCStatus = present in the System Memory";
CM_ SG_ 2654339136 CurrentCanNMState_FD11_EVCU2 "Indicates that CanNM state the ECU is currently executing";
CM_ SG_ 2654339136 WakeupSource_FD16_EVCU2 "Indicates the reason the ECU was most recently awakened";
CM_ SG_ 2654339136 WakeupSource_FD05_EVCU2 "Indicates the reason the ECU was most recently awakened";
CM_ SG_ 2654339136 StayActiveSource_FD16_EVCU2 "Indicates the source that requests the ECU to stay active";
CM_ SG_ 2654339136 StayActiveSource_FD05_EVCU2 "Indicates the source that requests the ECU to stay active";
CM_ SG_ 2654339136 PreviousCanNMState_FD16_EVCU2 "Indicates the last CanNM state that the ECU existed in";
CM_ SG_ 2654339136 PreviousCanNMState_FD05_EVCU2 "Indicates the last CanNM state that the ECU existed in";
CM_ SG_ 2654339136 GenericFailSts_FD16_EVCU2 "Indicates the presence/absent of at least one DTC in the System Memory";
CM_ SG_ 2654339136 GenericFailSts_FD05_EVCU2 "Indicates the presence/absent of at least one DTC in the System Memory";
CM_ SG_ 2654339136 EOL_FD16_EVCU2 "Indicates if the ECU requires configuration data at the assembly plant End Of Line";
CM_ SG_ 2654339136 EOL_FD05_EVCU2 "Indicates if the ECU requires configuration data at the assembly plant End Of Line";
CM_ SG_ 2654339136 DES_FD16_EVCU2 "Indicates whether the ECU?s CAN cell is in either ErrorActive, or ErrorPassive state OR has just now recovered from a BusOff condition";
CM_ SG_ 2654339136 DES_FD05_EVCU2 "Indicates whether the ECU?s CAN cell is in either ErrorActive, or ErrorPassive state OR has just now recovered from a BusOff condition";
CM_ SG_ 2654339136 CurrentFailSts_FD16_EVCU2 "Indicates the presence/absence of at least one DTC with DTCStatus = present in the System Memory";
CM_ SG_ 2654339136 CurrentFailSts_FD05_EVCU2 "Indicates the presence/absence of at least one DTC with DTCStatus = present in the System Memory";
CM_ SG_ 2654339136 CurrentCanNMState_FD16_EVCU2 "Indicates that CanNM state the ECU is currently executing";
CM_ SG_ 2654339136 CurrentCanNMState_FD05_EVCU2 "Indicates that CanNM state the ECU is currently executing";
CM_ SG_ 2654339142 WakeupSource_FD05_BPCM "Indicates the reason the ECU was most recently awakened";
CM_ SG_ 2654339142 StayActiveSource_FD05_BPCM "Indicates the source that requests the ECU to stay active";
CM_ SG_ 2654339142 PreviousCanNMState_FD05_BPCM "Indicates the last CanNM state that the ECU existed in";
CM_ SG_ 2654339142 GenericFailSts_FD05_BPCM "Indicates the presence/absent of at least one DTC in the System Memory";
CM_ SG_ 2654339142 EOL_FD05_BPCM "Indicates if the ECU requires configuration data at the assembly plant End Of Line";
CM_ SG_ 2654339142 DES_FD05_BPCM "Indicates whether the ECU?s CAN cell is in either ErrorActive, or ErrorPassive state OR has just now recovered from a BusOff condition";
CM_ SG_ 2654339142 CurrentFailSts_FD05_BPCM "Indicates the presence/absence of at least one DTC with DTCStatus = present in the System Memory";
CM_ SG_ 2654339142 CurrentCanNMState_FD05_BPCM "Indicates that CanNM state the ECU is currently executing";
CM_ SG_ 288 MessageCounter_BATT_HV_POWERLIMS "This signal is a counter used for safety checks strategies. This counter is incremented of 1 (one) unit at each frame transmission.";
CM_ SG_ 288 CRC_BATT_HV_POWERLIMS "CRC according to SAE J1850 standard at each frame transmission.";
CM_ SG_ 2564682306 N_PDU_18DDF242 "This signal is used for diagnostic purposes";
CM_ SG_ 2564682050 N_PDU_18DDF142 "This signal is used for diagnostic purposes";
CM_ SG_ 2564485756 N_PDU_18DAF27C "This signal is used for diagnostic purposes";
CM_ SG_ 2564485698 N_PDU_18DAF242 "This signal is used for diagnostic purposes";
CM_ SG_ 2564485442 N_PDU_18DAF142 "This signal is used for diagnostic purposes";
CM_ SG_ 2564440818 N_PDU_18DA42F2 "This signal is used for diagnostic purposes";
CM_ SG_ 2564440817 N_PDU_18DA42F1 "This signal is used for diagnostic purposes";
CM_ SG_ 2564486466 N_PDU_18DAF542 "This signal is used for diagnostic purposes";
CM_ SG_ 2564440821 N_PDU_18DA42F5 "This signal is used for diagnostic purposes";
CM_ SG_ 2654339142 StayActiveSource_FD11_BPCM "Indicates the source that requests the ECU to stay active";
BA_DEF_ SG_ "GenSigTimeoutTime_HCP" INT 0 65535;
BA_DEF_ SG_ "GenSigTimeoutTime_PPIM" INT 0 65535;
BA_DEF_ SG_ "GenSigTimeoutTime_APM2" INT 0 65535;
BA_DEF_ SG_ "GenSigTimeoutTime_VDCM" INT 0 65535;
BA_DEF_ SG_ "GenSigStartValue" INT 0 2147483647;
BA_DEF_ SG_ "GenSigInactiveValue" INT 0 2147483647;
BA_DEF_ SG_ "GenSigSendType" ENUM "NotUsed","OnWrite","OnWriteWithRepetition","OnChange","OnChangeWithRepetition","IfActive","IfActiveWithRepetition","NoSigSendType";
BA_DEF_ SG_ "SystemSignalLongSymbol" STRING ;
BA_DEF_ SG_ "GenSigTimeoutTime_BPCM" INT 0 65535;
BA_DEF_ SG_ "GenSigTimeoutTime_EVCU2" INT 0 65535;
BA_DEF_ SG_ "GenSigTimeoutTime_IDCM" INT 0 65535;
BA_DEF_ SG_ "GenSigTimeoutTime_SGW" INT 0 65535;
BA_DEF_ BO_ "DiagRequest" ENUM "No","Yes";
BA_DEF_ BO_ "Type" ENUM "P","C","PE","COC","PE_Cntrl","E","E_Cntrl","OC","S","BAF","DC","EM","MM","ISO-TP","-";
BA_DEF_ BO_ "DiagResponse" ENUM "No","Yes";
BA_DEF_ BO_ "NmMessage" ENUM "No","Yes";
BA_DEF_ BO_ "GenMsgSendType" ENUM "Cyclic","NotUsed","NotUsed","NotUsed","NotUsed","NotUsed","NotUsed","NotUsed","NoMsgSendType";
BA_DEF_ BO_ "GenMsgNrOfRepetition" INT 0 255;
BA_DEF_ BO_ "GenMsgILSupport" ENUM "No","Yes";
BA_DEF_ BO_ "GenMsgStartDelayTime" INT 0 65535;
BA_DEF_ BO_ "GenMsgCycleTimeFast" INT 0 65535;
BA_DEF_ BO_ "GenMsgCycleTime" INT 0 65535;
BA_DEF_ BO_ "GenMsgDelayTime" INT 0 65535;
BA_DEF_ BO_ "NmAsrMessage" ENUM "No","Yes";
BA_DEF_ BO_ "DiagState" ENUM "No","Yes";
BA_DEF_ BO_ "DiagConnection" HEX 0 65535;
BA_DEF_ BO_ "CanTpFcFrameId" HEX 0 2147483647;
BA_DEF_ BO_ "VFrameFormat" ENUM "StandardCAN","ExtendedCAN","reserved","reserved","reserved","reserved","reserved","reserved","reserved","reserved","reserved","reserved","reserved","reserved","StandardCAN_FD","ExtendedCAN_FD";
BA_DEF_ BO_ "CANFD_BRS" ENUM "0","1";
BA_DEF_DEF_ "GenSigTimeoutTime_HCP" 2500;
BA_DEF_DEF_ "GenSigTimeoutTime_PPIM" 2500;
BA_DEF_DEF_ "GenSigTimeoutTime_APM2" 2500;
BA_DEF_DEF_ "GenSigTimeoutTime_VDCM" 2500;
BA_DEF_DEF_ "GenSigStartValue" 0;
BA_DEF_DEF_ "GenSigInactiveValue" 0;
BA_DEF_DEF_ "GenSigSendType" "NoSigSendType";
BA_DEF_DEF_ "SystemSignalLongSymbol" "";
BA_DEF_DEF_ "GenSigTimeoutTime_BPCM" 2500;
BA_DEF_DEF_ "GenSigTimeoutTime_EVCU2" 2500;
BA_DEF_DEF_ "GenSigTimeoutTime_IDCM" 2500;
BA_DEF_DEF_ "GenSigTimeoutTime_SGW" 2500;
BA_DEF_DEF_ "DiagRequest" "No";
BA_DEF_DEF_ "Type" "-";
BA_DEF_DEF_ "DiagResponse" "No";
BA_DEF_DEF_ "NmMessage" "No";
BA_DEF_DEF_ "GenMsgSendType" "NoMsgSendType";
BA_DEF_DEF_ "GenMsgNrOfRepetition" 0;
BA_DEF_DEF_ "GenMsgILSupport" "No";
BA_DEF_DEF_ "GenMsgStartDelayTime" 0;
BA_DEF_DEF_ "GenMsgCycleTimeFast" 0;
BA_DEF_DEF_ "GenMsgCycleTime" 0;
BA_DEF_DEF_ "GenMsgDelayTime" 0;
BA_DEF_DEF_ "NmAsrMessage" "No";
BA_DEF_DEF_ "DiagState" "No";
BA_DEF_DEF_ "DiagConnection" 0;
BA_DEF_DEF_ "CanTpFcFrameId" 2147483647;
BA_DEF_DEF_ "VFrameFormat" "StandardCAN_FD";
BA_DEF_DEF_ "CANFD_BRS" "0";
BA_ "Type" BO_ 485 1;
BA_ "GenMsgSendType" BO_ 485 0;
BA_ "GenMsgILSupport" BO_ 485 1;
BA_ "GenMsgCycleTime" BO_ 485 20;
BA_ "CANFD_BRS" BO_ 485 1;
BA_ "Type" BO_ 288 1;
BA_ "GenMsgSendType" BO_ 288 0;
BA_ "GenMsgILSupport" BO_ 288 1;
BA_ "GenMsgCycleTime" BO_ 288 10;
BA_ "CANFD_BRS" BO_ 288 1;
BA_ "Type" BO_ 2564682306 8;
BA_ "DiagResponse" BO_ 2564682306 1;
BA_ "DiagConnection" BO_ 2564682306 62018;
BA_ "VFrameFormat" BO_ 2564682306 15;
BA_ "CANFD_BRS" BO_ 2564682306 1;
BA_ "Type" BO_ 2564682050 8;
BA_ "DiagResponse" BO_ 2564682050 1;
BA_ "DiagConnection" BO_ 2564682050 61762;
BA_ "VFrameFormat" BO_ 2564682050 1;
BA_ "Type" BO_ 2564485698 8;
BA_ "DiagResponse" BO_ 2564485698 1;
BA_ "DiagConnection" BO_ 2564485698 62018;
BA_ "VFrameFormat" BO_ 2564485698 15;
BA_ "CANFD_BRS" BO_ 2564485698 1;
BA_ "Type" BO_ 2564485442 8;
BA_ "DiagResponse" BO_ 2564485442 1;
BA_ "DiagConnection" BO_ 2564485442 61762;
BA_ "VFrameFormat" BO_ 2564485442 1;
BA_ "DiagRequest" BO_ 2564440818 1;
BA_ "Type" BO_ 2564440818 8;
BA_ "DiagConnection" BO_ 2564440818 62018;
BA_ "VFrameFormat" BO_ 2564440818 15;
BA_ "CANFD_BRS" BO_ 2564440818 1;
BA_ "DiagRequest" BO_ 2564440817 1;
BA_ "Type" BO_ 2564440817 8;
BA_ "DiagConnection" BO_ 2564440817 61762;
BA_ "VFrameFormat" BO_ 2564440817 1;
BA_ "Type" BO_ 1965 1;
BA_ "GenMsgSendType" BO_ 1965 0;
BA_ "GenMsgILSupport" BO_ 1965 1;
BA_ "GenMsgCycleTime" BO_ 1965 1000;
BA_ "CANFD_BRS" BO_ 1965 1;
BA_ "Type" BO_ 1963 1;
BA_ "GenMsgSendType" BO_ 1963 0;
BA_ "GenMsgILSupport" BO_ 1963 1;
BA_ "GenMsgCycleTime" BO_ 1963 1000;
BA_ "CANFD_BRS" BO_ 1963 1;
BA_ "Type" BO_ 1962 1;
BA_ "GenMsgSendType" BO_ 1962 0;
BA_ "GenMsgILSupport" BO_ 1962 1;
BA_ "GenMsgCycleTime" BO_ 1962 1000;
BA_ "CANFD_BRS" BO_ 1962 1;
BA_ "Type" BO_ 1961 1;
BA_ "GenMsgSendType" BO_ 1961 0;
BA_ "GenMsgILSupport" BO_ 1961 1;
BA_ "GenMsgCycleTime" BO_ 1961 1000;
BA_ "CANFD_BRS" BO_ 1961 1;
BA_ "GenMsgCycleTime" BO_ 1960 1000;
BA_ "CANFD_BRS" BO_ 1960 1;
BA_ "Type" BO_ 1960 1;
BA_ "GenMsgSendType" BO_ 1960 0;
BA_ "GenMsgILSupport" BO_ 1960 1;
BA_ "Type" BO_ 1959 1;
BA_ "GenMsgSendType" BO_ 1959 0;
BA_ "GenMsgILSupport" BO_ 1959 1;
BA_ "GenMsgCycleTime" BO_ 1959 1000;
BA_ "CANFD_BRS" BO_ 1959 1;
BA_ "Type" BO_ 1958 1;
BA_ "GenMsgSendType" BO_ 1958 0;
BA_ "GenMsgILSupport" BO_ 1958 1;
BA_ "GenMsgCycleTime" BO_ 1958 1000;
BA_ "CANFD_BRS" BO_ 1958 1;
BA_ "Type" BO_ 2564486466 8;
BA_ "DiagResponse" BO_ 2564486466 1;
BA_ "DiagConnection" BO_ 2564486466 62786;
BA_ "VFrameFormat" BO_ 2564486466 15;
BA_ "CANFD_BRS" BO_ 2564486466 1;
BA_ "DiagRequest" BO_ 2564440821 1;
BA_ "Type" BO_ 2564440821 8;
BA_ "DiagConnection" BO_ 2564440821 62786;
BA_ "VFrameFormat" BO_ 2564440821 15;
BA_ "CANFD_BRS" BO_ 2564440821 1;
BA_ "Type" BO_ 2654339136 1;
BA_ "GenMsgSendType" BO_ 2654339136 0;
BA_ "GenMsgILSupport" BO_ 2654339136 1;
BA_ "GenMsgCycleTime" BO_ 2654339136 1000;
BA_ "VFrameFormat" BO_ 2654339136 15;
BA_ "CANFD_BRS" BO_ 2654339136 1;
BA_ "Type" BO_ 2654339142 1;
BA_ "GenMsgSendType" BO_ 2654339142 0;
BA_ "GenMsgILSupport" BO_ 2654339142 1;
BA_ "GenMsgCycleTime" BO_ 2654339142 1000;
BA_ "VFrameFormat" BO_ 2654339142 15;
BA_ "CANFD_BRS" BO_ 2654339142 1;
BA_ "Type" BO_ 2564485756 8;
BA_ "DiagResponse" BO_ 2564485756 1;
BA_ "DiagConnection" BO_ 2564485756 62076;
BA_ "VFrameFormat" BO_ 2564485756 15;
BA_ "CANFD_BRS" BO_ 2564485756 1;
BA_ "GenSigTimeoutTime_BPCM" SG_ 1963 HVBatCellVoltage_Cell394 0;
BA_ "GenSigTimeoutTime_EVCU2" SG_ 1963 HVBatCellVoltage_Cell394 0;
BA_ "GenSigTimeoutTime_IDCM" SG_ 1963 HVBatCellVoltage_Cell394 0;
BA_ "GenSigTimeoutTime_VDCM" SG_ 1963 HVBatCellVoltage_Cell395 0;
BA_ "GenSigTimeoutTime_APM2" SG_ 1963 HVBatCellVoltage_Cell395 0;
BA_ "GenSigTimeoutTime_BPCM" SG_ 1963 HVBatCellVoltage_Cell395 0;
BA_ "GenSigTimeoutTime_EVCU2" SG_ 1963 HVBatCellVoltage_Cell395 0;
BA_ "GenSigTimeoutTime_IDCM" SG_ 1963 HVBatCellVoltage_Cell395 0;
BA_ "GenSigTimeoutTime_VDCM" SG_ 1963 HVBatCellVoltage_Cell396 0;
BA_ "GenSigTimeoutTime_APM2" SG_ 1963 HVBatCellVoltage_Cell396 0;
BA_ "GenSigTimeoutTime_BPCM" SG_ 1963 HVBatCellVoltage_Cell396 0;
BA_ "GenSigTimeoutTime_EVCU2" SG_ 1963 HVBatCellVoltage_Cell396 0;
BA_ "GenSigTimeoutTime_IDCM" SG_ 1963 HVBatCellVoltage_Cell396 0;
BA_ "GenSigTimeoutTime_VDCM" SG_ 1963 HVBatCellVoltage_Cell397 0;
BA_ "GenSigTimeoutTime_APM2" SG_ 1963 HVBatCellVoltage_Cell397 0;
BA_ "GenSigTimeoutTime_BPCM" SG_ 1963 HVBatCellVoltage_Cell397 0;
BA_ "GenSigTimeoutTime_EVCU2" SG_ 1963 HVBatCellVoltage_Cell397 0;
BA_ "GenSigTimeoutTime_IDCM" SG_ 1963 HVBatCellVoltage_Cell397 0;
BA_ "GenSigTimeoutTime_VDCM" SG_ 1963 HVBatCellVoltage_Cell398 0;
BA_ "GenSigTimeoutTime_APM2" SG_ 1963 HVBatCellVoltage_Cell398 0;
BA_ "GenSigTimeoutTime_BPCM" SG_ 1963 HVBatCellVoltage_Cell398 0;
BA_ "GenSigTimeoutTime_EVCU2" SG_ 1963 HVBatCellVoltage_Cell398 0;
BA_ "GenSigTimeoutTime_IDCM" SG_ 1963 HVBatCellVoltage_Cell398 0;
BA_ "GenSigTimeoutTime_VDCM" SG_ 1963 HVBatCellVoltage_Cell400 0;
BA_ "GenSigTimeoutTime_APM2" SG_ 1963 HVBatCellVoltage_Cell400 0;
BA_ "GenSigTimeoutTime_BPCM" SG_ 1963 HVBatCellVoltage_Cell400 0;
BA_ "GenSigTimeoutTime_EVCU2" SG_ 1963 HVBatCellVoltage_Cell400 0;
BA_ "GenSigTimeoutTime_IDCM" SG_ 1963 HVBatCellVoltage_Cell400 0;
BA_ "GenSigTimeoutTime_VDCM" SG_ 1963 HVBatCellVoltage_Cell399 0;
BA_ "GenSigTimeoutTime_APM2" SG_ 1963 HVBatCellVoltage_Cell399 0;
BA_ "GenSigTimeoutTime_BPCM" SG_ 1963 HVBatCellVoltage_Cell399 0;
BA_ "GenSigTimeoutTime_EVCU2" SG_ 1963 HVBatCellVoltage_Cell399 0;
BA_ "GenSigTimeoutTime_IDCM" SG_ 1963 HVBatCellVoltage_Cell399 0;
BA_ "GenSigTimeoutTime_APM2" SG_ 1962 HVBatCellVoltage_Cell382 0;
BA_ "GenSigTimeoutTime_BPCM" SG_ 1962 HVBatCellVoltage_Cell382 0;
BA_ "GenSigTimeoutTime_EVCU2" SG_ 1962 HVBatCellVoltage_Cell382 0;
BA_ "GenSigTimeoutTime_IDCM" SG_ 1962 HVBatCellVoltage_Cell382 0;
BA_ "GenSigTimeoutTime_BPCM" SG_ 1962 HVBatCellVoltage_Cell381 0;
BA_ "GenSigTimeoutTime_EVCU2" SG_ 1962 HVBatCellVoltage_Cell381 0;
BA_ "GenSigTimeoutTime_IDCM" SG_ 1962 HVBatCellVoltage_Cell381 0;
BA_ "GenSigTimeoutTime_APM2" SG_ 1962 HVBatCellVoltage_Cell376 0;
BA_ "GenSigTimeoutTime_BPCM" SG_ 1962 HVBatCellVoltage_Cell376 0;
BA_ "GenSigTimeoutTime_EVCU2" SG_ 1962 HVBatCellVoltage_Cell376 0;
BA_ "GenSigTimeoutTime_IDCM" SG_ 1962 HVBatCellVoltage_Cell376 0;
BA_ "GenSigTimeoutTime_APM2" SG_ 1962 HVBatCellVoltage_Cell375 0;
BA_ "GenSigTimeoutTime_BPCM" SG_ 1962 HVBatCellVoltage_Cell375 0;
BA_ "GenSigTimeoutTime_EVCU2" SG_ 1962 HVBatCellVoltage_Cell375 0;
BA_ "GenSigTimeoutTime_IDCM" SG_ 1962 HVBatCellVoltage_Cell375 0;
BA_ "GenSigTimeoutTime_APM2" SG_ 1962 HVBatCellVoltage_Cell374 0;
BA_ "GenSigTimeoutTime_BPCM" SG_ 1962 HVBatCellVoltage_Cell374 0;
BA_ "GenSigTimeoutTime_EVCU2" SG_ 1962 HVBatCellVoltage_Cell374 0;
BA_ "GenSigTimeoutTime_IDCM" SG_ 1962 HVBatCellVoltage_Cell374 0;
BA_ "GenSigTimeoutTime_APM2" SG_ 1962 HVBatCellVoltage_Cell373 0;
BA_ "GenSigTimeoutTime_BPCM" SG_ 1962 HVBatCellVoltage_Cell373 0;
BA_ "GenSigTimeoutTime_EVCU2" SG_ 1962 HVBatCellVoltage_Cell373 0;
BA_ "GenSigTimeoutTime_IDCM" SG_ 1962 HVBatCellVoltage_Cell373 0;
BA_ "GenSigTimeoutTime_APM2" SG_ 1962 HVBatCellVoltage_Cell372 0;
BA_ "GenSigTimeoutTime_BPCM" SG_ 1962 HVBatCellVoltage_Cell372 0;
BA_ "GenSigTimeoutTime_EVCU2" SG_ 1962 HVBatCellVoltage_Cell372 0;
BA_ "GenSigTimeoutTime_IDCM" SG_ 1962 HVBatCellVoltage_Cell372 0;
BA_ "GenSigTimeoutTime_APM2" SG_ 1962 HVBatCellVoltage_Cell371 0;
BA_ "GenSigTimeoutTime_BPCM" SG_ 1962 HVBatCellVoltage_Cell371 0;
BA_ "GenSigTimeoutTime_EVCU2" SG_ 1962 HVBatCellVoltage_Cell371 0;
BA_ "GenSigTimeoutTime_IDCM" SG_ 1962 HVBatCellVoltage_Cell371 0;
BA_ "GenSigTimeoutTime_APM2" SG_ 1962 HVBatCellVoltage_Cell370 0;
BA_ "GenSigTimeoutTime_BPCM" SG_ 1962 HVBatCellVoltage_Cell370 0;
BA_ "GenSigTimeoutTime_EVCU2" SG_ 1962 HVBatCellVoltage_Cell370 0;
BA_ "GenSigTimeoutTime_IDCM" SG_ 1962 HVBatCellVoltage_Cell370 0;
BA_ "GenSigTimeoutTime_APM2" SG_ 1962 HVBatCellVoltage_Cell369 0;
BA_ "GenSigTimeoutTime_BPCM" SG_ 1962 HVBatCellVoltage_Cell369 0;
BA_ "GenSigTimeoutTime_EVCU2" SG_ 1962 HVBatCellVoltage_Cell369 0;
BA_ "GenSigTimeoutTime_IDCM" SG_ 1962 HVBatCellVoltage_Cell369 0;
BA_ "GenSigTimeoutTime_APM2" SG_ 1962 HVBatCellVoltage_Cell368 0;
BA_ "GenSigTimeoutTime_BPCM" SG_ 1962 HVBatCellVoltage_Cell368 0;
BA_ "GenSigTimeoutTime_EVCU2" SG_ 1962 HVBatCellVoltage_Cell368 0;
BA_ "GenSigTimeoutTime_IDCM" SG_ 1962 HVBatCellVoltage_Cell368 0;
BA_ "GenSigTimeoutTime_APM2" SG_ 1962 HVBatCellVoltage_Cell367 0;
BA_ "GenSigTimeoutTime_BPCM" SG_ 1962 HVBatCellVoltage_Cell367 0;
BA_ "GenSigTimeoutTime_EVCU2" SG_ 1962 HVBatCellVoltage_Cell367 0;
BA_ "GenSigTimeoutTime_IDCM" SG_ 1962 HVBatCellVoltage_Cell367 0;
BA_ "GenSigTimeoutTime_APM2" SG_ 1962 HVBatCellVoltage_Cell366 0;
BA_ "GenSigTimeoutTime_BPCM" SG_ 1962 HVBatCellVoltage_Cell366 0;
BA_ "GenSigTimeoutTime_EVCU2" SG_ 1962 HVBatCellVoltage_Cell366 0;
BA_ "GenSigTimeoutTime_IDCM" SG_ 1962 HVBatCellVoltage_Cell366 0;
BA_ "GenSigTimeoutTime_APM2" SG_ 1962 HVBatCellVoltage_Cell365 0;
BA_ "GenSigTimeoutTime_BPCM" SG_ 1962 HVBatCellVoltage_Cell365 0;
BA_ "GenSigTimeoutTime_EVCU2" SG_ 1962 HVBatCellVoltage_Cell365 0;
BA_ "GenSigTimeoutTime_IDCM" SG_ 1962 HVBatCellVoltage_Cell365 0;
BA_ "GenSigTimeoutTime_APM2" SG_ 1962 HVBatCellVoltage_Cell364 0;
BA_ "GenSigTimeoutTime_BPCM" SG_ 1962 HVBatCellVoltage_Cell364 0;
BA_ "GenSigTimeoutTime_EVCU2" SG_ 1962 HVBatCellVoltage_Cell364 0;
BA_ "GenSigTimeoutTime_IDCM" SG_ 1962 HVBatCellVoltage_Cell364 0;
BA_ "GenSigTimeoutTime_APM2" SG_ 1962 HVBatCellVoltage_Cell363 0;
BA_ "GenSigTimeoutTime_BPCM" SG_ 1962 HVBatCellVoltage_Cell363 0;
BA_ "GenSigTimeoutTime_EVCU2" SG_ 1962 HVBatCellVoltage_Cell363 0;
BA_ "GenSigTimeoutTime_IDCM" SG_ 1962 HVBatCellVoltage_Cell363 0;
BA_ "GenSigTimeoutTime_APM2" SG_ 1962 HVBatCellVoltage_Cell362 0;
BA_ "GenSigTimeoutTime_BPCM" SG_ 1962 HVBatCellVoltage_Cell362 0;
BA_ "GenSigTimeoutTime_EVCU2" SG_ 1962 HVBatCellVoltage_Cell362 0;
BA_ "GenSigTimeoutTime_IDCM" SG_ 1962 HVBatCellVoltage_Cell362 0;
BA_ "GenSigTimeoutTime_APM2" SG_ 1962 HVBatCellVoltage_Cell361 0;
BA_ "GenSigTimeoutTime_BPCM" SG_ 1962 HVBatCellVoltage_Cell361 0;
BA_ "GenSigTimeoutTime_EVCU2" SG_ 1962 HVBatCellVoltage_Cell361 0;
BA_ "GenSigTimeoutTime_IDCM" SG_ 1962 HVBatCellVoltage_Cell361 0;
BA_ "GenSigTimeoutTime_VDCM" SG_ 1965 HVBatCellVoltage_Cell232 0;
BA_ "GenSigTimeoutTime_VDCM" SG_ 1965 HVBatCellVoltage_Cell224 0;
BA_ "GenSigTimeoutTime_APM2" SG_ 1965 HVBatCellVoltage_Cell224 0;
BA_ "GenSigTimeoutTime_BPCM" SG_ 1965 HVBatCellVoltage_Cell224 0;
BA_ "GenSigTimeoutTime_EVCU2" SG_ 1965 HVBatCellVoltage_Cell224 0;
BA_ "GenSigTimeoutTime_IDCM" SG_ 1965 HVBatCellVoltage_Cell224 0;
BA_ "GenSigTimeoutTime_VDCM" SG_ 1965 HVBatCellVoltage_Cell225 0;
BA_ "GenSigTimeoutTime_APM2" SG_ 1965 HVBatCellVoltage_Cell225 0;
BA_ "GenSigTimeoutTime_BPCM" SG_ 1965 HVBatCellVoltage_Cell225 0;
BA_ "GenSigTimeoutTime_EVCU2" SG_ 1965 HVBatCellVoltage_Cell225 0;
BA_ "GenSigTimeoutTime_IDCM" SG_ 1965 HVBatCellVoltage_Cell225 0;
BA_ "GenSigTimeoutTime_VDCM" SG_ 1965 HVBatCellVoltage_Cell226 0;
BA_ "GenSigTimeoutTime_APM2" SG_ 1965 HVBatCellVoltage_Cell226 0;
BA_ "GenSigTimeoutTime_BPCM" SG_ 1965 HVBatCellVoltage_Cell226 0;
BA_ "GenSigTimeoutTime_EVCU2" SG_ 1965 HVBatCellVoltage_Cell226 0;
BA_ "GenSigTimeoutTime_IDCM" SG_ 1965 HVBatCellVoltage_Cell226 0;
BA_ "GenSigTimeoutTime_APM2" SG_ 1965 HVBatCellVoltage_Cell227 0;
BA_ "GenSigTimeoutTime_BPCM" SG_ 1965 HVBatCellVoltage_Cell227 0;
BA_ "GenSigTimeoutTime_EVCU2" SG_ 1965 HVBatCellVoltage_Cell227 0;
BA_ "GenSigTimeoutTime_IDCM" SG_ 1965 HVBatCellVoltage_Cell227 0;
BA_ "GenSigTimeoutTime_VDCM" SG_ 1965 HVBatCellVoltage_Cell227 0;
BA_ "GenSigTimeoutTime_APM2" SG_ 1965 HVBatCellVoltage_Cell228 0;
BA_ "GenSigTimeoutTime_BPCM" SG_ 1965 HVBatCellVoltage_Cell228 0;
BA_ "GenSigTimeoutTime_EVCU2" SG_ 1965 HVBatCellVoltage_Cell228 0;
BA_ "GenSigTimeoutTime_IDCM" SG_ 1965 HVBatCellVoltage_Cell228 0;
BA_ "GenSigTimeoutTime_VDCM" SG_ 1965 HVBatCellVoltage_Cell228 0;
BA_ "GenSigTimeoutTime_APM2" SG_ 1965 HVBatCellVoltage_Cell229 0;
BA_ "GenSigTimeoutTime_BPCM" SG_ 1965 HVBatCellVoltage_Cell229 0;
BA_ "GenSigTimeoutTime_EVCU2" SG_ 1965 HVBatCellVoltage_Cell229 0;
BA_ "GenSigTimeoutTime_IDCM" SG_ 1965 HVBatCellVoltage_Cell229 0;
BA_ "GenSigTimeoutTime_VDCM" SG_ 1965 HVBatCellVoltage_Cell229 0;
BA_ "GenSigTimeoutTime_VDCM" SG_ 1965 HVBatCellVoltage_Cell230 0;
BA_ "GenSigTimeoutTime_VDCM" SG_ 1965 HVBatCellVoltage_Cell231 0;
BA_ "GenSigTimeoutTime_VDCM" SG_ 1965 HVBatCellVoltage_Cell217 0;
BA_ "GenSigTimeoutTime_APM2" SG_ 1965 HVBatCellVoltage_Cell217 0;
BA_ "GenSigTimeoutTime_BPCM" SG_ 1965 HVBatCellVoltage_Cell217 0;
BA_ "GenSigTimeoutTime_EVCU2" SG_ 1965 HVBatCellVoltage_Cell217 0;
BA_ "GenSigTimeoutTime_IDCM" SG_ 1965 HVBatCellVoltage_Cell217 0;
BA_ "GenSigTimeoutTime_BPCM" SG_ 1965 HVBatCellVoltage_Cell218 0;
BA_ "GenSigTimeoutTime_EVCU2" SG_ 1965 HVBatCellVoltage_Cell218 0;
BA_ "GenSigTimeoutTime_IDCM" SG_ 1965 HVBatCellVoltage_Cell218 0;
BA_ "GenSigTimeoutTime_VDCM" SG_ 1965 HVBatCellVoltage_Cell218 0;
BA_ "GenSigTimeoutTime_APM2" SG_ 1965 HVBatCellVoltage_Cell218 0;
BA_ "GenSigTimeoutTime_APM2" SG_ 1965 HVBatCellVoltage_Cell219 0;
BA_ "GenSigTimeoutTime_BPCM" SG_ 1965 HVBatCellVoltage_Cell219 0;
BA_ "GenSigTimeoutTime_EVCU2" SG_ 1965 HVBatCellVoltage_Cell219 0;
BA_ "GenSigTimeoutTime_IDCM" SG_ 1965 HVBatCellVoltage_Cell219 0;
BA_ "GenSigTimeoutTime_VDCM" SG_ 1965 HVBatCellVoltage_Cell219 0;
BA_ "GenSigTimeoutTime_APM2" SG_ 1965 HVBatCellVoltage_Cell220 0;
BA_ "GenSigTimeoutTime_BPCM" SG_ 1965 HVBatCellVoltage_Cell220 0;
BA_ "GenSigTimeoutTime_EVCU2" SG_ 1965 HVBatCellVoltage_Cell220 0;
BA_ "GenSigTimeoutTime_IDCM" SG_ 1965 HVBatCellVoltage_Cell220 0;
BA_ "GenSigTimeoutTime_VDCM" SG_ 1965 HVBatCellVoltage_Cell220 0;
BA_ "GenSigTimeoutTime_VDCM" SG_ 1965 HVBatCellVoltage_Cell221 0;
BA_ "GenSigTimeoutTime_APM2" SG_ 1965 HVBatCellVoltage_Cell221 0;
BA_ "GenSigTimeoutTime_BPCM" SG_ 1965 HVBatCellVoltage_Cell221 0;
BA_ "GenSigTimeoutTime_EVCU2" SG_ 1965 HVBatCellVoltage_Cell221 0;
BA_ "GenSigTimeoutTime_IDCM" SG_ 1965 HVBatCellVoltage_Cell221 0;
BA_ "GenSigTimeoutTime_VDCM" SG_ 1965 HVBatCellVoltage_Cell222 0;
BA_ "GenSigTimeoutTime_APM2" SG_ 1965 HVBatCellVoltage_Cell222 0;
BA_ "GenSigTimeoutTime_BPCM" SG_ 1965 HVBatCellVoltage_Cell222 0;
BA_ "GenSigTimeoutTime_EVCU2" SG_ 1965 HVBatCellVoltage_Cell222 0;
BA_ "GenSigTimeoutTime_IDCM" SG_ 1965 HVBatCellVoltage_Cell222 0;
BA_ "GenSigTimeoutTime_VDCM" SG_ 1965 HVBatCellVoltage_Cell223 0;
BA_ "GenSigTimeoutTime_APM2" SG_ 1965 HVBatCellVoltage_Cell223 0;
BA_ "GenSigTimeoutTime_BPCM" SG_ 1965 HVBatCellVoltage_Cell223 0;
BA_ "GenSigTimeoutTime_EVCU2" SG_ 1965 HVBatCellVoltage_Cell223 0;
BA_ "GenSigTimeoutTime_IDCM" SG_ 1965 HVBatCellVoltage_Cell223 0;
BA_ "GenSigTimeoutTime_APM2" SG_ 1965 HVBatCellVoltage_Cell231 0;
BA_ "GenSigTimeoutTime_BPCM" SG_ 1965 HVBatCellVoltage_Cell231 0;
BA_ "GenSigTimeoutTime_EVCU2" SG_ 1965 HVBatCellVoltage_Cell231 0;
BA_ "GenSigTimeoutTime_IDCM" SG_ 1965 HVBatCellVoltage_Cell231 0;
BA_ "GenSigTimeoutTime_APM2" SG_ 1965 HVBatCellVoltage_Cell230 0;
BA_ "GenSigTimeoutTime_BPCM" SG_ 1965 HVBatCellVoltage_Cell230 0;
BA_ "GenSigTimeoutTime_EVCU2" SG_ 1965 HVBatCellVoltage_Cell230 0;
BA_ "GenSigTimeoutTime_IDCM" SG_ 1965 HVBatCellVoltage_Cell230 0;
BA_ "GenSigTimeoutTime_APM2" SG_ 1965 HVBatCellVoltage_Cell232 0;
BA_ "GenSigTimeoutTime_BPCM" SG_ 1965 HVBatCellVoltage_Cell232 0;
BA_ "GenSigTimeoutTime_EVCU2" SG_ 1965 HVBatCellVoltage_Cell232 0;
BA_ "GenSigTimeoutTime_IDCM" SG_ 1965 HVBatCellVoltage_Cell232 0;
BA_ "GenSigTimeoutTime_VDCM" SG_ 1958 HVBatCellVoltage_Cell233 0;
BA_ "GenSigTimeoutTime_APM2" SG_ 1958 HVBatCellVoltage_Cell233 0;
BA_ "GenSigTimeoutTime_BPCM" SG_ 1958 HVBatCellVoltage_Cell233 0;
BA_ "GenSigTimeoutTime_EVCU2" SG_ 1958 HVBatCellVoltage_Cell233 0;
BA_ "GenSigTimeoutTime_IDCM" SG_ 1958 HVBatCellVoltage_Cell233 0;
BA_ "GenSigTimeoutTime_VDCM" SG_ 1958 HVBatCellVoltage_Cell234 0;
BA_ "GenSigTimeoutTime_APM2" SG_ 1958 HVBatCellVoltage_Cell234 0;
BA_ "GenSigTimeoutTime_BPCM" SG_ 1958 HVBatCellVoltage_Cell234 0;
BA_ "GenSigTimeoutTime_EVCU2" SG_ 1958 HVBatCellVoltage_Cell234 0;
BA_ "GenSigTimeoutTime_IDCM" SG_ 1958 HVBatCellVoltage_Cell234 0;
BA_ "GenSigTimeoutTime_VDCM" SG_ 1958 HVBatCellVoltage_Cell235 0;
BA_ "GenSigTimeoutTime_APM2" SG_ 1958 HVBatCellVoltage_Cell235 0;
BA_ "GenSigTimeoutTime_BPCM" SG_ 1958 HVBatCellVoltage_Cell235 0;
BA_ "GenSigTimeoutTime_EVCU2" SG_ 1958 HVBatCellVoltage_Cell235 0;
BA_ "GenSigTimeoutTime_IDCM" SG_ 1958 HVBatCellVoltage_Cell235 0;
BA_ "GenSigTimeoutTime_VDCM" SG_ 1958 HVBatCellVoltage_Cell236 0;
BA_ "GenSigTimeoutTime_APM2" SG_ 1958 HVBatCellVoltage_Cell236 0;
BA_ "GenSigTimeoutTime_BPCM" SG_ 1958 HVBatCellVoltage_Cell236 0;
BA_ "GenSigTimeoutTime_EVCU2" SG_ 1958 HVBatCellVoltage_Cell236 0;
BA_ "GenSigTimeoutTime_IDCM" SG_ 1958 HVBatCellVoltage_Cell236 0;
BA_ "GenSigTimeoutTime_VDCM" SG_ 1958 HVBatCellVoltage_Cell237 0;
BA_ "GenSigTimeoutTime_APM2" SG_ 1958 HVBatCellVoltage_Cell237 0;
BA_ "GenSigTimeoutTime_BPCM" SG_ 1958 HVBatCellVoltage_Cell237 0;
BA_ "GenSigTimeoutTime_EVCU2" SG_ 1958 HVBatCellVoltage_Cell237 0;
BA_ "GenSigTimeoutTime_IDCM" SG_ 1958 HVBatCellVoltage_Cell237 0;
BA_ "GenSigTimeoutTime_VDCM" SG_ 1958 HVBatCellVoltage_Cell238 0;
BA_ "GenSigTimeoutTime_APM2" SG_ 1958 HVBatCellVoltage_Cell238 0;
BA_ "GenSigTimeoutTime_BPCM" SG_ 1958 HVBatCellVoltage_Cell238 0;
BA_ "GenSigTimeoutTime_EVCU2" SG_ 1958 HVBatCellVoltage_Cell238 0;
BA_ "GenSigTimeoutTime_IDCM" SG_ 1958 HVBatCellVoltage_Cell238 0;
BA_ "GenSigTimeoutTime_VDCM" SG_ 1958 HVBatCellVoltage_Cell239 0;
BA_ "GenSigTimeoutTime_APM2" SG_ 1958 HVBatCellVoltage_Cell239 0;
BA_ "GenSigTimeoutTime_BPCM" SG_ 1958 HVBatCellVoltage_Cell239 0;
BA_ "GenSigTimeoutTime_EVCU2" SG_ 1958 HVBatCellVoltage_Cell239 0;
BA_ "GenSigTimeoutTime_IDCM" SG_ 1958 HVBatCellVoltage_Cell239 0;
BA_ "GenSigTimeoutTime_VDCM" SG_ 1958 HVBatCellVoltage_Cell240 0;
BA_ "GenSigTimeoutTime_APM2" SG_ 1958 HVBatCellVoltage_Cell240 0;
BA_ "GenSigTimeoutTime_BPCM" SG_ 1958 HVBatCellVoltage_Cell240 0;
BA_ "GenSigTimeoutTime_EVCU2" SG_ 1958 HVBatCellVoltage_Cell240 0;
BA_ "GenSigTimeoutTime_IDCM" SG_ 1958 HVBatCellVoltage_Cell240 0;
BA_ "GenSigTimeoutTime_VDCM" SG_ 1958 HVBatCellVoltage_Cell241 0;
BA_ "GenSigTimeoutTime_APM2" SG_ 1958 HVBatCellVoltage_Cell241 0;
BA_ "GenSigTimeoutTime_BPCM" SG_ 1958 HVBatCellVoltage_Cell241 0;
BA_ "GenSigTimeoutTime_EVCU2" SG_ 1958 HVBatCellVoltage_Cell241 0;
BA_ "GenSigTimeoutTime_IDCM" SG_ 1958 HVBatCellVoltage_Cell241 0;
BA_ "GenSigTimeoutTime_VDCM" SG_ 1958 HVBatCellVoltage_Cell242 0;
BA_ "GenSigTimeoutTime_APM2" SG_ 1958 HVBatCellVoltage_Cell242 0;
BA_ "GenSigTimeoutTime_BPCM" SG_ 1958 HVBatCellVoltage_Cell242 0;
BA_ "GenSigTimeoutTime_EVCU2" SG_ 1958 HVBatCellVoltage_Cell242 0;
BA_ "GenSigTimeoutTime_IDCM" SG_ 1958 HVBatCellVoltage_Cell242 0;
BA_ "GenSigTimeoutTime_VDCM" SG_ 1958 HVBatCellVoltage_Cell243 0;
BA_ "GenSigTimeoutTime_APM2" SG_ 1958 HVBatCellVoltage_Cell243 0;
BA_ "GenSigTimeoutTime_BPCM" SG_ 1958 HVBatCellVoltage_Cell243 0;
BA_ "GenSigTimeoutTime_EVCU2" SG_ 1958 HVBatCellVoltage_Cell243 0;
BA_ "GenSigTimeoutTime_IDCM" SG_ 1958 HVBatCellVoltage_Cell243 0;
BA_ "GenSigTimeoutTime_VDCM" SG_ 1958 HVBatCellVoltage_Cell244 0;
BA_ "GenSigTimeoutTime_APM2" SG_ 1958 HVBatCellVoltage_Cell244 0;
BA_ "GenSigTimeoutTime_BPCM" SG_ 1958 HVBatCellVoltage_Cell244 0;
BA_ "GenSigTimeoutTime_EVCU2" SG_ 1958 HVBatCellVoltage_Cell244 0;
BA_ "GenSigTimeoutTime_IDCM" SG_ 1958 HVBatCellVoltage_Cell244 0;
BA_ "GenSigTimeoutTime_VDCM" SG_ 1958 HVBatCellVoltage_Cell245 0;
BA_ "GenSigTimeoutTime_APM2" SG_ 1958 HVBatCellVoltage_Cell245 0;
BA_ "GenSigTimeoutTime_BPCM" SG_ 1958 HVBatCellVoltage_Cell245 0;
BA_ "GenSigTimeoutTime_EVCU2" SG_ 1958 HVBatCellVoltage_Cell245 0;
BA_ "GenSigTimeoutTime_IDCM" SG_ 1958 HVBatCellVoltage_Cell245 0;
BA_ "GenSigTimeoutTime_VDCM" SG_ 1958 HVBatCellVoltage_Cell246 0;
BA_ "GenSigTimeoutTime_APM2" SG_ 1958 HVBatCellVoltage_Cell246 0;
BA_ "GenSigTimeoutTime_BPCM" SG_ 1958 HVBatCellVoltage_Cell246 0;
BA_ "GenSigTimeoutTime_EVCU2" SG_ 1958 HVBatCellVoltage_Cell246 0;
BA_ "GenSigTimeoutTime_IDCM" SG_ 1958 HVBatCellVoltage_Cell246 0;
BA_ "GenSigTimeoutTime_VDCM" SG_ 1958 HVBatCellVoltage_Cell247 0;
BA_ "GenSigTimeoutTime_APM2" SG_ 1958 HVBatCellVoltage_Cell247 0;
BA_ "GenSigTimeoutTime_BPCM" SG_ 1958 HVBatCellVoltage_Cell247 0;
BA_ "GenSigTimeoutTime_EVCU2" SG_ 1958 HVBatCellVoltage_Cell247 0;
BA_ "GenSigTimeoutTime_IDCM" SG_ 1958 HVBatCellVoltage_Cell247 0;
BA_ "GenSigTimeoutTime_VDCM" SG_ 1958 HVBatCellVoltage_Cell248 0;
BA_ "GenSigTimeoutTime_APM2" SG_ 1958 HVBatCellVoltage_Cell248 0;
BA_ "GenSigTimeoutTime_BPCM" SG_ 1958 HVBatCellVoltage_Cell248 0;
BA_ "GenSigTimeoutTime_EVCU2" SG_ 1958 HVBatCellVoltage_Cell248 0;
BA_ "GenSigTimeoutTime_IDCM" SG_ 1958 HVBatCellVoltage_Cell248 0;
BA_ "GenSigTimeoutTime_VDCM" SG_ 1958 HVBatCellVoltage_Cell249 0;
BA_ "GenSigTimeoutTime_APM2" SG_ 1958 HVBatCellVoltage_Cell249 0;
BA_ "GenSigTimeoutTime_BPCM" SG_ 1958 HVBatCellVoltage_Cell249 0;
BA_ "GenSigTimeoutTime_EVCU2" SG_ 1958 HVBatCellVoltage_Cell249 0;
BA_ "GenSigTimeoutTime_IDCM" SG_ 1958 HVBatCellVoltage_Cell249 0;
BA_ "GenSigTimeoutTime_VDCM" SG_ 1958 HVBatCellVoltage_Cell250 0;
BA_ "GenSigTimeoutTime_APM2" SG_ 1958 HVBatCellVoltage_Cell250 0;
BA_ "GenSigTimeoutTime_BPCM" SG_ 1958 HVBatCellVoltage_Cell250 0;
BA_ "GenSigTimeoutTime_EVCU2" SG_ 1958 HVBatCellVoltage_Cell250 0;
BA_ "GenSigTimeoutTime_IDCM" SG_ 1958 HVBatCellVoltage_Cell250 0;
BA_ "GenSigTimeoutTime_VDCM" SG_ 1958 HVBatCellVoltage_Cell251 0;
BA_ "GenSigTimeoutTime_APM2" SG_ 1958 HVBatCellVoltage_Cell251 0;
BA_ "GenSigTimeoutTime_BPCM" SG_ 1958 HVBatCellVoltage_Cell251 0;
BA_ "GenSigTimeoutTime_EVCU2" SG_ 1958 HVBatCellVoltage_Cell251 0;
BA_ "GenSigTimeoutTime_IDCM" SG_ 1958 HVBatCellVoltage_Cell251 0;
BA_ "GenSigTimeoutTime_VDCM" SG_ 1958 HVBatCellVoltage_Cell252 0;
BA_ "GenSigTimeoutTime_APM2" SG_ 1958 HVBatCellVoltage_Cell252 0;
BA_ "GenSigTimeoutTime_BPCM" SG_ 1958 HVBatCellVoltage_Cell252 0;
BA_ "GenSigTimeoutTime_EVCU2" SG_ 1958 HVBatCellVoltage_Cell252 0;
BA_ "GenSigTimeoutTime_IDCM" SG_ 1958 HVBatCellVoltage_Cell252 0;
BA_ "GenSigTimeoutTime_VDCM" SG_ 1958 HVBatCellVoltage_Cell253 0;
BA_ "GenSigTimeoutTime_APM2" SG_ 1958 HVBatCellVoltage_Cell253 0;
BA_ "GenSigTimeoutTime_BPCM" SG_ 1958 HVBatCellVoltage_Cell253 0;
BA_ "GenSigTimeoutTime_EVCU2" SG_ 1958 HVBatCellVoltage_Cell253 0;
BA_ "GenSigTimeoutTime_IDCM" SG_ 1958 HVBatCellVoltage_Cell253 0;
BA_ "GenSigTimeoutTime_VDCM" SG_ 1958 HVBatCellVoltage_Cell254 0;
BA_ "GenSigTimeoutTime_APM2" SG_ 1958 HVBatCellVoltage_Cell254 0;
BA_ "GenSigTimeoutTime_BPCM" SG_ 1958 HVBatCellVoltage_Cell254 0;
BA_ "GenSigTimeoutTime_EVCU2" SG_ 1958 HVBatCellVoltage_Cell254 0;
BA_ "GenSigTimeoutTime_IDCM" SG_ 1958 HVBatCellVoltage_Cell254 0;
BA_ "GenSigTimeoutTime_VDCM" SG_ 1958 HVBatCellVoltage_Cell255 0;
BA_ "GenSigTimeoutTime_APM2" SG_ 1958 HVBatCellVoltage_Cell255 0;
BA_ "GenSigTimeoutTime_BPCM" SG_ 1958 HVBatCellVoltage_Cell255 0;
BA_ "GenSigTimeoutTime_EVCU2" SG_ 1958 HVBatCellVoltage_Cell255 0;
BA_ "GenSigTimeoutTime_IDCM" SG_ 1958 HVBatCellVoltage_Cell255 0;
BA_ "GenSigTimeoutTime_VDCM" SG_ 1958 HVBatCellVoltage_Cell256 0;
BA_ "GenSigTimeoutTime_APM2" SG_ 1958 HVBatCellVoltage_Cell256 0;
BA_ "GenSigTimeoutTime_BPCM" SG_ 1958 HVBatCellVoltage_Cell256 0;
BA_ "GenSigTimeoutTime_EVCU2" SG_ 1958 HVBatCellVoltage_Cell256 0;
BA_ "GenSigTimeoutTime_IDCM" SG_ 1958 HVBatCellVoltage_Cell256 0;
BA_ "GenSigTimeoutTime_VDCM" SG_ 1958 HVBatCellVoltage_Cell257 0;
BA_ "GenSigTimeoutTime_APM2" SG_ 1958 HVBatCellVoltage_Cell257 0;
BA_ "GenSigTimeoutTime_BPCM" SG_ 1958 HVBatCellVoltage_Cell257 0;
BA_ "GenSigTimeoutTime_EVCU2" SG_ 1958 HVBatCellVoltage_Cell257 0;
BA_ "GenSigTimeoutTime_IDCM" SG_ 1958 HVBatCellVoltage_Cell257 0;
BA_ "GenSigTimeoutTime_VDCM" SG_ 1958 HVBatCellVoltage_Cell258 0;
BA_ "GenSigTimeoutTime_APM2" SG_ 1958 HVBatCellVoltage_Cell258 0;
BA_ "GenSigTimeoutTime_BPCM" SG_ 1958 HVBatCellVoltage_Cell258 0;
BA_ "GenSigTimeoutTime_EVCU2" SG_ 1958 HVBatCellVoltage_Cell258 0;
BA_ "GenSigTimeoutTime_IDCM" SG_ 1958 HVBatCellVoltage_Cell258 0;
BA_ "GenSigTimeoutTime_VDCM" SG_ 1958 HVBatCellVoltage_Cell259 0;
BA_ "GenSigTimeoutTime_APM2" SG_ 1958 HVBatCellVoltage_Cell259 0;
BA_ "GenSigTimeoutTime_BPCM" SG_ 1958 HVBatCellVoltage_Cell259 0;
BA_ "GenSigTimeoutTime_EVCU2" SG_ 1958 HVBatCellVoltage_Cell259 0;
BA_ "GenSigTimeoutTime_IDCM" SG_ 1958 HVBatCellVoltage_Cell259 0;
BA_ "GenSigTimeoutTime_IDCM" SG_ 1958 HVBatCellVoltage_Cell260 0;
BA_ "GenSigTimeoutTime_VDCM" SG_ 1958 HVBatCellVoltage_Cell260 0;
BA_ "GenSigTimeoutTime_APM2" SG_ 1958 HVBatCellVoltage_Cell260 0;
BA_ "GenSigTimeoutTime_BPCM" SG_ 1958 HVBatCellVoltage_Cell260 0;
BA_ "GenSigTimeoutTime_EVCU2" SG_ 1958 HVBatCellVoltage_Cell260 0;
BA_ "GenSigTimeoutTime_APM2" SG_ 1958 HVBatCellVoltage_Cell261 0;
BA_ "GenSigTimeoutTime_BPCM" SG_ 1958 HVBatCellVoltage_Cell261 0;
BA_ "GenSigTimeoutTime_EVCU2" SG_ 1958 HVBatCellVoltage_Cell261 0;
BA_ "GenSigTimeoutTime_IDCM" SG_ 1958 HVBatCellVoltage_Cell261 0;
BA_ "GenSigTimeoutTime_VDCM" SG_ 1958 HVBatCellVoltage_Cell261 0;
BA_ "GenSigTimeoutTime_APM2" SG_ 1958 HVBatCellVoltage_Cell262 0;
BA_ "GenSigTimeoutTime_BPCM" SG_ 1958 HVBatCellVoltage_Cell262 0;
BA_ "GenSigTimeoutTime_EVCU2" SG_ 1958 HVBatCellVoltage_Cell262 0;
BA_ "GenSigTimeoutTime_IDCM" SG_ 1958 HVBatCellVoltage_Cell262 0;
BA_ "GenSigTimeoutTime_VDCM" SG_ 1958 HVBatCellVoltage_Cell262 0;
BA_ "GenSigTimeoutTime_APM2" SG_ 1958 HVBatCellVoltage_Cell263 0;
BA_ "GenSigTimeoutTime_BPCM" SG_ 1958 HVBatCellVoltage_Cell263 0;
BA_ "GenSigTimeoutTime_EVCU2" SG_ 1958 HVBatCellVoltage_Cell263 0;
BA_ "GenSigTimeoutTime_IDCM" SG_ 1958 HVBatCellVoltage_Cell263 0;
BA_ "GenSigTimeoutTime_VDCM" SG_ 1958 HVBatCellVoltage_Cell263 0;
BA_ "GenSigTimeoutTime_APM2" SG_ 1958 HVBatCellVoltage_Cell264 0;
BA_ "GenSigTimeoutTime_BPCM" SG_ 1958 HVBatCellVoltage_Cell264 0;
BA_ "GenSigTimeoutTime_EVCU2" SG_ 1958 HVBatCellVoltage_Cell264 0;
BA_ "GenSigTimeoutTime_IDCM" SG_ 1958 HVBatCellVoltage_Cell264 0;
BA_ "GenSigTimeoutTime_VDCM" SG_ 1958 HVBatCellVoltage_Cell264 0;
BA_ "GenSigTimeoutTime_VDCM" SG_ 1959 HVBatCellVoltage_Cell265 0;
BA_ "GenSigTimeoutTime_APM2" SG_ 1959 HVBatCellVoltage_Cell265 0;
BA_ "GenSigTimeoutTime_BPCM" SG_ 1959 HVBatCellVoltage_Cell265 0;
BA_ "GenSigTimeoutTime_EVCU2" SG_ 1959 HVBatCellVoltage_Cell265 0;
BA_ "GenSigTimeoutTime_IDCM" SG_ 1959 HVBatCellVoltage_Cell265 0;
BA_ "GenSigTimeoutTime_VDCM" SG_ 1959 HVBatCellVoltage_Cell266 0;
BA_ "GenSigTimeoutTime_APM2" SG_ 1959 HVBatCellVoltage_Cell266 0;
BA_ "GenSigTimeoutTime_BPCM" SG_ 1959 HVBatCellVoltage_Cell266 0;
BA_ "GenSigTimeoutTime_EVCU2" SG_ 1959 HVBatCellVoltage_Cell266 0;
BA_ "GenSigTimeoutTime_IDCM" SG_ 1959 HVBatCellVoltage_Cell266 0;
BA_ "GenSigTimeoutTime_VDCM" SG_ 1959 HVBatCellVoltage_Cell267 0;
BA_ "GenSigTimeoutTime_APM2" SG_ 1959 HVBatCellVoltage_Cell267 0;
BA_ "GenSigTimeoutTime_BPCM" SG_ 1959 HVBatCellVoltage_Cell267 0;
BA_ "GenSigTimeoutTime_EVCU2" SG_ 1959 HVBatCellVoltage_Cell267 0;
BA_ "GenSigTimeoutTime_IDCM" SG_ 1959 HVBatCellVoltage_Cell267 0;
BA_ "GenSigTimeoutTime_EVCU2" SG_ 1959 HVBatCellVoltage_Cell268 0;
BA_ "GenSigTimeoutTime_IDCM" SG_ 1959 HVBatCellVoltage_Cell268 0;
BA_ "GenSigTimeoutTime_APM2" SG_ 2564485442 N_PDU_18DAF142 0;
BA_ "GenSigTimeoutTime_VDCM" SG_ 2564485442 N_PDU_18DAF142 0;
BA_ "GenSigTimeoutTime_BPCM" SG_ 2564485442 N_PDU_18DAF142 0;
BA_ "GenSigTimeoutTime_EVCU2" SG_ 2564485442 N_PDU_18DAF142 0;
BA_ "GenSigTimeoutTime_IDCM" SG_ 2564485442 N_PDU_18DAF142 0;
BA_ "GenSigTimeoutTime_SGW" SG_ 2564485442 N_PDU_18DAF142 0;
BA_ "GenSigTimeoutTime_APM2" SG_ 2564682050 N_PDU_18DDF142 0;
BA_ "GenSigTimeoutTime_VDCM" SG_ 2564682050 N_PDU_18DDF142 0;
BA_ "GenSigTimeoutTime_BPCM" SG_ 2564682050 N_PDU_18DDF142 0;
BA_ "GenSigTimeoutTime_EVCU2" SG_ 2564682050 N_PDU_18DDF142 0;
BA_ "GenSigTimeoutTime_IDCM" SG_ 2564682050 N_PDU_18DDF142 0;
BA_ "GenSigTimeoutTime_SGW" SG_ 2564682050 N_PDU_18DDF142 0;
BA_ "GenSigTimeoutTime_APM2" SG_ 2564682306 N_PDU_18DDF242 0;
BA_ "GenSigTimeoutTime_VDCM" SG_ 2564682306 N_PDU_18DDF242 0;
BA_ "GenSigTimeoutTime_BPCM" SG_ 2564682306 N_PDU_18DDF242 0;
BA_ "GenSigTimeoutTime_EVCU2" SG_ 2564682306 N_PDU_18DDF242 0;
BA_ "GenSigTimeoutTime_IDCM" SG_ 2564682306 N_PDU_18DDF242 0;
BA_ "GenSigTimeoutTime_SGW" SG_ 2564682306 N_PDU_18DDF242 0;
BA_ "GenSigTimeoutTime_APM2" SG_ 2564440817 N_PDU_18DA42F1 0;
BA_ "GenSigTimeoutTime_VDCM" SG_ 2564440817 N_PDU_18DA42F1 0;
BA_ "GenSigTimeoutTime_BPCM" SG_ 2564440817 N_PDU_18DA42F1 0;
BA_ "GenSigTimeoutTime_EVCU2" SG_ 2564440817 N_PDU_18DA42F1 0;
BA_ "GenSigTimeoutTime_IDCM" SG_ 2564440817 N_PDU_18DA42F1 0;
BA_ "GenSigTimeoutTime_SGW" SG_ 2564440817 N_PDU_18DA42F1 0;
BA_ "GenSigTimeoutTime_HCP" SG_ 2654339142 StayActiveSource_FD11_BPCM 0;
BA_ "GenSigTimeoutTime_PPIM" SG_ 2654339142 StayActiveSource_FD11_BPCM 0;
BA_ "GenSigTimeoutTime_APM2" SG_ 2654339142 StayActiveSource_FD11_BPCM 0;
BA_ "GenSigTimeoutTime_VDCM" SG_ 2654339142 StayActiveSource_FD11_BPCM 0;
BA_ "GenSigTimeoutTime_BPCM" SG_ 2654339142 StayActiveSource_FD11_BPCM 0;
BA_ "GenSigTimeoutTime_EVCU2" SG_ 2654339142 StayActiveSource_FD11_BPCM 0;
BA_ "GenSigTimeoutTime_IDCM" SG_ 2654339142 StayActiveSource_FD11_BPCM 0;
BA_ "GenSigTimeoutTime_HCP" SG_ 2654339136 PreviousCanNMState_FD11_EVCU2 0;
BA_ "GenSigTimeoutTime_PPIM" SG_ 2654339136 PreviousCanNMState_FD11_EVCU2 0;
BA_ "GenSigTimeoutTime_APM2" SG_ 2654339136 PreviousCanNMState_FD11_EVCU2 0;
BA_ "GenSigTimeoutTime_VDCM" SG_ 2654339136 PreviousCanNMState_FD11_EVCU2 0;
BA_ "GenSigTimeoutTime_HCP" SG_ 2654339136 StayActiveSource_FD11_EVCU2 0;
BA_ "GenSigTimeoutTime_PPIM" SG_ 2654339136 StayActiveSource_FD11_EVCU2 0;
BA_ "GenSigTimeoutTime_APM2" SG_ 2654339136 StayActiveSource_FD11_EVCU2 0;
BA_ "GenSigTimeoutTime_VDCM" SG_ 2654339136 StayActiveSource_FD11_EVCU2 0;
BA_ "GenSigTimeoutTime_HCP" SG_ 2654339136 WakeupSource_FD11_EVCU2 0;
BA_ "GenSigTimeoutTime_PPIM" SG_ 2654339136 WakeupSource_FD11_EVCU2 0;
BA_ "GenSigTimeoutTime_APM2" SG_ 2654339136 WakeupSource_FD11_EVCU2 0;
BA_ "GenSigTimeoutTime_VDCM" SG_ 2654339136 WakeupSource_FD11_EVCU2 0;
BA_ "GenSigTimeoutTime_PPIM" SG_ 2654339142 CurrentFailSts_FD11_BPCM 0;
BA_ "GenSigTimeoutTime_APM2" SG_ 2654339142 CurrentFailSts_FD11_BPCM 0;
BA_ "GenSigTimeoutTime_VDCM" SG_ 2654339142 CurrentFailSts_FD11_BPCM 0;
BA_ "GenSigTimeoutTime_BPCM" SG_ 2654339142 CurrentFailSts_FD11_BPCM 0;
BA_ "GenSigTimeoutTime_IDCM" SG_ 2654339142 CurrentFailSts_FD11_BPCM 0;
BA_ "GenSigTimeoutTime_APM2" SG_ 2654339136 CurrentCanNMState_FD03_EVCU2 0;
BA_ "GenSigTimeoutTime_VDCM" SG_ 2654339136 CurrentCanNMState_FD03_EVCU2 0;
BA_ "GenSigTimeoutTime_APM2" SG_ 2654339136 CurrentFailSts_FD03_EVCU2 0;
BA_ "GenSigTimeoutTime_VDCM" SG_ 2654339136 CurrentFailSts_FD03_EVCU2 0;
BA_ "GenSigTimeoutTime_APM2" SG_ 2654339136 DES_FD03_EVCU2 0;
BA_ "GenSigTimeoutTime_VDCM" SG_ 2654339136 DES_FD03_EVCU2 0;
BA_ "GenSigTimeoutTime_HCP" SG_ 2654339136 WakeupSource_FD16_EVCU2 0;
BA_ "GenSigTimeoutTime_PPIM" SG_ 2654339136 WakeupSource_FD16_EVCU2 0;
BA_ "GenSigTimeoutTime_HCP" SG_ 2654339142 CurrentCanNMState_FD05_BPCM 0;
BA_ "GenSigTimeoutTime_PPIM" SG_ 2654339142 CurrentCanNMState_FD05_BPCM 0;
BA_ "GenSigTimeoutTime_APM2" SG_ 2654339142 CurrentCanNMState_FD05_BPCM 0;
BA_ "GenSigTimeoutTime_VDCM" SG_ 2654339142 CurrentCanNMState_FD05_BPCM 0;
BA_ "GenSigTimeoutTime_BPCM" SG_ 2654339142 CurrentCanNMState_FD05_BPCM 0;
BA_ "GenSigTimeoutTime_EVCU2" SG_ 2654339142 CurrentCanNMState_FD05_BPCM 0;
BA_ "GenSigTimeoutTime_IDCM" SG_ 2654339142 CurrentCanNMState_FD05_BPCM 0;
BA_ "GenSigTimeoutTime_HCP" SG_ 2654339142 CurrentFailSts_FD05_BPCM 0;
BA_ "GenSigTimeoutTime_PPIM" SG_ 2654339142 CurrentFailSts_FD05_BPCM 0;
BA_ "GenSigTimeoutTime_APM2" SG_ 2654339142 CurrentFailSts_FD05_BPCM 0;
BA_ "GenSigTimeoutTime_VDCM" SG_ 2654339142 CurrentFailSts_FD05_BPCM 0;
BA_ "GenSigTimeoutTime_BPCM" SG_ 2654339142 CurrentFailSts_FD05_BPCM 0;
BA_ "GenSigTimeoutTime_EVCU2" SG_ 2654339142 CurrentFailSts_FD05_BPCM 0;
BA_ "GenSigTimeoutTime_IDCM" SG_ 2654339142 CurrentFailSts_FD05_BPCM 0;
BA_ "GenSigTimeoutTime_HCP" SG_ 2654339142 DES_FD05_BPCM 0;
BA_ "GenSigTimeoutTime_PPIM" SG_ 2654339142 DES_FD05_BPCM 0;
BA_ "GenSigTimeoutTime_APM2" SG_ 2654339142 DES_FD05_BPCM 0;
BA_ "GenSigTimeoutTime_VDCM" SG_ 2654339142 DES_FD05_BPCM 0;
BA_ "GenSigTimeoutTime_BPCM" SG_ 2654339142 DES_FD05_BPCM 0;
BA_ "GenSigTimeoutTime_EVCU2" SG_ 2654339142 DES_FD05_BPCM 0;
BA_ "GenSigTimeoutTime_IDCM" SG_ 2654339142 DES_FD05_BPCM 0;
BA_ "GenSigTimeoutTime_HCP" SG_ 2654339142 EOL_FD05_BPCM 0;
BA_ "GenSigTimeoutTime_PPIM" SG_ 2654339142 EOL_FD05_BPCM 0;
BA_ "GenSigTimeoutTime_APM2" SG_ 2654339142 EOL_FD05_BPCM 0;
BA_ "GenSigTimeoutTime_VDCM" SG_ 2654339142 EOL_FD05_BPCM 0;
BA_ "GenSigTimeoutTime_BPCM" SG_ 2654339142 EOL_FD05_BPCM 0;
BA_ "GenSigTimeoutTime_EVCU2" SG_ 2654339142 EOL_FD05_BPCM 0;
BA_ "GenSigTimeoutTime_IDCM" SG_ 2654339142 EOL_FD05_BPCM 0;
BA_ "GenSigTimeoutTime_HCP" SG_ 2654339142 GenericFailSts_FD05_BPCM 0;
BA_ "GenSigTimeoutTime_PPIM" SG_ 2654339142 GenericFailSts_FD05_BPCM 0;
BA_ "GenSigTimeoutTime_APM2" SG_ 2654339142 GenericFailSts_FD05_BPCM 0;
BA_ "GenSigTimeoutTime_VDCM" SG_ 2654339142 GenericFailSts_FD05_BPCM 0;
BA_ "GenSigTimeoutTime_BPCM" SG_ 2654339142 GenericFailSts_FD05_BPCM 0;
BA_ "GenSigTimeoutTime_EVCU2" SG_ 2654339142 GenericFailSts_FD05_BPCM 0;
BA_ "GenSigTimeoutTime_IDCM" SG_ 2654339142 GenericFailSts_FD05_BPCM 0;
BA_ "GenSigTimeoutTime_HCP" SG_ 2654339142 WakeupSource_FD05_BPCM 0;
BA_ "GenSigTimeoutTime_PPIM" SG_ 2654339142 WakeupSource_FD05_BPCM 0;
BA_ "GenSigTimeoutTime_APM2" SG_ 2654339142 WakeupSource_FD05_BPCM 0;
BA_ "GenSigTimeoutTime_VDCM" SG_ 2654339142 WakeupSource_FD05_BPCM 0;
BA_ "GenSigTimeoutTime_BPCM" SG_ 2654339142 WakeupSource_FD05_BPCM 0;
BA_ "GenSigTimeoutTime_EVCU2" SG_ 2654339142 WakeupSource_FD05_BPCM 0;
BA_ "GenSigTimeoutTime_IDCM" SG_ 2654339142 WakeupSource_FD05_BPCM 0;
BA_ "GenSigTimeoutTime_HCP" SG_ 2654339142 PreviousCanNMState_FD05_BPCM 0;
BA_ "GenSigTimeoutTime_PPIM" SG_ 2654339142 PreviousCanNMState_FD05_BPCM 0;
BA_ "GenSigTimeoutTime_APM2" SG_ 2654339142 PreviousCanNMState_FD05_BPCM 0;
BA_ "GenSigTimeoutTime_VDCM" SG_ 2654339142 PreviousCanNMState_FD05_BPCM 0;
BA_ "GenSigTimeoutTime_BPCM" SG_ 2654339142 PreviousCanNMState_FD05_BPCM 0;
BA_ "GenSigTimeoutTime_EVCU2" SG_ 2654339142 PreviousCanNMState_FD05_BPCM 0;
BA_ "GenSigTimeoutTime_IDCM" SG_ 2654339142 PreviousCanNMState_FD05_BPCM 0;
BA_ "GenSigTimeoutTime_HCP" SG_ 2654339142 StayActiveSource_FD05_BPCM 0;
BA_ "GenSigTimeoutTime_PPIM" SG_ 2654339142 StayActiveSource_FD05_BPCM 0;
BA_ "GenSigTimeoutTime_APM2" SG_ 2654339142 StayActiveSource_FD05_BPCM 0;
BA_ "GenSigTimeoutTime_VDCM" SG_ 2654339142 StayActiveSource_FD05_BPCM 0;
BA_ "GenSigTimeoutTime_BPCM" SG_ 2654339142 StayActiveSource_FD05_BPCM 0;
BA_ "GenSigTimeoutTime_EVCU2" SG_ 2654339142 StayActiveSource_FD05_BPCM 0;
BA_ "GenSigTimeoutTime_IDCM" SG_ 2654339142 StayActiveSource_FD05_BPCM 0;
BA_ "GenSigTimeoutTime_HCP" SG_ 2564485756 N_PDU_18DAF27C 0;
BA_ "GenSigTimeoutTime_PPIM" SG_ 2564485756 N_PDU_18DAF27C 0;
BA_ "GenSigTimeoutTime_BPCM" SG_ 2564485756 N_PDU_18DAF27C 0;
BA_ "GenSigTimeoutTime_EVCU2" SG_ 2564485756 N_PDU_18DAF27C 0;
BA_ "GenSigTimeoutTime_IDCM" SG_ 2564485756 N_PDU_18DAF27C 0;
BA_ "GenSigTimeoutTime_SGW" SG_ 2564485756 N_PDU_18DAF27C 0;
BA_ "GenSigTimeoutTime_HCP" SG_ 2654339136 CurrentCanNMState_FD05_EVCU2 0;
BA_ "GenSigTimeoutTime_PPIM" SG_ 2654339136 CurrentCanNMState_FD05_EVCU2 0;
BA_ "GenSigTimeoutTime_APM2" SG_ 2654339136 CurrentCanNMState_FD05_EVCU2 0;
BA_ "GenSigTimeoutTime_VDCM" SG_ 2654339136 CurrentCanNMState_FD05_EVCU2 0;
BA_ "GenSigTimeoutTime_BPCM" SG_ 2654339136 CurrentCanNMState_FD05_EVCU2 0;
BA_ "GenSigTimeoutTime_EVCU2" SG_ 2654339136 CurrentCanNMState_FD05_EVCU2 0;
BA_ "GenSigTimeoutTime_IDCM" SG_ 2654339136 CurrentCanNMState_FD05_EVCU2 0;
BA_ "GenSigTimeoutTime_HCP" SG_ 2654339136 CurrentCanNMState_FD16_EVCU2 0;
BA_ "GenSigTimeoutTime_PPIM" SG_ 2654339136 CurrentCanNMState_FD16_EVCU2 0;
BA_ "GenSigTimeoutTime_APM2" SG_ 2654339136 CurrentCanNMState_FD16_EVCU2 0;
BA_ "GenSigTimeoutTime_VDCM" SG_ 2654339136 CurrentCanNMState_FD16_EVCU2 0;
BA_ "GenSigTimeoutTime_BPCM" SG_ 2654339136 CurrentCanNMState_FD16_EVCU2 0;
BA_ "GenSigTimeoutTime_EVCU2" SG_ 2654339136 CurrentCanNMState_FD16_EVCU2 0;
BA_ "GenSigTimeoutTime_IDCM" SG_ 2654339136 CurrentCanNMState_FD16_EVCU2 0;
BA_ "GenSigTimeoutTime_HCP" SG_ 2654339136 CurrentFailSts_FD05_EVCU2 0;
BA_ "GenSigTimeoutTime_PPIM" SG_ 2654339136 CurrentFailSts_FD05_EVCU2 0;
BA_ "GenSigTimeoutTime_APM2" SG_ 2654339136 CurrentFailSts_FD05_EVCU2 0;
BA_ "GenSigTimeoutTime_VDCM" SG_ 2654339136 CurrentFailSts_FD05_EVCU2 0;
BA_ "GenSigTimeoutTime_BPCM" SG_ 2654339136 CurrentFailSts_FD05_EVCU2 0;
BA_ "GenSigTimeoutTime_EVCU2" SG_ 2654339136 CurrentFailSts_FD05_EVCU2 0;
BA_ "GenSigTimeoutTime_IDCM" SG_ 2654339136 CurrentFailSts_FD05_EVCU2 0;
BA_ "GenSigTimeoutTime_HCP" SG_ 2654339136 CurrentFailSts_FD16_EVCU2 0;
BA_ "GenSigTimeoutTime_PPIM" SG_ 2654339136 CurrentFailSts_FD16_EVCU2 0;
BA_ "GenSigTimeoutTime_APM2" SG_ 2654339136 CurrentFailSts_FD16_EVCU2 0;
BA_ "GenSigTimeoutTime_VDCM" SG_ 2654339136 CurrentFailSts_FD16_EVCU2 0;
BA_ "GenSigTimeoutTime_BPCM" SG_ 2654339136 CurrentFailSts_FD16_EVCU2 0;
BA_ "GenSigTimeoutTime_EVCU2" SG_ 2654339136 CurrentFailSts_FD16_EVCU2 0;
BA_ "GenSigTimeoutTime_IDCM" SG_ 2654339136 CurrentFailSts_FD16_EVCU2 0;
BA_ "GenSigTimeoutTime_HCP" SG_ 2654339136 DES_FD05_EVCU2 0;
BA_ "GenSigTimeoutTime_PPIM" SG_ 2654339136 DES_FD05_EVCU2 0;
BA_ "GenSigTimeoutTime_APM2" SG_ 2654339136 DES_FD05_EVCU2 0;
BA_ "GenSigTimeoutTime_VDCM" SG_ 2654339136 DES_FD05_EVCU2 0;
BA_ "GenSigTimeoutTime_BPCM" SG_ 2654339136 DES_FD05_EVCU2 0;
BA_ "GenSigTimeoutTime_EVCU2" SG_ 2654339136 DES_FD05_EVCU2 0;
BA_ "GenSigTimeoutTime_IDCM" SG_ 2654339136 DES_FD05_EVCU2 0;
BA_ "GenSigTimeoutTime_HCP" SG_ 2654339136 DES_FD16_EVCU2 0;
BA_ "GenSigTimeoutTime_PPIM" SG_ 2654339136 DES_FD16_EVCU2 0;
BA_ "GenSigTimeoutTime_APM2" SG_ 2654339136 DES_FD16_EVCU2 0;
BA_ "GenSigTimeoutTime_VDCM" SG_ 2654339136 DES_FD16_EVCU2 0;
BA_ "GenSigTimeoutTime_BPCM" SG_ 2654339136 DES_FD16_EVCU2 0;
BA_ "GenSigTimeoutTime_EVCU2" SG_ 2654339136 DES_FD16_EVCU2 0;
BA_ "GenSigTimeoutTime_IDCM" SG_ 2654339136 DES_FD16_EVCU2 0;
BA_ "GenSigTimeoutTime_HCP" SG_ 2654339136 EOL_FD05_EVCU2 0;
BA_ "GenSigTimeoutTime_PPIM" SG_ 2654339136 EOL_FD05_EVCU2 0;
BA_ "GenSigTimeoutTime_APM2" SG_ 2654339136 EOL_FD05_EVCU2 0;
BA_ "GenSigTimeoutTime_VDCM" SG_ 2654339136 EOL_FD05_EVCU2 0;
BA_ "GenSigTimeoutTime_BPCM" SG_ 2654339136 EOL_FD05_EVCU2 0;
BA_ "GenSigTimeoutTime_EVCU2" SG_ 2654339136 EOL_FD05_EVCU2 0;
BA_ "GenSigTimeoutTime_IDCM" SG_ 2654339136 EOL_FD05_EVCU2 0;
BA_ "GenSigTimeoutTime_HCP" SG_ 2654339136 EOL_FD16_EVCU2 0;
BA_ "GenSigTimeoutTime_PPIM" SG_ 2654339136 EOL_FD16_EVCU2 0;
BA_ "GenSigTimeoutTime_APM2" SG_ 2654339136 EOL_FD16_EVCU2 0;
BA_ "GenSigTimeoutTime_VDCM" SG_ 2654339136 EOL_FD16_EVCU2 0;
BA_ "GenSigTimeoutTime_BPCM" SG_ 2654339136 EOL_FD16_EVCU2 0;
BA_ "GenSigTimeoutTime_EVCU2" SG_ 2654339136 EOL_FD16_EVCU2 0;
BA_ "GenSigTimeoutTime_IDCM" SG_ 2654339136 EOL_FD16_EVCU2 0;
BA_ "GenSigTimeoutTime_HCP" SG_ 2654339136 GenericFailSts_FD05_EVCU2 0;
BA_ "GenSigTimeoutTime_PPIM" SG_ 2654339136 GenericFailSts_FD05_EVCU2 0;
BA_ "GenSigTimeoutTime_APM2" SG_ 2654339136 GenericFailSts_FD05_EVCU2 0;
BA_ "GenSigTimeoutTime_VDCM" SG_ 2654339136 GenericFailSts_FD05_EVCU2 0;
BA_ "GenSigTimeoutTime_BPCM" SG_ 2654339136 GenericFailSts_FD05_EVCU2 0;
BA_ "GenSigTimeoutTime_EVCU2" SG_ 2654339136 GenericFailSts_FD05_EVCU2 0;
BA_ "GenSigTimeoutTime_IDCM" SG_ 2654339136 GenericFailSts_FD05_EVCU2 0;
BA_ "GenSigTimeoutTime_HCP" SG_ 2654339136 GenericFailSts_FD16_EVCU2 0;
BA_ "GenSigTimeoutTime_PPIM" SG_ 2654339136 GenericFailSts_FD16_EVCU2 0;
BA_ "GenSigTimeoutTime_APM2" SG_ 2654339136 GenericFailSts_FD16_EVCU2 0;
BA_ "GenSigTimeoutTime_VDCM" SG_ 2654339136 GenericFailSts_FD16_EVCU2 0;
BA_ "GenSigTimeoutTime_BPCM" SG_ 2654339136 GenericFailSts_FD16_EVCU2 0;
BA_ "GenSigTimeoutTime_EVCU2" SG_ 2654339136 GenericFailSts_FD16_EVCU2 0;
BA_ "GenSigTimeoutTime_IDCM" SG_ 2654339136 GenericFailSts_FD16_EVCU2 0;
BA_ "GenSigTimeoutTime_HCP" SG_ 2654339136 PreviousCanNMState_FD05_EVCU2 0;
BA_ "GenSigTimeoutTime_PPIM" SG_ 2654339136 PreviousCanNMState_FD05_EVCU2 0;
BA_ "GenSigTimeoutTime_APM2" SG_ 2654339136 PreviousCanNMState_FD05_EVCU2 0;
BA_ "GenSigTimeoutTime_VDCM" SG_ 2654339136 PreviousCanNMState_FD05_EVCU2 0;
BA_ "GenSigTimeoutTime_BPCM" SG_ 2654339136 PreviousCanNMState_FD05_EVCU2 0;
BA_ "GenSigTimeoutTime_EVCU2" SG_ 2654339136 PreviousCanNMState_FD05_EVCU2 0;
BA_ "GenSigTimeoutTime_IDCM" SG_ 2654339136 PreviousCanNMState_FD05_EVCU2 0;
BA_ "GenSigTimeoutTime_HCP" SG_ 2654339136 PreviousCanNMState_FD16_EVCU2 0;
BA_ "GenSigTimeoutTime_PPIM" SG_ 2654339136 PreviousCanNMState_FD16_EVCU2 0;
BA_ "GenSigTimeoutTime_APM2" SG_ 2654339136 PreviousCanNMState_FD16_EVCU2 0;
BA_ "GenSigTimeoutTime_VDCM" SG_ 2654339136 PreviousCanNMState_FD16_EVCU2 0;
BA_ "GenSigTimeoutTime_BPCM" SG_ 2654339136 PreviousCanNMState_FD16_EVCU2 0;
BA_ "GenSigTimeoutTime_EVCU2" SG_ 2654339136 PreviousCanNMState_FD16_EVCU2 0;
BA_ "GenSigTimeoutTime_IDCM" SG_ 2654339136 PreviousCanNMState_FD16_EVCU2 0;
BA_ "GenSigTimeoutTime_HCP" SG_ 2654339136 StayActiveSource_FD05_EVCU2 0;
BA_ "GenSigTimeoutTime_PPIM" SG_ 2654339136 StayActiveSource_FD05_EVCU2 0;
BA_ "GenSigTimeoutTime_APM2" SG_ 2654339136 StayActiveSource_FD05_EVCU2 0;
BA_ "GenSigTimeoutTime_VDCM" SG_ 2654339136 StayActiveSource_FD05_EVCU2 0;
BA_ "GenSigTimeoutTime_BPCM" SG_ 2654339136 StayActiveSource_FD05_EVCU2 0;
BA_ "GenSigTimeoutTime_EVCU2" SG_ 2654339136 StayActiveSource_FD05_EVCU2 0;
BA_ "GenSigTimeoutTime_IDCM" SG_ 2654339136 StayActiveSource_FD05_EVCU2 0;
BA_ "GenSigTimeoutTime_APM2" SG_ 2654339136 WakeupSource_FD16_EVCU2 0;
BA_ "GenSigTimeoutTime_VDCM" SG_ 2654339136 WakeupSource_FD16_EVCU2 0;
BA_ "GenSigTimeoutTime_BPCM" SG_ 2654339136 WakeupSource_FD16_EVCU2 0;
BA_ "GenSigTimeoutTime_EVCU2" SG_ 2654339136 WakeupSource_FD16_EVCU2 0;
BA_ "GenSigTimeoutTime_IDCM" SG_ 2654339136 WakeupSource_FD16_EVCU2 0;
BA_ "GenSigTimeoutTime_HCP" SG_ 2654339136 StayActiveSource_FD16_EVCU2 0;
BA_ "GenSigTimeoutTime_PPIM" SG_ 2654339136 StayActiveSource_FD16_EVCU2 0;
BA_ "GenSigTimeoutTime_APM2" SG_ 2654339136 StayActiveSource_FD16_EVCU2 0;
BA_ "GenSigTimeoutTime_VDCM" SG_ 2654339136 StayActiveSource_FD16_EVCU2 0;
BA_ "GenSigTimeoutTime_BPCM" SG_ 2654339136 StayActiveSource_FD16_EVCU2 0;
BA_ "GenSigTimeoutTime_EVCU2" SG_ 2654339136 StayActiveSource_FD16_EVCU2 0;
BA_ "GenSigTimeoutTime_IDCM" SG_ 2654339136 StayActiveSource_FD16_EVCU2 0;
BA_ "GenSigTimeoutTime_HCP" SG_ 2654339136 WakeupSource_FD05_EVCU2 0;
BA_ "GenSigTimeoutTime_PPIM" SG_ 2654339136 WakeupSource_FD05_EVCU2 0;
BA_ "GenSigTimeoutTime_APM2" SG_ 2654339136 WakeupSource_FD05_EVCU2 0;
BA_ "GenSigTimeoutTime_VDCM" SG_ 2654339136 WakeupSource_FD05_EVCU2 0;
BA_ "GenSigTimeoutTime_BPCM" SG_ 2654339136 WakeupSource_FD05_EVCU2 0;
BA_ "GenSigTimeoutTime_EVCU2" SG_ 2654339136 WakeupSource_FD05_EVCU2 0;
BA_ "GenSigTimeoutTime_IDCM" SG_ 2654339136 WakeupSource_FD05_EVCU2 0;
BA_ "GenSigTimeoutTime_BPCM" SG_ 2654339136 DES_FD03_EVCU2 0;
BA_ "GenSigTimeoutTime_EVCU2" SG_ 2654339136 DES_FD03_EVCU2 0;
BA_ "GenSigTimeoutTime_IDCM" SG_ 2654339136 DES_FD03_EVCU2 0;
BA_ "GenSigTimeoutTime_BPCM" SG_ 2654339136 CurrentFailSts_FD03_EVCU2 0;
BA_ "GenSigTimeoutTime_EVCU2" SG_ 2654339136 CurrentFailSts_FD03_EVCU2 0;
BA_ "GenSigTimeoutTime_IDCM" SG_ 2654339136 CurrentFailSts_FD03_EVCU2 0;
BA_ "GenSigTimeoutTime_BPCM" SG_ 2654339136 CurrentCanNMState_FD03_EVCU2 0;
BA_ "GenSigTimeoutTime_EVCU2" SG_ 2654339136 CurrentCanNMState_FD03_EVCU2 0;
BA_ "GenSigTimeoutTime_IDCM" SG_ 2654339136 CurrentCanNMState_FD03_EVCU2 0;
BA_ "GenSigTimeoutTime_BPCM" SG_ 2654339136 WakeupSource_FD03_EVCU2 0;
BA_ "GenSigTimeoutTime_EVCU2" SG_ 2654339136 WakeupSource_FD03_EVCU2 0;
BA_ "GenSigTimeoutTime_IDCM" SG_ 2654339136 WakeupSource_FD03_EVCU2 0;
BA_ "GenSigTimeoutTime_APM2" SG_ 2654339136 WakeupSource_FD03_EVCU2 0;
BA_ "GenSigTimeoutTime_VDCM" SG_ 2654339136 WakeupSource_FD03_EVCU2 0;
BA_ "GenSigTimeoutTime_BPCM" SG_ 2654339136 EOL_FD03_EVCU2 0;
BA_ "GenSigTimeoutTime_EVCU2" SG_ 2654339136 EOL_FD03_EVCU2 0;
BA_ "GenSigTimeoutTime_IDCM" SG_ 2654339136 EOL_FD03_EVCU2 0;
BA_ "GenSigTimeoutTime_APM2" SG_ 2654339136 EOL_FD03_EVCU2 0;
BA_ "GenSigTimeoutTime_VDCM" SG_ 2654339136 EOL_FD03_EVCU2 0;
BA_ "GenSigTimeoutTime_BPCM" SG_ 2654339136 GenericFailSts_FD03_EVCU2 0;
BA_ "GenSigTimeoutTime_EVCU2" SG_ 2654339136 GenericFailSts_FD03_EVCU2 0;
BA_ "GenSigTimeoutTime_IDCM" SG_ 2654339136 GenericFailSts_FD03_EVCU2 0;
BA_ "GenSigTimeoutTime_APM2" SG_ 2654339136 GenericFailSts_FD03_EVCU2 0;
BA_ "GenSigTimeoutTime_VDCM" SG_ 2654339136 GenericFailSts_FD03_EVCU2 0;
BA_ "GenSigTimeoutTime_BPCM" SG_ 2654339136 PreviousCanNMState_FD03_EVCU2 0;
BA_ "GenSigTimeoutTime_EVCU2" SG_ 2654339136 PreviousCanNMState_FD03_EVCU2 0;
BA_ "GenSigTimeoutTime_IDCM" SG_ 2654339136 PreviousCanNMState_FD03_EVCU2 0;
BA_ "GenSigTimeoutTime_APM2" SG_ 2654339136 PreviousCanNMState_FD03_EVCU2 0;
BA_ "GenSigTimeoutTime_VDCM" SG_ 2654339136 PreviousCanNMState_FD03_EVCU2 0;
BA_ "GenSigTimeoutTime_BPCM" SG_ 2654339136 StayActiveSource_FD03_EVCU2 0;
BA_ "GenSigTimeoutTime_EVCU2" SG_ 2654339136 StayActiveSource_FD03_EVCU2 0;
BA_ "GenSigTimeoutTime_IDCM" SG_ 2654339136 StayActiveSource_FD03_EVCU2 0;
BA_ "GenSigTimeoutTime_APM2" SG_ 2654339136 StayActiveSource_FD03_EVCU2 0;
BA_ "GenSigTimeoutTime_VDCM" SG_ 2654339136 StayActiveSource_FD03_EVCU2 0;
BA_ "GenSigTimeoutTime_HCP" SG_ 2654339136 CurrentCanNMState_FD11_EVCU2 0;
BA_ "GenSigTimeoutTime_PPIM" SG_ 2654339136 CurrentCanNMState_FD11_EVCU2 0;
BA_ "GenSigTimeoutTime_APM2" SG_ 2654339136 CurrentCanNMState_FD11_EVCU2 0;
BA_ "GenSigTimeoutTime_VDCM" SG_ 2654339136 CurrentCanNMState_FD11_EVCU2 0;
BA_ "GenSigTimeoutTime_BPCM" SG_ 2654339136 CurrentCanNMState_FD11_EVCU2 0;
BA_ "GenSigTimeoutTime_EVCU2" SG_ 2654339136 CurrentCanNMState_FD11_EVCU2 0;
BA_ "GenSigTimeoutTime_IDCM" SG_ 2654339136 CurrentCanNMState_FD11_EVCU2 0;
BA_ "GenSigTimeoutTime_HCP" SG_ 2654339136 CurrentFailSts_FD11_EVCU2 0;
BA_ "GenSigTimeoutTime_PPIM" SG_ 2654339136 CurrentFailSts_FD11_EVCU2 0;
BA_ "GenSigTimeoutTime_APM2" SG_ 2654339136 CurrentFailSts_FD11_EVCU2 0;
BA_ "GenSigTimeoutTime_VDCM" SG_ 2654339136 CurrentFailSts_FD11_EVCU2 0;
BA_ "GenSigTimeoutTime_BPCM" SG_ 2654339136 CurrentFailSts_FD11_EVCU2 0;
BA_ "GenSigTimeoutTime_EVCU2" SG_ 2654339136 CurrentFailSts_FD11_EVCU2 0;
BA_ "GenSigTimeoutTime_IDCM" SG_ 2654339136 CurrentFailSts_FD11_EVCU2 0;
BA_ "GenSigTimeoutTime_HCP" SG_ 2654339136 DES_FD11_EVCU2 0;
BA_ "GenSigTimeoutTime_PPIM" SG_ 2654339136 DES_FD11_EVCU2 0;
BA_ "GenSigTimeoutTime_APM2" SG_ 2654339136 DES_FD11_EVCU2 0;
BA_ "GenSigTimeoutTime_VDCM" SG_ 2654339136 DES_FD11_EVCU2 0;
BA_ "GenSigTimeoutTime_BPCM" SG_ 2654339136 DES_FD11_EVCU2 0;
BA_ "GenSigTimeoutTime_EVCU2" SG_ 2654339136 DES_FD11_EVCU2 0;
BA_ "GenSigTimeoutTime_IDCM" SG_ 2654339136 DES_FD11_EVCU2 0;
BA_ "GenSigTimeoutTime_HCP" SG_ 2654339136 EOL_FD11_EVCU2 0;
BA_ "GenSigTimeoutTime_PPIM" SG_ 2654339136 EOL_FD11_EVCU2 0;
BA_ "GenSigTimeoutTime_APM2" SG_ 2654339136 EOL_FD11_EVCU2 0;
BA_ "GenSigTimeoutTime_VDCM" SG_ 2654339136 EOL_FD11_EVCU2 0;
BA_ "GenSigTimeoutTime_BPCM" SG_ 2654339136 EOL_FD11_EVCU2 0;
BA_ "GenSigTimeoutTime_EVCU2" SG_ 2654339136 EOL_FD11_EVCU2 0;
BA_ "GenSigTimeoutTime_IDCM" SG_ 2654339136 EOL_FD11_EVCU2 0;
BA_ "GenSigTimeoutTime_BPCM" SG_ 2654339136 WakeupSource_FD11_EVCU2 0;
BA_ "GenSigTimeoutTime_EVCU2" SG_ 2654339136 WakeupSource_FD11_EVCU2 0;
BA_ "GenSigTimeoutTime_IDCM" SG_ 2654339136 WakeupSource_FD11_EVCU2 0;
BA_ "GenSigTimeoutTime_BPCM" SG_ 2654339136 StayActiveSource_FD11_EVCU2 0;
BA_ "GenSigTimeoutTime_EVCU2" SG_ 2654339136 StayActiveSource_FD11_EVCU2 0;
BA_ "GenSigTimeoutTime_IDCM" SG_ 2654339136 StayActiveSource_FD11_EVCU2 0;
BA_ "GenSigTimeoutTime_BPCM" SG_ 2654339136 PreviousCanNMState_FD11_EVCU2 0;
BA_ "GenSigTimeoutTime_EVCU2" SG_ 2654339136 PreviousCanNMState_FD11_EVCU2 0;
BA_ "GenSigTimeoutTime_IDCM" SG_ 2654339136 PreviousCanNMState_FD11_EVCU2 0;
BA_ "GenSigTimeoutTime_HCP" SG_ 2654339136 GenericFailSts_FD11_EVCU2 0;
BA_ "GenSigTimeoutTime_PPIM" SG_ 2654339136 GenericFailSts_FD11_EVCU2 0;
BA_ "GenSigTimeoutTime_APM2" SG_ 2654339136 GenericFailSts_FD11_EVCU2 0;
BA_ "GenSigTimeoutTime_VDCM" SG_ 2654339136 GenericFailSts_FD11_EVCU2 0;
BA_ "GenSigTimeoutTime_BPCM" SG_ 2654339136 GenericFailSts_FD11_EVCU2 0;
BA_ "GenSigTimeoutTime_EVCU2" SG_ 2654339136 GenericFailSts_FD11_EVCU2 0;
BA_ "GenSigTimeoutTime_IDCM" SG_ 2654339136 GenericFailSts_FD11_EVCU2 0;
BA_ "GenSigTimeoutTime_HCP" SG_ 2564440821 N_PDU_18DA42F5 0;
BA_ "GenSigTimeoutTime_PPIM" SG_ 2564440821 N_PDU_18DA42F5 0;
BA_ "GenSigTimeoutTime_APM2" SG_ 2564440821 N_PDU_18DA42F5 0;
BA_ "GenSigTimeoutTime_VDCM" SG_ 2564440821 N_PDU_18DA42F5 0;
BA_ "GenSigTimeoutTime_BPCM" SG_ 2564440821 N_PDU_18DA42F5 0;
BA_ "GenSigTimeoutTime_EVCU2" SG_ 2564440821 N_PDU_18DA42F5 0;
BA_ "GenSigTimeoutTime_IDCM" SG_ 2564440821 N_PDU_18DA42F5 0;
BA_ "GenSigTimeoutTime_SGW" SG_ 2564440821 N_PDU_18DA42F5 0;
BA_ "GenSigTimeoutTime_HCP" SG_ 2564486466 N_PDU_18DAF542 0;
BA_ "GenSigTimeoutTime_PPIM" SG_ 2564486466 N_PDU_18DAF542 0;
BA_ "GenSigTimeoutTime_APM2" SG_ 2564486466 N_PDU_18DAF542 0;
BA_ "GenSigTimeoutTime_VDCM" SG_ 2564486466 N_PDU_18DAF542 0;
BA_ "GenSigTimeoutTime_BPCM" SG_ 2564486466 N_PDU_18DAF542 0;
BA_ "GenSigTimeoutTime_EVCU2" SG_ 2564486466 N_PDU_18DAF542 0;
BA_ "GenSigTimeoutTime_IDCM" SG_ 2564486466 N_PDU_18DAF542 0;
BA_ "GenSigTimeoutTime_SGW" SG_ 2564486466 N_PDU_18DAF542 0;
BA_ "GenSigTimeoutTime_HCP" SG_ 2564440818 N_PDU_18DA42F2 0;
BA_ "GenSigTimeoutTime_PPIM" SG_ 2564440818 N_PDU_18DA42F2 0;
BA_ "GenSigTimeoutTime_APM2" SG_ 2564440818 N_PDU_18DA42F2 0;
BA_ "GenSigTimeoutTime_VDCM" SG_ 2564440818 N_PDU_18DA42F2 0;
BA_ "GenSigTimeoutTime_BPCM" SG_ 2564440818 N_PDU_18DA42F2 0;
BA_ "GenSigTimeoutTime_EVCU2" SG_ 2564440818 N_PDU_18DA42F2 0;
BA_ "GenSigTimeoutTime_IDCM" SG_ 2564440818 N_PDU_18DA42F2 0;
BA_ "GenSigTimeoutTime_SGW" SG_ 2564440818 N_PDU_18DA42F2 0;
BA_ "GenSigTimeoutTime_HCP" SG_ 2564485698 N_PDU_18DAF242 0;
BA_ "GenSigTimeoutTime_PPIM" SG_ 2564485698 N_PDU_18DAF242 0;
BA_ "GenSigTimeoutTime_APM2" SG_ 2564485698 N_PDU_18DAF242 0;
BA_ "GenSigTimeoutTime_VDCM" SG_ 2564485698 N_PDU_18DAF242 0;
BA_ "GenSigTimeoutTime_BPCM" SG_ 2564485698 N_PDU_18DAF242 0;
BA_ "GenSigTimeoutTime_EVCU2" SG_ 2564485698 N_PDU_18DAF242 0;
BA_ "GenSigTimeoutTime_IDCM" SG_ 2564485698 N_PDU_18DAF242 0;
BA_ "GenSigTimeoutTime_SGW" SG_ 2564485698 N_PDU_18DAF242 0;
BA_ "GenSigTimeoutTime_HCP" SG_ 288 CRC_BATT_HV_POWERLIMS 0;
BA_ "GenSigTimeoutTime_PPIM" SG_ 288 CRC_BATT_HV_POWERLIMS 0;
BA_ "GenSigTimeoutTime_APM2" SG_ 288 CRC_BATT_HV_POWERLIMS 0;
BA_ "GenSigTimeoutTime_VDCM" SG_ 288 CRC_BATT_HV_POWERLIMS 0;
BA_ "GenSigTimeoutTime_BPCM" SG_ 288 CRC_BATT_HV_POWERLIMS 0;
BA_ "GenSigTimeoutTime_IDCM" SG_ 288 CRC_BATT_HV_POWERLIMS 0;
BA_ "GenSigTimeoutTime_SGW" SG_ 288 CRC_BATT_HV_POWERLIMS 0;
BA_ "GenSigTimeoutTime_HCP" SG_ 288 MessageCounter_BATT_HV_POWERLIMS 0;
BA_ "GenSigTimeoutTime_PPIM" SG_ 288 MessageCounter_BATT_HV_POWERLIMS 0;
BA_ "GenSigTimeoutTime_APM2" SG_ 288 MessageCounter_BATT_HV_POWERLIMS 0;
BA_ "GenSigTimeoutTime_VDCM" SG_ 288 MessageCounter_BATT_HV_POWERLIMS 0;
BA_ "GenSigTimeoutTime_BPCM" SG_ 288 MessageCounter_BATT_HV_POWERLIMS 0;
BA_ "GenSigTimeoutTime_IDCM" SG_ 288 MessageCounter_BATT_HV_POWERLIMS 0;
BA_ "GenSigTimeoutTime_SGW" SG_ 288 MessageCounter_BATT_HV_POWERLIMS 0;
BA_ "GenSigTimeoutTime_VDCM" SG_ 1959 HVBatCellVoltage_Cell282 0;
BA_ "GenSigTimeoutTime_VDCM" SG_ 1959 HVBatCellVoltage_Cell283 0;
BA_ "GenSigTimeoutTime_VDCM" SG_ 1959 HVBatCellVoltage_Cell288 0;
BA_ "GenSigTimeoutTime_VDCM" SG_ 1959 HVBatCellVoltage_Cell289 0;
BA_ "GenSigTimeoutTime_VDCM" SG_ 1959 HVBatCellVoltage_Cell290 0;
BA_ "GenSigTimeoutTime_VDCM" SG_ 1959 HVBatCellVoltage_Cell291 0;
BA_ "GenSigTimeoutTime_VDCM" SG_ 1959 HVBatCellVoltage_Cell292 0;
BA_ "GenSigTimeoutTime_VDCM" SG_ 1959 HVBatCellVoltage_Cell293 0;
BA_ "GenSigTimeoutTime_VDCM" SG_ 1959 HVBatCellVoltage_Cell294 0;
BA_ "GenSigTimeoutTime_VDCM" SG_ 1959 HVBatCellVoltage_Cell295 0;
BA_ "GenSigTimeoutTime_VDCM" SG_ 1959 HVBatCellVoltage_Cell296 0;
BA_ "GenSigTimeoutTime_APM2" SG_ 1959 HVBatCellVoltage_Cell296 0;
BA_ "GenSigTimeoutTime_BPCM" SG_ 1959 HVBatCellVoltage_Cell296 0;
BA_ "GenSigTimeoutTime_EVCU2" SG_ 1959 HVBatCellVoltage_Cell296 0;
BA_ "GenSigTimeoutTime_IDCM" SG_ 1959 HVBatCellVoltage_Cell296 0;
BA_ "GenSigTimeoutTime_APM2" SG_ 1959 HVBatCellVoltage_Cell295 0;
BA_ "GenSigTimeoutTime_BPCM" SG_ 1959 HVBatCellVoltage_Cell295 0;
BA_ "GenSigTimeoutTime_EVCU2" SG_ 1959 HVBatCellVoltage_Cell295 0;
BA_ "GenSigTimeoutTime_IDCM" SG_ 1959 HVBatCellVoltage_Cell295 0;
BA_ "GenSigTimeoutTime_VDCM" SG_ 1960 HVBatCellVoltage_Cell297 0;
BA_ "GenSigTimeoutTime_VDCM" SG_ 1960 HVBatCellVoltage_Cell298 0;
BA_ "GenSigTimeoutTime_VDCM" SG_ 1960 HVBatCellVoltage_Cell299 0;
BA_ "GenSigTimeoutTime_VDCM" SG_ 1960 HVBatCellVoltage_Cell300 0;
BA_ "GenSigTimeoutTime_VDCM" SG_ 1960 HVBatCellVoltage_Cell301 0;
BA_ "GenSigTimeoutTime_VDCM" SG_ 1960 HVBatCellVoltage_Cell302 0;
BA_ "GenSigTimeoutTime_APM2" SG_ 1959 HVBatCellVoltage_Cell294 0;
BA_ "GenSigTimeoutTime_BPCM" SG_ 1959 HVBatCellVoltage_Cell294 0;
BA_ "GenSigTimeoutTime_EVCU2" SG_ 1959 HVBatCellVoltage_Cell294 0;
BA_ "GenSigTimeoutTime_IDCM" SG_ 1959 HVBatCellVoltage_Cell294 0;
BA_ "GenSigTimeoutTime_APM2" SG_ 1959 HVBatCellVoltage_Cell293 0;
BA_ "GenSigTimeoutTime_BPCM" SG_ 1959 HVBatCellVoltage_Cell293 0;
BA_ "GenSigTimeoutTime_EVCU2" SG_ 1959 HVBatCellVoltage_Cell293 0;
BA_ "GenSigTimeoutTime_IDCM" SG_ 1959 HVBatCellVoltage_Cell293 0;
BA_ "GenSigTimeoutTime_APM2" SG_ 1959 HVBatCellVoltage_Cell292 0;
BA_ "GenSigTimeoutTime_BPCM" SG_ 1959 HVBatCellVoltage_Cell292 0;
BA_ "GenSigTimeoutTime_EVCU2" SG_ 1959 HVBatCellVoltage_Cell292 0;
BA_ "GenSigTimeoutTime_IDCM" SG_ 1959 HVBatCellVoltage_Cell292 0;
BA_ "GenSigTimeoutTime_APM2" SG_ 1959 HVBatCellVoltage_Cell291 0;
BA_ "GenSigTimeoutTime_BPCM" SG_ 1959 HVBatCellVoltage_Cell291 0;
BA_ "GenSigTimeoutTime_EVCU2" SG_ 1959 HVBatCellVoltage_Cell291 0;
BA_ "GenSigTimeoutTime_IDCM" SG_ 1959 HVBatCellVoltage_Cell291 0;
BA_ "GenSigTimeoutTime_APM2" SG_ 1959 HVBatCellVoltage_Cell290 0;
BA_ "GenSigTimeoutTime_BPCM" SG_ 1959 HVBatCellVoltage_Cell290 0;
BA_ "GenSigTimeoutTime_EVCU2" SG_ 1959 HVBatCellVoltage_Cell290 0;
BA_ "GenSigTimeoutTime_IDCM" SG_ 1959 HVBatCellVoltage_Cell290 0;
BA_ "GenSigTimeoutTime_APM2" SG_ 1959 HVBatCellVoltage_Cell289 0;
BA_ "GenSigTimeoutTime_BPCM" SG_ 1959 HVBatCellVoltage_Cell289 0;
BA_ "GenSigTimeoutTime_EVCU2" SG_ 1959 HVBatCellVoltage_Cell289 0;
BA_ "GenSigTimeoutTime_IDCM" SG_ 1959 HVBatCellVoltage_Cell289 0;
BA_ "GenSigTimeoutTime_APM2" SG_ 1959 HVBatCellVoltage_Cell288 0;
BA_ "GenSigTimeoutTime_BPCM" SG_ 1959 HVBatCellVoltage_Cell288 0;
BA_ "GenSigTimeoutTime_EVCU2" SG_ 1959 HVBatCellVoltage_Cell288 0;
BA_ "GenSigTimeoutTime_IDCM" SG_ 1959 HVBatCellVoltage_Cell288 0;
BA_ "GenSigTimeoutTime_VDCM" SG_ 1959 HVBatCellVoltage_Cell287 0;
BA_ "GenSigTimeoutTime_APM2" SG_ 1959 HVBatCellVoltage_Cell287 0;
BA_ "GenSigTimeoutTime_BPCM" SG_ 1959 HVBatCellVoltage_Cell287 0;
BA_ "GenSigTimeoutTime_EVCU2" SG_ 1959 HVBatCellVoltage_Cell287 0;
BA_ "GenSigTimeoutTime_IDCM" SG_ 1959 HVBatCellVoltage_Cell287 0;
BA_ "GenSigTimeoutTime_VDCM" SG_ 1960 HVBatCellVoltage_Cell303 0;
BA_ "GenSigTimeoutTime_VDCM" SG_ 1960 HVBatCellVoltage_Cell304 0;
BA_ "GenSigTimeoutTime_VDCM" SG_ 1960 HVBatCellVoltage_Cell305 0;
BA_ "GenSigTimeoutTime_VDCM" SG_ 1960 HVBatCellVoltage_Cell306 0;
BA_ "GenSigTimeoutTime_VDCM" SG_ 1960 HVBatCellVoltage_Cell307 0;
BA_ "GenSigTimeoutTime_VDCM" SG_ 1960 HVBatCellVoltage_Cell308 0;
BA_ "GenSigTimeoutTime_VDCM" SG_ 1960 HVBatCellVoltage_Cell309 0;
BA_ "GenSigTimeoutTime_VDCM" SG_ 1960 HVBatCellVoltage_Cell310 0;
BA_ "GenSigTimeoutTime_VDCM" SG_ 1960 HVBatCellVoltage_Cell311 0;
BA_ "GenSigTimeoutTime_VDCM" SG_ 1960 HVBatCellVoltage_Cell312 0;
BA_ "GenSigTimeoutTime_VDCM" SG_ 1960 HVBatCellVoltage_Cell313 0;
BA_ "GenSigTimeoutTime_VDCM" SG_ 1960 HVBatCellVoltage_Cell314 0;
BA_ "GenSigTimeoutTime_VDCM" SG_ 1960 HVBatCellVoltage_Cell315 0;
BA_ "GenSigTimeoutTime_VDCM" SG_ 1960 HVBatCellVoltage_Cell316 0;
BA_ "GenSigTimeoutTime_APM2" SG_ 1960 HVBatCellVoltage_Cell317 0;
BA_ "GenSigTimeoutTime_BPCM" SG_ 1960 HVBatCellVoltage_Cell317 0;
BA_ "GenSigTimeoutTime_EVCU2" SG_ 1960 HVBatCellVoltage_Cell317 0;
BA_ "GenSigTimeoutTime_IDCM" SG_ 1960 HVBatCellVoltage_Cell317 0;
BA_ "GenSigTimeoutTime_VDCM" SG_ 1960 HVBatCellVoltage_Cell317 0;
BA_ "GenSigTimeoutTime_APM2" SG_ 1960 HVBatCellVoltage_Cell318 0;
BA_ "GenSigTimeoutTime_BPCM" SG_ 1960 HVBatCellVoltage_Cell318 0;
BA_ "GenSigTimeoutTime_EVCU2" SG_ 1960 HVBatCellVoltage_Cell318 0;
BA_ "GenSigTimeoutTime_IDCM" SG_ 1960 HVBatCellVoltage_Cell318 0;
BA_ "GenSigTimeoutTime_VDCM" SG_ 1960 HVBatCellVoltage_Cell318 0;
BA_ "GenSigTimeoutTime_VDCM" SG_ 1960 HVBatCellVoltage_Cell328 0;
BA_ "GenSigTimeoutTime_VDCM" SG_ 1960 HVBatCellVoltage_Cell327 0;
BA_ "GenSigTimeoutTime_APM2" SG_ 1960 HVBatCellVoltage_Cell319 0;
BA_ "GenSigTimeoutTime_BPCM" SG_ 1960 HVBatCellVoltage_Cell319 0;
BA_ "GenSigTimeoutTime_VDCM" SG_ 1960 HVBatCellVoltage_Cell319 0;
BA_ "GenSigTimeoutTime_VDCM" SG_ 1960 HVBatCellVoltage_Cell320 0;
BA_ "GenSigTimeoutTime_VDCM" SG_ 1960 HVBatCellVoltage_Cell321 0;
BA_ "GenSigTimeoutTime_VDCM" SG_ 1960 HVBatCellVoltage_Cell322 0;
BA_ "GenSigTimeoutTime_VDCM" SG_ 1960 HVBatCellVoltage_Cell323 0;
BA_ "GenSigTimeoutTime_VDCM" SG_ 1960 HVBatCellVoltage_Cell324 0;
BA_ "GenSigTimeoutTime_VDCM" SG_ 1960 HVBatCellVoltage_Cell325 0;
BA_ "GenSigTimeoutTime_VDCM" SG_ 1960 HVBatCellVoltage_Cell326 0;
BA_ "GenSigTimeoutTime_APM2" SG_ 1959 HVBatCellVoltage_Cell283 0;
BA_ "GenSigTimeoutTime_BPCM" SG_ 1959 HVBatCellVoltage_Cell283 0;
BA_ "GenSigTimeoutTime_EVCU2" SG_ 1959 HVBatCellVoltage_Cell283 0;
BA_ "GenSigTimeoutTime_IDCM" SG_ 1959 HVBatCellVoltage_Cell283 0;
BA_ "GenSigTimeoutTime_VDCM" SG_ 1959 HVBatCellVoltage_Cell284 0;
BA_ "GenSigTimeoutTime_APM2" SG_ 1959 HVBatCellVoltage_Cell284 0;
BA_ "GenSigTimeoutTime_BPCM" SG_ 1959 HVBatCellVoltage_Cell284 0;
BA_ "GenSigTimeoutTime_EVCU2" SG_ 1959 HVBatCellVoltage_Cell284 0;
BA_ "GenSigTimeoutTime_IDCM" SG_ 1959 HVBatCellVoltage_Cell284 0;
BA_ "GenSigTimeoutTime_VDCM" SG_ 1959 HVBatCellVoltage_Cell285 0;
BA_ "GenSigTimeoutTime_APM2" SG_ 1959 HVBatCellVoltage_Cell285 0;
BA_ "GenSigTimeoutTime_BPCM" SG_ 1959 HVBatCellVoltage_Cell285 0;
BA_ "GenSigTimeoutTime_EVCU2" SG_ 1959 HVBatCellVoltage_Cell285 0;
BA_ "GenSigTimeoutTime_IDCM" SG_ 1959 HVBatCellVoltage_Cell285 0;
BA_ "GenSigTimeoutTime_VDCM" SG_ 1959 HVBatCellVoltage_Cell286 0;
BA_ "GenSigTimeoutTime_APM2" SG_ 1959 HVBatCellVoltage_Cell286 0;
BA_ "GenSigTimeoutTime_BPCM" SG_ 1959 HVBatCellVoltage_Cell286 0;
BA_ "GenSigTimeoutTime_EVCU2" SG_ 1959 HVBatCellVoltage_Cell286 0;
BA_ "GenSigTimeoutTime_IDCM" SG_ 1959 HVBatCellVoltage_Cell286 0;
BA_ "GenSigTimeoutTime_APM2" SG_ 1959 HVBatCellVoltage_Cell282 0;
BA_ "GenSigTimeoutTime_BPCM" SG_ 1959 HVBatCellVoltage_Cell282 0;
BA_ "GenSigTimeoutTime_EVCU2" SG_ 1959 HVBatCellVoltage_Cell282 0;
BA_ "GenSigTimeoutTime_IDCM" SG_ 1959 HVBatCellVoltage_Cell282 0;
BA_ "GenSigTimeoutTime_VDCM" SG_ 1959 HVBatCellVoltage_Cell281 0;
BA_ "GenSigTimeoutTime_APM2" SG_ 1959 HVBatCellVoltage_Cell281 0;
BA_ "GenSigTimeoutTime_BPCM" SG_ 1959 HVBatCellVoltage_Cell281 0;
BA_ "GenSigTimeoutTime_EVCU2" SG_ 1959 HVBatCellVoltage_Cell281 0;
BA_ "GenSigTimeoutTime_IDCM" SG_ 1959 HVBatCellVoltage_Cell281 0;
BA_ "GenSigTimeoutTime_VDCM" SG_ 1959 HVBatCellVoltage_Cell279 0;
BA_ "GenSigTimeoutTime_APM2" SG_ 1959 HVBatCellVoltage_Cell279 0;
BA_ "GenSigTimeoutTime_BPCM" SG_ 1959 HVBatCellVoltage_Cell279 0;
BA_ "GenSigTimeoutTime_EVCU2" SG_ 1959 HVBatCellVoltage_Cell279 0;
BA_ "GenSigTimeoutTime_IDCM" SG_ 1959 HVBatCellVoltage_Cell279 0;
BA_ "GenSigTimeoutTime_VDCM" SG_ 1959 HVBatCellVoltage_Cell280 0;
BA_ "GenSigTimeoutTime_APM2" SG_ 1959 HVBatCellVoltage_Cell280 0;
BA_ "GenSigTimeoutTime_BPCM" SG_ 1959 HVBatCellVoltage_Cell280 0;
BA_ "GenSigTimeoutTime_EVCU2" SG_ 1959 HVBatCellVoltage_Cell280 0;
BA_ "GenSigTimeoutTime_IDCM" SG_ 1959 HVBatCellVoltage_Cell280 0;
BA_ "GenSigTimeoutTime_VDCM" SG_ 1959 HVBatCellVoltage_Cell271 0;
BA_ "GenSigTimeoutTime_APM2" SG_ 1959 HVBatCellVoltage_Cell271 0;
BA_ "GenSigTimeoutTime_BPCM" SG_ 1959 HVBatCellVoltage_Cell271 0;
BA_ "GenSigTimeoutTime_EVCU2" SG_ 1959 HVBatCellVoltage_Cell271 0;
BA_ "GenSigTimeoutTime_IDCM" SG_ 1959 HVBatCellVoltage_Cell271 0;
BA_ "GenSigTimeoutTime_VDCM" SG_ 1959 HVBatCellVoltage_Cell272 0;
BA_ "GenSigTimeoutTime_APM2" SG_ 1959 HVBatCellVoltage_Cell272 0;
BA_ "GenSigTimeoutTime_BPCM" SG_ 1959 HVBatCellVoltage_Cell272 0;
BA_ "GenSigTimeoutTime_EVCU2" SG_ 1959 HVBatCellVoltage_Cell272 0;
BA_ "GenSigTimeoutTime_IDCM" SG_ 1959 HVBatCellVoltage_Cell272 0;
BA_ "GenSigTimeoutTime_VDCM" SG_ 1959 HVBatCellVoltage_Cell273 0;
BA_ "GenSigTimeoutTime_APM2" SG_ 1959 HVBatCellVoltage_Cell273 0;
BA_ "GenSigTimeoutTime_BPCM" SG_ 1959 HVBatCellVoltage_Cell273 0;
BA_ "GenSigTimeoutTime_EVCU2" SG_ 1959 HVBatCellVoltage_Cell273 0;
BA_ "GenSigTimeoutTime_IDCM" SG_ 1959 HVBatCellVoltage_Cell273 0;
BA_ "GenSigTimeoutTime_VDCM" SG_ 1959 HVBatCellVoltage_Cell274 0;
BA_ "GenSigTimeoutTime_APM2" SG_ 1959 HVBatCellVoltage_Cell274 0;
BA_ "GenSigTimeoutTime_BPCM" SG_ 1959 HVBatCellVoltage_Cell274 0;
BA_ "GenSigTimeoutTime_EVCU2" SG_ 1959 HVBatCellVoltage_Cell274 0;
BA_ "GenSigTimeoutTime_IDCM" SG_ 1959 HVBatCellVoltage_Cell274 0;
BA_ "GenSigTimeoutTime_VDCM" SG_ 1959 HVBatCellVoltage_Cell275 0;
BA_ "GenSigTimeoutTime_APM2" SG_ 1959 HVBatCellVoltage_Cell275 0;
BA_ "GenSigTimeoutTime_BPCM" SG_ 1959 HVBatCellVoltage_Cell275 0;
BA_ "GenSigTimeoutTime_EVCU2" SG_ 1959 HVBatCellVoltage_Cell275 0;
BA_ "GenSigTimeoutTime_IDCM" SG_ 1959 HVBatCellVoltage_Cell275 0;
BA_ "GenSigTimeoutTime_VDCM" SG_ 1959 HVBatCellVoltage_Cell276 0;
BA_ "GenSigTimeoutTime_APM2" SG_ 1959 HVBatCellVoltage_Cell276 0;
BA_ "GenSigTimeoutTime_BPCM" SG_ 1959 HVBatCellVoltage_Cell276 0;
BA_ "GenSigTimeoutTime_EVCU2" SG_ 1959 HVBatCellVoltage_Cell276 0;
BA_ "GenSigTimeoutTime_IDCM" SG_ 1959 HVBatCellVoltage_Cell276 0;
BA_ "GenSigTimeoutTime_VDCM" SG_ 1959 HVBatCellVoltage_Cell277 0;
BA_ "GenSigTimeoutTime_APM2" SG_ 1959 HVBatCellVoltage_Cell277 0;
BA_ "GenSigTimeoutTime_BPCM" SG_ 1959 HVBatCellVoltage_Cell277 0;
BA_ "GenSigTimeoutTime_EVCU2" SG_ 1959 HVBatCellVoltage_Cell277 0;
BA_ "GenSigTimeoutTime_IDCM" SG_ 1959 HVBatCellVoltage_Cell277 0;
BA_ "GenSigTimeoutTime_VDCM" SG_ 1959 HVBatCellVoltage_Cell278 0;
BA_ "GenSigTimeoutTime_APM2" SG_ 1959 HVBatCellVoltage_Cell278 0;
BA_ "GenSigTimeoutTime_BPCM" SG_ 1959 HVBatCellVoltage_Cell278 0;
BA_ "GenSigTimeoutTime_EVCU2" SG_ 1959 HVBatCellVoltage_Cell278 0;
BA_ "GenSigTimeoutTime_IDCM" SG_ 1959 HVBatCellVoltage_Cell278 0;
BA_ "GenSigTimeoutTime_VDCM" SG_ 1959 HVBatCellVoltage_Cell268 0;
BA_ "GenSigTimeoutTime_APM2" SG_ 1959 HVBatCellVoltage_Cell268 0;
BA_ "GenSigTimeoutTime_BPCM" SG_ 1959 HVBatCellVoltage_Cell268 0;
BA_ "GenSigTimeoutTime_VDCM" SG_ 1959 HVBatCellVoltage_Cell269 0;
BA_ "GenSigTimeoutTime_APM2" SG_ 1959 HVBatCellVoltage_Cell269 0;
BA_ "GenSigTimeoutTime_BPCM" SG_ 1959 HVBatCellVoltage_Cell269 0;
BA_ "GenSigTimeoutTime_EVCU2" SG_ 1959 HVBatCellVoltage_Cell269 0;
BA_ "GenSigTimeoutTime_IDCM" SG_ 1959 HVBatCellVoltage_Cell269 0;
BA_ "GenSigTimeoutTime_VDCM" SG_ 1959 HVBatCellVoltage_Cell270 0;
BA_ "GenSigTimeoutTime_APM2" SG_ 1959 HVBatCellVoltage_Cell270 0;
BA_ "GenSigTimeoutTime_BPCM" SG_ 1959 HVBatCellVoltage_Cell270 0;
BA_ "GenSigTimeoutTime_EVCU2" SG_ 1959 HVBatCellVoltage_Cell270 0;
BA_ "GenSigTimeoutTime_IDCM" SG_ 1959 HVBatCellVoltage_Cell270 0;
BA_ "GenSigTimeoutTime_APM2" SG_ 1960 HVBatCellVoltage_Cell326 0;
BA_ "GenSigTimeoutTime_BPCM" SG_ 1960 HVBatCellVoltage_Cell326 0;
BA_ "GenSigTimeoutTime_EVCU2" SG_ 1960 HVBatCellVoltage_Cell326 0;
BA_ "GenSigTimeoutTime_IDCM" SG_ 1960 HVBatCellVoltage_Cell326 0;
BA_ "GenSigTimeoutTime_APM2" SG_ 1960 HVBatCellVoltage_Cell325 0;
BA_ "GenSigTimeoutTime_BPCM" SG_ 1960 HVBatCellVoltage_Cell325 0;
BA_ "GenSigTimeoutTime_EVCU2" SG_ 1960 HVBatCellVoltage_Cell325 0;
BA_ "GenSigTimeoutTime_IDCM" SG_ 1960 HVBatCellVoltage_Cell325 0;
BA_ "GenSigTimeoutTime_APM2" SG_ 1960 HVBatCellVoltage_Cell324 0;
BA_ "GenSigTimeoutTime_BPCM" SG_ 1960 HVBatCellVoltage_Cell324 0;
BA_ "GenSigTimeoutTime_EVCU2" SG_ 1960 HVBatCellVoltage_Cell324 0;
BA_ "GenSigTimeoutTime_IDCM" SG_ 1960 HVBatCellVoltage_Cell324 0;
BA_ "GenSigTimeoutTime_APM2" SG_ 1960 HVBatCellVoltage_Cell323 0;
BA_ "GenSigTimeoutTime_BPCM" SG_ 1960 HVBatCellVoltage_Cell323 0;
BA_ "GenSigTimeoutTime_EVCU2" SG_ 1960 HVBatCellVoltage_Cell323 0;
BA_ "GenSigTimeoutTime_IDCM" SG_ 1960 HVBatCellVoltage_Cell323 0;
BA_ "GenSigTimeoutTime_APM2" SG_ 1960 HVBatCellVoltage_Cell322 0;
BA_ "GenSigTimeoutTime_BPCM" SG_ 1960 HVBatCellVoltage_Cell322 0;
BA_ "GenSigTimeoutTime_EVCU2" SG_ 1960 HVBatCellVoltage_Cell322 0;
BA_ "GenSigTimeoutTime_IDCM" SG_ 1960 HVBatCellVoltage_Cell322 0;
BA_ "GenSigTimeoutTime_APM2" SG_ 1960 HVBatCellVoltage_Cell321 0;
BA_ "GenSigTimeoutTime_BPCM" SG_ 1960 HVBatCellVoltage_Cell321 0;
BA_ "GenSigTimeoutTime_EVCU2" SG_ 1960 HVBatCellVoltage_Cell321 0;
BA_ "GenSigTimeoutTime_IDCM" SG_ 1960 HVBatCellVoltage_Cell321 0;
BA_ "GenSigTimeoutTime_APM2" SG_ 1960 HVBatCellVoltage_Cell320 0;
BA_ "GenSigTimeoutTime_BPCM" SG_ 1960 HVBatCellVoltage_Cell320 0;
BA_ "GenSigTimeoutTime_EVCU2" SG_ 1960 HVBatCellVoltage_Cell320 0;
BA_ "GenSigTimeoutTime_IDCM" SG_ 1960 HVBatCellVoltage_Cell320 0;
BA_ "GenSigTimeoutTime_EVCU2" SG_ 1960 HVBatCellVoltage_Cell319 0;
BA_ "GenSigTimeoutTime_IDCM" SG_ 1960 HVBatCellVoltage_Cell319 0;
BA_ "GenSigTimeoutTime_APM2" SG_ 1960 HVBatCellVoltage_Cell327 0;
BA_ "GenSigTimeoutTime_BPCM" SG_ 1960 HVBatCellVoltage_Cell327 0;
BA_ "GenSigTimeoutTime_EVCU2" SG_ 1960 HVBatCellVoltage_Cell327 0;
BA_ "GenSigTimeoutTime_IDCM" SG_ 1960 HVBatCellVoltage_Cell327 0;
BA_ "GenSigTimeoutTime_APM2" SG_ 1960 HVBatCellVoltage_Cell328 0;
BA_ "GenSigTimeoutTime_BPCM" SG_ 1960 HVBatCellVoltage_Cell328 0;
BA_ "GenSigTimeoutTime_EVCU2" SG_ 1960 HVBatCellVoltage_Cell328 0;
BA_ "GenSigTimeoutTime_IDCM" SG_ 1960 HVBatCellVoltage_Cell328 0;
BA_ "GenSigTimeoutTime_VDCM" SG_ 1961 HVBatCellVoltage_Cell329 0;
BA_ "GenSigTimeoutTime_VDCM" SG_ 1961 HVBatCellVoltage_Cell330 0;
BA_ "GenSigTimeoutTime_VDCM" SG_ 1961 HVBatCellVoltage_Cell331 0;
BA_ "GenSigTimeoutTime_VDCM" SG_ 1961 HVBatCellVoltage_Cell332 0;
BA_ "GenSigTimeoutTime_VDCM" SG_ 1961 HVBatCellVoltage_Cell333 0;
BA_ "GenSigTimeoutTime_VDCM" SG_ 1961 HVBatCellVoltage_Cell334 0;
BA_ "GenSigTimeoutTime_VDCM" SG_ 1961 HVBatCellVoltage_Cell335 0;
BA_ "GenSigTimeoutTime_VDCM" SG_ 1961 HVBatCellVoltage_Cell336 0;
BA_ "GenSigTimeoutTime_VDCM" SG_ 1961 HVBatCellVoltage_Cell337 0;
BA_ "GenSigTimeoutTime_VDCM" SG_ 1961 HVBatCellVoltage_Cell338 0;
BA_ "GenSigTimeoutTime_VDCM" SG_ 1961 HVBatCellVoltage_Cell339 0;
BA_ "GenSigTimeoutTime_VDCM" SG_ 1961 HVBatCellVoltage_Cell340 0;
BA_ "GenSigTimeoutTime_VDCM" SG_ 1961 HVBatCellVoltage_Cell341 0;
BA_ "GenSigTimeoutTime_VDCM" SG_ 1961 HVBatCellVoltage_Cell342 0;
BA_ "GenSigTimeoutTime_APM2" SG_ 1961 HVBatCellVoltage_Cell343 0;
BA_ "GenSigTimeoutTime_BPCM" SG_ 1961 HVBatCellVoltage_Cell343 0;
BA_ "GenSigTimeoutTime_EVCU2" SG_ 1961 HVBatCellVoltage_Cell343 0;
BA_ "GenSigTimeoutTime_IDCM" SG_ 1961 HVBatCellVoltage_Cell343 0;
BA_ "GenSigTimeoutTime_VDCM" SG_ 1961 HVBatCellVoltage_Cell343 0;
BA_ "GenSigTimeoutTime_APM2" SG_ 1961 HVBatCellVoltage_Cell344 0;
BA_ "GenSigTimeoutTime_BPCM" SG_ 1961 HVBatCellVoltage_Cell344 0;
BA_ "GenSigTimeoutTime_EVCU2" SG_ 1961 HVBatCellVoltage_Cell344 0;
BA_ "GenSigTimeoutTime_IDCM" SG_ 1961 HVBatCellVoltage_Cell344 0;
BA_ "GenSigTimeoutTime_VDCM" SG_ 1961 HVBatCellVoltage_Cell344 0;
BA_ "GenSigTimeoutTime_APM2" SG_ 1961 HVBatCellVoltage_Cell345 0;
BA_ "GenSigTimeoutTime_VDCM" SG_ 1961 HVBatCellVoltage_Cell345 0;
BA_ "GenSigTimeoutTime_VDCM" SG_ 1961 HVBatCellVoltage_Cell346 0;
BA_ "GenSigTimeoutTime_VDCM" SG_ 1961 HVBatCellVoltage_Cell347 0;
BA_ "GenSigTimeoutTime_VDCM" SG_ 1961 HVBatCellVoltage_Cell348 0;
BA_ "GenSigTimeoutTime_VDCM" SG_ 1961 HVBatCellVoltage_Cell349 0;
BA_ "GenSigTimeoutTime_APM2" SG_ 1961 HVBatCellVoltage_Cell349 0;
BA_ "GenSigTimeoutTime_BPCM" SG_ 1961 HVBatCellVoltage_Cell349 0;
BA_ "GenSigTimeoutTime_EVCU2" SG_ 1961 HVBatCellVoltage_Cell349 0;
BA_ "GenSigTimeoutTime_IDCM" SG_ 1961 HVBatCellVoltage_Cell349 0;
BA_ "GenSigTimeoutTime_VDCM" SG_ 1961 HVBatCellVoltage_Cell350 0;
BA_ "GenSigTimeoutTime_APM2" SG_ 1961 HVBatCellVoltage_Cell350 0;
BA_ "GenSigTimeoutTime_BPCM" SG_ 1961 HVBatCellVoltage_Cell350 0;
BA_ "GenSigTimeoutTime_EVCU2" SG_ 1961 HVBatCellVoltage_Cell350 0;
BA_ "GenSigTimeoutTime_IDCM" SG_ 1961 HVBatCellVoltage_Cell350 0;
BA_ "GenSigTimeoutTime_APM2" SG_ 1960 HVBatCellVoltage_Cell316 0;
BA_ "GenSigTimeoutTime_BPCM" SG_ 1960 HVBatCellVoltage_Cell316 0;
BA_ "GenSigTimeoutTime_EVCU2" SG_ 1960 HVBatCellVoltage_Cell316 0;
BA_ "GenSigTimeoutTime_IDCM" SG_ 1960 HVBatCellVoltage_Cell316 0;
BA_ "GenSigTimeoutTime_APM2" SG_ 1960 HVBatCellVoltage_Cell315 0;
BA_ "GenSigTimeoutTime_BPCM" SG_ 1960 HVBatCellVoltage_Cell315 0;
BA_ "GenSigTimeoutTime_EVCU2" SG_ 1960 HVBatCellVoltage_Cell315 0;
BA_ "GenSigTimeoutTime_IDCM" SG_ 1960 HVBatCellVoltage_Cell315 0;
BA_ "GenSigTimeoutTime_APM2" SG_ 1960 HVBatCellVoltage_Cell314 0;
BA_ "GenSigTimeoutTime_BPCM" SG_ 1960 HVBatCellVoltage_Cell314 0;
BA_ "GenSigTimeoutTime_EVCU2" SG_ 1960 HVBatCellVoltage_Cell314 0;
BA_ "GenSigTimeoutTime_IDCM" SG_ 1960 HVBatCellVoltage_Cell314 0;
BA_ "GenSigTimeoutTime_APM2" SG_ 1960 HVBatCellVoltage_Cell313 0;
BA_ "GenSigTimeoutTime_BPCM" SG_ 1960 HVBatCellVoltage_Cell313 0;
BA_ "GenSigTimeoutTime_EVCU2" SG_ 1960 HVBatCellVoltage_Cell313 0;
BA_ "GenSigTimeoutTime_IDCM" SG_ 1960 HVBatCellVoltage_Cell313 0;
BA_ "GenSigTimeoutTime_APM2" SG_ 1960 HVBatCellVoltage_Cell312 0;
BA_ "GenSigTimeoutTime_BPCM" SG_ 1960 HVBatCellVoltage_Cell312 0;
BA_ "GenSigTimeoutTime_EVCU2" SG_ 1960 HVBatCellVoltage_Cell312 0;
BA_ "GenSigTimeoutTime_IDCM" SG_ 1960 HVBatCellVoltage_Cell312 0;
BA_ "GenSigTimeoutTime_APM2" SG_ 1960 HVBatCellVoltage_Cell311 0;
BA_ "GenSigTimeoutTime_BPCM" SG_ 1960 HVBatCellVoltage_Cell311 0;
BA_ "GenSigTimeoutTime_EVCU2" SG_ 1960 HVBatCellVoltage_Cell311 0;
BA_ "GenSigTimeoutTime_IDCM" SG_ 1960 HVBatCellVoltage_Cell311 0;
BA_ "GenSigTimeoutTime_APM2" SG_ 1960 HVBatCellVoltage_Cell310 0;
BA_ "GenSigTimeoutTime_BPCM" SG_ 1960 HVBatCellVoltage_Cell310 0;
BA_ "GenSigTimeoutTime_EVCU2" SG_ 1960 HVBatCellVoltage_Cell310 0;
BA_ "GenSigTimeoutTime_IDCM" SG_ 1960 HVBatCellVoltage_Cell310 0;
BA_ "GenSigTimeoutTime_APM2" SG_ 1960 HVBatCellVoltage_Cell309 0;
BA_ "GenSigTimeoutTime_BPCM" SG_ 1960 HVBatCellVoltage_Cell309 0;
BA_ "GenSigTimeoutTime_EVCU2" SG_ 1960 HVBatCellVoltage_Cell309 0;
BA_ "GenSigTimeoutTime_IDCM" SG_ 1960 HVBatCellVoltage_Cell309 0;
BA_ "GenSigTimeoutTime_APM2" SG_ 1960 HVBatCellVoltage_Cell308 0;
BA_ "GenSigTimeoutTime_BPCM" SG_ 1960 HVBatCellVoltage_Cell308 0;
BA_ "GenSigTimeoutTime_EVCU2" SG_ 1960 HVBatCellVoltage_Cell308 0;
BA_ "GenSigTimeoutTime_IDCM" SG_ 1960 HVBatCellVoltage_Cell308 0;
BA_ "GenSigTimeoutTime_APM2" SG_ 1960 HVBatCellVoltage_Cell307 0;
BA_ "GenSigTimeoutTime_BPCM" SG_ 1960 HVBatCellVoltage_Cell307 0;
BA_ "GenSigTimeoutTime_EVCU2" SG_ 1960 HVBatCellVoltage_Cell307 0;
BA_ "GenSigTimeoutTime_IDCM" SG_ 1960 HVBatCellVoltage_Cell307 0;
BA_ "GenSigTimeoutTime_APM2" SG_ 1960 HVBatCellVoltage_Cell306 0;
BA_ "GenSigTimeoutTime_BPCM" SG_ 1960 HVBatCellVoltage_Cell306 0;
BA_ "GenSigTimeoutTime_EVCU2" SG_ 1960 HVBatCellVoltage_Cell306 0;
BA_ "GenSigTimeoutTime_IDCM" SG_ 1960 HVBatCellVoltage_Cell306 0;
BA_ "GenSigTimeoutTime_APM2" SG_ 1960 HVBatCellVoltage_Cell305 0;
BA_ "GenSigTimeoutTime_BPCM" SG_ 1960 HVBatCellVoltage_Cell305 0;
BA_ "GenSigTimeoutTime_EVCU2" SG_ 1960 HVBatCellVoltage_Cell305 0;
BA_ "GenSigTimeoutTime_IDCM" SG_ 1960 HVBatCellVoltage_Cell305 0;
BA_ "GenSigTimeoutTime_APM2" SG_ 1960 HVBatCellVoltage_Cell304 0;
BA_ "GenSigTimeoutTime_BPCM" SG_ 1960 HVBatCellVoltage_Cell304 0;
BA_ "GenSigTimeoutTime_EVCU2" SG_ 1960 HVBatCellVoltage_Cell304 0;
BA_ "GenSigTimeoutTime_IDCM" SG_ 1960 HVBatCellVoltage_Cell304 0;
BA_ "GenSigTimeoutTime_APM2" SG_ 1960 HVBatCellVoltage_Cell303 0;
BA_ "GenSigTimeoutTime_BPCM" SG_ 1960 HVBatCellVoltage_Cell303 0;
BA_ "GenSigTimeoutTime_EVCU2" SG_ 1960 HVBatCellVoltage_Cell303 0;
BA_ "GenSigTimeoutTime_IDCM" SG_ 1960 HVBatCellVoltage_Cell303 0;
BA_ "GenSigTimeoutTime_APM2" SG_ 1960 HVBatCellVoltage_Cell302 0;
BA_ "GenSigTimeoutTime_BPCM" SG_ 1960 HVBatCellVoltage_Cell302 0;
BA_ "GenSigTimeoutTime_EVCU2" SG_ 1960 HVBatCellVoltage_Cell302 0;
BA_ "GenSigTimeoutTime_IDCM" SG_ 1960 HVBatCellVoltage_Cell302 0;
BA_ "GenSigTimeoutTime_APM2" SG_ 1960 HVBatCellVoltage_Cell301 0;
BA_ "GenSigTimeoutTime_BPCM" SG_ 1960 HVBatCellVoltage_Cell301 0;
BA_ "GenSigTimeoutTime_EVCU2" SG_ 1960 HVBatCellVoltage_Cell301 0;
BA_ "GenSigTimeoutTime_IDCM" SG_ 1960 HVBatCellVoltage_Cell301 0;
BA_ "GenSigTimeoutTime_APM2" SG_ 1960 HVBatCellVoltage_Cell300 0;
BA_ "GenSigTimeoutTime_BPCM" SG_ 1960 HVBatCellVoltage_Cell300 0;
BA_ "GenSigTimeoutTime_EVCU2" SG_ 1960 HVBatCellVoltage_Cell300 0;
BA_ "GenSigTimeoutTime_IDCM" SG_ 1960 HVBatCellVoltage_Cell300 0;
BA_ "GenSigTimeoutTime_APM2" SG_ 1960 HVBatCellVoltage_Cell299 0;
BA_ "GenSigTimeoutTime_BPCM" SG_ 1960 HVBatCellVoltage_Cell299 0;
BA_ "GenSigTimeoutTime_EVCU2" SG_ 1960 HVBatCellVoltage_Cell299 0;
BA_ "GenSigTimeoutTime_IDCM" SG_ 1960 HVBatCellVoltage_Cell299 0;
BA_ "GenSigTimeoutTime_APM2" SG_ 1960 HVBatCellVoltage_Cell298 0;
BA_ "GenSigTimeoutTime_BPCM" SG_ 1960 HVBatCellVoltage_Cell298 0;
BA_ "GenSigTimeoutTime_EVCU2" SG_ 1960 HVBatCellVoltage_Cell298 0;
BA_ "GenSigTimeoutTime_IDCM" SG_ 1960 HVBatCellVoltage_Cell298 0;
BA_ "GenSigTimeoutTime_APM2" SG_ 1960 HVBatCellVoltage_Cell297 0;
BA_ "GenSigTimeoutTime_BPCM" SG_ 1960 HVBatCellVoltage_Cell297 0;
BA_ "GenSigTimeoutTime_EVCU2" SG_ 1960 HVBatCellVoltage_Cell297 0;
BA_ "GenSigTimeoutTime_IDCM" SG_ 1960 HVBatCellVoltage_Cell297 0;
BA_ "GenSigTimeoutTime_VDCM" SG_ 1961 HVBatCellVoltage_Cell359 0;
BA_ "GenSigTimeoutTime_VDCM" SG_ 1961 HVBatCellVoltage_Cell360 0;
BA_ "GenSigTimeoutTime_VDCM" SG_ 1961 HVBatCellVoltage_Cell355 0;
BA_ "GenSigTimeoutTime_VDCM" SG_ 1961 HVBatCellVoltage_Cell356 0;
BA_ "GenSigTimeoutTime_VDCM" SG_ 1961 HVBatCellVoltage_Cell357 0;
BA_ "GenSigTimeoutTime_VDCM" SG_ 1961 HVBatCellVoltage_Cell358 0;
BA_ "GenSigTimeoutTime_APM2" SG_ 1961 HVBatCellVoltage_Cell353 0;
BA_ "GenSigTimeoutTime_BPCM" SG_ 1961 HVBatCellVoltage_Cell353 0;
BA_ "GenSigTimeoutTime_EVCU2" SG_ 1961 HVBatCellVoltage_Cell353 0;
BA_ "GenSigTimeoutTime_IDCM" SG_ 1961 HVBatCellVoltage_Cell353 0;
BA_ "GenSigTimeoutTime_VDCM" SG_ 1961 HVBatCellVoltage_Cell353 0;
BA_ "GenSigTimeoutTime_APM2" SG_ 1961 HVBatCellVoltage_Cell354 0;
BA_ "GenSigTimeoutTime_BPCM" SG_ 1961 HVBatCellVoltage_Cell354 0;
BA_ "GenSigTimeoutTime_EVCU2" SG_ 1961 HVBatCellVoltage_Cell354 0;
BA_ "GenSigTimeoutTime_IDCM" SG_ 1961 HVBatCellVoltage_Cell354 0;
BA_ "GenSigTimeoutTime_VDCM" SG_ 1961 HVBatCellVoltage_Cell354 0;
BA_ "GenSigTimeoutTime_APM2" SG_ 1961 HVBatCellVoltage_Cell352 0;
BA_ "GenSigTimeoutTime_BPCM" SG_ 1961 HVBatCellVoltage_Cell352 0;
BA_ "GenSigTimeoutTime_EVCU2" SG_ 1961 HVBatCellVoltage_Cell352 0;
BA_ "GenSigTimeoutTime_IDCM" SG_ 1961 HVBatCellVoltage_Cell352 0;
BA_ "GenSigTimeoutTime_VDCM" SG_ 1961 HVBatCellVoltage_Cell352 0;
BA_ "GenSigTimeoutTime_EVCU2" SG_ 1961 HVBatCellVoltage_Cell351 0;
BA_ "GenSigTimeoutTime_IDCM" SG_ 1961 HVBatCellVoltage_Cell351 0;
BA_ "GenSigTimeoutTime_VDCM" SG_ 1961 HVBatCellVoltage_Cell351 0;
BA_ "GenSigTimeoutTime_APM2" SG_ 1961 HVBatCellVoltage_Cell351 0;
BA_ "GenSigTimeoutTime_BPCM" SG_ 1961 HVBatCellVoltage_Cell351 0;
BA_ "GenSigTimeoutTime_APM2" SG_ 1961 HVBatCellVoltage_Cell358 0;
BA_ "GenSigTimeoutTime_BPCM" SG_ 1961 HVBatCellVoltage_Cell358 0;
BA_ "GenSigTimeoutTime_EVCU2" SG_ 1961 HVBatCellVoltage_Cell358 0;
BA_ "GenSigTimeoutTime_IDCM" SG_ 1961 HVBatCellVoltage_Cell358 0;
BA_ "GenSigTimeoutTime_APM2" SG_ 1961 HVBatCellVoltage_Cell357 0;
BA_ "GenSigTimeoutTime_BPCM" SG_ 1961 HVBatCellVoltage_Cell357 0;
BA_ "GenSigTimeoutTime_EVCU2" SG_ 1961 HVBatCellVoltage_Cell357 0;
BA_ "GenSigTimeoutTime_IDCM" SG_ 1961 HVBatCellVoltage_Cell357 0;
BA_ "GenSigTimeoutTime_APM2" SG_ 1961 HVBatCellVoltage_Cell356 0;
BA_ "GenSigTimeoutTime_BPCM" SG_ 1961 HVBatCellVoltage_Cell356 0;
BA_ "GenSigTimeoutTime_EVCU2" SG_ 1961 HVBatCellVoltage_Cell356 0;
BA_ "GenSigTimeoutTime_IDCM" SG_ 1961 HVBatCellVoltage_Cell356 0;
BA_ "GenSigTimeoutTime_APM2" SG_ 1961 HVBatCellVoltage_Cell355 0;
BA_ "GenSigTimeoutTime_BPCM" SG_ 1961 HVBatCellVoltage_Cell355 0;
BA_ "GenSigTimeoutTime_EVCU2" SG_ 1961 HVBatCellVoltage_Cell355 0;
BA_ "GenSigTimeoutTime_IDCM" SG_ 1961 HVBatCellVoltage_Cell355 0;
BA_ "GenSigTimeoutTime_APM2" SG_ 1961 HVBatCellVoltage_Cell360 0;
BA_ "GenSigTimeoutTime_BPCM" SG_ 1961 HVBatCellVoltage_Cell360 0;
BA_ "GenSigTimeoutTime_EVCU2" SG_ 1961 HVBatCellVoltage_Cell360 0;
BA_ "GenSigTimeoutTime_IDCM" SG_ 1961 HVBatCellVoltage_Cell360 0;
BA_ "GenSigTimeoutTime_APM2" SG_ 1961 HVBatCellVoltage_Cell359 0;
BA_ "GenSigTimeoutTime_BPCM" SG_ 1961 HVBatCellVoltage_Cell359 0;
BA_ "GenSigTimeoutTime_EVCU2" SG_ 1961 HVBatCellVoltage_Cell359 0;
BA_ "GenSigTimeoutTime_IDCM" SG_ 1961 HVBatCellVoltage_Cell359 0;
BA_ "GenSigTimeoutTime_VDCM" SG_ 1962 HVBatCellVoltage_Cell361 0;
BA_ "GenSigTimeoutTime_VDCM" SG_ 1962 HVBatCellVoltage_Cell362 0;
BA_ "GenSigTimeoutTime_VDCM" SG_ 1962 HVBatCellVoltage_Cell363 0;
BA_ "GenSigTimeoutTime_VDCM" SG_ 1962 HVBatCellVoltage_Cell364 0;
BA_ "GenSigTimeoutTime_VDCM" SG_ 1962 HVBatCellVoltage_Cell365 0;
BA_ "GenSigTimeoutTime_VDCM" SG_ 1962 HVBatCellVoltage_Cell366 0;
BA_ "GenSigTimeoutTime_VDCM" SG_ 1962 HVBatCellVoltage_Cell367 0;
BA_ "GenSigTimeoutTime_VDCM" SG_ 1962 HVBatCellVoltage_Cell368 0;
BA_ "GenSigTimeoutTime_VDCM" SG_ 1962 HVBatCellVoltage_Cell369 0;
BA_ "GenSigTimeoutTime_VDCM" SG_ 1962 HVBatCellVoltage_Cell370 0;
BA_ "GenSigTimeoutTime_VDCM" SG_ 1962 HVBatCellVoltage_Cell371 0;
BA_ "GenSigTimeoutTime_VDCM" SG_ 1962 HVBatCellVoltage_Cell372 0;
BA_ "GenSigTimeoutTime_VDCM" SG_ 1962 HVBatCellVoltage_Cell373 0;
BA_ "GenSigTimeoutTime_VDCM" SG_ 1962 HVBatCellVoltage_Cell374 0;
BA_ "GenSigTimeoutTime_VDCM" SG_ 1962 HVBatCellVoltage_Cell375 0;
BA_ "GenSigTimeoutTime_VDCM" SG_ 1962 HVBatCellVoltage_Cell376 0;
BA_ "GenSigTimeoutTime_APM2" SG_ 1962 HVBatCellVoltage_Cell377 0;
BA_ "GenSigTimeoutTime_BPCM" SG_ 1962 HVBatCellVoltage_Cell377 0;
BA_ "GenSigTimeoutTime_EVCU2" SG_ 1962 HVBatCellVoltage_Cell377 0;
BA_ "GenSigTimeoutTime_IDCM" SG_ 1962 HVBatCellVoltage_Cell377 0;
BA_ "GenSigTimeoutTime_VDCM" SG_ 1962 HVBatCellVoltage_Cell377 0;
BA_ "GenSigTimeoutTime_APM2" SG_ 1962 HVBatCellVoltage_Cell378 0;
BA_ "GenSigTimeoutTime_BPCM" SG_ 1962 HVBatCellVoltage_Cell378 0;
BA_ "GenSigTimeoutTime_EVCU2" SG_ 1962 HVBatCellVoltage_Cell378 0;
BA_ "GenSigTimeoutTime_IDCM" SG_ 1962 HVBatCellVoltage_Cell378 0;
BA_ "GenSigTimeoutTime_VDCM" SG_ 1962 HVBatCellVoltage_Cell378 0;
BA_ "GenSigTimeoutTime_APM2" SG_ 1962 HVBatCellVoltage_Cell379 0;
BA_ "GenSigTimeoutTime_BPCM" SG_ 1962 HVBatCellVoltage_Cell379 0;
BA_ "GenSigTimeoutTime_EVCU2" SG_ 1962 HVBatCellVoltage_Cell379 0;
BA_ "GenSigTimeoutTime_IDCM" SG_ 1962 HVBatCellVoltage_Cell379 0;
BA_ "GenSigTimeoutTime_VDCM" SG_ 1962 HVBatCellVoltage_Cell379 0;
BA_ "GenSigTimeoutTime_APM2" SG_ 1962 HVBatCellVoltage_Cell380 0;
BA_ "GenSigTimeoutTime_BPCM" SG_ 1962 HVBatCellVoltage_Cell380 0;
BA_ "GenSigTimeoutTime_EVCU2" SG_ 1962 HVBatCellVoltage_Cell380 0;
BA_ "GenSigTimeoutTime_IDCM" SG_ 1962 HVBatCellVoltage_Cell380 0;
BA_ "GenSigTimeoutTime_VDCM" SG_ 1962 HVBatCellVoltage_Cell380 0;
BA_ "GenSigTimeoutTime_APM2" SG_ 1962 HVBatCellVoltage_Cell381 0;
BA_ "GenSigTimeoutTime_VDCM" SG_ 1962 HVBatCellVoltage_Cell381 0;
BA_ "GenSigTimeoutTime_VDCM" SG_ 1962 HVBatCellVoltage_Cell382 0;
BA_ "GenSigTimeoutTime_VDCM" SG_ 1962 HVBatCellVoltage_Cell383 0;
BA_ "GenSigTimeoutTime_APM2" SG_ 1962 HVBatCellVoltage_Cell383 0;
BA_ "GenSigTimeoutTime_BPCM" SG_ 1962 HVBatCellVoltage_Cell383 0;
BA_ "GenSigTimeoutTime_EVCU2" SG_ 1962 HVBatCellVoltage_Cell383 0;
BA_ "GenSigTimeoutTime_IDCM" SG_ 1962 HVBatCellVoltage_Cell383 0;
BA_ "GenSigTimeoutTime_VDCM" SG_ 1962 HVBatCellVoltage_Cell384 0;
BA_ "GenSigTimeoutTime_APM2" SG_ 1962 HVBatCellVoltage_Cell384 0;
BA_ "GenSigTimeoutTime_BPCM" SG_ 1962 HVBatCellVoltage_Cell384 0;
BA_ "GenSigTimeoutTime_EVCU2" SG_ 1962 HVBatCellVoltage_Cell384 0;
BA_ "GenSigTimeoutTime_IDCM" SG_ 1962 HVBatCellVoltage_Cell384 0;
BA_ "GenSigTimeoutTime_VDCM" SG_ 1962 HVBatCellVoltage_Cell385 0;
BA_ "GenSigTimeoutTime_APM2" SG_ 1962 HVBatCellVoltage_Cell385 0;
BA_ "GenSigTimeoutTime_BPCM" SG_ 1962 HVBatCellVoltage_Cell385 0;
BA_ "GenSigTimeoutTime_EVCU2" SG_ 1962 HVBatCellVoltage_Cell385 0;
BA_ "GenSigTimeoutTime_IDCM" SG_ 1962 HVBatCellVoltage_Cell385 0;
BA_ "GenSigTimeoutTime_VDCM" SG_ 1962 HVBatCellVoltage_Cell386 0;
BA_ "GenSigTimeoutTime_APM2" SG_ 1962 HVBatCellVoltage_Cell386 0;
BA_ "GenSigTimeoutTime_BPCM" SG_ 1962 HVBatCellVoltage_Cell386 0;
BA_ "GenSigTimeoutTime_EVCU2" SG_ 1962 HVBatCellVoltage_Cell386 0;
BA_ "GenSigTimeoutTime_IDCM" SG_ 1962 HVBatCellVoltage_Cell386 0;
BA_ "GenSigTimeoutTime_BPCM" SG_ 1962 HVBatCellVoltage_Cell387 0;
BA_ "GenSigTimeoutTime_EVCU2" SG_ 1962 HVBatCellVoltage_Cell387 0;
BA_ "GenSigTimeoutTime_IDCM" SG_ 1962 HVBatCellVoltage_Cell387 0;
BA_ "GenSigTimeoutTime_VDCM" SG_ 1962 HVBatCellVoltage_Cell387 0;
BA_ "GenSigTimeoutTime_APM2" SG_ 1962 HVBatCellVoltage_Cell387 0;
BA_ "GenSigTimeoutTime_APM2" SG_ 1962 HVBatCellVoltage_Cell388 0;
BA_ "GenSigTimeoutTime_BPCM" SG_ 1962 HVBatCellVoltage_Cell388 0;
BA_ "GenSigTimeoutTime_EVCU2" SG_ 1962 HVBatCellVoltage_Cell388 0;
BA_ "GenSigTimeoutTime_IDCM" SG_ 1962 HVBatCellVoltage_Cell388 0;
BA_ "GenSigTimeoutTime_VDCM" SG_ 1962 HVBatCellVoltage_Cell388 0;
BA_ "GenSigTimeoutTime_VDCM" SG_ 1962 HVBatCellVoltage_Cell389 0;
BA_ "GenSigTimeoutTime_APM2" SG_ 1962 HVBatCellVoltage_Cell389 0;
BA_ "GenSigTimeoutTime_BPCM" SG_ 1962 HVBatCellVoltage_Cell389 0;
BA_ "GenSigTimeoutTime_EVCU2" SG_ 1962 HVBatCellVoltage_Cell389 0;
BA_ "GenSigTimeoutTime_IDCM" SG_ 1962 HVBatCellVoltage_Cell389 0;
BA_ "GenSigTimeoutTime_VDCM" SG_ 1962 HVBatCellVoltage_Cell390 0;
BA_ "GenSigTimeoutTime_APM2" SG_ 1962 HVBatCellVoltage_Cell390 0;
BA_ "GenSigTimeoutTime_BPCM" SG_ 1962 HVBatCellVoltage_Cell390 0;
BA_ "GenSigTimeoutTime_EVCU2" SG_ 1962 HVBatCellVoltage_Cell390 0;
BA_ "GenSigTimeoutTime_IDCM" SG_ 1962 HVBatCellVoltage_Cell390 0;
BA_ "GenSigTimeoutTime_VDCM" SG_ 1962 HVBatCellVoltage_Cell391 0;
BA_ "GenSigTimeoutTime_APM2" SG_ 1962 HVBatCellVoltage_Cell391 0;
BA_ "GenSigTimeoutTime_BPCM" SG_ 1962 HVBatCellVoltage_Cell391 0;
BA_ "GenSigTimeoutTime_EVCU2" SG_ 1962 HVBatCellVoltage_Cell391 0;
BA_ "GenSigTimeoutTime_IDCM" SG_ 1962 HVBatCellVoltage_Cell391 0;
BA_ "GenSigTimeoutTime_VDCM" SG_ 1962 HVBatCellVoltage_Cell392 0;
BA_ "GenSigTimeoutTime_APM2" SG_ 1962 HVBatCellVoltage_Cell392 0;
BA_ "GenSigTimeoutTime_BPCM" SG_ 1962 HVBatCellVoltage_Cell392 0;
BA_ "GenSigTimeoutTime_EVCU2" SG_ 1962 HVBatCellVoltage_Cell392 0;
BA_ "GenSigTimeoutTime_IDCM" SG_ 1962 HVBatCellVoltage_Cell392 0;
BA_ "GenSigTimeoutTime_APM2" SG_ 1961 HVBatCellVoltage_Cell348 0;
BA_ "GenSigTimeoutTime_BPCM" SG_ 1961 HVBatCellVoltage_Cell348 0;
BA_ "GenSigTimeoutTime_EVCU2" SG_ 1961 HVBatCellVoltage_Cell348 0;
BA_ "GenSigTimeoutTime_IDCM" SG_ 1961 HVBatCellVoltage_Cell348 0;
BA_ "GenSigTimeoutTime_APM2" SG_ 1961 HVBatCellVoltage_Cell347 0;
BA_ "GenSigTimeoutTime_BPCM" SG_ 1961 HVBatCellVoltage_Cell347 0;
BA_ "GenSigTimeoutTime_EVCU2" SG_ 1961 HVBatCellVoltage_Cell347 0;
BA_ "GenSigTimeoutTime_IDCM" SG_ 1961 HVBatCellVoltage_Cell347 0;
BA_ "GenSigTimeoutTime_APM2" SG_ 1961 HVBatCellVoltage_Cell346 0;
BA_ "GenSigTimeoutTime_BPCM" SG_ 1961 HVBatCellVoltage_Cell346 0;
BA_ "GenSigTimeoutTime_EVCU2" SG_ 1961 HVBatCellVoltage_Cell346 0;
BA_ "GenSigTimeoutTime_IDCM" SG_ 1961 HVBatCellVoltage_Cell346 0;
BA_ "GenSigTimeoutTime_BPCM" SG_ 1961 HVBatCellVoltage_Cell345 0;
BA_ "GenSigTimeoutTime_EVCU2" SG_ 1961 HVBatCellVoltage_Cell345 0;
BA_ "GenSigTimeoutTime_IDCM" SG_ 1961 HVBatCellVoltage_Cell345 0;
BA_ "GenSigTimeoutTime_APM2" SG_ 1961 HVBatCellVoltage_Cell342 0;
BA_ "GenSigTimeoutTime_BPCM" SG_ 1961 HVBatCellVoltage_Cell342 0;
BA_ "GenSigTimeoutTime_EVCU2" SG_ 1961 HVBatCellVoltage_Cell342 0;
BA_ "GenSigTimeoutTime_IDCM" SG_ 1961 HVBatCellVoltage_Cell342 0;
BA_ "GenSigTimeoutTime_APM2" SG_ 1961 HVBatCellVoltage_Cell341 0;
BA_ "GenSigTimeoutTime_BPCM" SG_ 1961 HVBatCellVoltage_Cell341 0;
BA_ "GenSigTimeoutTime_EVCU2" SG_ 1961 HVBatCellVoltage_Cell341 0;
BA_ "GenSigTimeoutTime_IDCM" SG_ 1961 HVBatCellVoltage_Cell341 0;
BA_ "GenSigTimeoutTime_APM2" SG_ 1961 HVBatCellVoltage_Cell340 0;
BA_ "GenSigTimeoutTime_BPCM" SG_ 1961 HVBatCellVoltage_Cell340 0;
BA_ "GenSigTimeoutTime_EVCU2" SG_ 1961 HVBatCellVoltage_Cell340 0;
BA_ "GenSigTimeoutTime_IDCM" SG_ 1961 HVBatCellVoltage_Cell340 0;
BA_ "GenSigTimeoutTime_APM2" SG_ 1961 HVBatCellVoltage_Cell339 0;
BA_ "GenSigTimeoutTime_BPCM" SG_ 1961 HVBatCellVoltage_Cell339 0;
BA_ "GenSigTimeoutTime_EVCU2" SG_ 1961 HVBatCellVoltage_Cell339 0;
BA_ "GenSigTimeoutTime_IDCM" SG_ 1961 HVBatCellVoltage_Cell339 0;
BA_ "GenSigTimeoutTime_APM2" SG_ 1961 HVBatCellVoltage_Cell338 0;
BA_ "GenSigTimeoutTime_BPCM" SG_ 1961 HVBatCellVoltage_Cell338 0;
BA_ "GenSigTimeoutTime_EVCU2" SG_ 1961 HVBatCellVoltage_Cell338 0;
BA_ "GenSigTimeoutTime_IDCM" SG_ 1961 HVBatCellVoltage_Cell338 0;
BA_ "GenSigTimeoutTime_APM2" SG_ 1961 HVBatCellVoltage_Cell337 0;
BA_ "GenSigTimeoutTime_BPCM" SG_ 1961 HVBatCellVoltage_Cell337 0;
BA_ "GenSigTimeoutTime_EVCU2" SG_ 1961 HVBatCellVoltage_Cell337 0;
BA_ "GenSigTimeoutTime_IDCM" SG_ 1961 HVBatCellVoltage_Cell337 0;
BA_ "GenSigTimeoutTime_APM2" SG_ 1961 HVBatCellVoltage_Cell336 0;
BA_ "GenSigTimeoutTime_BPCM" SG_ 1961 HVBatCellVoltage_Cell336 0;
BA_ "GenSigTimeoutTime_EVCU2" SG_ 1961 HVBatCellVoltage_Cell336 0;
BA_ "GenSigTimeoutTime_IDCM" SG_ 1961 HVBatCellVoltage_Cell336 0;
BA_ "GenSigTimeoutTime_APM2" SG_ 1961 HVBatCellVoltage_Cell335 0;
BA_ "GenSigTimeoutTime_BPCM" SG_ 1961 HVBatCellVoltage_Cell335 0;
BA_ "GenSigTimeoutTime_EVCU2" SG_ 1961 HVBatCellVoltage_Cell335 0;
BA_ "GenSigTimeoutTime_IDCM" SG_ 1961 HVBatCellVoltage_Cell335 0;
BA_ "GenSigTimeoutTime_APM2" SG_ 1961 HVBatCellVoltage_Cell334 0;
BA_ "GenSigTimeoutTime_BPCM" SG_ 1961 HVBatCellVoltage_Cell334 0;
BA_ "GenSigTimeoutTime_EVCU2" SG_ 1961 HVBatCellVoltage_Cell334 0;
BA_ "GenSigTimeoutTime_IDCM" SG_ 1961 HVBatCellVoltage_Cell334 0;
BA_ "GenSigTimeoutTime_APM2" SG_ 1961 HVBatCellVoltage_Cell333 0;
BA_ "GenSigTimeoutTime_BPCM" SG_ 1961 HVBatCellVoltage_Cell333 0;
BA_ "GenSigTimeoutTime_EVCU2" SG_ 1961 HVBatCellVoltage_Cell333 0;
BA_ "GenSigTimeoutTime_IDCM" SG_ 1961 HVBatCellVoltage_Cell333 0;
BA_ "GenSigTimeoutTime_APM2" SG_ 1961 HVBatCellVoltage_Cell332 0;
BA_ "GenSigTimeoutTime_BPCM" SG_ 1961 HVBatCellVoltage_Cell332 0;
BA_ "GenSigTimeoutTime_EVCU2" SG_ 1961 HVBatCellVoltage_Cell332 0;
BA_ "GenSigTimeoutTime_IDCM" SG_ 1961 HVBatCellVoltage_Cell332 0;
BA_ "GenSigTimeoutTime_APM2" SG_ 1961 HVBatCellVoltage_Cell331 0;
BA_ "GenSigTimeoutTime_BPCM" SG_ 1961 HVBatCellVoltage_Cell331 0;
BA_ "GenSigTimeoutTime_EVCU2" SG_ 1961 HVBatCellVoltage_Cell331 0;
BA_ "GenSigTimeoutTime_IDCM" SG_ 1961 HVBatCellVoltage_Cell331 0;
BA_ "GenSigTimeoutTime_APM2" SG_ 1961 HVBatCellVoltage_Cell330 0;
BA_ "GenSigTimeoutTime_BPCM" SG_ 1961 HVBatCellVoltage_Cell330 0;
BA_ "GenSigTimeoutTime_EVCU2" SG_ 1961 HVBatCellVoltage_Cell330 0;
BA_ "GenSigTimeoutTime_IDCM" SG_ 1961 HVBatCellVoltage_Cell330 0;
BA_ "GenSigTimeoutTime_APM2" SG_ 1961 HVBatCellVoltage_Cell329 0;
BA_ "GenSigTimeoutTime_BPCM" SG_ 1961 HVBatCellVoltage_Cell329 0;
BA_ "GenSigTimeoutTime_EVCU2" SG_ 1961 HVBatCellVoltage_Cell329 0;
BA_ "GenSigTimeoutTime_IDCM" SG_ 1961 HVBatCellVoltage_Cell329 0;
BA_ "GenSigTimeoutTime_VDCM" SG_ 1963 HVBatCellVoltage_Cell393 0;
BA_ "GenSigTimeoutTime_APM2" SG_ 1963 HVBatCellVoltage_Cell393 0;
BA_ "GenSigTimeoutTime_BPCM" SG_ 1963 HVBatCellVoltage_Cell393 0;
BA_ "GenSigTimeoutTime_EVCU2" SG_ 1963 HVBatCellVoltage_Cell393 0;
BA_ "GenSigTimeoutTime_IDCM" SG_ 1963 HVBatCellVoltage_Cell393 0;
BA_ "GenSigTimeoutTime_VDCM" SG_ 1963 HVBatCellVoltage_Cell394 0;
BA_ "GenSigTimeoutTime_APM2" SG_ 1963 HVBatCellVoltage_Cell394 0;
BA_ "GenSigTimeoutTime_BPCM" SG_ 2654339142 EOL_FD11_BPCM 0;
BA_ "GenSigTimeoutTime_IDCM" SG_ 2654339142 EOL_FD11_BPCM 0;
BA_ "GenSigTimeoutTime_PPIM" SG_ 2654339142 EOL_FD11_BPCM 0;
BA_ "GenSigTimeoutTime_APM2" SG_ 2654339142 EOL_FD11_BPCM 0;
BA_ "GenSigTimeoutTime_VDCM" SG_ 2654339142 EOL_FD11_BPCM 0;
BA_ "GenSigTimeoutTime_BPCM" SG_ 2654339142 GenericFailSts_FD11_BPCM 0;
BA_ "GenSigTimeoutTime_IDCM" SG_ 2654339142 GenericFailSts_FD11_BPCM 0;
BA_ "GenSigTimeoutTime_PPIM" SG_ 2654339142 GenericFailSts_FD11_BPCM 0;
BA_ "GenSigTimeoutTime_APM2" SG_ 2654339142 GenericFailSts_FD11_BPCM 0;
BA_ "GenSigTimeoutTime_VDCM" SG_ 2654339142 GenericFailSts_FD11_BPCM 0;
BA_ "GenSigTimeoutTime_HCP" SG_ 2654339142 CurrentCanNMState_FD11_BPCM 0;
BA_ "GenSigTimeoutTime_PPIM" SG_ 2654339142 CurrentCanNMState_FD11_BPCM 0;
BA_ "GenSigTimeoutTime_APM2" SG_ 2654339142 CurrentCanNMState_FD11_BPCM 0;
BA_ "GenSigTimeoutTime_VDCM" SG_ 2654339142 CurrentCanNMState_FD11_BPCM 0;
BA_ "GenSigTimeoutTime_BPCM" SG_ 2654339142 CurrentCanNMState_FD11_BPCM 0;
BA_ "GenSigTimeoutTime_EVCU2" SG_ 2654339142 CurrentCanNMState_FD11_BPCM 0;
BA_ "GenSigTimeoutTime_IDCM" SG_ 2654339142 CurrentCanNMState_FD11_BPCM 0;
BA_ "GenSigTimeoutTime_BPCM" SG_ 2654339142 WakeupSource_FD11_BPCM 0;
BA_ "GenSigTimeoutTime_EVCU2" SG_ 2654339142 WakeupSource_FD11_BPCM 0;
BA_ "GenSigTimeoutTime_IDCM" SG_ 2654339142 WakeupSource_FD11_BPCM 0;
BA_ "GenSigTimeoutTime_HCP" SG_ 2654339142 WakeupSource_FD11_BPCM 0;
BA_ "GenSigTimeoutTime_PPIM" SG_ 2654339142 WakeupSource_FD11_BPCM 0;
BA_ "GenSigTimeoutTime_APM2" SG_ 2654339142 WakeupSource_FD11_BPCM 0;
BA_ "GenSigTimeoutTime_VDCM" SG_ 2654339142 WakeupSource_FD11_BPCM 0;
BA_ "GenSigTimeoutTime_HCP" SG_ 2654339142 DES_FD11_BPCM 0;
BA_ "GenSigTimeoutTime_PPIM" SG_ 2654339142 DES_FD11_BPCM 0;
BA_ "GenSigTimeoutTime_APM2" SG_ 2654339142 DES_FD11_BPCM 0;
BA_ "GenSigTimeoutTime_VDCM" SG_ 2654339142 DES_FD11_BPCM 0;
BA_ "GenSigTimeoutTime_BPCM" SG_ 2654339142 DES_FD11_BPCM 0;
BA_ "GenSigTimeoutTime_EVCU2" SG_ 2654339142 DES_FD11_BPCM 0;
BA_ "GenSigTimeoutTime_IDCM" SG_ 2654339142 DES_FD11_BPCM 0;
BA_ "GenSigTimeoutTime_BPCM" SG_ 2654339142 PreviousCanNMState_FD11_BPCM 0;
BA_ "GenSigTimeoutTime_EVCU2" SG_ 2654339142 PreviousCanNMState_FD11_BPCM 0;
BA_ "GenSigTimeoutTime_IDCM" SG_ 2654339142 PreviousCanNMState_FD11_BPCM 0;
BA_ "GenSigTimeoutTime_HCP" SG_ 2654339142 PreviousCanNMState_FD11_BPCM 0;
BA_ "GenSigTimeoutTime_PPIM" SG_ 2654339142 PreviousCanNMState_FD11_BPCM 0;
BA_ "GenSigTimeoutTime_APM2" SG_ 2654339142 PreviousCanNMState_FD11_BPCM 0;
BA_ "GenSigTimeoutTime_VDCM" SG_ 2654339142 PreviousCanNMState_FD11_BPCM 0;
BA_ "GenSigTimeoutTime_HCP" SG_ 288 BPCM_HV_HVBatChargeStat 0;
BA_ "GenSigTimeoutTime_PPIM" SG_ 288 BPCM_HV_HVBatChargeStat 0;
BA_ "GenSigTimeoutTime_APM2" SG_ 288 BPCM_HV_HVBatChargeStat 0;
BA_ "GenSigTimeoutTime_VDCM" SG_ 288 BPCM_HV_HVBatChargeStat 0;
BA_ "GenSigTimeoutTime_BPCM" SG_ 288 BPCM_HV_HVBatChargeStat 0;
BA_ "GenSigTimeoutTime_IDCM" SG_ 288 BPCM_HV_HVBatChargeStat 0;
BA_ "GenSigTimeoutTime_SGW" SG_ 288 BPCM_HV_HVBatChargeStat 0;
BA_ "GenSigTimeoutTime_HCP" SG_ 485 BPCM_Max_Pk_Volt_Allowed 0;
BA_ "GenSigTimeoutTime_PPIM" SG_ 485 BPCM_Max_Pk_Volt_Allowed 0;
BA_ "GenSigTimeoutTime_APM2" SG_ 485 BPCM_Max_Pk_Volt_Allowed 0;
BA_ "GenSigTimeoutTime_VDCM" SG_ 485 BPCM_Max_Pk_Volt_Allowed 0;
BA_ "GenSigTimeoutTime_HCP" SG_ 485 BPCM_Min_Pk_Volt_Allowed 0;
BA_ "GenSigTimeoutTime_PPIM" SG_ 485 BPCM_Min_Pk_Volt_Allowed 0;
BA_ "GenSigTimeoutTime_APM2" SG_ 485 BPCM_Min_Pk_Volt_Allowed 0;
BA_ "GenSigTimeoutTime_VDCM" SG_ 485 BPCM_Min_Pk_Volt_Allowed 0;
BA_ "GenSigTimeoutTime_BPCM" SG_ 485 BPCM_HV_NumCellMaxVolt 0;
BA_ "GenSigTimeoutTime_IDCM" SG_ 485 BPCM_HV_NumCellMaxVolt 0;
BA_ "GenSigTimeoutTime_SGW" SG_ 485 BPCM_HV_NumCellMaxVolt 0;
BA_ "GenSigTimeoutTime_HCP" SG_ 485 BPCM_HV_NumCellMaxVolt 0;
BA_ "GenSigTimeoutTime_PPIM" SG_ 485 BPCM_HV_NumCellMaxVolt 0;
BA_ "GenSigTimeoutTime_APM2" SG_ 485 BPCM_HV_NumCellMaxVolt 0;
BA_ "GenSigTimeoutTime_VDCM" SG_ 485 BPCM_HV_NumCellMaxVolt 0;
BA_ "GenSigTimeoutTime_BPCM" SG_ 485 BPCM_HV_NumCellMinVolt 0;
BA_ "GenSigTimeoutTime_IDCM" SG_ 485 BPCM_HV_NumCellMinVolt 0;
BA_ "GenSigTimeoutTime_SGW" SG_ 485 BPCM_HV_NumCellMinVolt 0;
BA_ "GenSigTimeoutTime_HCP" SG_ 485 BPCM_HV_NumCellMinVolt 0;
BA_ "GenSigTimeoutTime_PPIM" SG_ 485 BPCM_HV_NumCellMinVolt 0;
BA_ "GenSigTimeoutTime_APM2" SG_ 485 BPCM_HV_NumCellMinVolt 0;
BA_ "GenSigTimeoutTime_VDCM" SG_ 485 BPCM_HV_NumCellMinVolt 0;
BA_ "GenSigTimeoutTime_BPCM" SG_ 485 BPCM_HV_NumCellMaxTemp 0;
BA_ "GenSigTimeoutTime_HCP" SG_ 485 BPCM_HV_NumCellMaxTemp 0;
BA_ "GenSigTimeoutTime_PPIM" SG_ 485 BPCM_HV_NumCellMaxTemp 0;
BA_ "GenSigTimeoutTime_APM2" SG_ 485 BPCM_HV_NumCellMaxTemp 0;
BA_ "GenSigTimeoutTime_VDCM" SG_ 485 BPCM_HV_NumCellMaxTemp 0;
BA_ "GenSigTimeoutTime_HCP" SG_ 485 BPCM_HV_NumCellMinTemp 0;
BA_ "GenSigTimeoutTime_PPIM" SG_ 485 BPCM_HV_NumCellMinTemp 0;
BA_ "GenSigTimeoutTime_APM2" SG_ 485 BPCM_HV_NumCellMinTemp 0;
BA_ "GenSigTimeoutTime_VDCM" SG_ 485 BPCM_HV_NumCellMinTemp 0;
BA_ "GenSigTimeoutTime_HCP" SG_ 485 CRC_BATT_HV_VLIMITS 0;
BA_ "GenSigTimeoutTime_PPIM" SG_ 485 CRC_BATT_HV_VLIMITS 0;
BA_ "GenSigTimeoutTime_APM2" SG_ 485 CRC_BATT_HV_VLIMITS 0;
BA_ "GenSigTimeoutTime_VDCM" SG_ 485 CRC_BATT_HV_VLIMITS 0;
BA_ "GenSigTimeoutTime_HCP" SG_ 485 MessageCounter_BATT_HV_VLIMITS 0;
BA_ "GenSigTimeoutTime_PPIM" SG_ 485 MessageCounter_BATT_HV_VLIMITS 0;
BA_ "GenSigTimeoutTime_APM2" SG_ 485 MessageCounter_BATT_HV_VLIMITS 0;
BA_ "GenSigTimeoutTime_VDCM" SG_ 485 MessageCounter_BATT_HV_VLIMITS 0;
BA_ "GenSigTimeoutTime_HCP" SG_ 288 BPCM_CntctrsMidTrmOpeningWarn 0;
BA_ "GenSigTimeoutTime_PPIM" SG_ 288 BPCM_CntctrsMidTrmOpeningWarn 0;
BA_ "GenSigTimeoutTime_APM2" SG_ 288 BPCM_CntctrsMidTrmOpeningWarn 0;
BA_ "GenSigTimeoutTime_VDCM" SG_ 288 BPCM_CntctrsMidTrmOpeningWarn 0;
BA_ "GenSigTimeoutTime_BPCM" SG_ 288 BPCM_CntctrsMidTrmOpeningWarn 0;
BA_ "GenSigTimeoutTime_IDCM" SG_ 288 BPCM_CntctrsMidTrmOpeningWarn 0;
BA_ "GenSigTimeoutTime_SGW" SG_ 288 BPCM_CntctrsMidTrmOpeningWarn 0;
BA_ "GenSigTimeoutTime_HCP" SG_ 288 BPCM_CntctrsShtTrmOpeningWarn 0;
BA_ "GenSigTimeoutTime_PPIM" SG_ 288 BPCM_CntctrsShtTrmOpeningWarn 0;
BA_ "GenSigTimeoutTime_APM2" SG_ 288 BPCM_CntctrsShtTrmOpeningWarn 0;
BA_ "GenSigTimeoutTime_VDCM" SG_ 288 BPCM_CntctrsShtTrmOpeningWarn 0;
BA_ "GenSigTimeoutTime_IDCM" SG_ 288 BPCM_CntctrsShtTrmOpeningWarn 0;
BA_ "GenSigTimeoutTime_BPCM" SG_ 288 BPCM_CntctrsShtTrmOpeningWarn 0;
BA_ "GenSigTimeoutTime_SGW" SG_ 288 BPCM_CntctrsShtTrmOpeningWarn 0;
BA_ "GenSigTimeoutTime_HCP" SG_ 288 BPCM_HV_Cell_MaxDischrg_Imped 0;
BA_ "GenSigTimeoutTime_PPIM" SG_ 288 BPCM_HV_Cell_MaxDischrg_Imped 0;
BA_ "GenSigTimeoutTime_APM2" SG_ 288 BPCM_HV_Cell_MaxDischrg_Imped 0;
BA_ "GenSigTimeoutTime_VDCM" SG_ 288 BPCM_HV_Cell_MaxDischrg_Imped 0;
BA_ "GenSigTimeoutTime_BPCM" SG_ 288 BPCM_HV_Cell_MaxDischrg_Imped 0;
BA_ "GenSigTimeoutTime_IDCM" SG_ 288 BPCM_HV_Cell_MaxDischrg_Imped 0;
BA_ "GenSigTimeoutTime_SGW" SG_ 288 BPCM_HV_Cell_MaxDischrg_Imped 0;
BA_ "GenSigTimeoutTime_HCP" SG_ 288 BPCM_HV_Cell_MinDischrg_Imped 0;
BA_ "GenSigTimeoutTime_PPIM" SG_ 288 BPCM_HV_Cell_MinDischrg_Imped 0;
BA_ "GenSigTimeoutTime_APM2" SG_ 288 BPCM_HV_Cell_MinDischrg_Imped 0;
BA_ "GenSigTimeoutTime_VDCM" SG_ 288 BPCM_HV_Cell_MinDischrg_Imped 0;
BA_ "GenSigTimeoutTime_BPCM" SG_ 288 BPCM_HV_Cell_MinDischrg_Imped 0;
BA_ "GenSigTimeoutTime_IDCM" SG_ 288 BPCM_HV_Cell_MinDischrg_Imped 0;
BA_ "GenSigTimeoutTime_SGW" SG_ 288 BPCM_HV_Cell_MinDischrg_Imped 0;
BA_ "GenSigTimeoutTime_HCP" SG_ 288 BPCM_HV_ChargingCurrentProfile 0;
BA_ "GenSigTimeoutTime_PPIM" SG_ 288 BPCM_HV_ChargingCurrentProfile 0;
BA_ "GenSigTimeoutTime_APM2" SG_ 288 BPCM_HV_ChargingCurrentProfile 0;
BA_ "GenSigTimeoutTime_VDCM" SG_ 288 BPCM_HV_ChargingCurrentProfile 0;
BA_ "GenSigTimeoutTime_BPCM" SG_ 288 BPCM_HV_ChargingCurrentProfile 0;
BA_ "GenSigTimeoutTime_IDCM" SG_ 288 BPCM_HV_ChargingCurrentProfile 0;
BA_ "GenSigTimeoutTime_SGW" SG_ 288 BPCM_HV_ChargingCurrentProfile 0;
BA_ "GenSigTimeoutTime_HCP" SG_ 288 BPCM_HV_CrntLmtInstChrg 0;
BA_ "GenSigTimeoutTime_PPIM" SG_ 288 BPCM_HV_CrntLmtInstChrg 0;
BA_ "GenSigTimeoutTime_APM2" SG_ 288 BPCM_HV_CrntLmtInstChrg 0;
BA_ "GenSigTimeoutTime_VDCM" SG_ 288 BPCM_HV_CrntLmtInstChrg 0;
BA_ "GenSigTimeoutTime_BPCM" SG_ 288 BPCM_HV_CrntLmtInstChrg 0;
BA_ "GenSigTimeoutTime_IDCM" SG_ 288 BPCM_HV_CrntLmtInstChrg 0;
BA_ "GenSigTimeoutTime_SGW" SG_ 288 BPCM_HV_CrntLmtInstChrg 0;
BA_ "GenSigTimeoutTime_HCP" SG_ 288 BPCM_HV_CrntLmtInstDschg 0;
BA_ "GenSigTimeoutTime_PPIM" SG_ 288 BPCM_HV_CrntLmtInstDschg 0;
BA_ "GenSigTimeoutTime_APM2" SG_ 288 BPCM_HV_CrntLmtInstDschg 0;
BA_ "GenSigTimeoutTime_VDCM" SG_ 288 BPCM_HV_CrntLmtInstDschg 0;
BA_ "GenSigTimeoutTime_BPCM" SG_ 288 BPCM_HV_CrntLmtInstDschg 0;
BA_ "GenSigTimeoutTime_IDCM" SG_ 288 BPCM_HV_CrntLmtInstDschg 0;
BA_ "GenSigTimeoutTime_SGW" SG_ 288 BPCM_HV_CrntLmtInstDschg 0;
BA_ "GenSigTimeoutTime_HCP" SG_ 485 BPCM_OCV_Avg_Cell_Volt 0;
BA_ "GenSigTimeoutTime_PPIM" SG_ 485 BPCM_OCV_Avg_Cell_Volt 0;
BA_ "GenSigTimeoutTime_APM2" SG_ 485 BPCM_OCV_Avg_Cell_Volt 0;
BA_ "GenSigTimeoutTime_VDCM" SG_ 485 BPCM_OCV_Avg_Cell_Volt 0;
BA_ "GenSigTimeoutTime_HCP" SG_ 485 BPCM_OCV_Max_Cell_Volt 0;
BA_ "GenSigTimeoutTime_PPIM" SG_ 485 BPCM_OCV_Max_Cell_Volt 0;
BA_ "GenSigTimeoutTime_APM2" SG_ 485 BPCM_OCV_Max_Cell_Volt 0;
BA_ "GenSigTimeoutTime_VDCM" SG_ 485 BPCM_OCV_Max_Cell_Volt 0;
BA_ "GenSigTimeoutTime_HCP" SG_ 485 BPCM_OCV_Min_Cell_Volt 0;
BA_ "GenSigTimeoutTime_PPIM" SG_ 485 BPCM_OCV_Min_Cell_Volt 0;
BA_ "GenSigTimeoutTime_APM2" SG_ 485 BPCM_OCV_Min_Cell_Volt 0;
BA_ "GenSigTimeoutTime_VDCM" SG_ 485 BPCM_OCV_Min_Cell_Volt 0;
BA_ "GenSigTimeoutTime_HCP" SG_ 485 BPCM_Cell_Volt_Min 0;
BA_ "GenSigTimeoutTime_PPIM" SG_ 485 BPCM_Cell_Volt_Min 0;
BA_ "GenSigTimeoutTime_APM2" SG_ 485 BPCM_Cell_Volt_Min 0;
BA_ "GenSigTimeoutTime_VDCM" SG_ 485 BPCM_Cell_Volt_Min 0;
BA_ "GenSigTimeoutTime_HCP" SG_ 485 BPCM_HV_Insulation_Resistance 0;
BA_ "GenSigTimeoutTime_PPIM" SG_ 485 BPCM_HV_Insulation_Resistance 0;
BA_ "GenSigTimeoutTime_APM2" SG_ 485 BPCM_HV_Insulation_Resistance 0;
BA_ "GenSigTimeoutTime_VDCM" SG_ 485 BPCM_HV_Insulation_Resistance 0;
BA_ "GenSigTimeoutTime_HCP" SG_ 485 BPCM_Max_Cell_Volt_Allowed 0;
BA_ "GenSigTimeoutTime_PPIM" SG_ 485 BPCM_Max_Cell_Volt_Allowed 0;
BA_ "GenSigTimeoutTime_APM2" SG_ 485 BPCM_Max_Cell_Volt_Allowed 0;
BA_ "GenSigTimeoutTime_VDCM" SG_ 485 BPCM_Max_Cell_Volt_Allowed 0;
BA_ "GenSigTimeoutTime_HCP" SG_ 485 BPCM_Min_Cell_Volt_Allowed 0;
BA_ "GenSigTimeoutTime_PPIM" SG_ 485 BPCM_Min_Cell_Volt_Allowed 0;
BA_ "GenSigTimeoutTime_APM2" SG_ 485 BPCM_Min_Cell_Volt_Allowed 0;
BA_ "GenSigTimeoutTime_VDCM" SG_ 485 BPCM_Min_Cell_Volt_Allowed 0;
BA_ "GenSigTimeoutTime_HCP" SG_ 485 BPCM_Cell_Volt_Avg 0;
BA_ "GenSigTimeoutTime_PPIM" SG_ 485 BPCM_Cell_Volt_Avg 0;
BA_ "GenSigTimeoutTime_APM2" SG_ 485 BPCM_Cell_Volt_Avg 0;
BA_ "GenSigTimeoutTime_VDCM" SG_ 485 BPCM_Cell_Volt_Avg 0;
BA_ "GenSigTimeoutTime_HCP" SG_ 485 BPCM_Cell_Volt_Max 0;
BA_ "GenSigTimeoutTime_PPIM" SG_ 485 BPCM_Cell_Volt_Max 0;
BA_ "GenSigTimeoutTime_APM2" SG_ 485 BPCM_Cell_Volt_Max 0;
BA_ "GenSigTimeoutTime_VDCM" SG_ 485 BPCM_Cell_Volt_Max 0;
BA_ "GenSigTimeoutTime_HCP" SG_ 288 BPCM_HV_Power_MaxCharge_LgTrm 0;
BA_ "GenSigTimeoutTime_PPIM" SG_ 288 BPCM_HV_Power_MaxCharge_LgTrm 0;
BA_ "GenSigTimeoutTime_APM2" SG_ 288 BPCM_HV_Power_MaxCharge_LgTrm 0;
BA_ "GenSigTimeoutTime_VDCM" SG_ 288 BPCM_HV_Power_MaxCharge_LgTrm 0;
BA_ "GenSigTimeoutTime_BPCM" SG_ 288 BPCM_HV_Power_MaxCharge_LgTrm 0;
BA_ "GenSigTimeoutTime_IDCM" SG_ 288 BPCM_HV_Power_MaxCharge_LgTrm 0;
BA_ "GenSigTimeoutTime_SGW" SG_ 288 BPCM_HV_Power_MaxCharge_LgTrm 0;
BA_ "GenSigTimeoutTime_HCP" SG_ 288 BPCM_HV_Power_MaxCharge_MdTrm 0;
BA_ "GenSigTimeoutTime_PPIM" SG_ 288 BPCM_HV_Power_MaxCharge_MdTrm 0;
BA_ "GenSigTimeoutTime_APM2" SG_ 288 BPCM_HV_Power_MaxCharge_MdTrm 0;
BA_ "GenSigTimeoutTime_VDCM" SG_ 288 BPCM_HV_Power_MaxCharge_MdTrm 0;
BA_ "GenSigTimeoutTime_BPCM" SG_ 288 BPCM_HV_Power_MaxCharge_MdTrm 0;
BA_ "GenSigTimeoutTime_IDCM" SG_ 288 BPCM_HV_Power_MaxCharge_MdTrm 0;
BA_ "GenSigTimeoutTime_SGW" SG_ 288 BPCM_HV_Power_MaxCharge_MdTrm 0;
BA_ "GenSigTimeoutTime_HCP" SG_ 288 BPCM_HV_Power_MaxCharge_ShrTrm 0;
BA_ "GenSigTimeoutTime_PPIM" SG_ 288 BPCM_HV_Power_MaxCharge_ShrTrm 0;
BA_ "GenSigTimeoutTime_APM2" SG_ 288 BPCM_HV_Power_MaxCharge_ShrTrm 0;
BA_ "GenSigTimeoutTime_VDCM" SG_ 288 BPCM_HV_Power_MaxCharge_ShrTrm 0;
BA_ "GenSigTimeoutTime_BPCM" SG_ 288 BPCM_HV_Power_MaxCharge_ShrTrm 0;
BA_ "GenSigTimeoutTime_IDCM" SG_ 288 BPCM_HV_Power_MaxCharge_ShrTrm 0;
BA_ "GenSigTimeoutTime_SGW" SG_ 288 BPCM_HV_Power_MaxCharge_ShrTrm 0;
BA_ "GenSigTimeoutTime_HCP" SG_ 288 BPCM_HV_Power_MaxDischarge_LgTrm 0;
BA_ "GenSigTimeoutTime_PPIM" SG_ 288 BPCM_HV_Power_MaxDischarge_LgTrm 0;
BA_ "GenSigTimeoutTime_APM2" SG_ 288 BPCM_HV_Power_MaxDischarge_LgTrm 0;
BA_ "GenSigTimeoutTime_VDCM" SG_ 288 BPCM_HV_Power_MaxDischarge_LgTrm 0;
BA_ "GenSigTimeoutTime_BPCM" SG_ 288 BPCM_HV_Power_MaxDischarge_LgTrm 0;
BA_ "GenSigTimeoutTime_IDCM" SG_ 288 BPCM_HV_Power_MaxDischarge_LgTrm 0;
BA_ "GenSigTimeoutTime_SGW" SG_ 288 BPCM_HV_Power_MaxDischarge_LgTrm 0;
BA_ "GenSigTimeoutTime_HCP" SG_ 288 BPCM_HV_Power_MaxDischarge_MdTrm 0;
BA_ "GenSigTimeoutTime_PPIM" SG_ 288 BPCM_HV_Power_MaxDischarge_MdTrm 0;
BA_ "GenSigTimeoutTime_APM2" SG_ 288 BPCM_HV_Power_MaxDischarge_MdTrm 0;
BA_ "GenSigTimeoutTime_VDCM" SG_ 288 BPCM_HV_Power_MaxDischarge_MdTrm 0;
BA_ "GenSigTimeoutTime_BPCM" SG_ 288 BPCM_HV_Power_MaxDischarge_MdTrm 0;
BA_ "GenSigTimeoutTime_IDCM" SG_ 288 BPCM_HV_Power_MaxDischarge_MdTrm 0;
BA_ "GenSigTimeoutTime_SGW" SG_ 288 BPCM_HV_Power_MaxDischarge_MdTrm 0;
BA_ "GenSigTimeoutTime_HCP" SG_ 288 BPCM_HV_Pwr_MaxDischrg_ShrTrm 0;
BA_ "GenSigTimeoutTime_PPIM" SG_ 288 BPCM_HV_Pwr_MaxDischrg_ShrTrm 0;
BA_ "GenSigTimeoutTime_APM2" SG_ 288 BPCM_HV_Pwr_MaxDischrg_ShrTrm 0;
BA_ "GenSigTimeoutTime_VDCM" SG_ 288 BPCM_HV_Pwr_MaxDischrg_ShrTrm 0;
BA_ "GenSigTimeoutTime_BPCM" SG_ 288 BPCM_HV_Pwr_MaxDischrg_ShrTrm 0;
BA_ "GenSigTimeoutTime_IDCM" SG_ 288 BPCM_HV_Pwr_MaxDischrg_ShrTrm 0;
BA_ "GenSigTimeoutTime_SGW" SG_ 288 BPCM_HV_Pwr_MaxDischrg_ShrTrm 0;
BA_ "GenSigTimeoutTime_HCP" SG_ 288 BPCM_HV_PwrLmtInstChrg 0;
BA_ "GenSigTimeoutTime_PPIM" SG_ 288 BPCM_HV_PwrLmtInstChrg 0;
BA_ "GenSigTimeoutTime_APM2" SG_ 288 BPCM_HV_PwrLmtInstChrg 0;
BA_ "GenSigTimeoutTime_VDCM" SG_ 288 BPCM_HV_PwrLmtInstChrg 0;
BA_ "GenSigTimeoutTime_BPCM" SG_ 288 BPCM_HV_PwrLmtInstChrg 0;
BA_ "GenSigTimeoutTime_IDCM" SG_ 288 BPCM_HV_PwrLmtInstChrg 0;
BA_ "GenSigTimeoutTime_SGW" SG_ 288 BPCM_HV_PwrLmtInstChrg 0;
BA_ "GenSigTimeoutTime_HCP" SG_ 288 BPCM_HV_PwrLmtInstDschg 0;
BA_ "GenSigTimeoutTime_PPIM" SG_ 288 BPCM_HV_PwrLmtInstDschg 0;
BA_ "GenSigTimeoutTime_APM2" SG_ 288 BPCM_HV_PwrLmtInstDschg 0;
BA_ "GenSigTimeoutTime_VDCM" SG_ 288 BPCM_HV_PwrLmtInstDschg 0;
BA_ "GenSigTimeoutTime_BPCM" SG_ 288 BPCM_HV_PwrLmtInstDschg 0;
BA_ "GenSigTimeoutTime_IDCM" SG_ 288 BPCM_HV_PwrLmtInstDschg 0;
BA_ "GenSigTimeoutTime_SGW" SG_ 288 BPCM_HV_PwrLmtInstDschg 0;
BA_ "GenSigTimeoutTime_BPCM" SG_ 485 BPCM_Cell_Volt_Max 0;
BA_ "GenSigTimeoutTime_IDCM" SG_ 485 BPCM_Cell_Volt_Max 0;
BA_ "GenSigTimeoutTime_SGW" SG_ 485 BPCM_Cell_Volt_Max 0;
BA_ "GenSigTimeoutTime_BPCM" SG_ 485 BPCM_Cell_Volt_Avg 0;
BA_ "GenSigTimeoutTime_IDCM" SG_ 485 BPCM_Cell_Volt_Avg 0;
BA_ "GenSigTimeoutTime_SGW" SG_ 485 BPCM_Cell_Volt_Avg 0;
BA_ "GenSigTimeoutTime_BPCM" SG_ 485 BPCM_Min_Cell_Volt_Allowed 0;
BA_ "GenSigTimeoutTime_IDCM" SG_ 485 BPCM_Min_Cell_Volt_Allowed 0;
BA_ "GenSigTimeoutTime_SGW" SG_ 485 BPCM_Min_Cell_Volt_Allowed 0;
BA_ "GenSigTimeoutTime_BPCM" SG_ 485 BPCM_Max_Cell_Volt_Allowed 0;
BA_ "GenSigTimeoutTime_IDCM" SG_ 485 BPCM_Max_Cell_Volt_Allowed 0;
BA_ "GenSigTimeoutTime_SGW" SG_ 485 BPCM_Max_Cell_Volt_Allowed 0;
BA_ "GenSigTimeoutTime_BPCM" SG_ 485 BPCM_HV_Insulation_Resistance 0;
BA_ "GenSigTimeoutTime_IDCM" SG_ 485 BPCM_HV_Insulation_Resistance 0;
BA_ "GenSigTimeoutTime_SGW" SG_ 485 BPCM_HV_Insulation_Resistance 0;
BA_ "GenSigTimeoutTime_BPCM" SG_ 485 BPCM_Cell_Volt_Min 0;
BA_ "GenSigTimeoutTime_IDCM" SG_ 485 BPCM_Cell_Volt_Min 0;
BA_ "GenSigTimeoutTime_SGW" SG_ 485 BPCM_Cell_Volt_Min 0;
BA_ "GenSigTimeoutTime_BPCM" SG_ 485 BPCM_OCV_Min_Cell_Volt 0;
BA_ "GenSigTimeoutTime_IDCM" SG_ 485 BPCM_OCV_Min_Cell_Volt 0;
BA_ "GenSigTimeoutTime_SGW" SG_ 485 BPCM_OCV_Min_Cell_Volt 0;
BA_ "GenSigTimeoutTime_BPCM" SG_ 485 BPCM_OCV_Max_Cell_Volt 0;
BA_ "GenSigTimeoutTime_IDCM" SG_ 485 BPCM_OCV_Max_Cell_Volt 0;
BA_ "GenSigTimeoutTime_SGW" SG_ 485 BPCM_OCV_Max_Cell_Volt 0;
BA_ "GenSigTimeoutTime_BPCM" SG_ 485 BPCM_OCV_Avg_Cell_Volt 0;
BA_ "GenSigTimeoutTime_IDCM" SG_ 485 BPCM_OCV_Avg_Cell_Volt 0;
BA_ "GenSigTimeoutTime_SGW" SG_ 485 BPCM_OCV_Avg_Cell_Volt 0;
BA_ "GenSigTimeoutTime_BPCM" SG_ 485 MessageCounter_BATT_HV_VLIMITS 0;
BA_ "GenSigTimeoutTime_IDCM" SG_ 485 MessageCounter_BATT_HV_VLIMITS 0;
BA_ "GenSigTimeoutTime_SGW" SG_ 485 MessageCounter_BATT_HV_VLIMITS 0;
BA_ "GenSigTimeoutTime_BPCM" SG_ 485 CRC_BATT_HV_VLIMITS 0;
BA_ "GenSigTimeoutTime_IDCM" SG_ 485 CRC_BATT_HV_VLIMITS 0;
BA_ "GenSigTimeoutTime_SGW" SG_ 485 CRC_BATT_HV_VLIMITS 0;
BA_ "GenSigTimeoutTime_BPCM" SG_ 485 BPCM_HV_NumCellMinTemp 0;
BA_ "GenSigTimeoutTime_IDCM" SG_ 485 BPCM_HV_NumCellMinTemp 0;
BA_ "GenSigTimeoutTime_SGW" SG_ 485 BPCM_HV_NumCellMinTemp 0;
BA_ "GenSigTimeoutTime_IDCM" SG_ 485 BPCM_HV_NumCellMaxTemp 0;
BA_ "GenSigTimeoutTime_SGW" SG_ 485 BPCM_HV_NumCellMaxTemp 0;
BA_ "GenSigTimeoutTime_BPCM" SG_ 485 BPCM_Min_Pk_Volt_Allowed 0;
BA_ "GenSigTimeoutTime_IDCM" SG_ 485 BPCM_Min_Pk_Volt_Allowed 0;
BA_ "GenSigTimeoutTime_SGW" SG_ 485 BPCM_Min_Pk_Volt_Allowed 0;
BA_ "GenSigTimeoutTime_BPCM" SG_ 485 BPCM_Max_Pk_Volt_Allowed 0;
BA_ "GenSigTimeoutTime_IDCM" SG_ 485 BPCM_Max_Pk_Volt_Allowed 0;
BA_ "GenSigTimeoutTime_SGW" SG_ 485 BPCM_Max_Pk_Volt_Allowed 0;
VAL_ 2654339142 GenericFailSts_FD11_BPCM 0 "No_Fail_Present" 1 "Fail_Present";
VAL_ 2654339142 EOL_FD11_BPCM 0 "No_EOL_Programming" 1 "EOL_Programming";
VAL_ 2654339142 WakeupSource_FD11_BPCM 0 "No_Wakeup";
VAL_ 2654339142 PreviousCanNMState_FD11_BPCM 0 "Uninitialized State" 1 "Bus-Sleep State" 2 "Prepare-Bus State" 3 "Ready-Sleep State" 4 "Normal Operation State" 5 "Repeat Message State" 6 "Synchronize State" 7 "Offline State";
VAL_ 2654339142 DES_FD11_BPCM 0 "Error_Active_state" 1 "Error_passive_warning_state" 2 "Bus_off_state" 3 "Not_used";
VAL_ 2654339142 CurrentCanNMState_FD11_BPCM 0 "Uninitialized State" 1 "Bus-Sleep State" 2 "Prepare-Bus State" 3 "Ready-Sleep State" 4 "Normal Operation State" 5 "Repeat Message State" 6 "Synchronize State" 7 "Offline State";
VAL_ 288 BPCM_HV_CrntLmtInstDschg 32767 "SNA";
VAL_ 288 BPCM_HV_CrntLmtInstChrg 32767 "SNA";
VAL_ 288 BPCM_HV_ChargingCurrentProfile 32767 "SNA";
VAL_ 288 BPCM_HV_Cell_MinDischrg_Imped 8191 "SNA";
VAL_ 288 BPCM_HV_Cell_MaxDischrg_Imped 8191 "SNA";
VAL_ 485 BPCM_HV_NumCellMinTemp 511 "SNA";
VAL_ 485 BPCM_HV_NumCellMaxTemp 511 "SNA";
VAL_ 485 BPCM_HV_NumCellMinVolt 511 "SNA";
VAL_ 485 BPCM_HV_NumCellMaxVolt 511 "SNA";
VAL_ 485 BPCM_Min_Pk_Volt_Allowed 2047 "SNA";
VAL_ 485 BPCM_Max_Pk_Volt_Allowed 2047 "SNA";
VAL_ 288 BPCM_HV_HVBatChargeStat 0 "NOT_READY" 1 "READY" 2 "ERROR_DETECTED" 3 "COMPLETE" 7 "SNA";
VAL_ 485 BPCM_OCV_Min_Cell_Volt 8191 "SNA";
VAL_ 485 BPCM_OCV_Max_Cell_Volt 8191 "SNA";
VAL_ 485 BPCM_OCV_Avg_Cell_Volt 8191 "SNA";
VAL_ 485 BPCM_Min_Cell_Volt_Allowed 8191 "SNA";
VAL_ 485 BPCM_Max_Cell_Volt_Allowed 8191 "SNA";
VAL_ 485 BPCM_Cell_Volt_Min 8191 "SNA";
VAL_ 485 BPCM_Cell_Volt_Max 8191 "SNA";
VAL_ 485 BPCM_Cell_Volt_Avg 8191 "SNA";
VAL_ 288 BPCM_HV_PwrLmtInstDschg 16383 "SNA";
VAL_ 288 BPCM_HV_PwrLmtInstChrg 16383 "SNA";
VAL_ 288 BPCM_HV_Pwr_MaxDischrg_ShrTrm 16383 "SNA";
VAL_ 288 BPCM_HV_Power_MaxDischarge_MdTrm 16383 "SNA";
VAL_ 288 BPCM_HV_Power_MaxDischarge_LgTrm 16383 "SNA";
VAL_ 288 BPCM_HV_Power_MaxCharge_ShrTrm 16383 "SNA";
VAL_ 288 BPCM_HV_Power_MaxCharge_MdTrm 16383 "SNA";
VAL_ 288 BPCM_HV_Power_MaxCharge_LgTrm 16383 "SNA";
VAL_ 288 BPCM_CntctrsShtTrmOpeningWarn 0 "FALSE" 1 "TRUE";
VAL_ 288 BPCM_CntctrsMidTrmOpeningWarn 0 "FALSE" 1 "TRUE";
VAL_ 1965 HVBatCellVoltage_Cell232 8191 "SNA";
VAL_ 1965 HVBatCellVoltage_Cell231 8191 "SNA";
VAL_ 1965 HVBatCellVoltage_Cell230 8191 "SNA";
VAL_ 1965 HVBatCellVoltage_Cell229 8191 "SNA";
VAL_ 1965 HVBatCellVoltage_Cell228 8191 "SNA";
VAL_ 1965 HVBatCellVoltage_Cell227 8191 "SNA";
VAL_ 1965 HVBatCellVoltage_Cell226 8191 "SNA";
VAL_ 1965 HVBatCellVoltage_Cell225 8191 "SNA";
VAL_ 1965 HVBatCellVoltage_Cell224 8191 "SNA";
VAL_ 1965 HVBatCellVoltage_Cell223 8191 "SNA";
VAL_ 1965 HVBatCellVoltage_Cell222 8191 "SNA";
VAL_ 1965 HVBatCellVoltage_Cell221 8191 "SNA";
VAL_ 1965 HVBatCellVoltage_Cell220 8191 "SNA";
VAL_ 1965 HVBatCellVoltage_Cell219 8191 "SNA";
VAL_ 1965 HVBatCellVoltage_Cell218 8191 "SNA";
VAL_ 1965 HVBatCellVoltage_Cell217 8191 "SNA";
VAL_ 1963 HVBatCellVoltage_Cell400 8191 "SNA";
VAL_ 1963 HVBatCellVoltage_Cell399 8191 "SNA";
VAL_ 1963 HVBatCellVoltage_Cell398 8191 "SNA";
VAL_ 1963 HVBatCellVoltage_Cell397 8191 "SNA";
VAL_ 1963 HVBatCellVoltage_Cell396 8191 "SNA";
VAL_ 1963 HVBatCellVoltage_Cell395 8191 "SNA";
VAL_ 1963 HVBatCellVoltage_Cell394 8191 "SNA";
VAL_ 1963 HVBatCellVoltage_Cell393 8191 "SNA";
VAL_ 1962 HVBatCellVoltage_Cell392 8191 "SNA";
VAL_ 1962 HVBatCellVoltage_Cell391 8191 "SNA";
VAL_ 1962 HVBatCellVoltage_Cell390 8191 "SNA";
VAL_ 1962 HVBatCellVoltage_Cell389 8191 "SNA";
VAL_ 1962 HVBatCellVoltage_Cell388 8191 "SNA";
VAL_ 1962 HVBatCellVoltage_Cell387 8191 "SNA";
VAL_ 1962 HVBatCellVoltage_Cell386 8191 "SNA";
VAL_ 1962 HVBatCellVoltage_Cell385 8191 "SNA";
VAL_ 1962 HVBatCellVoltage_Cell384 8191 "SNA";
VAL_ 1962 HVBatCellVoltage_Cell383 8191 "SNA";
VAL_ 1962 HVBatCellVoltage_Cell382 8191 "SNA";
VAL_ 1962 HVBatCellVoltage_Cell381 8191 "SNA";
VAL_ 1962 HVBatCellVoltage_Cell380 8191 "SNA";
VAL_ 1962 HVBatCellVoltage_Cell379 8191 "SNA";
VAL_ 1962 HVBatCellVoltage_Cell378 8191 "SNA";
VAL_ 1962 HVBatCellVoltage_Cell377 8191 "SNA";
VAL_ 1962 HVBatCellVoltage_Cell376 8191 "SNA";
VAL_ 1962 HVBatCellVoltage_Cell375 8191 "SNA";
VAL_ 1962 HVBatCellVoltage_Cell374 8191 "SNA";
VAL_ 1962 HVBatCellVoltage_Cell373 8191 "SNA";
VAL_ 1962 HVBatCellVoltage_Cell372 8191 "SNA";
VAL_ 1962 HVBatCellVoltage_Cell371 8191 "SNA";
VAL_ 1962 HVBatCellVoltage_Cell370 8191 "SNA";
VAL_ 1962 HVBatCellVoltage_Cell369 8191 "SNA";
VAL_ 1962 HVBatCellVoltage_Cell368 8191 "SNA";
VAL_ 1962 HVBatCellVoltage_Cell367 8191 "SNA";
VAL_ 1962 HVBatCellVoltage_Cell366 8191 "SNA";
VAL_ 1962 HVBatCellVoltage_Cell365 8191 "SNA";
VAL_ 1962 HVBatCellVoltage_Cell364 8191 "SNA";
VAL_ 1962 HVBatCellVoltage_Cell363 8191 "SNA";
VAL_ 1962 HVBatCellVoltage_Cell362 8191 "SNA";
VAL_ 1962 HVBatCellVoltage_Cell361 8191 "SNA";
VAL_ 1961 HVBatCellVoltage_Cell360 8191 "SNA";
VAL_ 1961 HVBatCellVoltage_Cell359 8191 "SNA";
VAL_ 1961 HVBatCellVoltage_Cell358 8191 "SNA";
VAL_ 1961 HVBatCellVoltage_Cell357 8191 "SNA";
VAL_ 1961 HVBatCellVoltage_Cell356 8191 "SNA";
VAL_ 1961 HVBatCellVoltage_Cell355 8191 "SNA";
VAL_ 1961 HVBatCellVoltage_Cell354 8191 "SNA";
VAL_ 1961 HVBatCellVoltage_Cell353 8191 "SNA";
VAL_ 1961 HVBatCellVoltage_Cell352 8191 "SNA";
VAL_ 1961 HVBatCellVoltage_Cell351 8191 "SNA";
VAL_ 1961 HVBatCellVoltage_Cell350 8191 "SNA";
VAL_ 1961 HVBatCellVoltage_Cell349 8191 "SNA";
VAL_ 1961 HVBatCellVoltage_Cell348 8191 "SNA";
VAL_ 1961 HVBatCellVoltage_Cell347 8191 "SNA";
VAL_ 1961 HVBatCellVoltage_Cell346 8191 "SNA";
VAL_ 1961 HVBatCellVoltage_Cell345 8191 "SNA";
VAL_ 1961 HVBatCellVoltage_Cell344 8191 "SNA";
VAL_ 1961 HVBatCellVoltage_Cell343 8191 "SNA";
VAL_ 1961 HVBatCellVoltage_Cell342 8191 "SNA";
VAL_ 1961 HVBatCellVoltage_Cell341 8191 "SNA";
VAL_ 1961 HVBatCellVoltage_Cell340 8191 "SNA";
VAL_ 1961 HVBatCellVoltage_Cell339 8191 "SNA";
VAL_ 1961 HVBatCellVoltage_Cell338 8191 "SNA";
VAL_ 1961 HVBatCellVoltage_Cell337 8191 "SNA";
VAL_ 1961 HVBatCellVoltage_Cell336 8191 "SNA";
VAL_ 1961 HVBatCellVoltage_Cell335 8191 "SNA";
VAL_ 1961 HVBatCellVoltage_Cell334 8191 "SNA";
VAL_ 1961 HVBatCellVoltage_Cell333 8191 "SNA";
VAL_ 1961 HVBatCellVoltage_Cell332 8191 "SNA";
VAL_ 1961 HVBatCellVoltage_Cell331 8191 "SNA";
VAL_ 1961 HVBatCellVoltage_Cell330 8191 "SNA";
VAL_ 1961 HVBatCellVoltage_Cell329 8191 "SNA";
VAL_ 1960 HVBatCellVoltage_Cell328 8191 "SNA";
VAL_ 1960 HVBatCellVoltage_Cell327 8191 "SNA";
VAL_ 1960 HVBatCellVoltage_Cell326 8191 "SNA";
VAL_ 1960 HVBatCellVoltage_Cell325 8191 "SNA";
VAL_ 1960 HVBatCellVoltage_Cell324 8191 "SNA";
VAL_ 1960 HVBatCellVoltage_Cell323 8191 "SNA";
VAL_ 1960 HVBatCellVoltage_Cell322 8191 "SNA";
VAL_ 1960 HVBatCellVoltage_Cell321 8191 "SNA";
VAL_ 1960 HVBatCellVoltage_Cell320 8191 "SNA";
VAL_ 1960 HVBatCellVoltage_Cell319 8191 "SNA";
VAL_ 1960 HVBatCellVoltage_Cell318 8191 "SNA";
VAL_ 1960 HVBatCellVoltage_Cell317 8191 "SNA";
VAL_ 1960 HVBatCellVoltage_Cell316 8191 "SNA";
VAL_ 1960 HVBatCellVoltage_Cell315 8191 "SNA";
VAL_ 1960 HVBatCellVoltage_Cell314 8191 "SNA";
VAL_ 1960 HVBatCellVoltage_Cell313 8191 "SNA";
VAL_ 1960 HVBatCellVoltage_Cell312 8191 "SNA";
VAL_ 1960 HVBatCellVoltage_Cell311 8191 "SNA";
VAL_ 1960 HVBatCellVoltage_Cell310 8191 "SNA";
VAL_ 1960 HVBatCellVoltage_Cell309 8191 "SNA";
VAL_ 1960 HVBatCellVoltage_Cell308 8191 "SNA";
VAL_ 1960 HVBatCellVoltage_Cell307 8191 "SNA";
VAL_ 1960 HVBatCellVoltage_Cell306 8191 "SNA";
VAL_ 1960 HVBatCellVoltage_Cell305 8191 "SNA";
VAL_ 1960 HVBatCellVoltage_Cell304 8191 "SNA";
VAL_ 1960 HVBatCellVoltage_Cell303 8191 "SNA";
VAL_ 1960 HVBatCellVoltage_Cell302 8191 "SNA";
VAL_ 1960 HVBatCellVoltage_Cell301 8191 "SNA";
VAL_ 1960 HVBatCellVoltage_Cell300 8191 "SNA";
VAL_ 1960 HVBatCellVoltage_Cell299 8191 "SNA";
VAL_ 1960 HVBatCellVoltage_Cell298 8191 "SNA";
VAL_ 1960 HVBatCellVoltage_Cell297 8191 "SNA";
VAL_ 1959 HVBatCellVoltage_Cell296 8191 "SNA";
VAL_ 1959 HVBatCellVoltage_Cell295 8191 "SNA";
VAL_ 1959 HVBatCellVoltage_Cell294 8191 "SNA";
VAL_ 1959 HVBatCellVoltage_Cell293 8191 "SNA";
VAL_ 1959 HVBatCellVoltage_Cell292 8191 "SNA";
VAL_ 1959 HVBatCellVoltage_Cell291 8191 "SNA";
VAL_ 1959 HVBatCellVoltage_Cell290 8191 "SNA";
VAL_ 1959 HVBatCellVoltage_Cell289 8191 "SNA";
VAL_ 1959 HVBatCellVoltage_Cell288 8191 "SNA";
VAL_ 1959 HVBatCellVoltage_Cell287 8191 "SNA";
VAL_ 1959 HVBatCellVoltage_Cell286 8191 "SNA";
VAL_ 1959 HVBatCellVoltage_Cell285 8191 "SNA";
VAL_ 1959 HVBatCellVoltage_Cell284 8191 "SNA";
VAL_ 1959 HVBatCellVoltage_Cell283 8191 "SNA";
VAL_ 1959 HVBatCellVoltage_Cell282 8191 "SNA";
VAL_ 1959 HVBatCellVoltage_Cell281 8191 "SNA";
VAL_ 1959 HVBatCellVoltage_Cell280 8191 "SNA";
VAL_ 1959 HVBatCellVoltage_Cell279 8191 "SNA";
VAL_ 1959 HVBatCellVoltage_Cell278 8191 "SNA";
VAL_ 1959 HVBatCellVoltage_Cell277 8191 "SNA";
VAL_ 1959 HVBatCellVoltage_Cell276 8191 "SNA";
VAL_ 1959 HVBatCellVoltage_Cell275 8191 "SNA";
VAL_ 1959 HVBatCellVoltage_Cell274 8191 "SNA";
VAL_ 1959 HVBatCellVoltage_Cell273 8191 "SNA";
VAL_ 1959 HVBatCellVoltage_Cell272 8191 "SNA";
VAL_ 1959 HVBatCellVoltage_Cell271 8191 "SNA";
VAL_ 1959 HVBatCellVoltage_Cell270 8191 "SNA";
VAL_ 1959 HVBatCellVoltage_Cell269 8191 "SNA";
VAL_ 1959 HVBatCellVoltage_Cell268 8191 "SNA";
VAL_ 1959 HVBatCellVoltage_Cell267 8191 "SNA";
VAL_ 1959 HVBatCellVoltage_Cell266 8191 "SNA";
VAL_ 1959 HVBatCellVoltage_Cell265 8191 "SNA";
VAL_ 1958 HVBatCellVoltage_Cell264 8191 "SNA";
VAL_ 1958 HVBatCellVoltage_Cell263 8191 "SNA";
VAL_ 1958 HVBatCellVoltage_Cell262 8191 "SNA";
VAL_ 1958 HVBatCellVoltage_Cell261 8191 "SNA";
VAL_ 1958 HVBatCellVoltage_Cell260 8191 "SNA";
VAL_ 1958 HVBatCellVoltage_Cell259 8191 "SNA";
VAL_ 1958 HVBatCellVoltage_Cell258 8191 "SNA";
VAL_ 1958 HVBatCellVoltage_Cell257 8191 "SNA";
VAL_ 1958 HVBatCellVoltage_Cell256 8191 "SNA";
VAL_ 1958 HVBatCellVoltage_Cell255 8191 "SNA";
VAL_ 1958 HVBatCellVoltage_Cell254 8191 "SNA";
VAL_ 1958 HVBatCellVoltage_Cell253 8191 "SNA";
VAL_ 1958 HVBatCellVoltage_Cell252 8191 "SNA";
VAL_ 1958 HVBatCellVoltage_Cell251 8191 "SNA";
VAL_ 1958 HVBatCellVoltage_Cell250 8191 "SNA";
VAL_ 1958 HVBatCellVoltage_Cell249 8191 "SNA";
VAL_ 1958 HVBatCellVoltage_Cell248 8191 "SNA";
VAL_ 1958 HVBatCellVoltage_Cell247 8191 "SNA";
VAL_ 1958 HVBatCellVoltage_Cell246 8191 "SNA";
VAL_ 1958 HVBatCellVoltage_Cell245 8191 "SNA";
VAL_ 1958 HVBatCellVoltage_Cell244 8191 "SNA";
VAL_ 1958 HVBatCellVoltage_Cell243 8191 "SNA";
VAL_ 1958 HVBatCellVoltage_Cell242 8191 "SNA";
VAL_ 1958 HVBatCellVoltage_Cell241 8191 "SNA";
VAL_ 1958 HVBatCellVoltage_Cell240 8191 "SNA";
VAL_ 1958 HVBatCellVoltage_Cell239 8191 "SNA";
VAL_ 1958 HVBatCellVoltage_Cell238 8191 "SNA";
VAL_ 1958 HVBatCellVoltage_Cell237 8191 "SNA";
VAL_ 1958 HVBatCellVoltage_Cell236 8191 "SNA";
VAL_ 1958 HVBatCellVoltage_Cell235 8191 "SNA";
VAL_ 1958 HVBatCellVoltage_Cell234 8191 "SNA";
VAL_ 1958 HVBatCellVoltage_Cell233 8191 "SNA";
VAL_ 2654339136 WakeupSource_FD03_EVCU2 0 "No_Wakeup";
VAL_ 2654339136 PreviousCanNMState_FD03_EVCU2 0 "Uninitialized State" 1 "Bus-Sleep State" 2 "Prepare-Bus State" 3 "Ready-Sleep State" 4 "Normal Operation State" 5 "Repeat Message State" 6 "Synchronize State" 7 "Offline State";
VAL_ 2654339136 GenericFailSts_FD03_EVCU2 0 "No_Fail_Present" 1 "Fail_Present";
VAL_ 2654339136 EOL_FD03_EVCU2 0 "No_EOL_Programming" 1 "EOL_Programming";
VAL_ 2654339136 DES_FD03_EVCU2 0 "Error_Active_state" 1 "Error_passive_warning_state" 2 "Bus_off_state" 3 "Not_used";
VAL_ 2654339136 CurrentFailSts_FD03_EVCU2 0 "No_Fail_Present" 1 "Fail_Present";
VAL_ 2654339136 CurrentCanNMState_FD03_EVCU2 0 "Uninitialized State" 1 "Bus-Sleep State" 2 "Prepare-Bus State" 3 "Ready-Sleep State" 4 "Normal Operation State" 5 "Repeat Message State" 6 "Synchronize State" 7 "Offline State";
VAL_ 2654339142 CurrentFailSts_FD11_BPCM 0 "No_Fail_Present" 1 "Fail_Present";
VAL_ 2654339136 WakeupSource_FD16_EVCU2 0 "No_Wakeup";
VAL_ 2654339136 WakeupSource_FD05_EVCU2 0 "No_Wakeup";
VAL_ 2654339136 PreviousCanNMState_FD16_EVCU2 0 "Uninitialized State" 1 "Bus-Sleep State" 2 "Prepare-Bus State" 3 "Ready-Sleep State" 4 "Normal Operation State" 5 "Repeat Message State" 6 "Synchronize State" 7 "Offline State";
VAL_ 2654339136 PreviousCanNMState_FD05_EVCU2 0 "Uninitialized State" 1 "Bus-Sleep State" 2 "Prepare-Bus State" 3 "Ready-Sleep State" 4 "Normal Operation State" 5 "Repeat Message State" 6 "Synchronize State" 7 "Offline State";
VAL_ 2654339136 GenericFailSts_FD16_EVCU2 0 "No_Fail_Present" 1 "Fail_Present";
VAL_ 2654339136 GenericFailSts_FD05_EVCU2 0 "No_Fail_Present" 1 "Fail_Present";
VAL_ 2654339136 EOL_FD16_EVCU2 0 "No_EOL_Programming" 1 "EOL_Programming";
VAL_ 2654339136 EOL_FD05_EVCU2 0 "No_EOL_Programming" 1 "EOL_Programming";
VAL_ 2654339136 DES_FD16_EVCU2 0 "Error_Active_state" 1 "Error_passive_warning_state" 2 "Bus_off_state" 3 "Not_used";
VAL_ 2654339136 WakeupSource_FD11_EVCU2 0 "None" 1 "Ignition_Active" 2 "CmdIgnSts_LK_to_ACC_RUN_START" 3 "HazardSwitch_ON" 4 "DrvDoorAjar" 5 "DrvDoor2Ajar" 6 "PsngrDoorAjar" 7 "LR_DoorAjar" 8 "RR_DoorAjar" 9 "TrunkAjar" 10 "BonnetAjar" 11 "RAPHandle_Req" 12 "MainLightSelector_Req_OFF" 13 "HiBmLvr_Stat_HIBM_FLASH_ON_PSD" 14 "LowBeamSts_SET" 15 "ParkingLightSts_SET" 16 "FlashToPass_SET" 17 "RemStActvSts_Active" 18 "Fuel_Door_Release_Switch" 19 "ENGINE_FD_8_RefuelEvent_Pending" 20 "OHC_1_Front_Int_LG_Sw_1" 21 "HFRM_1_RearKick" 22 "LeakCheckTimerExpired" 23 "Horn_Req_Not Pressed_to_Pressed" 24 "Comfort_Enable_Time_not_0" 25 "CmdIgnSts_ACC_RUN_START" 26 "ENGINE_FD_8_LeakTestSts_1" 27 "Non_Default_Diagnostic_Session" 28 "RL_Lk_Sw_LK_RQ_or_UNLK_RQ" 29 "RR_Lk_Sw_LK_RQ_or_UNLK_RQ" 30 "FD-CAN1" 31 "FD-CAN2" 32 "FD-CAN3" 33 "FD-CAN4" 34 "BH-CAN" 35 "C-CAN1" 36 "EVAP_SWC" 37 "FUEL_DR_REL_SWC" 38 "Other_Software_Factory_Component" 39 "OHC_1_Front_Map_LGT_RT_Sw" 40 "OHC_1_Front_Map_LGT_LT_Sw" 41 "Fog_Lights_Signal " 42 "DOME_ON_OR_DOME_DEFEAT " 43 "Screen_Open_Close_is_pressed" 44 "Diagnostic_Message_Routing_DMR" 45 "Reserved" 46 "Reserved" 47 "Reserved" 48 "Reserved" 49 "Reserved" 50 "Reserved" 51 "Reserved" 52 "Reserved" 53 "Reserved" 54 "Reserved" 55 "Reserved" 56 "Reserved" 57 "Reserved" 58 "Reserved" 59 "Reserved" 60 "Reserved" 61 "Reserved" 62 "Reserved" 63 "Reserved" 64 "Reserved" 65 "Reserved" 66 "Reserved" 67 "Reserved" 68 "Reserved" 69 "Reserved" 70 "Reserved" 71 "Reserved" 72 "Reserved" 73 "Reserved" 74 "Reserved" 75 "Reserved" 76 "Reserved" 77 "Reserved" 78 "Reserved" 79 "Reserved" 80 "Reserved" 81 "Reserved" 82 "Reserved" 83 "Reserved" 84 "Reserved" 85 "Reserved" 86 "Reserved" 87 "Reserved" 88 "Reserved" 89 "Reserved" 90 "Reserved" 91 "Reserved" 92 "Reserved" 93 "Reserved" 94 "Reserved" 95 "Reserved" 96 "Reserved" 97 "Reserved" 98 "Reserved" 99 "Reserved" 100 "Reserved" 101 "Reserved" 102 "Reserved" 103 "Reserved" 104 "Reserved" 105 "Reserved" 106 "Reserved" 107 "Reserved" 108 "Reserved" 109 "Reserved" 110 "Reserved" 111 "Reserved" 112 "Reserved" 113 "Reserved" 114 "Reserved" 115 "Reserved" 116 "Reserved" 117 "Reserved" 118 "Reserved" 119 "Reserved" 120 "Reserved" 121 "Reserved" 122 "Reserved" 123 "Reserved" 124 "Reserved" 125 "Reserved" 126 "Reserved" 127 "Reserved" 128 "Reserved" 129 "FD_CAN1" 130 "FD_CAN2" 131 "FD_CAN3" 132 "FD_CAN4" 133 "FD_CAN5" 134 "FD_CAN6" 135 "FD_CAN7" 136 "FD_CAN8" 137 "FD_CAN9" 138 "FD_CAN10" 139 "FD_CAN11" 140 "FD_CAN12" 141 "FD_CAN13" 142 "FD_CAN14" 143 "FD_CAN15" 144 "FD_CAN16" 145 "FD_CAN17" 146 "FD_CAN18" 147 "FD_CAN19" 148 "FD_CAN20" 149 "FD_CAN21" 150 "FD_CAN22" 151 "FD_CAN23" 152 "FD_CAN24" 153 "FD_CAN25" 154 "FD_CAN26" 155 "FD_CAN27" 156 "FD_CAN28" 157 "FD_CAN29" 158 "FD_CAN30" 159 "FD_CAN31" 160 "BH-CAN" 161 "BH-CAN1" 162 "BH-CAN2" 163 "C-CAN" 164 "C-CAN1" 165 "Reserved" 166 "Reserved" 167 "Reserved" 168 "Reserved" 169 "Reserved" 170 "Reserved" 171 "Reserved" 172 "Reserved" 173 "Reserved" 174 "Reserved" 175 "Reserved" 176 "Reserved" 177 "Reserved" 178 "Reserved" 179 "Reserved" 180 "Reserved" 181 "Reserved" 182 "Reserved" 183 "Reserved" 184 "Reserved" 185 "Reserved" 186 "Reserved" 187 "Reserved" 188 "Reserved" 189 "Reserved" 190 "Reserved" 191 "Reserved" 192 "Reserved" 193 "Reserved" 194 "Reserved" 195 "Reserved" 196 "Reserved" 197 "Reserved" 198 "Reserved" 199 "Reserved" 200 "Reserved" 201 "Reserved" 202 "Reserved" 203 "Reserved" 204 "Reserved" 205 "Reserved" 206 "Reserved" 207 "Reserved" 208 "Reserved" 209 "Reserved" 210 "Reserved" 211 "Reserved" 212 "Reserved" 213 "Reserved" 214 "Reserved" 215 "Reserved" 216 "Reserved" 217 "Reserved" 218 "Reserved" 219 "Reserved" 220 "Reserved" 221 "Reserved" 222 "Reserved" 223 "Reserved" 224 "Reserved" 225 "Reserved" 226 "Reserved" 227 "Reserved" 228 "Reserved" 229 "Reserved" 230 "Reserved" 231 "Reserved" 232 "Reserved" 233 "Reserved" 234 "Reserved" 235 "Reserved" 236 "Reserved" 237 "Reserved" 238 "Reserved" 239 "Reserved" 240 "Reserved" 241 "Reserved" 242 "Reserved" 243 "Reserved" 244 "Reserved" 245 "Reserved" 246 "Reserved" 247 "Reserved" 248 "Reserved" 249 "Reserved" 250 "Reserved" 251 "Reserved" 252 "Reserved" 253 "Reserved" 254 "Reserved" 255 "Reserved";
VAL_ 2654339136 PreviousCanNMState_FD11_EVCU2 0 "Uninitialized State" 1 "Bus-Sleep State" 2 "Prepare-Bus State" 3 "Ready-Sleep State" 4 "Normal Operation State" 5 "Repeat Message State" 6 "Synchronize State" 7 "Offline State";
VAL_ 2654339136 GenericFailSts_FD11_EVCU2 0 "No_Fail_Present" 1 "Fail_Present";
VAL_ 2654339136 EOL_FD11_EVCU2 0 "No_EOL_Programming" 1 "EOL_Programming";
VAL_ 2654339136 DES_FD11_EVCU2 0 "Error_Active_state" 1 "Error_passive_warning_state" 2 "Bus_off_state" 3 "Not_used";
VAL_ 2654339136 CurrentFailSts_FD11_EVCU2 0 "No_Fail_Present" 1 "Fail_Present";
VAL_ 2654339136 CurrentCanNMState_FD11_EVCU2 0 "Uninitialized State" 1 "Bus-Sleep State" 2 "Prepare-Bus State" 3 "Ready-Sleep State" 4 "Normal Operation State" 5 "Repeat Message State" 6 "Synchronize State" 7 "Offline State";
VAL_ 2654339136 DES_FD05_EVCU2 0 "Error_Active_state" 1 "Error_passive_warning_state" 2 "Bus_off_state" 3 "Not_used";
VAL_ 2654339136 CurrentFailSts_FD16_EVCU2 0 "No_Fail_Present" 1 "Fail_Present";
VAL_ 2654339136 CurrentFailSts_FD05_EVCU2 0 "No_Fail_Present" 1 "Fail_Present";
VAL_ 2654339136 CurrentCanNMState_FD16_EVCU2 0 "Uninitialized State" 1 "Bus-Sleep State" 2 "Prepare-Bus State" 3 "Ready-Sleep State" 4 "Normal Operation State" 5 "Repeat Message State" 6 "Synchronize State" 7 "Offline State";
VAL_ 2654339136 CurrentCanNMState_FD05_EVCU2 0 "Uninitialized State" 1 "Bus-Sleep State" 2 "Prepare-Bus State" 3 "Ready-Sleep State" 4 "Normal Operation State" 5 "Repeat Message State" 6 "Synchronize State" 7 "Offline State";
VAL_ 2654339142 WakeupSource_FD05_BPCM 0 "No_Wakeup";
VAL_ 2654339142 PreviousCanNMState_FD05_BPCM 0 "Uninitialized State" 1 "Bus-Sleep State" 2 "Prepare-Bus State" 3 "Ready-Sleep State" 4 "Normal Operation State" 5 "Repeat Message State" 6 "Synchronize State" 7 "Offline State";
VAL_ 2654339142 GenericFailSts_FD05_BPCM 0 "No_Fail_Present" 1 "Fail_Present";
VAL_ 2654339142 EOL_FD05_BPCM 0 "No_EOL_Programming" 1 "EOL_Programming";
VAL_ 2654339142 DES_FD05_BPCM 0 "Error_Active_state" 1 "Error_passive_warning_state" 2 "Bus_off_state" 3 "Not_used";
VAL_ 2654339142 CurrentFailSts_FD05_BPCM 0 "No_Fail_Present" 1 "Fail_Present";
VAL_ 2654339142 CurrentCanNMState_FD05_BPCM 0 "Uninitialized State" 1 "Bus-Sleep State" 2 "Prepare-Bus State" 3 "Ready-Sleep State" 4 "Normal Operation State" 5 "Repeat Message State" 6 "Synchronize State" 7 "Offline State";
VAL_ 2654339142 StayActiveSource_FD11_BPCM 0 "CANNM_Ready_Sleep" 1 "IGN_ON" 2 "NonDefault_Diag" 4 "ING_OFF_NormSt_RptSt" 8 "HV_ON" 1073741824 "SASource_Not_Listed";
SIG_GROUP_ 485 BATTERY_HV_VLIMITS_Pkt 1 : BPCM_Max_Pk_Volt_Allowed BPCM_Min_Pk_Volt_Allowed BPCM_HV_NumCellMaxVolt BPCM_HV_NumCellMinVolt BPCM_HV_NumCellMaxTemp BPCM_HV_NumCellMinTemp CRC_BATT_HV_VLIMITS MessageCounter_BATT_HV_VLIMITS BPCM_Cell_Volt_Avg BPCM_Cell_Volt_Max BPCM_Cell_Volt_Min BPCM_HV_Insulation_Resistance BPCM_Max_Cell_Volt_Allowed BPCM_Min_Cell_Volt_Allowed BPCM_OCV_Avg_Cell_Volt BPCM_OCV_Max_Cell_Volt BPCM_OCV_Min_Cell_Volt;
SIG_GROUP_ 288 BATTERY_HV_POWERLIMITS_Pkt 1 : BPCM_HV_HVBatChargeStat BPCM_HV_PwrLmtInstDschg BPCM_HV_PwrLmtInstChrg BPCM_HV_Pwr_MaxDischrg_ShrTrm BPCM_HV_Power_MaxDischarge_MdTrm BPCM_HV_Power_MaxDischarge_LgTrm BPCM_HV_Power_MaxCharge_ShrTrm BPCM_HV_Power_MaxCharge_MdTrm BPCM_HV_Power_MaxCharge_LgTrm BPCM_HV_CrntLmtInstDschg BPCM_HV_CrntLmtInstChrg BPCM_HV_ChargingCurrentProfile BPCM_HV_Cell_MinDischrg_Imped BPCM_HV_Cell_MaxDischrg_Imped BPCM_CntctrsShtTrmOpeningWarn BPCM_CntctrsMidTrmOpeningWarn MessageCounter_BATT_HV_POWERLIMS CRC_BATT_HV_POWERLIMS;

VERSION ""

NS_ :

BS_:

BU_: PPIM HCP VDCM APM2 SGW IDCM EVCU2 BPCM

BO_ 546 VDCM_OBCM2: 64 EVCU2
 SG_ VDCM_MaxChrgTime_sec : 47|8@0+ (10,0) [0|2550] "sec"  IDCM
 SG_ VDCM_MaxChrgTime_min : 39|8@0+ (1,0) [0|255] "min"  IDCM
 SG_ VDCM_EV_Batt_Max_T_Limit : 23|8@0+ (1,0) [0|255] "°C"  IDCM
 SG_ VDCM_EstChrgTime_min : 31|8@0+ (1,0) [0|255] "min"  IDCM
 SG_ VDCM_ChrgMode_Req : 15|8@0+ (1,0) [0|255] "" IDCM
 SG_ VDCM_ChrgCurrDeviationErr : 48|1@0+ (1,0) [0|1] "" IDCM
 SG_ VDCM_ChrgCompleteReason : 63|3@0+ (1,0) [0|7] "" IDCM
 SG_ VDCM_BattUnderVolt : 51|1@0+ (1,0) [0|1] "" IDCM
 SG_ VDCM_BattOverVolt : 52|1@0+ (1,0) [0|1] "" IDCM
 SG_ VDCM_BattFullSOC_prc : 7|8@0+ (1,0) [0|255] "%"  IDCM
 SG_ CPIM_Over_Temperature : 54|1@0+ (1,0) [0|1] "" IDCM
 SG_ CPIM_Error : 55|1@0+ (1,0) [0|1] "" IDCM
 SG_ WeldCheck_Complete : 258|1@0+ (1,0) [0|1] "" IDCM
 SG_ VDCM_SOCIsOOR : 273|2@0+ (1,0) [0|3] "" IDCM
 SG_ VDCM_ChargeCurrIsOOR : 287|2@0+ (1,0) [0|3] "" IDCM
 SG_ VDCM_CellVoltIsOOR : 275|2@0+ (1,0) [0|3] "" IDCM
 SG_ VDCM_BattTempIsOOR : 285|2@0+ (1,0) [0|3] "" IDCM
 SG_ ReadyToChargeState : 259|1@0+ (1,0) [0|1] "" IDCM
 SG_ HCP_SessionStopCmd : 260|1@0+ (1,0) [0|1] "" IDCM
 SG_ HCP_DC_Retry : 249|5@0+ (1,0) [0|31] "" IDCM
 SG_ DCChrg_BatSideCurrent_VDCM : 237|10@0+ (1,-50) [-50|973] "A"  APM2,IDCM
 SG_ BMS_Max_Pk_Volt_Allowed_VDCM : 196|10@0+ (1,0) [0|1022] "V"  IDCM
 SG_ BMS_Max_Cell_Volt_Allowed_Vldty : 98|1@0+ (1,0) [0|1] "" IDCM
 SG_ BMS_Max_Cell_Volt_Allowed_VDCM : 95|13@0+ (0.001,0) [0|8.19] "V"  IDCM
 SG_ BMS_HV_Trac_PreCha_Contac_Sts_V : 176|3@0+ (1,0) [0|7] "" IDCM,BPCM
 SG_ BMS_HV_Trac_Main_Contac_Sts_VDCM : 189|3@0+ (1,0) [0|7] "" IDCM,BPCM
 SG_ BMS_HV_Temperature_Min_VDCM : 118|11@0+ (0.1,-40) [-40|164.6] "°C"  IDCM
 SG_ BMS_HV_Temperature_Max_VDCM : 97|11@0+ (0.1,-40) [-40|164.6] "°C"  IDCM
 SG_ BMS_HV_SOC_AccuracySts_VDCM : 161|2@0+ (1,0) [0|2] "-"  IDCM
 SG_ BMS_HV_NumCellMinTemp_VDCM : 123|9@0+ (1,0) [0|510] "" IDCM
 SG_ BMS_HV_NumCellMaxVolt_VDCM : 130|8@0+ (1,0) [0|255] "" IDCM
 SG_ BMS_HV_NumCellMaxTemp_VDCM : 172|9@0+ (1,0) [0|510] "" IDCM
 SG_ BMS_HV_Low_Temp_Thrsh_VDCM : 159|11@0+ (0.1,-40) [-40|164.7] "°C"  IDCM
 SG_ BMS_HV_InternalVoltage_VDCM : 213|13@0+ (0.1,90.9) [90.9|910] "V"  APM2,IDCM,BPCM
 SG_ BMS_HV_High_Temp_Thrsh_VDCM : 138|11@0+ (0.1,-40) [-40|164.7] "°C"  IDCM
 SG_ BMS_HV_Common_Contactor_Sts_VDCM : 164|3@0+ (1,0) [0|6] "" IDCM,BPCM
 SG_ BMS_HV_Battery_GFD_Sts_VDCM : 179|3@0+ (1,0) [0|7] "" IDCM,BPCM
 SG_ BMS_HV_BatIntrlk_InternalStat_V : 175|3@0+ (1,0) [0|7] "" IDCM,BPCM
 SG_ BMS_HV_AC_Char_Main_Contac_Sts_ : 200|3@0+ (1,0) [0|7] "" IDCM,BPCM
 SG_ BMS_Cell_Volt_Min_Vldty_VDCM : 80|1@0+ (1,0) [0|1] "" IDCM
 SG_ BMS_Cell_Volt_Min_VDCM : 77|13@0+ (0.001,0) [0|8.19] "V"  IDCM
 SG_ BMS_Cell_Volt_Max_Vldty_VDCM : 78|1@0+ (1,0) [0|1] "" IDCM
 SG_ BMS_Cell_Volt_Max_VDCM : 59|13@0+ (0.001,0) [0|8.19] "V"  IDCM
 SG_ AC_Chrg_Branch_Voltage_VDCM : 243|10@0+ (1,0) [0|1023] "V"  IDCM
 SG_ BMS_HV_Char_PreCha_Contac_Sts_V : 199|3@0+ (1,0) [0|7] "" APM2,IDCM,BPCM
 SG_ BMS_HV_Char_Main_Contac_Sts_VDCM : 186|3@0+ (1,0) [0|7] "" APM2,IDCM,BPCM
 SG_ BMS_HV_TractionBusVoltage_VDCM : 311|10@0+ (1,0) [0|1023] "V"  IDCM,BPCM
 SG_ BMS_HV_Trac_Bus_Sts_VDCM : 283|3@0+ (1,0) [0|7] "" IDCM,BPCM
 SG_ BMS_HV_ChargingBusVoltage_VDCM : 289|10@0+ (1,0) [0|1023] "V"  IDCM,BPCM
 SG_ BMS_HV_Char_Bus_Sts_VDCM : 280|3@0+ (1,0) [0|7] "" IDCM,BPCM
 SG_ BMS_HV_BatState_VDCM : 293|4@0+ (1,0) [0|15] "" IDCM,BPCM
 SG_ BMS_HV_BatActualPower_VDCM : 317|15@0+ (0.1,-1638.3) [-1638.3|1638.4] "kW"  IDCM,BPCM
 SG_ VDCM_ChargingPermitting : 53|1@0+ (1,0) [0|1] "" IDCM
 SG_ GBT_Target_Voltage_Reached : 334|2@0+ (1,0) [0|3] "" IDCM
 SG_ GBT_Target_Cell_Voltage_Reached : 332|2@0+ (1,0) [0|3] "" IDCM
 SG_ GBT_Ready_to_Charge : 60|1@0+ (1,0) [0|1] "" IDCM
 SG_ GBT_Desired_SOC_Reached : 50|2@0+ (1,0) [0|3] "" IDCM
 SG_ GBT_Charger_Active_Interruption : 330|2@0+ (1,0) [0|3] "" IDCM
 SG_ MessageCounter_VO2 : 435|4@0+ (1,0) [0|15] "" IDCM,BPCM
 SG_ CRC_VO2 : 447|8@0+ (1,0) [0|255] "" IDCM,BPCM
 SG_ SelectedSecurityProtocol : 328|1@0+ (1,0) [0|1] "-"  IDCM
 SG_ SelectedAppProtocol : 343|2@0+ (1,0) [0|3] "-"  IDCM

BO_ 544 OBCM_VDCM2: 64 IDCM
 SG_ Plug_Locked_by_EVSE : 52|2@0+ (1,0) [0|2] "" EVCU2
 SG_ HVCMS_EVSEID : 7|32@0+ (1,0) [0|4294967294] "" EVCU2
 SG_ ExtChargerSts : 42|2@0+ (1,0) [0|2] "" EVCU2
 SG_ EVSE_Error : 54|2@0+ (1,0) [0|2] "" EVCU2
 SG_ EVSE_ChrgStopControl : 40|2@0+ (1,0) [0|2] "" EVCU2
 SG_ Charger_WeldingDetectAvail : 44|2@0+ (1,0) [0|2] "" EVCU2
 SG_ Charger_StndbyReqReason : 47|3@0+ (1,0) [0|6] "" EVCU2
 SG_ Charger_StndbyReq : 33|2@0+ (1,0) [0|2] "" EVCU2
 SG_ Charger_FaultStates : 37|4@0+ (1,0) [0|14] "" EVCU2
 SG_ CC2VoltDetError : 39|2@0+ (1,0) [0|2] "" EVCU2
 SG_ OBCM_CSSts : 152|2@0+ (1,0) [0|3] "" EVCU2
 SG_ OBCM_CP3Sts : 158|3@0+ (1,0) [0|7] "" EVCU2
 SG_ OBCM_CP2Sts : 145|3@0+ (1,0) [0|7] "" EVCU2
 SG_ OBCM_CCSts : 155|3@0+ (1,0) [0|7] "" EVCU2
 SG_ OBCM_APAMSts : 147|2@0+ (1,0) [0|3] "" EVCU2
 SG_ TCP_Communication_Terminated : 162|1@0+ (1,0) [0|1] "" EVCU2
 SG_ OBCM_CP1Sts : 166|3@0+ (1,0) [0|7] "" EVCU2
 SG_ TxGBTMessageResponse : 61|5@0+ (1,0) [0|31] "" EVCU2
 SG_ TxGBTMessageRequest : 50|5@0+ (1,0) [0|31] "" EVCU2
 SG_ OBCM_Timeout : 56|1@0+ (1,0) [0|1] "" EVCU2
 SG_ EVCC_FailureSts : 163|1@0+ (1,0) [0|1] "" EVCU2
 SG_ CC2_VoltageValue : 71|8@0+ (0.1,0) [0|25.5] "V"  EVCU2
 SG_ GBT_EVSE_Charge_Permitting : 79|1@0+ (1,0) [0|1] "" EVCU2
 SG_ MessageCounter_OV2 : 435|4@0+ (1,0) [0|15] "" EVCU2
 SG_ CRC_OV2 : 447|8@0+ (1,0) [0|255] "" EVCU2
 SG_ EVSE_NotificationMaxDelay : 87|18@0+ (1,0) [0|262143] "s"  EVCU2
 SG_ CdM_ExtFun_Reset_Max_Time : 77|1@0+ (1,0) [0|1] "" EVCU2
 SG_ CdM_ExtFun_Relia_Design : 150|1@0+ (1,0) [0|1] "" EVCU2
 SG_ CdM_ExtFun_Over_Temp_Trotec_Conn : 149|1@0+ (1,0) [0|1] "" EVCU2
 SG_ CdM_ExtFun_Oper_Cond : 148|1@0+ (1,0) [0|1] "" EVCU2
 SG_ CdM_ExtFun_Cur_Lim_Conn : 72|1@0+ (1,0) [0|1] "" EVCU2
 SG_ CdM_ExtFun_Cur_Lim_Cable : 73|1@0+ (1,0) [0|1] "" EVCU2
 SG_ CdM_ExtFun_Cool_Func_Conn : 74|1@0+ (1,0) [0|1] "" EVCU2
 SG_ CdM_ExtFun_Cool_Func_Cable : 75|1@0+ (1,0) [0|1] "" EVCU2
 SG_ CdM_ExtFun_Chr_Dyn_Control_Comp : 78|1@0+ (1,0) [0|1] "" EVCU2
 SG_ CdM_ExtFun_Char_HC_Control_Comp : 76|1@0+ (1,0) [0|1] "" EVCU2

BO_ 1790 BATTERY_HV2: 32 BPCM
 SG_ BMS_HV_SOC_AccuracySts : 17|2@0+ (1,0) [0|2] "-"  EVCU2
 SG_ BMS_HV_Low_Temp_Thrsh : 12|11@0+ (0.1,-40) [-40|164.7] "°C"  EVCU2
 SG_ BMS_HV_High_Temp_Thrsh : 7|11@0+ (0.1,-40) [-40|164.7] "°C"  EVCU2
 SG_ HVBatCell_Voltage_Low_Thrsh : 49|13@0+ (0.001,0) [0|8.191] "" EVCU2
 SG_ HVBatCell_Voltage_High_Thrsh : 46|13@0+ (0.001,0) [0|8.191] "" EVCU2
 SG_ HEV_OnRq_BPCM : 31|1@0+ (1,0) [0|1] "" EVCU2,SGW
 SG_ BMS_HV_SOC_Min : 30|8@0+ (0.391257,0) [0|100] "%"  EVCU2
 SG_ BMS_HV_SOC_Max : 38|8@0+ (0.392157,0) [0|100] "%"  EVCU2

BO_ 834 GLIWA_T1_TX: 8 EVCU2
 SG_ N_PDU_342 : 7|64@0+ (1,0) [0|0] "" SGW

BO_ 835 GLIWA_T1_RX: 8 SGW
 SG_ N_PDU_343 : 7|64@0+ (1,0) [0|0] "" EVCU2

BO_ 105 VDCM_PWT3: 64 EVCU2
 SG_ ClrLgsDiagInfo : 431|1@0+ (1,0) [0|1] "" IDCM

BO_ 1062 MCPA_DATA2: 64 EVCU2
 SG_ MCPA_Temp : 7|8@0+ (1,-40) [-40|215] "°C"  SGW

BO_ 1893 HVBATTERY_RM_MODS2: 48 BPCM
 SG_ HVBatModuleTemp_66 : 199|8@0+ (1,-40) [-40|215] "°C"  SGW
 SG_ HVBatModuleTemp_65 : 191|8@0+ (1,-40) [-40|215] "°C"  SGW
 SG_ HVBatModuleTemp_64 : 183|8@0+ (1,-40) [-40|215] "°C"  SGW
 SG_ HVBatModuleTemp_63 : 175|8@0+ (1,-40) [-40|215] "°C"  SGW
 SG_ HVBatModuleTemp_62 : 167|8@0+ (1,-40) [-40|215] "°C"  SGW
 SG_ HVBatModuleTemp_61 : 159|8@0+ (1,-40) [-40|215] "°C"  SGW
 SG_ HVBatModuleTemp_60 : 151|8@0+ (1,-40) [-40|215] "°C"  SGW
 SG_ HVBatModuleTemp_59 : 143|8@0+ (1,-40) [-40|215] "°C"  SGW
 SG_ HVBatModuleTemp_58 : 135|8@0+ (1,-40) [-40|215] "°C"  SGW
 SG_ HVBatModuleTemp_57 : 127|8@0+ (1,-40) [-40|215] "°C"  SGW
 SG_ HVBatModuleTemp_56 : 119|8@0+ (1,-40) [-40|215] "°C"  SGW
 SG_ HVBatModuleTemp_55 : 111|8@0+ (1,-40) [-40|215] "°C"  SGW
 SG_ HVBatModuleTemp_54 : 103|8@0+ (1,-40) [-40|215] "°C"  SGW
 SG_ HVBatModuleTemp_41 : 223|8@0+ (1,-40) [-40|215] "°C"  SGW
 SG_ HVBatModuleTemp_40 : 215|8@0+ (1,-40) [-40|215] "°C"  SGW
 SG_ HVBatModuleTemp_39 : 207|8@0+ (1,-40) [-40|215] "°C"  SGW
 SG_ HVBatModuleVoltage_NumMin : 225|6@0+ (1,0) [0|63] "" SGW
 SG_ HVBatModuleVoltage_NumMax : 231|6@0+ (1,0) [0|63] "" SGW
 SG_ HVBatModuleTemp_53 : 95|8@0+ (1,-40) [-40|215] "°C"  SGW
 SG_ HVBatModuleTemp_52 : 87|8@0+ (1,-40) [-40|215] "°C"  SGW
 SG_ HVBatModuleTemp_51 : 79|8@0+ (1,-40) [-40|215] "°C"  SGW
 SG_ HVBatModuleTemp_50 : 71|8@0+ (1,-40) [-40|215] "°C"  SGW
 SG_ HVBatModuleTemp_49 : 63|8@0+ (1,-40) [-40|215] "°C"  SGW
 SG_ HVBatModuleTemp_48 : 55|8@0+ (1,-40) [-40|215] "°C"  SGW
 SG_ HVBatModuleTemp_47 : 47|8@0+ (1,-40) [-40|215] "°C"  SGW
 SG_ HVBatModuleTemp_46 : 39|8@0+ (1,-40) [-40|215] "°C"  SGW
 SG_ HVBatModuleTemp_45 : 31|8@0+ (1,-40) [-40|215] "°C"  SGW
 SG_ HVBatModuleTemp_44 : 23|8@0+ (1,-40) [-40|215] "°C"  SGW
 SG_ HVBatModuleTemp_43 : 15|8@0+ (1,-40) [-40|215] "°C"  SGW
 SG_ HVBatModuleTemp_42 : 7|8@0+ (1,-40) [-40|215] "°C"  SGW

BO_ 1031 HV_CHARGER1: 64 IDCM
 SG_ InputCurrentAvailable : 96|9@0+ (1,0) [0|300] "Amp"  EVCU2
 SG_ AC_Side_Volt3 : 164|13@0+ (0.1,0) [0|819] "Volts"  EVCU2,SGW
 SG_ AC_Side_Volt2 : 145|13@0+ (0.1,0) [0|819] "Volts"  EVCU2,SGW
 SG_ AC_Side_Volt1 : 142|13@0+ (0.1,0) [0|819] "Volts"  EVCU2,SGW
 SG_ AC_Side_Curr3 : 121|11@0+ (0.1,-100) [-100|104.6] "Amp"  EVCU2,SGW
 SG_ AC_Side_Curr2 : 65|11@0+ (0.1,-100) [-100|104.6] "Amp"  EVCU2,SGW
 SG_ AC_Side_Curr1 : 19|11@0+ (0.1,-100) [-100|104.6] "Amp"  EVCU2,SGW
 SG_ ProximitySts : 39|3@0+ (1,0) [0|7] "-"  EVCU2
 SG_ OBCM_SlacSts : 54|2@0+ (1,0) [0|3] "-"  EVCU2
 SG_ OBCM_SdpSts : 102|2@0+ (1,0) [0|3] "" EVCU2
 SG_ OBCInterlockSts : 86|2@0+ (1,0) [0|3] "" EVCU2
 SG_ OBC_DeratingReason : 7|4@0+ (1,0) [0|15] "-"  EVCU2
 SG_ J1772_State : 22|3@0+ (1,0) [0|7] "-"  EVCU2
 SG_ J1772_S2_Sts : 23|1@0+ (1,0) [0|1] "-"  EVCU2
 SG_ InputVoltage_isAC : 82|1@0+ (1,0) [0|1] "-"  EVCU2
 SG_ InputVoltage_is60Hz : 71|1@0+ (1,0) [0|1] "-"  EVCU2
 SG_ HV_Overvoltage : 69|1@0+ (1,0) [0|1] "-"  EVCU2
 SG_ HV_Overcurrent : 68|1@0+ (1,0) [0|1] "-"  EVCU2
 SG_ ControlPilotSts : 36|3@0+ (1,0) [0|7] "-"  EVCU2
 SG_ ChargeEnableSts : 181|2@0+ (1,0) [0|2] "-"  EVCU2
 SG_ ChargeCurrentAvailable : 49|10@0+ (0.1,0) [0|102.3] "Amp"  EVCU2
 SG_ ChargeCurrent : 33|10@0+ (0.1,0) [0|102.3] "Amp"  EVCU2
 SG_ BatterySideCurrent : 81|11@0+ (0.1,-50) [-50|154.7] "Amp"  EVCU2
 SG_ AC_Present : 70|1@0+ (1,0) [0|1] "-"  EVCU2
 SG_ AC_HighLoadWarning : 51|1@0+ (1,0) [0|1] "-"  EVCU2
 SG_ Supported_VerNumberMinor : 264|3@0+ (1,0) [0|7] "" EVCU2
 SG_ Supported_VerNumberMajor : 267|3@0+ (1,0) [0|7] "" EVCU2
 SG_ Supported_SchemaID : 270|3@0+ (1,0) [0|7] "" EVCU2
 SG_ Supported_ProtocolName : 257|3@0+ (1,0) [0|7] "" EVCU2
 SG_ MessageCounter_HV_CHARGER1 : 179|4@0+ (1,0) [0|15] "-"  EVCU2
 SG_ EVCC_FailureReason : 263|6@0+ (1,0) [0|63] "" EVCU2
 SG_ CRC_HV_CHARGER1 : 191|8@0+ (1,0) [0|255] "-"  EVCU2
 SG_ BatterySideVoltage : 119|14@0+ (0.1,0) [0|1638.3] "Volts"  EVCU2
 SG_ AC_LnLow : 50|1@0+ (1,0) [0|1] "" EVCU2
 SG_ AC_LnHi : 183|1@0+ (1,0) [0|1] "" EVCU2
 SG_ Plug_And_Charge_Contract_Sts : 67|2@0+ (1,0) [0|3] "" SGW
 SG_ RCD : 274|1@0+ (1,0) [0|1] "-"  EVCU2
 SG_ EVSENominalVoltage : 273|10@0+ (1,0) [0|1023] "V"  EVCU2
 SG_ EVSEMaxCurrent : 288|9@0+ (1,0) [0|511] "A"  EVCU2
 SG_ Pilot_DutyCycle : 311|8@0+ (0.5,0) [0|127.5] "%"  EVCU2

BO_ 2564486468 DIAGNOSTIC_RESPONSE_FOTA_BPCM: 64 BPCM
 SG_ N_PDU_18DAF544 : 7|64@0+ (1,0) [0|0] "" SGW

BO_ 253 APM2_VDCM: 32 APM2
 SG_ VltgChgEVSE : 37|14@0+ (0.1,0) [0|1638.2] "V"  EVCU2
 SG_ PwrEff : 31|10@0+ (0.1,0) [0|102.2] "%"  EVCU2
 SG_ CurrEVSE : 13|14@0+ (0.1,-815) [-815|823.2] "A"  EVCU2
 SG_ APM2InterlockSts : 7|2@0+ (1,0) [0|3] "" EVCU2,SGW
 SG_ APM2_ModeSts_Fbk : 5|4@0+ (1,0) [0|14] "" EVCU2
 SG_ APM2_HVChrgBusVoltage : 55|14@0+ (0.1,0) [0|1638.3] "V"  EVCU2
 SG_ APM2_HVChrgBusCurrent : 57|14@0+ (0.1,-815) [-815|823.3] "A"  EVCU2
 SG_ APM2_FaultSts : 83|2@0+ (1,0) [0|3] "" EVCU2
 SG_ APM2_DeratRsnSts : 0|3@0+ (1,0) [0|7] "" EVCU2
 SG_ APM2_DcChEnaSts_Fdbk : 1|1@0+ (1,0) [0|1] "" EVCU2
 SG_ APM2_RecoveryAction : 81|3@0+ (1,0) [0|7] "" EVCU2
 SG_ APM2_TempMargin : 180|7@0+ (0.333,-21) [-21|21.219] "°C"  EVCU2
 SG_ APM2_TempL2 : 172|8@0+ (1,-40) [-40|215] "°C"  EVCU2
 SG_ APM2_TempL1 : 164|8@0+ (1,-40) [-40|215] "°C"  EVCU2
 SG_ APM2_TempInt : 156|8@0+ (1,-40) [-40|215] "°C"  EVCU2
 SG_ APM2_TempFET2 : 148|8@0+ (1,-40) [-40|215] "°C"  EVCU2
 SG_ APM2_TempFET1 : 140|8@0+ (1,-40) [-40|215] "°C"  EVCU2
 SG_ APM2_Service_Lamp_Request : 189|1@0+ (1,0) [0|1] "" EVCU2
 SG_ APM2_IInpMaxCnvr : 92|14@0+ (0.1,-815) [-815|823.2] "A"  EVCU2
 SG_ APM2_ErrorWord : 108|32@0+ (1,0) [0|4294967295] "" EVCU2
 SG_ APM2_DisChargedSts_Fdbk : 110|1@0+ (1,0) [0|1] "" EVCU2
 SG_ APM2_ContactorFault : 94|2@0+ (1,0) [0|2] "" EVCU2,IDCM
 SG_ APM2_BoostSwitchSts : 109|1@0+ (1,0) [0|1] "" EVCU2
 SG_ VltgChgInt : 184|14@0+ (0.1,0) [0|1638.3] "V"  EVCU2
 SG_ APM2_TempInlet : 202|11@0+ (0.1,-40) [-40|164.7] "°C"  EVCU2
 SG_ APM2_K7_WldgDtnSts : 186|2@0+ (1,0) [0|3] "-"  EVCU2
 SG_ APM2_K6_WldgDtnSts : 188|2@0+ (1,0) [0|3] "-"  EVCU2

BO_ 2654814269 ECU_APPL_FD_BPCM: 64 BPCM
 SG_ ECU_APPL_FD_BPCM : 455|64@0+ (1,0) [0|0] "" HCP

BO_ 1063 MCPB_DATA2: 64 EVCU2
 SG_ MCPB_Temp : 6|8@0+ (1,-40) [-40|215] "°C"  SGW

BO_ 2564486421 DIAGNOSTIC_RESPONSE_FOTA_MCPB: 64 EVCU2
 SG_ N_PDU_18DAF515 : 7|64@0+ (1,0) [0|0] "" SGW

BO_ 2564486420 DIAGNOSTIC_RESPONSE_FOTA_MCPA: 64 EVCU2
 SG_ N_PDU_18DAF514 : 7|64@0+ (1,0) [0|0] "" SGW

BO_ 2564429301 DIAGNOSTIC_REQUEST_FOTA_MCPB: 64 SGW
 SG_ N_PDU_18DA15F5 : 7|64@0+ (1,0) [0|0] "" EVCU2

BO_ 2564429045 DIAGNOSTIC_REQUEST_FOTA_MCPA: 64 SGW
 SG_ N_PDU_18DA14F5 : 7|64@0+ (1,0) [0|0] "" EVCU2

BO_ 2564441333 DIAGNOSTIC_REQUEST_FOTA_BPCM: 64 SGW
 SG_ N_PDU_18DA44F5 : 455|64@0+ (1,0) [0|0] "" BPCM

BO_ 2564486480 DIAGNOSTIC_RESPONSE_FOTA_IDCM: 64 IDCM
 SG_ N_PDU_18DAF550 : 7|64@0+ (1,0) [0|0] "" SGW

BO_ 2564444405 DIAGNOSTIC_REQUEST_FOTA_IDCM: 64 SGW
 SG_ N_PDU_18DA50F5 : 7|64@0+ (1,0) [0|0] "" IDCM

BO_ 2564554485 DIAGNOSTIC_REQUEST_FUNC_FOTA: 64 SGW
 SG_ N_PDU_18DBFEF5 : 7|64@0+ (1,0) [0|0] "" PPIM,APM2,IDCM,BPCM,HCP

BO_ 292 BATTERY_HV_STATUS1: 64 BPCM
 SG_ MessageCounter_BATT_HV_STATUS1 : 435|4@0+ (1,0) [0|15] "-"  EVCU2,IDCM
 SG_ CRC_BATT_HV_STATUS1 : 447|8@0+ (1,0) [0|255] "-"  EVCU2,IDCM
 SG_ HVBatContactorWeldCheck : 302|1@0+ (1,0) [0|1] "" EVCU2
 SG_ HVBatReady : 268|1@0+ (1,0) [0|1] "" EVCU2
 SG_ BPCM_DC_CntctrsMidTrmOpeningWarn : 267|1@0+ (1,0) [0|1] "" EVCU2
 SG_ BPCM_DC_CntctrsShtTrmOpeningWarn : 266|1@0+ (1,0) [0|1] "" EVCU2
 SG_ BPCM_HV_Char_Main_Contac_Sts : 178|3@0+ (1,0) [0|7] "" EVCU2
 SG_ BPCM_HV_Trac_Main_Contac_Sts : 181|3@0+ (1,0) [0|7] "" EVCU2,IDCM
 SG_ BPCM_HV_BalancingMode : 164|2@0+ (1,0) [0|3] "" EVCU2
 SG_ BPCM_HV_ChargingBusVoltage : 162|11@0+ (1,0) [0|2047] "V"  EVCU2
 SG_ BPCM_HV_TractionBusVoltage : 146|11@0+ (1,0) [0|2047] "V"  EVCU2,IDCM
 SG_ BPCM_Pwr_Limp_Home_On : 55|1@0+ (1,0) [0|1] "" EVCU2
 SG_ BPCM_HV_Trac_Bus_Sts : 36|3@0+ (1,0) [0|7] "" EVCU2,IDCM
 SG_ BPCM_HV_Char_Bus_Sts : 39|3@0+ (1,0) [0|7] "" EVCU2
 SG_ BPCM_HV_SOH_Low : 30|7@0+ (1,0) [0|127] "" EVCU2
 SG_ BPCM_HV_SOH : 22|7@0+ (1,0) [0|127] "" EVCU2,SGW
 SG_ HVBatContactorOpenTime : 15|8@0+ (0.2,0) [0|51] "Hours"  EVCU2
 SG_ HVBatLastSlept : 7|8@0+ (0.2,0) [0|51] "Days"  EVCU2
 SG_ BPCMInterlockSts : 54|3@0+ (1,0) [0|4] "" EVCU2
 SG_ BPCM_HV_BatIntrlk_InternalStat : 271|3@0+ (1,0) [0|3] "" EVCU2
 SG_ BPCM_HV_Temperature_Min : 218|11@0+ (0.1,-40) [-40|164.7] "°C"  EVCU2
 SG_ BPCM_HV_Temperature_Max : 202|11@0+ (0.1,-40) [-40|164.7] "°C"  EVCU2
 SG_ BPCM_HV_Temperature_Avg : 186|11@0+ (0.1,-40) [-40|164.7] "°C"  EVCU2
 SG_ BPCM_HV_SOC : 33|10@0+ (0.1,0) [0|102.3] "%"  EVCU2,SGW
 SG_ BPCM_HV_Outlet_Temp : 250|11@0+ (0.1,-40) [-40|164.7] "°C"  EVCU2
 SG_ BPCM_HV_InternalVoltage : 133|14@0+ (0.1,90.9) [90.9|1729.2] "V"  EVCU2
 SG_ BPCM_HV_Inlet_Temp : 234|11@0+ (0.1,-40) [-40|164.7] "°C"  EVCU2
 SG_ BPCM_HV_Current : 71|16@0+ (0.1,-3276.7) [-3276.7|3276.8] "A"  EVCU2
 SG_ BPCM_HV_Capacity : 51|12@0+ (0.15,0) [0|614.25] "Ah"  EVCU2
 SG_ BPCM_HV_Battery_GFD_Sts : 149|3@0+ (1,0) [0|4] "" EVCU2
 SG_ BPCM_Wakeup_Request : 23|1@0+ (1,0) [0|1] "" EVCU2
 SG_ BPCM_HV_ThermalRunaway : 135|2@0+ (1,0) [0|3] "" EVCU2
 SG_ HVBP_Busbar_Temp : 423|8@0+ (1,-40) [-40|215] "°C"  EVCU2
 SG_ HVBP_BDU_Busbar_Temp : 415|8@0+ (1,-40) [-40|215] "°C"  EVCU2
 SG_ DC_Charge_Type_Status : 319|3@0+ (1,0) [0|7] "" EVCU2
 SG_ BPCM_Series_Voltage : 367|13@0+ (0.1,90.9) [90.9|910] "V"  EVCU2
 SG_ BPCM_Request_for_Aux_Load_off : 313|1@0+ (1,0) [0|1] "" EVCU2
 SG_ BPCM_HV_Trac_Main_Contac_Config : 316|3@0+ (1,0) [0|7] "" EVCU2
 SG_ BPCM_HV_InternalVoltageString2 : 351|13@0+ (0.1,90.9) [90.9|910] "V"  EVCU2
 SG_ BPCM_HV_InternalVoltageString1 : 335|13@0+ (0.1,90.9) [90.9|910] "V"  EVCU2
 SG_ BPCM_HV_DCFC_Isolation_Sts : 167|3@0+ (1,0) [0|7] "" EVCU2
 SG_ BPCM_HV_Trac_PreCha_Contac_Sts : 354|3@0+ (1,0) [0|7] "" EVCU2
 SG_ BPCM_HV_Current_String2 : 399|16@0+ (0.1,-3276.7) [-3276.7|3276.8] "A"  EVCU2

CM_ SG_ 1031 InputCurrentAvailable "J1772 input curent available";
CM_ SG_ 2654814269 ECU_APPL_FD_BPCM "ECU to external application";
CM_ SG_ 1031 AC_Side_Volt3 "AC line voltage3p, p3";
CM_ SG_ 1031 AC_Side_Volt2 "AC line voltage3p, p2";
CM_ SG_ 1031 AC_Side_Volt1 "AC line voltage3p, p1";
CM_ SG_ 1031 AC_Side_Curr3 "AC line current3p, p3";
CM_ SG_ 1031 AC_Side_Curr2 "AC line current3p, p2";
CM_ SG_ 1031 AC_Side_Curr1 "AC line current3p, p1";
CM_ SG_ 1031 ProximitySts "Proximity status based on the voltage level";
CM_ SG_ 1031 OBCM_SlacSts "Communication PLC protocol status, SLAC process";
CM_ SG_ 1031 OBCM_SdpSts "Network protocol implementation status";
CM_ SG_ 1031 OBCInterlockSts "OBCM interlock state";
CM_ SG_ 1031 OBC_DeratingReason "OBCM recovery action";
CM_ SG_ 1031 J1772_State "J1772 status";
CM_ SG_ 1031 InputVoltage_isAC "Input voltage is a/c (dc - [0], ac - [1])";
CM_ SG_ 1031 InputVoltage_is60Hz "Input voltage frrequency is 60 hz (50 hz - [0], 60 hz - [1])";
CM_ SG_ 1031 HV_Overvoltage "High voltage - over voltage";
CM_ SG_ 1031 HV_Overcurrent "High voltage over current";
CM_ SG_ 1031 ControlPilotSts "EVSE pilot status";
CM_ SG_ 1031 ChargeEnableSts "OBCM Feedback status.";
CM_ SG_ 1031 ChargeCurrentAvailable ".";
CM_ SG_ 1031 ChargeCurrent ".";
CM_ SG_ 1031 BatterySideCurrent "Battery side current";
CM_ SG_ 1031 AC_Present "AC line detection";
CM_ SG_ 1031 AC_HighLoadWarning "Infrastructure overload";
CM_ SG_ 253 VltgChgEVSE "Voltage from DC-charge connector";
CM_ SG_ 253 PwrEff "APM2 power efficiency";
CM_ SG_ 253 CurrEVSE "Available Current from DC- charge connector";
CM_ SG_ 253 APM2InterlockSts "APM interlock state.";
CM_ SG_ 253 APM2_ModeSts_Fbk "DC-BC Feedback status or operational mode status.";
CM_ SG_ 253 APM2_HVChrgBusVoltage "Voltage measured by DCBC on HV system side";
CM_ SG_ 253 APM2_HVChrgBusCurrent "Current measured by DCBC on HV system side";
CM_ SG_ 253 APM2_FaultSts "Control System failure type";
CM_ SG_ 253 APM2_DeratRsnSts "OBCM Derating cause";
CM_ SG_ 253 APM2_DcChEnaSts_Fdbk "DC-BC charge Status";
CM_ SG_ 546 VDCM_MaxChrgTime_sec "For comm with charging station type A";
CM_ SG_ 546 VDCM_MaxChrgTime_min "For comm with charging station type A";
CM_ SG_ 546 VDCM_EV_Batt_Max_T_Limit "For comm with charging station type B";
CM_ SG_ 546 VDCM_EstChrgTime_min "For comm with charging station type A";
CM_ SG_ 546 VDCM_ChrgMode_Req "For comm with charging station type B";
CM_ SG_ 546 VDCM_BattFullSOC_prc "For comm with charging station type B";
CM_ SG_ 544 Charger_StndbyReq "For communication with charging station type B";
CM_ SG_ 544 CC2VoltDetError "For communication with charging station type B";
CM_ SG_ 1790 BMS_HV_SOC_AccuracySts "This signal indicates the Validity of the SOC value read";
CM_ SG_ 1790 BMS_HV_Low_Temp_Thrsh "This signal indicates the lowest battery pack temperature allowed.";
CM_ SG_ 1790 BMS_HV_High_Temp_Thrsh "This signal indicates the highest battery pack temperature allowed.";
CM_ SG_ 253 APM2_RecoveryAction "System Recovery action in case of APM2 Fault";
CM_ SG_ 105 ClrLgsDiagInfo "Clear Legislated Diagnostic Information";
CM_ SG_ 546 WeldCheck_Complete "Weld check complete";
CM_ SG_ 546 ReadyToChargeState "Bit to indicate if EV is ready to charge or not";
CM_ SG_ 546 HCP_SessionStopCmd "Session stop command to stop charging";
CM_ SG_ 546 HCP_DC_Retry "Retry command";
CM_ SG_ 546 DCChrg_BatSideCurrent_VDCM "DC Charging Current, measured in boost, read from EVSE in bypass";
CM_ SG_ 546 BMS_Max_Pk_Volt_Allowed_VDCM "This signal indicates the Maximum battery pack voltage allowed.";
CM_ SG_ 546 BMS_Max_Cell_Volt_Allowed_Vldty "This signal indicates the Max cell voltage allowed valid.";
CM_ SG_ 546 BMS_Max_Cell_Volt_Allowed_VDCM "This signal indicates the Max cell voltage allowed.";
CM_ SG_ 546 BMS_HV_Trac_PreCha_Contac_Sts_V "Traction pre-charge contactor Physical relay status";
CM_ SG_ 546 BMS_HV_Trac_Main_Contac_Sts_VDCM "Traction main contactor physical relay status";
CM_ SG_ 546 BMS_HV_Temperature_Min_VDCM "Battery Minimum Temperature";
CM_ SG_ 546 BMS_HV_Temperature_Max_VDCM "Battery Average Temperature";
CM_ SG_ 546 BMS_HV_SOC_AccuracySts_VDCM "This signal indicates the Validity of the SOC value read";
CM_ SG_ 546 BMS_HV_NumCellMinTemp_VDCM "This signal indicates the Numner of the battery cell with the lowest temperature.";
CM_ SG_ 546 BMS_HV_NumCellMaxVolt_VDCM "This signal indicates the ID No. of cell with max. voltage";
CM_ SG_ 546 BMS_HV_NumCellMaxTemp_VDCM "This signal indicates the Number of the battery cell with the highest temperature.";
CM_ SG_ 546 BMS_HV_Low_Temp_Thrsh_VDCM "This signal indicates the lowest battery pack temperature allowed.";
CM_ SG_ 546 BMS_HV_InternalVoltage_VDCM "This signal indicates the Battery internal voltage as interpreted from VDCM.";
CM_ SG_ 546 BMS_HV_High_Temp_Thrsh_VDCM "This signal indicates the highest battery pack temperature allowed.";
CM_ SG_ 546 BMS_HV_Common_Contactor_Sts_VDCM "HV Bus common contactor status";
CM_ SG_ 546 BMS_HV_Battery_GFD_Sts_VDCM "HV Battery ground fault detection(Isolation)";
CM_ SG_ 546 BMS_HV_BatIntrlk_InternalStat_V "HVIL Status internal";
CM_ SG_ 546 BMS_HV_AC_Char_Main_Contac_Sts_ "AC Charging main contactor physical relay status from VDCM";
CM_ SG_ 546 BMS_Cell_Volt_Min_Vldty_VDCM "This signal indicates the Min cell voltage validity.";
CM_ SG_ 546 BMS_Cell_Volt_Min_VDCM "This signal indicates the Min cell voltage.";
CM_ SG_ 546 BMS_Cell_Volt_Max_Vldty_VDCM "This signal indicates the Max cell voltage validity.";
CM_ SG_ 546 BMS_Cell_Volt_Max_VDCM "This signal indicates the Max cell voltage.";
CM_ SG_ 546 AC_Chrg_Branch_Voltage_VDCM "Voltage measured after AC charge switch interpreted by VDCM";
CM_ SG_ 544 OBCM_CSSts "Proximity signal of CHAdeMO charging Plug";
CM_ SG_ 544 OBCM_CP3Sts "CP3 line status for CHAdeMO";
CM_ SG_ 544 OBCM_CP2Sts "CP2 line status for CHAdeMO";
CM_ SG_ 544 OBCM_CCSts "Proximity signal of GBT charging contact";
CM_ SG_ 544 OBCM_APAMSts "Status of charging station LV supply on terminals A plus and A minus for GB/T charging";
CM_ SG_ 1063 MCPB_Temp "Motor B temperature";
CM_ SG_ 1062 MCPA_Temp "Motor A temperature";
CM_ SG_ 1893 HVBatModuleTemp_66 "High voltage battery module temperature";
CM_ SG_ 1893 HVBatModuleTemp_65 "High voltage battery module temperature";
CM_ SG_ 1893 HVBatModuleTemp_64 "High voltage battery module temperature";
CM_ SG_ 1893 HVBatModuleTemp_63 "High voltage battery module temperature";
CM_ SG_ 1893 HVBatModuleTemp_62 "High voltage battery module temperature";
CM_ SG_ 1893 HVBatModuleTemp_61 "High voltage battery module temperature";
CM_ SG_ 1893 HVBatModuleTemp_60 "High voltage battery module temperature";
CM_ SG_ 1893 HVBatModuleTemp_59 "High voltage battery module temperature";
CM_ SG_ 1893 HVBatModuleTemp_58 "High voltage battery module temperature";
CM_ SG_ 1893 HVBatModuleTemp_57 "High voltage battery module temperature";
CM_ SG_ 1893 HVBatModuleTemp_56 "High voltage battery module temperature";
CM_ SG_ 1893 HVBatModuleTemp_55 "High voltage battery module temperature";
CM_ SG_ 1893 HVBatModuleTemp_54 "High voltage battery module temperature";
CM_ SG_ 1893 HVBatModuleTemp_41 "High voltage battery module temperature";
CM_ SG_ 1893 HVBatModuleTemp_40 "High voltage battery module temperature";
CM_ SG_ 1893 HVBatModuleTemp_39 "High voltage battery module temperature";
CM_ SG_ 1031 Supported_VerNumberMajor "Version Number Major accepted by  EVCC to support";
CM_ SG_ 1031 Supported_SchemaID "SchemaID accepted by  EVCC to support";
CM_ SG_ 1031 Supported_ProtocolName "Protocol accepted by  EVCC to support";
CM_ SG_ 1031 MessageCounter_HV_CHARGER1 "This signal is a counter used for safety checks strategies. This counter is incremented of 1 (one) unit at each frame transmission.";
CM_ SG_ 1031 EVCC_FailureReason "EVCC failure reason";
CM_ SG_ 1031 CRC_HV_CHARGER1 "CRC according to SAE J1850 standard at each frame transmission.";
CM_ SG_ 1031 BatterySideVoltage "Battery side voltage";
CM_ SG_ 1031 AC_LnLow "AC line voltage too low";
CM_ SG_ 1031 AC_LnHi "AC line voltage too High";
CM_ SG_ 1790 HVBatCell_Voltage_Low_Thrsh "HV Battery Cell Voltage Low Thrsh";
CM_ SG_ 1790 HVBatCell_Voltage_High_Thrsh "HV Battery Cell Voltage High Thrsh";
CM_ SG_ 1790 BMS_HV_SOC_Min "Minimum HV battery cell state of charge";
CM_ SG_ 1790 BMS_HV_SOC_Max "Maximum HV battery cell state of charge";
CM_ SG_ 253 APM2_TempMargin "DCBC temperature margin, derating active when greater then 0";
CM_ SG_ 253 APM2_TempL2 "Choke 2 temperature";
CM_ SG_ 253 APM2_TempL1 "Choke 1 temperature";
CM_ SG_ 253 APM2_TempInt "PCB temperature";
CM_ SG_ 253 APM2_TempFET2 "Power stage 2 temperature";
CM_ SG_ 253 APM2_TempFET1 "Power stage 1 temperature";
CM_ SG_ 253 APM2_Service_Lamp_Request "Lamp activation request";
CM_ SG_ 253 APM2_IInpMaxCnvr "Maximum EVSE current to be converted ( DCBC limits / derating)";
CM_ SG_ 253 APM2_ErrorWord "APM2 Error Code";
CM_ SG_ 253 APM2_DisChargedSts_Fdbk "Discharged status feedback";
CM_ SG_ 253 APM2_BoostSwitchSts "K6 Status Feedback";
CM_ SG_ 546 BMS_HV_Char_PreCha_Contac_Sts_V "Charging pre-charge contactor physical relay status";
CM_ SG_ 546 BMS_HV_Char_Main_Contac_Sts_VDCM "Charging main contactor physical relay status";
CM_ SG_ 546 BMS_HV_TractionBusVoltage_VDCM "Battery link traction bus voltage";
CM_ SG_ 546 BMS_HV_Trac_Bus_Sts_VDCM "HV Traction Bus Status";
CM_ SG_ 546 BMS_HV_ChargingBusVoltage_VDCM "Battery link charging bus voltage";
CM_ SG_ 546 BMS_HV_Char_Bus_Sts_VDCM "HV Traction Bus Status";
CM_ SG_ 546 BMS_HV_BatState_VDCM "Battery state";
CM_ SG_ 546 BMS_HV_BatActualPower_VDCM "Battery Pack actual power";
CM_ SG_ 544 TCP_Communication_Terminated "TCP communication terminated";
CM_ SG_ 544 OBCM_CP1Sts "CP1 line status for CHAdeMO";
CM_ SG_ 1893 HVBatModuleVoltage_NumMin "Module number - Minimum voltage; Enumeration 0 = Module 1, ...31 = Module 32. MASAH ONLY: Module number - Minimum voltage; Enumeration 1 = Module 1 ...32 = Module 32.";
CM_ SG_ 1893 HVBatModuleVoltage_NumMax "Module number - maximum voltage; Enumeration 0 = Module 1 ...31 = Module 32. MASAH ONLY: Module number - maximum voltage; Enumeration 1 = Module 1 ...32 = Module 32.";
CM_ SG_ 1893 HVBatModuleTemp_53 "High voltage battery module temperature";
CM_ SG_ 1893 HVBatModuleTemp_52 "High voltage battery module temperature";
CM_ SG_ 1893 HVBatModuleTemp_51 "High voltage battery module temperature";
CM_ SG_ 1893 HVBatModuleTemp_50 "High voltage battery module temperature";
CM_ SG_ 1893 HVBatModuleTemp_49 "High voltage battery module temperature";
CM_ SG_ 1893 HVBatModuleTemp_48 "High voltage battery module temperature";
CM_ SG_ 1893 HVBatModuleTemp_47 "High voltage battery module temperature";
CM_ SG_ 1893 HVBatModuleTemp_46 "High voltage battery module temperature";
CM_ SG_ 1893 HVBatModuleTemp_45 "High voltage battery module temperature";
CM_ SG_ 1893 HVBatModuleTemp_44 "High voltage battery module temperature";
CM_ SG_ 1893 HVBatModuleTemp_43 "High voltage battery module temperature";
CM_ SG_ 1893 HVBatModuleTemp_42 "High voltage battery module temperature";
CM_ SG_ 253 VltgChgInt "Internal voltage from DC-charge connector side";
CM_ SG_ 253 APM2_TempInlet "APM2 coolant inlet temperature";
CM_ SG_ 253 APM2_K7_WldgDtnSts "K7 contactor welding check status feedback from APM2";
CM_ SG_ 253 APM2_K6_WldgDtnSts "K6 contactor welding check status feedback from APM2";
CM_ SG_ 544 TxGBTMessageResponse "Last message communicated from SECC to EVCC for type B.";
CM_ SG_ 544 TxGBTMessageRequest "Last message communicated from EVCC to SECC for type B.";
CM_ SG_ 544 OBCM_Timeout "This signal indicates a timeout from the OBCM side.";
CM_ SG_ 544 EVCC_FailureSts "EVCC failure status";
CM_ SG_ 544 CC2_VoltageValue "This signal indicates the voltage value measured on the CC2 pin.";
CM_ SG_ 2564486420 N_PDU_18DAF514 "This signal is used for diagnostic purposes";
CM_ SG_ 2564429045 N_PDU_18DA14F5 "This signal is used for diagnostic purposes";
CM_ SG_ 546 VDCM_ChargingPermitting "VDCM boolean value that allows the charge process for GBT applications";
CM_ SG_ 546 GBT_Target_Voltage_Reached "BMS end of charge for Targer Voltage Reached for GBT Applications.";
CM_ SG_ 546 GBT_Target_Cell_Voltage_Reached "BMS end of charge for Targer Cell Voltage Reached for GBT Applications.";
CM_ SG_ 546 GBT_Ready_to_Charge "VDCM boolean value for starting charging phase and Ending Charge for GBT applications";
CM_ SG_ 546 GBT_Desired_SOC_Reached "BMS end of charge for Targer SOC Reached for GBT Applications.";
CM_ SG_ 546 GBT_Charger_Active_Interruption "BMS end of charge for Active Interruption for GBT applications";
CM_ SG_ 544 GBT_EVSE_Charge_Permitting "EVSE boolean value that allows to charge for GBT applications.";
CM_ SG_ 292 MessageCounter_BATT_HV_STATUS1 "This signal is a counter used for safety checks strategies. This counter is incremented of 1 (one) unit at each frame transmission.";
CM_ SG_ 292 CRC_BATT_HV_STATUS1 "CRC according to SAE J1850 standard at each frame transmission.";
CM_ SG_ 292 HVBatContactorWeldCheck "Contactor weld check report from BPCM for DC charging.";
CM_ SG_ 292 HVBatReady "High Voltage Battery Ready";
CM_ SG_ 292 BPCM_HV_Char_Main_Contac_Sts "DC Charging main contactor physical relay status.";
CM_ SG_ 292 BPCM_HV_Trac_Main_Contac_Sts "Traction main contactor physical relay status";
CM_ SG_ 292 BPCM_HV_BalancingMode "Balancing Mode";
CM_ SG_ 292 BPCM_HV_ChargingBusVoltage "Voltage measurement between positive main bus (after contactor) and negative charging branch.";
CM_ SG_ 292 BPCM_HV_TractionBusVoltage "Battery link traction bus voltage.";
CM_ SG_ 292 BPCM_Pwr_Limp_Home_On "Traction Battery Limp Home mode flag.";
CM_ SG_ 292 BPCM_HV_SOH_Low "State of Health calculated at low SOC.";
CM_ SG_ 292 BPCM_HV_SOH "Status of Healt";
CM_ SG_ 292 HVBatContactorOpenTime "Time Since Bat contactors last transitioned to Open.";
CM_ SG_ 292 HVBatLastSlept "Time since BPCM last went to sleep.";
CM_ SG_ 2564486421 N_PDU_18DAF515 "This signal is used for diagnostic purposes";
CM_ SG_ 2564486480 N_PDU_18DAF550 "This signal is used for diagnostic purposes";
CM_ SG_ 2564486468 N_PDU_18DAF544 "This signal is used for diagnostic purposes";
CM_ SG_ 2564554485 N_PDU_18DBFEF5 "This signal is used for diagnostic purposes";
CM_ SG_ 2564429301 N_PDU_18DA15F5 "This signal is used for diagnostic purposes";
CM_ SG_ 2564444405 N_PDU_18DA50F5 "This signal is used for diagnostic purposes";
CM_ SG_ 2564441333 N_PDU_18DA44F5 "This signal is used for diagnostic purposes";
CM_ SG_ 292 BPCMInterlockSts "BPCM interlock state";
CM_ SG_ 292 BPCM_HV_BatIntrlk_InternalStat "HVIL Status internal";
CM_ SG_ 292 BPCM_HV_Temperature_Min "Battery Minimum Temperature 22/06/2020 Allegra Giordano - changes: Value, Max (previous values: 164,7 - 164,6) (Daniele Zaharia's request)";
CM_ SG_ 292 BPCM_HV_Temperature_Max "Battery Max Temperature 22/06/2020 Allegra Giordano - changes: Value, Max (previous values: 164,7 - 164,6) (Daniele Zaharia's request)";
CM_ SG_ 292 BPCM_HV_Temperature_Avg "Battery Average Temperature 22/06/2020 Allegra Giordano - changes: Value, Max (previous values: 164,7 - 164,6) (Daniele Zaharia' request)";
CM_ SG_ 292 BPCM_HV_SOC "State of Charge";
CM_ SG_ 292 BPCM_HV_Outlet_Temp "Outlet Temperature";
CM_ SG_ 292 BPCM_HV_InternalVoltage "Battery internal voltage.";
CM_ SG_ 292 BPCM_HV_Inlet_Temp "Inlet temperature";
CM_ SG_ 292 BPCM_HV_Current "Battery Current";
CM_ SG_ 292 BPCM_HV_Capacity "Battery Capacity";
CM_ SG_ 292 BPCM_HV_Battery_GFD_Sts "HV Battery ground fault detection(Isolation).";
CM_ SG_ 292 BPCM_Wakeup_Request "BPCM Wakeup event";
CM_ SG_ 292 BPCM_HV_ThermalRunaway "Thermal runaway status";
CM_ SG_ 1031 Plug_And_Charge_Contract_Sts "HU Plug and Charge Contract status";
CM_ SG_ 1031 RCD "Used to Indicate the current status of the Residual Current Device (RCD)";
CM_ SG_ 1031 EVSENominalVoltage "RMS of the maximum voltage vehicle can accept";
CM_ SG_ 1031 EVSEMaxCurrent "EV Maximum current supported per Phase";
CM_ SG_ 292 HVBP_Busbar_Temp "HVBP Busbar temp";
CM_ SG_ 292 HVBP_BDU_Busbar_Temp "HVBP BDU Busbar temp";
CM_ SG_ 292 DC_Charge_Type_Status "800 V charging type acknowledgement";
CM_ SG_ 292 BPCM_Series_Voltage "Voltage value of batery pack as per configuration";
CM_ SG_ 292 BPCM_Request_for_Aux_Load_off "Request to turn off AUX load for battery switching operation about to commence";
CM_ SG_ 292 BPCM_HV_Trac_Main_Contac_Config "Breaktor contactor configuration status to confirm DCFC control sequence";
CM_ SG_ 292 BPCM_HV_InternalVoltageString2 "Voltage measured  on battery side of DCFC breaktor";
CM_ SG_ 292 BPCM_HV_InternalVoltageString1 "Voltage measured  on battery side of DCFC breaktor";
CM_ SG_ 292 BPCM_HV_DCFC_Isolation_Sts "Status of DC Circuit isolation failure";
CM_ SG_ 546 MessageCounter_VO2 "This signal is a counter used for safety checks strategies. This counter is incremented of 1 (one) unit at each frame transmission.";
CM_ SG_ 546 CRC_VO2 "CRC according to SAE J1850 standard at each frame transmission.";
CM_ SG_ 544 MessageCounter_OV2 "This signal is a counter used for safety checks strategies. This counter is incremented of 1 (one) unit at each frame transmission.";
CM_ SG_ 544 CRC_OV2 "CRC according to SAE J1850 standard at each frame transmission.";
CM_ SG_ 292 BPCM_HV_Trac_PreCha_Contac_Sts "Status of DC Circuit isolation failure";
CM_ SG_ 544 EVSE_NotificationMaxDelay "This signal is used to indicate the time until SECC expects the EVCC to react on the action request.";
CM_ SG_ 834 N_PDU_342 "This signal is used for diagnostic purposes";
CM_ SG_ 835 N_PDU_343 "This signal is used for diagnostic purposes";
CM_ SG_ 292 BPCM_HV_Current_String2 "Battery Current (2nd String)";
CM_ SG_ 546 SelectedSecurityProtocol "Signal Used by VDCM to select or not TLS communication between EV and SECC.";
CM_ SG_ 546 SelectedAppProtocol "Signal Used by VDCM to select one of various standard needed for HLC communication.";
CM_ SG_ 1031 Pilot_DutyCycle "Duty Cyle reported by the Pilot Circuit";
CM_ SG_ 544 CdM_ExtFun_Reset_Max_Time "Flag which indicate to reset timing of maximum charging time.(0: enable 1: disable)";
CM_ SG_ 544 CdM_ExtFun_Relia_Design "A flag indicating the charging current shall be decreased less than or equal to the continuous rated current 1 or the charger shall shift to error stop in case a malfunction of the charging cable and the charging connector is detected";
CM_ SG_ 544 CdM_ExtFun_Over_Temp_Trotec_Conn "A flag indicating the charging connector is compatible with the function of overtemperature protection of the charging connector";
CM_ SG_ 544 CdM_ExtFun_Oper_Cond "A flag indicating operating condition of a charger.";
CM_ SG_ 544 CdM_ExtFun_Cur_Lim_Conn "A flag indicating the charging connector is compatible with the function which retains charging current based on measured result of terminal temperature of the charging connector";
CM_ SG_ 544 CdM_ExtFun_Cur_Lim_Cable "A flag indicating the charging cable is compatible with a function which retains the charging current based on measured result of surface temperature of the charging cable";
CM_ SG_ 544 CdM_ExtFun_Cool_Func_Conn "A flag indicating the charging connector is compatible with the function which retains temperature rise of the charging connector";
CM_ SG_ 544 CdM_ExtFun_Cool_Func_Cable "A flag indicating the charging cable is compatible with a function that retains the temperature rise of the charging cable";
CM_ SG_ 544 CdM_ExtFun_Chr_Dyn_Control_Comp "Flag indicating charger that is compatible with dynamic control.";
CM_ SG_ 544 CdM_ExtFun_Char_HC_Control_Comp "A flag indicating a charger is compatible with high current control";
BA_DEF_ SG_ "GenSigTimeoutTime_HCP" INT 0 65535;
BA_DEF_ SG_ "GenSigTimeoutTime_PPIM" INT 0 65535;
BA_DEF_ SG_ "GenSigTimeoutTime_APM2" INT 0 65535;
BA_DEF_ SG_ "GenSigTimeoutTime_VDCM" INT 0 65535;
BA_DEF_ SG_ "GenSigStartValue" INT 0 2147483647;
BA_DEF_ SG_ "GenSigInactiveValue" INT 0 2147483647;
BA_DEF_ SG_ "GenSigSendType" ENUM "NotUsed","OnWrite","OnWriteWithRepetition","OnChange","OnChangeWithRepetition","IfActive","IfActiveWithRepetition","NoSigSendType";
BA_DEF_ SG_ "SystemSignalLongSymbol" STRING ;
BA_DEF_ SG_ "GenSigTimeoutTime_BPCM" INT 0 65535;
BA_DEF_ SG_ "GenSigTimeoutTime_EVCU2" INT 0 65535;
BA_DEF_ SG_ "GenSigTimeoutTime_IDCM" INT 0 65535;
BA_DEF_ SG_ "GenSigTimeoutTime_SGW" INT 0 65535;
BA_DEF_ BO_ "DiagRequest" ENUM "No","Yes";
BA_DEF_ BO_ "Type" ENUM "P","C","PE","COC","PE_Cntrl","E","E_Cntrl","OC","S","BAF","DC","EM","MM","ISO-TP","-";
BA_DEF_ BO_ "DiagResponse" ENUM "No","Yes";
BA_DEF_ BO_ "NmMessage" ENUM "No","Yes";
BA_DEF_ BO_ "GenMsgSendType" ENUM "Cyclic","NotUsed","NotUsed","NotUsed","NotUsed","NotUsed","NotUsed","NotUsed","NoMsgSendType";
BA_DEF_ BO_ "GenMsgNrOfRepetition" INT 0 255;
BA_DEF_ BO_ "GenMsgILSupport" ENUM "No","Yes";
BA_DEF_ BO_ "GenMsgStartDelayTime" INT 0 65535;
BA_DEF_ BO_ "GenMsgCycleTimeFast" INT 0 65535;
BA_DEF_ BO_ "GenMsgCycleTime" INT 0 65535;
BA_DEF_ BO_ "GenMsgDelayTime" INT 0 65535;
BA_DEF_ BO_ "NmAsrMessage" ENUM "No","Yes";
BA_DEF_ BO_ "DiagState" ENUM "No","Yes";
BA_DEF_ BO_ "DiagConnection" HEX 0 65535;
BA_DEF_ BO_ "CanTpFcFrameId" HEX 0 2147483647;
BA_DEF_ BO_ "VFrameFormat" ENUM "StandardCAN","ExtendedCAN","reserved","reserved","reserved","reserved","reserved","reserved","reserved","reserved","reserved","reserved","reserved","reserved","StandardCAN_FD","ExtendedCAN_FD";
BA_DEF_ BO_ "CANFD_BRS" ENUM "0","1";
BA_DEF_DEF_ "GenSigTimeoutTime_HCP" 2500;
BA_DEF_DEF_ "GenSigTimeoutTime_PPIM" 2500;
BA_DEF_DEF_ "GenSigTimeoutTime_APM2" 2500;
BA_DEF_DEF_ "GenSigTimeoutTime_VDCM" 2500;
BA_DEF_DEF_ "GenSigStartValue" 0;
BA_DEF_DEF_ "GenSigInactiveValue" 0;
BA_DEF_DEF_ "GenSigSendType" "NoSigSendType";
BA_DEF_DEF_ "SystemSignalLongSymbol" "";
BA_DEF_DEF_ "GenSigTimeoutTime_BPCM" 2500;
BA_DEF_DEF_ "GenSigTimeoutTime_EVCU2" 2500;
BA_DEF_DEF_ "GenSigTimeoutTime_IDCM" 2500;
BA_DEF_DEF_ "GenSigTimeoutTime_SGW" 2500;
BA_DEF_DEF_ "DiagRequest" "No";
BA_DEF_DEF_ "Type" "-";
BA_DEF_DEF_ "DiagResponse" "No";
BA_DEF_DEF_ "NmMessage" "No";
BA_DEF_DEF_ "GenMsgSendType" "NoMsgSendType";
BA_DEF_DEF_ "GenMsgNrOfRepetition" 0;
BA_DEF_DEF_ "GenMsgILSupport" "No";
BA_DEF_DEF_ "GenMsgStartDelayTime" 0;
BA_DEF_DEF_ "GenMsgCycleTimeFast" 0;
BA_DEF_DEF_ "GenMsgCycleTime" 0;
BA_DEF_DEF_ "GenMsgDelayTime" 0;
BA_DEF_DEF_ "NmAsrMessage" "No";
BA_DEF_DEF_ "DiagState" "No";
BA_DEF_DEF_ "DiagConnection" 0;
BA_DEF_DEF_ "CanTpFcFrameId" 2147483647;
BA_DEF_DEF_ "VFrameFormat" "StandardCAN_FD";
BA_DEF_DEF_ "CANFD_BRS" "0";
BA_ "Type" BO_ 546 1;
BA_ "GenMsgSendType" BO_ 546 0;
BA_ "GenMsgILSupport" BO_ 546 1;
BA_ "GenMsgCycleTime" BO_ 546 20;
BA_ "CANFD_BRS" BO_ 546 1;
BA_ "Type" BO_ 544 1;
BA_ "GenMsgSendType" BO_ 544 0;
BA_ "GenMsgILSupport" BO_ 544 1;
BA_ "GenMsgCycleTime" BO_ 544 20;
BA_ "CANFD_BRS" BO_ 544 1;
BA_ "Type" BO_ 1790 3;
BA_ "GenMsgSendType" BO_ 1790 0;
BA_ "GenMsgILSupport" BO_ 1790 1;
BA_ "GenMsgCycleTime" BO_ 1790 500;
BA_ "GenMsgDelayTime" BO_ 1790 20;
BA_ "CANFD_BRS" BO_ 1790 1;
BA_ "Type" BO_ 834 8;
BA_ "GenMsgILSupport" BO_ 834 1;
BA_ "CANFD_BRS" BO_ 834 1;
BA_ "Type" BO_ 835 8;
BA_ "GenMsgILSupport" BO_ 835 1;
BA_ "CANFD_BRS" BO_ 835 1;
BA_ "Type" BO_ 105 3;
BA_ "GenMsgSendType" BO_ 105 0;
BA_ "GenMsgILSupport" BO_ 105 1;
BA_ "GenMsgCycleTime" BO_ 105 1000;
BA_ "GenMsgDelayTime" BO_ 105 100;
BA_ "CANFD_BRS" BO_ 105 1;
BA_ "Type" BO_ 1062 1;
BA_ "GenMsgSendType" BO_ 1062 0;
BA_ "GenMsgILSupport" BO_ 1062 1;
BA_ "GenMsgCycleTime" BO_ 1062 100;
BA_ "CANFD_BRS" BO_ 1062 1;
BA_ "Type" BO_ 1893 1;
BA_ "GenMsgSendType" BO_ 1893 0;
BA_ "GenMsgILSupport" BO_ 1893 1;
BA_ "GenMsgCycleTime" BO_ 1893 1000;
BA_ "CANFD_BRS" BO_ 1893 1;
BA_ "Type" BO_ 1031 1;
BA_ "GenMsgSendType" BO_ 1031 0;
BA_ "GenMsgILSupport" BO_ 1031 1;
BA_ "GenMsgCycleTime" BO_ 1031 100;
BA_ "CANFD_BRS" BO_ 1031 1;
BA_ "Type" BO_ 2564486468 8;
BA_ "DiagResponse" BO_ 2564486468 1;
BA_ "DiagConnection" BO_ 2564486468 62788;
BA_ "VFrameFormat" BO_ 2564486468 15;
BA_ "CANFD_BRS" BO_ 2564486468 1;
BA_ "Type" BO_ 253 1;
BA_ "GenMsgSendType" BO_ 253 0;
BA_ "GenMsgILSupport" BO_ 253 1;
BA_ "GenMsgCycleTime" BO_ 253 10;
BA_ "CANFD_BRS" BO_ 253 1;
BA_ "Type" BO_ 2654814269 8;
BA_ "GenMsgILSupport" BO_ 2654814269 1;
BA_ "VFrameFormat" BO_ 2654814269 15;
BA_ "CANFD_BRS" BO_ 2654814269 1;
BA_ "Type" BO_ 1063 1;
BA_ "GenMsgSendType" BO_ 1063 0;
BA_ "GenMsgILSupport" BO_ 1063 1;
BA_ "GenMsgCycleTime" BO_ 1063 100;
BA_ "CANFD_BRS" BO_ 1063 1;
BA_ "Type" BO_ 2564486421 8;
BA_ "DiagResponse" BO_ 2564486421 1;
BA_ "DiagConnection" BO_ 2564486421 62741;
BA_ "VFrameFormat" BO_ 2564486421 15;
BA_ "CANFD_BRS" BO_ 2564486421 1;
BA_ "Type" BO_ 2564486420 8;
BA_ "DiagResponse" BO_ 2564486420 1;
BA_ "DiagConnection" BO_ 2564486420 62740;
BA_ "VFrameFormat" BO_ 2564486420 15;
BA_ "CANFD_BRS" BO_ 2564486420 1;
BA_ "DiagConnection" BO_ 2564429301 62741;
BA_ "VFrameFormat" BO_ 2564429301 15;
BA_ "CANFD_BRS" BO_ 2564429301 1;
BA_ "DiagRequest" BO_ 2564429301 1;
BA_ "Type" BO_ 2564429301 8;
BA_ "DiagRequest" BO_ 2564429045 1;
BA_ "Type" BO_ 2564429045 8;
BA_ "DiagConnection" BO_ 2564429045 62740;
BA_ "VFrameFormat" BO_ 2564429045 15;
BA_ "CANFD_BRS" BO_ 2564429045 1;
BA_ "DiagRequest" BO_ 2564441333 1;
BA_ "Type" BO_ 2564441333 8;
BA_ "DiagConnection" BO_ 2564441333 62788;
BA_ "VFrameFormat" BO_ 2564441333 15;
BA_ "CANFD_BRS" BO_ 2564441333 1;
BA_ "Type" BO_ 2564486480 8;
BA_ "DiagResponse" BO_ 2564486480 1;
BA_ "DiagConnection" BO_ 2564486480 62800;
BA_ "VFrameFormat" BO_ 2564486480 15;
BA_ "CANFD_BRS" BO_ 2564486480 1;
BA_ "DiagRequest" BO_ 2564444405 1;
BA_ "Type" BO_ 2564444405 8;
BA_ "DiagConnection" BO_ 2564444405 62800;
BA_ "VFrameFormat" BO_ 2564444405 15;
BA_ "CANFD_BRS" BO_ 2564444405 1;
BA_ "Type" BO_ 2564554485 8;
BA_ "DiagState" BO_ 2564554485 1;
BA_ "DiagConnection" BO_ 2564554485 62974;
BA_ "VFrameFormat" BO_ 2564554485 15;
BA_ "CANFD_BRS" BO_ 2564554485 1;
BA_ "Type" BO_ 292 1;
BA_ "GenMsgSendType" BO_ 292 0;
BA_ "GenMsgILSupport" BO_ 292 1;
BA_ "GenMsgCycleTime" BO_ 292 10;
BA_ "CANFD_BRS" BO_ 292 1;
BA_ "GenSigTimeoutTime_HCP" SG_ 1031 InputCurrentAvailable 0;
BA_ "GenSigTimeoutTime_PPIM" SG_ 1031 InputCurrentAvailable 0;
BA_ "GenSigTimeoutTime_APM2" SG_ 1031 InputCurrentAvailable 0;
BA_ "GenSigTimeoutTime_VDCM" SG_ 1031 InputCurrentAvailable 0;
BA_ "GenSigTimeoutTime_HCP" SG_ 1031 AC_Side_Volt3 0;
BA_ "GenSigTimeoutTime_PPIM" SG_ 1031 AC_Side_Volt3 0;
BA_ "GenSigTimeoutTime_APM2" SG_ 1031 AC_Side_Volt3 0;
BA_ "GenSigTimeoutTime_VDCM" SG_ 1031 AC_Side_Volt3 0;
BA_ "GenSigTimeoutTime_HCP" SG_ 1031 AC_Side_Volt2 0;
BA_ "GenSigTimeoutTime_PPIM" SG_ 1031 AC_Side_Volt2 0;
BA_ "GenSigTimeoutTime_APM2" SG_ 1031 AC_Side_Volt2 0;
BA_ "GenSigTimeoutTime_VDCM" SG_ 1031 AC_Side_Volt2 0;
BA_ "GenSigTimeoutTime_HCP" SG_ 1031 AC_Side_Volt1 0;
BA_ "GenSigTimeoutTime_PPIM" SG_ 1031 AC_Side_Volt1 0;
BA_ "GenSigTimeoutTime_APM2" SG_ 1031 AC_Side_Volt1 0;
BA_ "GenSigTimeoutTime_VDCM" SG_ 1031 AC_Side_Volt1 0;
BA_ "GenSigTimeoutTime_HCP" SG_ 1031 AC_Side_Curr3 0;
BA_ "GenSigTimeoutTime_PPIM" SG_ 1031 AC_Side_Curr3 0;
BA_ "GenSigTimeoutTime_APM2" SG_ 1031 AC_Side_Curr3 0;
BA_ "GenSigTimeoutTime_VDCM" SG_ 1031 AC_Side_Curr3 0;
BA_ "GenSigTimeoutTime_HCP" SG_ 1031 AC_Side_Curr1 0;
BA_ "GenSigTimeoutTime_PPIM" SG_ 1031 AC_Side_Curr1 0;
BA_ "GenSigTimeoutTime_APM2" SG_ 1031 AC_Side_Curr1 0;
BA_ "GenSigTimeoutTime_VDCM" SG_ 1031 AC_Side_Curr1 0;
BA_ "GenSigStartValue" SG_ 1031 AC_Side_Curr1 1000;
BA_ "GenSigTimeoutTime_BPCM" SG_ 1031 AC_Side_Curr1 0;
BA_ "GenSigTimeoutTime_EVCU2" SG_ 1031 AC_Side_Curr1 0;
BA_ "GenSigTimeoutTime_IDCM" SG_ 1031 AC_Side_Curr1 0;
BA_ "GenSigTimeoutTime_SGW" SG_ 1031 AC_Side_Curr1 0;
BA_ "GenSigTimeoutTime_HCP" SG_ 1031 AC_Side_Curr2 0;
BA_ "GenSigTimeoutTime_PPIM" SG_ 1031 AC_Side_Curr2 0;
BA_ "GenSigTimeoutTime_APM2" SG_ 1031 AC_Side_Curr2 0;
BA_ "GenSigTimeoutTime_VDCM" SG_ 1031 AC_Side_Curr2 0;
BA_ "GenSigTimeoutTime_HCP" SG_ 1031 ProximitySts 0;
BA_ "GenSigTimeoutTime_PPIM" SG_ 1031 ProximitySts 0;
BA_ "GenSigTimeoutTime_APM2" SG_ 1031 ProximitySts 0;
BA_ "GenSigTimeoutTime_VDCM" SG_ 1031 ProximitySts 0;
BA_ "GenSigStartValue" SG_ 1031 ProximitySts 1;
BA_ "GenSigTimeoutTime_BPCM" SG_ 1031 ProximitySts 0;
BA_ "GenSigTimeoutTime_IDCM" SG_ 1031 ProximitySts 0;
BA_ "GenSigTimeoutTime_SGW" SG_ 1031 ProximitySts 0;
BA_ "GenSigTimeoutTime_HCP" SG_ 1031 OBCM_SlacSts 0;
BA_ "GenSigTimeoutTime_PPIM" SG_ 1031 OBCM_SlacSts 0;
BA_ "GenSigTimeoutTime_APM2" SG_ 1031 OBCM_SlacSts 0;
BA_ "GenSigTimeoutTime_VDCM" SG_ 1031 OBCM_SlacSts 0;
BA_ "GenSigTimeoutTime_BPCM" SG_ 1031 OBCM_SlacSts 0;
BA_ "GenSigTimeoutTime_IDCM" SG_ 1031 OBCM_SlacSts 0;
BA_ "GenSigTimeoutTime_SGW" SG_ 1031 OBCM_SlacSts 0;
BA_ "GenSigTimeoutTime_HCP" SG_ 1031 OBCM_SdpSts 0;
BA_ "GenSigTimeoutTime_PPIM" SG_ 1031 OBCM_SdpSts 0;
BA_ "GenSigTimeoutTime_APM2" SG_ 1031 OBCM_SdpSts 0;
BA_ "GenSigTimeoutTime_VDCM" SG_ 1031 OBCM_SdpSts 0;
BA_ "GenSigTimeoutTime_BPCM" SG_ 1031 OBCM_SdpSts 0;
BA_ "GenSigTimeoutTime_IDCM" SG_ 1031 OBCM_SdpSts 0;
BA_ "GenSigTimeoutTime_SGW" SG_ 1031 OBCM_SdpSts 0;
BA_ "GenSigTimeoutTime_HCP" SG_ 1031 OBCInterlockSts 0;
BA_ "GenSigTimeoutTime_PPIM" SG_ 1031 OBCInterlockSts 0;
BA_ "GenSigTimeoutTime_APM2" SG_ 1031 OBCInterlockSts 0;
BA_ "GenSigTimeoutTime_VDCM" SG_ 1031 OBCInterlockSts 0;
BA_ "GenSigTimeoutTime_BPCM" SG_ 1031 OBCInterlockSts 0;
BA_ "GenSigTimeoutTime_IDCM" SG_ 1031 OBCInterlockSts 0;
BA_ "GenSigTimeoutTime_SGW" SG_ 1031 OBCInterlockSts 0;
BA_ "GenSigTimeoutTime_HCP" SG_ 1031 OBC_DeratingReason 0;
BA_ "GenSigTimeoutTime_PPIM" SG_ 1031 OBC_DeratingReason 0;
BA_ "GenSigTimeoutTime_APM2" SG_ 1031 OBC_DeratingReason 0;
BA_ "GenSigTimeoutTime_VDCM" SG_ 1031 OBC_DeratingReason 0;
BA_ "GenSigTimeoutTime_BPCM" SG_ 1031 OBC_DeratingReason 0;
BA_ "GenSigTimeoutTime_IDCM" SG_ 1031 OBC_DeratingReason 0;
BA_ "GenSigTimeoutTime_SGW" SG_ 1031 OBC_DeratingReason 0;
BA_ "GenSigTimeoutTime_BPCM" SG_ 1031 J1772_State 0;
BA_ "GenSigTimeoutTime_EVCU2" SG_ 1031 J1772_State 0;
BA_ "GenSigTimeoutTime_IDCM" SG_ 1031 J1772_State 0;
BA_ "GenSigTimeoutTime_SGW" SG_ 1031 J1772_State 0;
BA_ "GenSigTimeoutTime_HCP" SG_ 1031 J1772_State 0;
BA_ "GenSigTimeoutTime_PPIM" SG_ 1031 J1772_State 0;
BA_ "GenSigTimeoutTime_APM2" SG_ 1031 J1772_State 0;
BA_ "GenSigTimeoutTime_VDCM" SG_ 1031 J1772_State 0;
BA_ "GenSigTimeoutTime_BPCM" SG_ 1031 J1772_S2_Sts 0;
BA_ "GenSigTimeoutTime_IDCM" SG_ 1031 J1772_S2_Sts 0;
BA_ "GenSigTimeoutTime_SGW" SG_ 1031 J1772_S2_Sts 0;
BA_ "GenSigTimeoutTime_HCP" SG_ 1031 J1772_S2_Sts 0;
BA_ "GenSigTimeoutTime_PPIM" SG_ 1031 J1772_S2_Sts 0;
BA_ "GenSigTimeoutTime_APM2" SG_ 1031 J1772_S2_Sts 0;
BA_ "GenSigTimeoutTime_VDCM" SG_ 1031 J1772_S2_Sts 0;
BA_ "GenSigTimeoutTime_BPCM" SG_ 1031 InputVoltage_isAC 0;
BA_ "GenSigTimeoutTime_EVCU2" SG_ 1031 InputVoltage_isAC 0;
BA_ "GenSigTimeoutTime_IDCM" SG_ 1031 InputVoltage_isAC 0;
BA_ "GenSigTimeoutTime_SGW" SG_ 1031 InputVoltage_isAC 0;
BA_ "GenSigTimeoutTime_HCP" SG_ 1031 InputVoltage_isAC 0;
BA_ "GenSigTimeoutTime_PPIM" SG_ 1031 InputVoltage_isAC 0;
BA_ "GenSigTimeoutTime_APM2" SG_ 1031 InputVoltage_isAC 0;
BA_ "GenSigTimeoutTime_VDCM" SG_ 1031 InputVoltage_isAC 0;
BA_ "GenSigStartValue" SG_ 1031 InputVoltage_isAC 1;
BA_ "GenSigTimeoutTime_HCP" SG_ 1031 InputVoltage_is60Hz 0;
BA_ "GenSigTimeoutTime_PPIM" SG_ 1031 InputVoltage_is60Hz 0;
BA_ "GenSigTimeoutTime_APM2" SG_ 1031 InputVoltage_is60Hz 0;
BA_ "GenSigTimeoutTime_VDCM" SG_ 1031 InputVoltage_is60Hz 0;
BA_ "GenSigStartValue" SG_ 1031 InputVoltage_is60Hz 1;
BA_ "GenSigTimeoutTime_BPCM" SG_ 1031 InputVoltage_is60Hz 0;
BA_ "GenSigTimeoutTime_EVCU2" SG_ 1031 InputVoltage_is60Hz 0;
BA_ "GenSigTimeoutTime_IDCM" SG_ 1031 InputVoltage_is60Hz 0;
BA_ "GenSigTimeoutTime_SGW" SG_ 1031 InputVoltage_is60Hz 0;
BA_ "GenSigTimeoutTime_HCP" SG_ 1031 HV_Overvoltage 0;
BA_ "GenSigTimeoutTime_PPIM" SG_ 1031 HV_Overvoltage 0;
BA_ "GenSigTimeoutTime_APM2" SG_ 1031 HV_Overvoltage 0;
BA_ "GenSigTimeoutTime_VDCM" SG_ 1031 HV_Overvoltage 0;
BA_ "GenSigTimeoutTime_BPCM" SG_ 1031 HV_Overvoltage 0;
BA_ "GenSigTimeoutTime_EVCU2" SG_ 1031 HV_Overvoltage 0;
BA_ "GenSigTimeoutTime_IDCM" SG_ 1031 HV_Overvoltage 0;
BA_ "GenSigTimeoutTime_SGW" SG_ 1031 HV_Overvoltage 0;
BA_ "GenSigTimeoutTime_HCP" SG_ 1031 HV_Overcurrent 0;
BA_ "GenSigTimeoutTime_PPIM" SG_ 1031 HV_Overcurrent 0;
BA_ "GenSigTimeoutTime_APM2" SG_ 1031 HV_Overcurrent 0;
BA_ "GenSigTimeoutTime_VDCM" SG_ 1031 HV_Overcurrent 0;
BA_ "GenSigTimeoutTime_BPCM" SG_ 1031 HV_Overcurrent 0;
BA_ "GenSigTimeoutTime_EVCU2" SG_ 1031 HV_Overcurrent 0;
BA_ "GenSigTimeoutTime_IDCM" SG_ 1031 HV_Overcurrent 0;
BA_ "GenSigTimeoutTime_SGW" SG_ 1031 HV_Overcurrent 0;
BA_ "GenSigTimeoutTime_HCP" SG_ 1031 ControlPilotSts 0;
BA_ "GenSigTimeoutTime_PPIM" SG_ 1031 ControlPilotSts 0;
BA_ "GenSigTimeoutTime_APM2" SG_ 1031 ControlPilotSts 0;
BA_ "GenSigTimeoutTime_VDCM" SG_ 1031 ControlPilotSts 0;
BA_ "GenSigTimeoutTime_HCP" SG_ 1031 ChargeEnableSts 0;
BA_ "GenSigTimeoutTime_PPIM" SG_ 1031 ChargeEnableSts 0;
BA_ "GenSigTimeoutTime_APM2" SG_ 1031 ChargeEnableSts 0;
BA_ "GenSigTimeoutTime_VDCM" SG_ 1031 ChargeEnableSts 0;
BA_ "GenSigTimeoutTime_HCP" SG_ 1031 ChargeCurrentAvailable 0;
BA_ "GenSigTimeoutTime_PPIM" SG_ 1031 ChargeCurrentAvailable 0;
BA_ "GenSigTimeoutTime_APM2" SG_ 1031 ChargeCurrentAvailable 0;
BA_ "GenSigTimeoutTime_VDCM" SG_ 1031 ChargeCurrentAvailable 0;
BA_ "GenSigTimeoutTime_BPCM" SG_ 1031 ChargeCurrent 0;
BA_ "GenSigTimeoutTime_EVCU2" SG_ 1031 ChargeCurrent 0;
BA_ "GenSigTimeoutTime_IDCM" SG_ 1031 ChargeCurrent 0;
BA_ "GenSigTimeoutTime_SGW" SG_ 1031 ChargeCurrent 0;
BA_ "GenSigTimeoutTime_HCP" SG_ 1031 ChargeCurrent 0;
BA_ "GenSigTimeoutTime_PPIM" SG_ 1031 ChargeCurrent 0;
BA_ "GenSigTimeoutTime_APM2" SG_ 1031 ChargeCurrent 0;
BA_ "GenSigTimeoutTime_VDCM" SG_ 1031 ChargeCurrent 0;
BA_ "GenSigTimeoutTime_BPCM" SG_ 1031 BatterySideCurrent 0;
BA_ "GenSigTimeoutTime_EVCU2" SG_ 1031 BatterySideCurrent 0;
BA_ "GenSigTimeoutTime_IDCM" SG_ 1031 BatterySideCurrent 0;
BA_ "GenSigTimeoutTime_SGW" SG_ 1031 BatterySideCurrent 0;
BA_ "GenSigTimeoutTime_HCP" SG_ 1031 BatterySideCurrent 0;
BA_ "GenSigTimeoutTime_PPIM" SG_ 1031 BatterySideCurrent 0;
BA_ "GenSigTimeoutTime_APM2" SG_ 1031 BatterySideCurrent 0;
BA_ "GenSigTimeoutTime_VDCM" SG_ 1031 BatterySideCurrent 0;
BA_ "GenSigTimeoutTime_BPCM" SG_ 1031 AC_Present 0;
BA_ "GenSigTimeoutTime_EVCU2" SG_ 1031 AC_Present 0;
BA_ "GenSigTimeoutTime_IDCM" SG_ 1031 AC_Present 0;
BA_ "GenSigTimeoutTime_SGW" SG_ 1031 AC_Present 0;
BA_ "GenSigTimeoutTime_HCP" SG_ 1031 AC_Present 0;
BA_ "GenSigTimeoutTime_PPIM" SG_ 1031 AC_Present 0;
BA_ "GenSigTimeoutTime_APM2" SG_ 1031 AC_Present 0;
BA_ "GenSigTimeoutTime_VDCM" SG_ 1031 AC_Present 0;
BA_ "GenSigTimeoutTime_HCP" SG_ 1031 AC_HighLoadWarning 0;
BA_ "GenSigTimeoutTime_PPIM" SG_ 1031 AC_HighLoadWarning 0;
BA_ "GenSigTimeoutTime_APM2" SG_ 1031 AC_HighLoadWarning 0;
BA_ "GenSigTimeoutTime_VDCM" SG_ 1031 AC_HighLoadWarning 0;
BA_ "GenSigTimeoutTime_IDCM" SG_ 1063 MCPB_Temp 0;
BA_ "GenSigTimeoutTime_HCP" SG_ 1031 Supported_VerNumberMinor 0;
BA_ "GenSigTimeoutTime_PPIM" SG_ 1031 Supported_VerNumberMinor 0;
BA_ "GenSigTimeoutTime_APM2" SG_ 1031 Supported_VerNumberMinor 0;
BA_ "GenSigTimeoutTime_VDCM" SG_ 1031 Supported_VerNumberMinor 0;
BA_ "GenSigTimeoutTime_HCP" SG_ 1031 Supported_VerNumberMajor 0;
BA_ "GenSigTimeoutTime_PPIM" SG_ 1031 Supported_VerNumberMajor 0;
BA_ "GenSigTimeoutTime_APM2" SG_ 1031 Supported_VerNumberMajor 0;
BA_ "GenSigTimeoutTime_VDCM" SG_ 1031 Supported_VerNumberMajor 0;
BA_ "GenSigTimeoutTime_HCP" SG_ 1031 Supported_SchemaID 0;
BA_ "GenSigTimeoutTime_PPIM" SG_ 1031 Supported_SchemaID 0;
BA_ "GenSigTimeoutTime_APM2" SG_ 1031 Supported_SchemaID 0;
BA_ "GenSigTimeoutTime_VDCM" SG_ 1031 Supported_SchemaID 0;
BA_ "GenSigTimeoutTime_HCP" SG_ 1031 Supported_ProtocolName 0;
BA_ "GenSigTimeoutTime_PPIM" SG_ 1031 Supported_ProtocolName 0;
BA_ "GenSigTimeoutTime_APM2" SG_ 1031 Supported_ProtocolName 0;
BA_ "GenSigTimeoutTime_VDCM" SG_ 1031 Supported_ProtocolName 0;
BA_ "GenSigTimeoutTime_HCP" SG_ 1031 MessageCounter_HV_CHARGER1 0;
BA_ "GenSigTimeoutTime_PPIM" SG_ 1031 MessageCounter_HV_CHARGER1 0;
BA_ "GenSigTimeoutTime_APM2" SG_ 1031 MessageCounter_HV_CHARGER1 0;
BA_ "GenSigTimeoutTime_VDCM" SG_ 1031 MessageCounter_HV_CHARGER1 0;
BA_ "GenSigTimeoutTime_HCP" SG_ 1031 EVCC_FailureReason 0;
BA_ "GenSigTimeoutTime_PPIM" SG_ 1031 EVCC_FailureReason 0;
BA_ "GenSigTimeoutTime_APM2" SG_ 1031 EVCC_FailureReason 0;
BA_ "GenSigTimeoutTime_VDCM" SG_ 1031 EVCC_FailureReason 0;
BA_ "GenSigTimeoutTime_HCP" SG_ 1031 CRC_HV_CHARGER1 0;
BA_ "GenSigTimeoutTime_PPIM" SG_ 1031 CRC_HV_CHARGER1 0;
BA_ "GenSigTimeoutTime_APM2" SG_ 1031 CRC_HV_CHARGER1 0;
BA_ "GenSigTimeoutTime_VDCM" SG_ 1031 CRC_HV_CHARGER1 0;
BA_ "GenSigTimeoutTime_HCP" SG_ 1031 BatterySideVoltage 0;
BA_ "GenSigTimeoutTime_PPIM" SG_ 1031 BatterySideVoltage 0;
BA_ "GenSigTimeoutTime_APM2" SG_ 1031 BatterySideVoltage 0;
BA_ "GenSigTimeoutTime_VDCM" SG_ 1031 BatterySideVoltage 0;
BA_ "GenSigTimeoutTime_HCP" SG_ 1031 AC_LnLow 0;
BA_ "GenSigTimeoutTime_PPIM" SG_ 1031 AC_LnLow 0;
BA_ "GenSigTimeoutTime_APM2" SG_ 1031 AC_LnLow 0;
BA_ "GenSigTimeoutTime_VDCM" SG_ 1031 AC_LnLow 0;
BA_ "GenSigTimeoutTime_HCP" SG_ 1031 AC_LnHi 0;
BA_ "GenSigTimeoutTime_PPIM" SG_ 1031 AC_LnHi 0;
BA_ "GenSigTimeoutTime_APM2" SG_ 1031 AC_LnHi 0;
BA_ "GenSigTimeoutTime_VDCM" SG_ 1031 AC_LnHi 0;
BA_ "GenSigTimeoutTime_HCP" SG_ 2564486468 N_PDU_18DAF544 0;
BA_ "GenSigTimeoutTime_PPIM" SG_ 2564486468 N_PDU_18DAF544 0;
BA_ "GenSigTimeoutTime_APM2" SG_ 2564486468 N_PDU_18DAF544 0;
BA_ "GenSigTimeoutTime_VDCM" SG_ 2564486468 N_PDU_18DAF544 0;
BA_ "GenSigTimeoutTime_BPCM" SG_ 2564486468 N_PDU_18DAF544 0;
BA_ "GenSigTimeoutTime_EVCU2" SG_ 2564486468 N_PDU_18DAF544 0;
BA_ "GenSigTimeoutTime_IDCM" SG_ 2564486468 N_PDU_18DAF544 0;
BA_ "GenSigTimeoutTime_SGW" SG_ 2564486468 N_PDU_18DAF544 0;
BA_ "GenSigTimeoutTime_PPIM" SG_ 2654814269 ECU_APPL_FD_BPCM 0;
BA_ "GenSigTimeoutTime_BPCM" SG_ 2654814269 ECU_APPL_FD_BPCM 0;
BA_ "GenSigTimeoutTime_EVCU2" SG_ 2654814269 ECU_APPL_FD_BPCM 0;
BA_ "GenSigTimeoutTime_IDCM" SG_ 2654814269 ECU_APPL_FD_BPCM 0;
BA_ "GenSigTimeoutTime_SGW" SG_ 2654814269 ECU_APPL_FD_BPCM 0;
BA_ "GenSigTimeoutTime_VDCM" SG_ 253 APM2_RecoveryAction 0;
BA_ "GenSigTimeoutTime_APM2" SG_ 253 APM2_RecoveryAction 0;
BA_ "GenSigTimeoutTime_BPCM" SG_ 253 APM2_RecoveryAction 0;
BA_ "GenSigTimeoutTime_IDCM" SG_ 253 APM2_RecoveryAction 0;
BA_ "GenSigTimeoutTime_SGW" SG_ 253 APM2_RecoveryAction 0;
BA_ "GenSigTimeoutTime_APM2" SG_ 253 VltgChgEVSE 0;
BA_ "GenSigTimeoutTime_BPCM" SG_ 253 VltgChgEVSE 0;
BA_ "GenSigTimeoutTime_IDCM" SG_ 253 VltgChgEVSE 0;
BA_ "GenSigTimeoutTime_SGW" SG_ 253 VltgChgEVSE 0;
BA_ "GenSigTimeoutTime_VDCM" SG_ 253 VltgChgEVSE 0;
BA_ "GenSigTimeoutTime_VDCM" SG_ 253 PwrEff 0;
BA_ "GenSigTimeoutTime_APM2" SG_ 253 PwrEff 0;
BA_ "GenSigTimeoutTime_BPCM" SG_ 253 PwrEff 0;
BA_ "GenSigTimeoutTime_IDCM" SG_ 253 PwrEff 0;
BA_ "GenSigTimeoutTime_SGW" SG_ 253 PwrEff 0;
BA_ "GenSigTimeoutTime_VDCM" SG_ 253 CurrEVSE 0;
BA_ "GenSigTimeoutTime_APM2" SG_ 253 CurrEVSE 0;
BA_ "GenSigStartValue" SG_ 253 CurrEVSE 8150;
BA_ "GenSigTimeoutTime_BPCM" SG_ 253 CurrEVSE 0;
BA_ "GenSigTimeoutTime_IDCM" SG_ 253 CurrEVSE 0;
BA_ "GenSigTimeoutTime_SGW" SG_ 253 CurrEVSE 0;
BA_ "GenSigTimeoutTime_VDCM" SG_ 253 APM2_DcChEnaSts_Fdbk 0;
BA_ "GenSigTimeoutTime_APM2" SG_ 253 APM2_DcChEnaSts_Fdbk 0;
BA_ "GenSigTimeoutTime_BPCM" SG_ 253 APM2_DcChEnaSts_Fdbk 0;
BA_ "GenSigTimeoutTime_IDCM" SG_ 253 APM2_DcChEnaSts_Fdbk 0;
BA_ "GenSigTimeoutTime_SGW" SG_ 253 APM2_DcChEnaSts_Fdbk 0;
BA_ "GenSigTimeoutTime_VDCM" SG_ 253 APM2_DeratRsnSts 0;
BA_ "GenSigTimeoutTime_APM2" SG_ 253 APM2_DeratRsnSts 0;
BA_ "GenSigTimeoutTime_BPCM" SG_ 253 APM2_DeratRsnSts 0;
BA_ "GenSigTimeoutTime_IDCM" SG_ 253 APM2_DeratRsnSts 0;
BA_ "GenSigTimeoutTime_SGW" SG_ 253 APM2_DeratRsnSts 0;
BA_ "GenSigTimeoutTime_VDCM" SG_ 253 APM2_FaultSts 0;
BA_ "GenSigTimeoutTime_APM2" SG_ 253 APM2_FaultSts 0;
BA_ "GenSigTimeoutTime_BPCM" SG_ 253 APM2_FaultSts 0;
BA_ "GenSigTimeoutTime_IDCM" SG_ 253 APM2_FaultSts 0;
BA_ "GenSigTimeoutTime_SGW" SG_ 253 APM2_FaultSts 0;
BA_ "GenSigTimeoutTime_VDCM" SG_ 253 APM2_HVChrgBusCurrent 0;
BA_ "GenSigTimeoutTime_APM2" SG_ 253 APM2_HVChrgBusCurrent 0;
BA_ "GenSigStartValue" SG_ 253 APM2_HVChrgBusCurrent 8150;
BA_ "GenSigTimeoutTime_BPCM" SG_ 253 APM2_HVChrgBusCurrent 0;
BA_ "GenSigTimeoutTime_IDCM" SG_ 253 APM2_HVChrgBusCurrent 0;
BA_ "GenSigTimeoutTime_SGW" SG_ 253 APM2_HVChrgBusCurrent 0;
BA_ "GenSigTimeoutTime_VDCM" SG_ 253 APM2_HVChrgBusVoltage 0;
BA_ "GenSigTimeoutTime_APM2" SG_ 253 APM2_HVChrgBusVoltage 0;
BA_ "GenSigTimeoutTime_BPCM" SG_ 253 APM2_HVChrgBusVoltage 0;
BA_ "GenSigTimeoutTime_IDCM" SG_ 253 APM2_HVChrgBusVoltage 0;
BA_ "GenSigTimeoutTime_SGW" SG_ 253 APM2_HVChrgBusVoltage 0;
BA_ "GenSigTimeoutTime_VDCM" SG_ 253 APM2_ModeSts_Fbk 0;
BA_ "GenSigTimeoutTime_APM2" SG_ 253 APM2_ModeSts_Fbk 0;
BA_ "GenSigTimeoutTime_BPCM" SG_ 253 APM2_ModeSts_Fbk 0;
BA_ "GenSigTimeoutTime_IDCM" SG_ 253 APM2_ModeSts_Fbk 0;
BA_ "GenSigTimeoutTime_SGW" SG_ 253 APM2_ModeSts_Fbk 0;
BA_ "GenSigTimeoutTime_VDCM" SG_ 253 APM2InterlockSts 0;
BA_ "GenSigTimeoutTime_APM2" SG_ 253 APM2InterlockSts 0;
BA_ "GenSigTimeoutTime_BPCM" SG_ 253 APM2InterlockSts 0;
BA_ "GenSigTimeoutTime_IDCM" SG_ 253 APM2InterlockSts 0;
BA_ "GenSigTimeoutTime_SGW" SG_ 253 APM2InterlockSts 0;
BA_ "GenSigTimeoutTime_VDCM" SG_ 1893 HVBatModuleVoltage_NumMin 0;
BA_ "GenSigTimeoutTime_VDCM" SG_ 1893 HVBatModuleTemp_51 0;
BA_ "GenSigTimeoutTime_VDCM" SG_ 1893 HVBatModuleTemp_52 0;
BA_ "GenSigTimeoutTime_VDCM" SG_ 1893 HVBatModuleTemp_53 0;
BA_ "GenSigTimeoutTime_VDCM" SG_ 1893 HVBatModuleVoltage_NumMax 0;
BA_ "GenSigTimeoutTime_VDCM" SG_ 1893 HVBatModuleTemp_43 0;
BA_ "GenSigTimeoutTime_VDCM" SG_ 1893 HVBatModuleTemp_44 0;
BA_ "GenSigTimeoutTime_VDCM" SG_ 1893 HVBatModuleTemp_45 0;
BA_ "GenSigTimeoutTime_VDCM" SG_ 1893 HVBatModuleTemp_46 0;
BA_ "GenSigTimeoutTime_VDCM" SG_ 1893 HVBatModuleTemp_47 0;
BA_ "GenSigTimeoutTime_VDCM" SG_ 1893 HVBatModuleTemp_48 0;
BA_ "GenSigTimeoutTime_VDCM" SG_ 1893 HVBatModuleTemp_49 0;
BA_ "GenSigTimeoutTime_VDCM" SG_ 1893 HVBatModuleTemp_50 0;
BA_ "GenSigTimeoutTime_VDCM" SG_ 253 VltgChgInt 0;
BA_ "GenSigTimeoutTime_APM2" SG_ 253 VltgChgInt 0;
BA_ "GenSigTimeoutTime_BPCM" SG_ 253 VltgChgInt 0;
BA_ "GenSigTimeoutTime_IDCM" SG_ 253 VltgChgInt 0;
BA_ "GenSigTimeoutTime_SGW" SG_ 253 VltgChgInt 0;
BA_ "GenSigTimeoutTime_IDCM" SG_ 253 APM2_K6_WldgDtnSts 0;
BA_ "GenSigTimeoutTime_SGW" SG_ 253 APM2_K6_WldgDtnSts 0;
BA_ "GenSigTimeoutTime_VDCM" SG_ 253 APM2_K6_WldgDtnSts 0;
BA_ "GenSigTimeoutTime_APM2" SG_ 253 APM2_K6_WldgDtnSts 0;
BA_ "GenSigTimeoutTime_BPCM" SG_ 253 APM2_K6_WldgDtnSts 0;
BA_ "GenSigTimeoutTime_APM2" SG_ 253 APM2_K7_WldgDtnSts 0;
BA_ "GenSigTimeoutTime_BPCM" SG_ 253 APM2_K7_WldgDtnSts 0;
BA_ "GenSigTimeoutTime_IDCM" SG_ 253 APM2_K7_WldgDtnSts 0;
BA_ "GenSigTimeoutTime_SGW" SG_ 253 APM2_K7_WldgDtnSts 0;
BA_ "GenSigTimeoutTime_VDCM" SG_ 253 APM2_K7_WldgDtnSts 0;
BA_ "GenSigTimeoutTime_VDCM" SG_ 253 APM2_TempInlet 0;
BA_ "GenSigTimeoutTime_APM2" SG_ 253 APM2_TempInlet 0;
BA_ "GenSigTimeoutTime_BPCM" SG_ 253 APM2_TempInlet 0;
BA_ "GenSigTimeoutTime_IDCM" SG_ 253 APM2_TempInlet 0;
BA_ "GenSigTimeoutTime_SGW" SG_ 253 APM2_TempInlet 0;
BA_ "GenSigTimeoutTime_VDCM" SG_ 1893 HVBatModuleTemp_42 0;
BA_ "GenSigTimeoutTime_VDCM" SG_ 1893 HVBatModuleTemp_39 0;
BA_ "GenSigTimeoutTime_VDCM" SG_ 1893 HVBatModuleTemp_40 0;
BA_ "GenSigTimeoutTime_VDCM" SG_ 1893 HVBatModuleTemp_41 0;
BA_ "GenSigTimeoutTime_VDCM" SG_ 1893 HVBatModuleTemp_54 0;
BA_ "GenSigTimeoutTime_VDCM" SG_ 1893 HVBatModuleTemp_55 0;
BA_ "GenSigTimeoutTime_VDCM" SG_ 1893 HVBatModuleTemp_56 0;
BA_ "GenSigTimeoutTime_VDCM" SG_ 1893 HVBatModuleTemp_57 0;
BA_ "GenSigTimeoutTime_VDCM" SG_ 1893 HVBatModuleTemp_58 0;
BA_ "GenSigTimeoutTime_VDCM" SG_ 1893 HVBatModuleTemp_59 0;
BA_ "GenSigTimeoutTime_VDCM" SG_ 1893 HVBatModuleTemp_60 0;
BA_ "GenSigTimeoutTime_VDCM" SG_ 253 APM2_TempMargin 0;
BA_ "GenSigTimeoutTime_APM2" SG_ 253 APM2_TempMargin 0;
BA_ "GenSigStartValue" SG_ 253 APM2_TempMargin 64;
BA_ "GenSigTimeoutTime_BPCM" SG_ 253 APM2_TempMargin 0;
BA_ "GenSigTimeoutTime_IDCM" SG_ 253 APM2_TempMargin 0;
BA_ "GenSigTimeoutTime_SGW" SG_ 253 APM2_TempMargin 0;
BA_ "GenSigTimeoutTime_VDCM" SG_ 253 APM2_TempL1 0;
BA_ "GenSigTimeoutTime_APM2" SG_ 253 APM2_TempL1 0;
BA_ "GenSigStartValue" SG_ 253 APM2_TempL1 60;
BA_ "GenSigTimeoutTime_BPCM" SG_ 253 APM2_TempL1 0;
BA_ "GenSigTimeoutTime_IDCM" SG_ 253 APM2_TempL1 0;
BA_ "GenSigTimeoutTime_SGW" SG_ 253 APM2_TempL1 0;
BA_ "GenSigTimeoutTime_VDCM" SG_ 253 APM2_TempL2 0;
BA_ "GenSigTimeoutTime_APM2" SG_ 253 APM2_TempL2 0;
BA_ "GenSigStartValue" SG_ 253 APM2_TempL2 60;
BA_ "GenSigTimeoutTime_BPCM" SG_ 253 APM2_TempL2 0;
BA_ "GenSigTimeoutTime_IDCM" SG_ 253 APM2_TempL2 0;
BA_ "GenSigTimeoutTime_SGW" SG_ 253 APM2_TempL2 0;
BA_ "GenSigTimeoutTime_VDCM" SG_ 253 APM2_BoostSwitchSts 0;
BA_ "GenSigTimeoutTime_APM2" SG_ 253 APM2_BoostSwitchSts 0;
BA_ "GenSigTimeoutTime_BPCM" SG_ 253 APM2_BoostSwitchSts 0;
BA_ "GenSigTimeoutTime_IDCM" SG_ 253 APM2_BoostSwitchSts 0;
BA_ "GenSigTimeoutTime_SGW" SG_ 253 APM2_BoostSwitchSts 0;
BA_ "GenSigTimeoutTime_VDCM" SG_ 253 APM2_DisChargedSts_Fdbk 0;
BA_ "GenSigTimeoutTime_APM2" SG_ 253 APM2_DisChargedSts_Fdbk 0;
BA_ "GenSigTimeoutTime_BPCM" SG_ 253 APM2_DisChargedSts_Fdbk 0;
BA_ "GenSigTimeoutTime_IDCM" SG_ 253 APM2_DisChargedSts_Fdbk 0;
BA_ "GenSigTimeoutTime_SGW" SG_ 253 APM2_DisChargedSts_Fdbk 0;
BA_ "GenSigTimeoutTime_VDCM" SG_ 253 APM2_ContactorFault 0;
BA_ "GenSigTimeoutTime_APM2" SG_ 253 APM2_ContactorFault 0;
BA_ "GenSigStartValue" SG_ 253 APM2_ContactorFault 2;
BA_ "GenSigTimeoutTime_BPCM" SG_ 253 APM2_ContactorFault 0;
BA_ "GenSigTimeoutTime_SGW" SG_ 253 APM2_ContactorFault 0;
BA_ "GenSigTimeoutTime_VDCM" SG_ 253 APM2_ErrorWord 0;
BA_ "GenSigTimeoutTime_APM2" SG_ 253 APM2_ErrorWord 0;
BA_ "GenSigTimeoutTime_BPCM" SG_ 253 APM2_ErrorWord 0;
BA_ "GenSigTimeoutTime_IDCM" SG_ 253 APM2_ErrorWord 0;
BA_ "GenSigTimeoutTime_SGW" SG_ 253 APM2_ErrorWord 0;
BA_ "GenSigTimeoutTime_VDCM" SG_ 253 APM2_IInpMaxCnvr 0;
BA_ "GenSigTimeoutTime_APM2" SG_ 253 APM2_IInpMaxCnvr 0;
BA_ "GenSigStartValue" SG_ 253 APM2_IInpMaxCnvr 8150;
BA_ "GenSigTimeoutTime_BPCM" SG_ 253 APM2_IInpMaxCnvr 0;
BA_ "GenSigTimeoutTime_IDCM" SG_ 253 APM2_IInpMaxCnvr 0;
BA_ "GenSigTimeoutTime_SGW" SG_ 253 APM2_IInpMaxCnvr 0;
BA_ "GenSigTimeoutTime_VDCM" SG_ 253 APM2_Service_Lamp_Request 0;
BA_ "GenSigTimeoutTime_APM2" SG_ 253 APM2_Service_Lamp_Request 0;
BA_ "GenSigTimeoutTime_BPCM" SG_ 253 APM2_Service_Lamp_Request 0;
BA_ "GenSigTimeoutTime_IDCM" SG_ 253 APM2_Service_Lamp_Request 0;
BA_ "GenSigTimeoutTime_SGW" SG_ 253 APM2_Service_Lamp_Request 0;
BA_ "GenSigTimeoutTime_VDCM" SG_ 253 APM2_TempFET1 0;
BA_ "GenSigTimeoutTime_APM2" SG_ 253 APM2_TempFET1 0;
BA_ "GenSigStartValue" SG_ 253 APM2_TempFET1 60;
BA_ "GenSigTimeoutTime_BPCM" SG_ 253 APM2_TempFET1 0;
BA_ "GenSigTimeoutTime_IDCM" SG_ 253 APM2_TempFET1 0;
BA_ "GenSigTimeoutTime_SGW" SG_ 253 APM2_TempFET1 0;
BA_ "GenSigTimeoutTime_VDCM" SG_ 253 APM2_TempFET2 0;
BA_ "GenSigTimeoutTime_APM2" SG_ 253 APM2_TempFET2 0;
BA_ "GenSigStartValue" SG_ 253 APM2_TempFET2 60;
BA_ "GenSigTimeoutTime_BPCM" SG_ 253 APM2_TempFET2 0;
BA_ "GenSigTimeoutTime_IDCM" SG_ 253 APM2_TempFET2 0;
BA_ "GenSigTimeoutTime_SGW" SG_ 253 APM2_TempFET2 0;
BA_ "GenSigTimeoutTime_VDCM" SG_ 253 APM2_TempInt 0;
BA_ "GenSigTimeoutTime_APM2" SG_ 253 APM2_TempInt 0;
BA_ "GenSigStartValue" SG_ 253 APM2_TempInt 60;
BA_ "GenSigTimeoutTime_BPCM" SG_ 253 APM2_TempInt 0;
BA_ "GenSigTimeoutTime_IDCM" SG_ 253 APM2_TempInt 0;
BA_ "GenSigTimeoutTime_SGW" SG_ 253 APM2_TempInt 0;
BA_ "GenSigTimeoutTime_APM2" SG_ 1893 HVBatModuleTemp_60 0;
BA_ "GenSigTimeoutTime_BPCM" SG_ 1893 HVBatModuleTemp_60 0;
BA_ "GenSigTimeoutTime_EVCU2" SG_ 1893 HVBatModuleTemp_60 0;
BA_ "GenSigTimeoutTime_IDCM" SG_ 1893 HVBatModuleTemp_60 0;
BA_ "GenSigTimeoutTime_APM2" SG_ 1893 HVBatModuleTemp_59 0;
BA_ "GenSigTimeoutTime_BPCM" SG_ 1893 HVBatModuleTemp_59 0;
BA_ "GenSigTimeoutTime_EVCU2" SG_ 1893 HVBatModuleTemp_59 0;
BA_ "GenSigTimeoutTime_IDCM" SG_ 1893 HVBatModuleTemp_59 0;
BA_ "GenSigTimeoutTime_APM2" SG_ 1893 HVBatModuleTemp_58 0;
BA_ "GenSigTimeoutTime_BPCM" SG_ 1893 HVBatModuleTemp_58 0;
BA_ "GenSigTimeoutTime_EVCU2" SG_ 1893 HVBatModuleTemp_58 0;
BA_ "GenSigTimeoutTime_IDCM" SG_ 1893 HVBatModuleTemp_58 0;
BA_ "GenSigTimeoutTime_APM2" SG_ 1893 HVBatModuleTemp_57 0;
BA_ "GenSigTimeoutTime_BPCM" SG_ 1893 HVBatModuleTemp_57 0;
BA_ "GenSigTimeoutTime_EVCU2" SG_ 1893 HVBatModuleTemp_57 0;
BA_ "GenSigTimeoutTime_IDCM" SG_ 1893 HVBatModuleTemp_57 0;
BA_ "GenSigTimeoutTime_VDCM" SG_ 1893 HVBatModuleTemp_61 0;
BA_ "GenSigTimeoutTime_APM2" SG_ 1893 HVBatModuleTemp_61 0;
BA_ "GenSigTimeoutTime_BPCM" SG_ 1893 HVBatModuleTemp_61 0;
BA_ "GenSigTimeoutTime_EVCU2" SG_ 1893 HVBatModuleTemp_61 0;
BA_ "GenSigTimeoutTime_IDCM" SG_ 1893 HVBatModuleTemp_61 0;
BA_ "GenSigTimeoutTime_VDCM" SG_ 1893 HVBatModuleTemp_62 0;
BA_ "GenSigTimeoutTime_APM2" SG_ 1893 HVBatModuleTemp_62 0;
BA_ "GenSigTimeoutTime_BPCM" SG_ 1893 HVBatModuleTemp_62 0;
BA_ "GenSigTimeoutTime_EVCU2" SG_ 1893 HVBatModuleTemp_62 0;
BA_ "GenSigTimeoutTime_IDCM" SG_ 1893 HVBatModuleTemp_62 0;
BA_ "GenSigTimeoutTime_VDCM" SG_ 1893 HVBatModuleTemp_63 0;
BA_ "GenSigTimeoutTime_APM2" SG_ 1893 HVBatModuleTemp_63 0;
BA_ "GenSigTimeoutTime_BPCM" SG_ 1893 HVBatModuleTemp_63 0;
BA_ "GenSigTimeoutTime_EVCU2" SG_ 1893 HVBatModuleTemp_63 0;
BA_ "GenSigTimeoutTime_IDCM" SG_ 1893 HVBatModuleTemp_63 0;
BA_ "GenSigTimeoutTime_VDCM" SG_ 1893 HVBatModuleTemp_64 0;
BA_ "GenSigTimeoutTime_APM2" SG_ 1893 HVBatModuleTemp_64 0;
BA_ "GenSigTimeoutTime_BPCM" SG_ 1893 HVBatModuleTemp_64 0;
BA_ "GenSigTimeoutTime_EVCU2" SG_ 1893 HVBatModuleTemp_64 0;
BA_ "GenSigTimeoutTime_IDCM" SG_ 1893 HVBatModuleTemp_64 0;
BA_ "GenSigTimeoutTime_VDCM" SG_ 1893 HVBatModuleTemp_65 0;
BA_ "GenSigTimeoutTime_APM2" SG_ 1893 HVBatModuleTemp_65 0;
BA_ "GenSigTimeoutTime_BPCM" SG_ 1893 HVBatModuleTemp_65 0;
BA_ "GenSigTimeoutTime_EVCU2" SG_ 1893 HVBatModuleTemp_65 0;
BA_ "GenSigTimeoutTime_IDCM" SG_ 1893 HVBatModuleTemp_65 0;
BA_ "GenSigTimeoutTime_VDCM" SG_ 1893 HVBatModuleTemp_66 0;
BA_ "GenSigTimeoutTime_APM2" SG_ 1893 HVBatModuleTemp_66 0;
BA_ "GenSigTimeoutTime_BPCM" SG_ 1893 HVBatModuleTemp_66 0;
BA_ "GenSigTimeoutTime_EVCU2" SG_ 1893 HVBatModuleTemp_66 0;
BA_ "GenSigTimeoutTime_IDCM" SG_ 1893 HVBatModuleTemp_66 0;
BA_ "GenSigTimeoutTime_APM2" SG_ 1893 HVBatModuleTemp_56 0;
BA_ "GenSigTimeoutTime_BPCM" SG_ 1893 HVBatModuleTemp_56 0;
BA_ "GenSigTimeoutTime_EVCU2" SG_ 1893 HVBatModuleTemp_56 0;
BA_ "GenSigTimeoutTime_IDCM" SG_ 1893 HVBatModuleTemp_56 0;
BA_ "GenSigTimeoutTime_APM2" SG_ 1893 HVBatModuleTemp_55 0;
BA_ "GenSigTimeoutTime_BPCM" SG_ 1893 HVBatModuleTemp_55 0;
BA_ "GenSigTimeoutTime_EVCU2" SG_ 1893 HVBatModuleTemp_55 0;
BA_ "GenSigTimeoutTime_IDCM" SG_ 1893 HVBatModuleTemp_55 0;
BA_ "GenSigTimeoutTime_APM2" SG_ 1893 HVBatModuleTemp_54 0;
BA_ "GenSigTimeoutTime_BPCM" SG_ 1893 HVBatModuleTemp_54 0;
BA_ "GenSigTimeoutTime_EVCU2" SG_ 1893 HVBatModuleTemp_54 0;
BA_ "GenSigTimeoutTime_IDCM" SG_ 1893 HVBatModuleTemp_54 0;
BA_ "GenSigTimeoutTime_APM2" SG_ 1893 HVBatModuleTemp_41 0;
BA_ "GenSigTimeoutTime_BPCM" SG_ 1893 HVBatModuleTemp_41 0;
BA_ "GenSigTimeoutTime_EVCU2" SG_ 1893 HVBatModuleTemp_41 0;
BA_ "GenSigTimeoutTime_IDCM" SG_ 1893 HVBatModuleTemp_41 0;
BA_ "GenSigTimeoutTime_APM2" SG_ 1893 HVBatModuleTemp_40 0;
BA_ "GenSigTimeoutTime_BPCM" SG_ 1893 HVBatModuleTemp_40 0;
BA_ "GenSigTimeoutTime_EVCU2" SG_ 1893 HVBatModuleTemp_40 0;
BA_ "GenSigTimeoutTime_IDCM" SG_ 1893 HVBatModuleTemp_40 0;
BA_ "GenSigTimeoutTime_APM2" SG_ 1893 HVBatModuleTemp_39 0;
BA_ "GenSigTimeoutTime_BPCM" SG_ 1893 HVBatModuleTemp_39 0;
BA_ "GenSigTimeoutTime_EVCU2" SG_ 1893 HVBatModuleTemp_39 0;
BA_ "GenSigTimeoutTime_IDCM" SG_ 1893 HVBatModuleTemp_39 0;
BA_ "GenSigTimeoutTime_APM2" SG_ 1893 HVBatModuleTemp_42 0;
BA_ "GenSigTimeoutTime_BPCM" SG_ 1893 HVBatModuleTemp_42 0;
BA_ "GenSigTimeoutTime_EVCU2" SG_ 1893 HVBatModuleTemp_42 0;
BA_ "GenSigTimeoutTime_IDCM" SG_ 1893 HVBatModuleTemp_42 0;
BA_ "GenSigTimeoutTime_APM2" SG_ 1893 HVBatModuleTemp_50 0;
BA_ "GenSigTimeoutTime_BPCM" SG_ 1893 HVBatModuleTemp_50 0;
BA_ "GenSigTimeoutTime_EVCU2" SG_ 1893 HVBatModuleTemp_50 0;
BA_ "GenSigTimeoutTime_IDCM" SG_ 1893 HVBatModuleTemp_50 0;
BA_ "GenSigTimeoutTime_APM2" SG_ 1893 HVBatModuleTemp_49 0;
BA_ "GenSigTimeoutTime_BPCM" SG_ 1893 HVBatModuleTemp_49 0;
BA_ "GenSigTimeoutTime_EVCU2" SG_ 1893 HVBatModuleTemp_49 0;
BA_ "GenSigTimeoutTime_IDCM" SG_ 1893 HVBatModuleTemp_49 0;
BA_ "GenSigTimeoutTime_APM2" SG_ 1893 HVBatModuleTemp_48 0;
BA_ "GenSigTimeoutTime_BPCM" SG_ 1893 HVBatModuleTemp_48 0;
BA_ "GenSigTimeoutTime_EVCU2" SG_ 1893 HVBatModuleTemp_48 0;
BA_ "GenSigTimeoutTime_IDCM" SG_ 1893 HVBatModuleTemp_48 0;
BA_ "GenSigTimeoutTime_APM2" SG_ 1893 HVBatModuleTemp_47 0;
BA_ "GenSigTimeoutTime_BPCM" SG_ 1893 HVBatModuleTemp_47 0;
BA_ "GenSigTimeoutTime_EVCU2" SG_ 1893 HVBatModuleTemp_47 0;
BA_ "GenSigTimeoutTime_IDCM" SG_ 1893 HVBatModuleTemp_47 0;
BA_ "GenSigTimeoutTime_APM2" SG_ 1893 HVBatModuleTemp_46 0;
BA_ "GenSigTimeoutTime_BPCM" SG_ 1893 HVBatModuleTemp_46 0;
BA_ "GenSigTimeoutTime_EVCU2" SG_ 1893 HVBatModuleTemp_46 0;
BA_ "GenSigTimeoutTime_IDCM" SG_ 1893 HVBatModuleTemp_46 0;
BA_ "GenSigTimeoutTime_APM2" SG_ 1893 HVBatModuleTemp_45 0;
BA_ "GenSigTimeoutTime_BPCM" SG_ 1893 HVBatModuleTemp_45 0;
BA_ "GenSigTimeoutTime_EVCU2" SG_ 1893 HVBatModuleTemp_45 0;
BA_ "GenSigTimeoutTime_IDCM" SG_ 1893 HVBatModuleTemp_45 0;
BA_ "GenSigTimeoutTime_APM2" SG_ 1893 HVBatModuleTemp_44 0;
BA_ "GenSigTimeoutTime_BPCM" SG_ 1893 HVBatModuleTemp_44 0;
BA_ "GenSigTimeoutTime_EVCU2" SG_ 1893 HVBatModuleTemp_44 0;
BA_ "GenSigTimeoutTime_IDCM" SG_ 1893 HVBatModuleTemp_44 0;
BA_ "GenSigTimeoutTime_APM2" SG_ 1893 HVBatModuleTemp_43 0;
BA_ "GenSigTimeoutTime_BPCM" SG_ 1893 HVBatModuleTemp_43 0;
BA_ "GenSigTimeoutTime_EVCU2" SG_ 1893 HVBatModuleTemp_43 0;
BA_ "GenSigTimeoutTime_IDCM" SG_ 1893 HVBatModuleTemp_43 0;
BA_ "GenSigTimeoutTime_APM2" SG_ 1893 HVBatModuleVoltage_NumMax 0;
BA_ "GenSigTimeoutTime_BPCM" SG_ 1893 HVBatModuleVoltage_NumMax 0;
BA_ "GenSigTimeoutTime_EVCU2" SG_ 1893 HVBatModuleVoltage_NumMax 0;
BA_ "GenSigTimeoutTime_IDCM" SG_ 1893 HVBatModuleVoltage_NumMax 0;
BA_ "GenSigTimeoutTime_SGW" SG_ 1893 HVBatModuleVoltage_NumMax 0;
BA_ "GenSigTimeoutTime_APM2" SG_ 1893 HVBatModuleTemp_53 0;
BA_ "GenSigTimeoutTime_BPCM" SG_ 1893 HVBatModuleTemp_53 0;
BA_ "GenSigTimeoutTime_EVCU2" SG_ 1893 HVBatModuleTemp_53 0;
BA_ "GenSigTimeoutTime_IDCM" SG_ 1893 HVBatModuleTemp_53 0;
BA_ "GenSigTimeoutTime_APM2" SG_ 1893 HVBatModuleTemp_52 0;
BA_ "GenSigTimeoutTime_BPCM" SG_ 1893 HVBatModuleTemp_52 0;
BA_ "GenSigTimeoutTime_EVCU2" SG_ 1893 HVBatModuleTemp_52 0;
BA_ "GenSigTimeoutTime_IDCM" SG_ 1893 HVBatModuleTemp_52 0;
BA_ "GenSigTimeoutTime_APM2" SG_ 1893 HVBatModuleTemp_51 0;
BA_ "GenSigTimeoutTime_BPCM" SG_ 1893 HVBatModuleTemp_51 0;
BA_ "GenSigTimeoutTime_EVCU2" SG_ 1893 HVBatModuleTemp_51 0;
BA_ "GenSigTimeoutTime_IDCM" SG_ 1893 HVBatModuleTemp_51 0;
BA_ "GenSigTimeoutTime_APM2" SG_ 1893 HVBatModuleVoltage_NumMin 0;
BA_ "GenSigTimeoutTime_BPCM" SG_ 1893 HVBatModuleVoltage_NumMin 0;
BA_ "GenSigTimeoutTime_EVCU2" SG_ 1893 HVBatModuleVoltage_NumMin 0;
BA_ "GenSigTimeoutTime_IDCM" SG_ 1893 HVBatModuleVoltage_NumMin 0;
BA_ "GenSigTimeoutTime_SGW" SG_ 1893 HVBatModuleVoltage_NumMin 0;
BA_ "GenSigTimeoutTime_HCP" SG_ 292 BPCM_HV_ThermalRunaway 0;
BA_ "GenSigTimeoutTime_PPIM" SG_ 292 BPCM_HV_ThermalRunaway 0;
BA_ "GenSigTimeoutTime_APM2" SG_ 292 BPCM_HV_ThermalRunaway 0;
BA_ "GenSigTimeoutTime_VDCM" SG_ 292 BPCM_HV_ThermalRunaway 0;
BA_ "GenSigTimeoutTime_HCP" SG_ 292 BPCM_Wakeup_Request 0;
BA_ "GenSigTimeoutTime_PPIM" SG_ 292 BPCM_Wakeup_Request 0;
BA_ "GenSigTimeoutTime_APM2" SG_ 292 BPCM_Wakeup_Request 0;
BA_ "GenSigTimeoutTime_VDCM" SG_ 292 BPCM_Wakeup_Request 0;
BA_ "GenSigTimeoutTime_HCP" SG_ 292 HVBP_Busbar_Temp 0;
BA_ "GenSigTimeoutTime_PPIM" SG_ 292 HVBP_Busbar_Temp 0;
BA_ "GenSigTimeoutTime_APM2" SG_ 292 HVBP_Busbar_Temp 0;
BA_ "GenSigTimeoutTime_VDCM" SG_ 292 HVBP_Busbar_Temp 0;
BA_ "GenSigTimeoutTime_HCP" SG_ 292 HVBP_BDU_Busbar_Temp 0;
BA_ "GenSigTimeoutTime_PPIM" SG_ 292 HVBP_BDU_Busbar_Temp 0;
BA_ "GenSigTimeoutTime_APM2" SG_ 292 HVBP_BDU_Busbar_Temp 0;
BA_ "GenSigTimeoutTime_VDCM" SG_ 292 HVBP_BDU_Busbar_Temp 0;
BA_ "GenSigTimeoutTime_HCP" SG_ 292 BPCM_HV_InternalVoltageString2 0;
BA_ "GenSigTimeoutTime_PPIM" SG_ 292 BPCM_HV_InternalVoltageString2 0;
BA_ "GenSigTimeoutTime_BPCM" SG_ 292 BPCM_HV_InternalVoltageString2 0;
BA_ "GenSigTimeoutTime_IDCM" SG_ 292 BPCM_HV_InternalVoltageString2 0;
BA_ "GenSigTimeoutTime_SGW" SG_ 292 BPCM_HV_InternalVoltageString2 0;
BA_ "GenSigTimeoutTime_HCP" SG_ 292 BPCM_HV_InternalVoltageString1 0;
BA_ "GenSigTimeoutTime_PPIM" SG_ 292 BPCM_HV_InternalVoltageString1 0;
BA_ "GenSigTimeoutTime_BPCM" SG_ 292 BPCM_HV_InternalVoltageString1 0;
BA_ "GenSigTimeoutTime_IDCM" SG_ 292 BPCM_HV_InternalVoltageString1 0;
BA_ "GenSigTimeoutTime_SGW" SG_ 292 BPCM_HV_InternalVoltageString1 0;
BA_ "GenSigTimeoutTime_HCP" SG_ 292 BPCM_Series_Voltage 0;
BA_ "GenSigTimeoutTime_PPIM" SG_ 292 BPCM_Series_Voltage 0;
BA_ "GenSigTimeoutTime_BPCM" SG_ 292 BPCM_Series_Voltage 0;
BA_ "GenSigTimeoutTime_IDCM" SG_ 292 BPCM_Series_Voltage 0;
BA_ "GenSigTimeoutTime_SGW" SG_ 292 BPCM_Series_Voltage 0;
BA_ "GenSigTimeoutTime_HCP" SG_ 292 BPCM_HV_Current_String2 0;
BA_ "GenSigTimeoutTime_PPIM" SG_ 292 BPCM_HV_Current_String2 0;
BA_ "GenSigTimeoutTime_BPCM" SG_ 292 BPCM_HV_Current_String2 0;
BA_ "GenSigTimeoutTime_IDCM" SG_ 292 BPCM_HV_Current_String2 0;
BA_ "GenSigTimeoutTime_SGW" SG_ 292 BPCM_HV_Current_String2 0;
BA_ "GenSigTimeoutTime_HCP" SG_ 292 BPCM_HV_DCFC_Isolation_Sts 0;
BA_ "GenSigTimeoutTime_PPIM" SG_ 292 BPCM_HV_DCFC_Isolation_Sts 0;
BA_ "GenSigTimeoutTime_APM2" SG_ 292 BPCM_HV_DCFC_Isolation_Sts 0;
BA_ "GenSigTimeoutTime_VDCM" SG_ 292 BPCM_HV_DCFC_Isolation_Sts 0;
BA_ "GenSigTimeoutTime_HCP" SG_ 292 BPCM_Request_for_Aux_Load_off 0;
BA_ "GenSigTimeoutTime_PPIM" SG_ 292 BPCM_Request_for_Aux_Load_off 0;
BA_ "GenSigTimeoutTime_BPCM" SG_ 292 BPCM_Request_for_Aux_Load_off 0;
BA_ "GenSigTimeoutTime_IDCM" SG_ 292 BPCM_Request_for_Aux_Load_off 0;
BA_ "GenSigTimeoutTime_SGW" SG_ 292 BPCM_Request_for_Aux_Load_off 0;
BA_ "GenSigTimeoutTime_HCP" SG_ 292 BPCM_HV_Trac_Main_Contac_Config 0;
BA_ "GenSigTimeoutTime_PPIM" SG_ 292 BPCM_HV_Trac_Main_Contac_Config 0;
BA_ "GenSigStartValue" SG_ 292 BPCM_HV_Trac_Main_Contac_Config 1;
BA_ "GenSigTimeoutTime_BPCM" SG_ 292 BPCM_HV_Trac_Main_Contac_Config 0;
BA_ "GenSigTimeoutTime_IDCM" SG_ 292 BPCM_HV_Trac_Main_Contac_Config 0;
BA_ "GenSigTimeoutTime_SGW" SG_ 292 BPCM_HV_Trac_Main_Contac_Config 0;
BA_ "GenSigTimeoutTime_HCP" SG_ 292 DC_Charge_Type_Status 0;
BA_ "GenSigTimeoutTime_PPIM" SG_ 292 DC_Charge_Type_Status 0;
BA_ "GenSigTimeoutTime_BPCM" SG_ 292 DC_Charge_Type_Status 0;
BA_ "GenSigTimeoutTime_IDCM" SG_ 292 DC_Charge_Type_Status 0;
BA_ "GenSigTimeoutTime_SGW" SG_ 292 DC_Charge_Type_Status 0;
BA_ "GenSigTimeoutTime_BPCM" SG_ 292 BPCM_HV_DCFC_Isolation_Sts 0;
BA_ "GenSigTimeoutTime_IDCM" SG_ 292 BPCM_HV_DCFC_Isolation_Sts 0;
BA_ "GenSigTimeoutTime_SGW" SG_ 292 BPCM_HV_DCFC_Isolation_Sts 0;
BA_ "GenSigTimeoutTime_BPCM" SG_ 292 HVBP_BDU_Busbar_Temp 0;
BA_ "GenSigTimeoutTime_IDCM" SG_ 292 HVBP_BDU_Busbar_Temp 0;
BA_ "GenSigTimeoutTime_SGW" SG_ 292 HVBP_BDU_Busbar_Temp 0;
BA_ "GenSigTimeoutTime_BPCM" SG_ 292 HVBP_Busbar_Temp 0;
BA_ "GenSigTimeoutTime_IDCM" SG_ 292 HVBP_Busbar_Temp 0;
BA_ "GenSigTimeoutTime_SGW" SG_ 292 HVBP_Busbar_Temp 0;
BA_ "GenSigTimeoutTime_BPCM" SG_ 292 BPCM_HV_Trac_PreCha_Contac_Sts 0;
BA_ "GenSigTimeoutTime_IDCM" SG_ 292 BPCM_HV_Trac_PreCha_Contac_Sts 0;
BA_ "GenSigTimeoutTime_SGW" SG_ 292 BPCM_HV_Trac_PreCha_Contac_Sts 0;
BA_ "GenSigSendType" SG_ 292 BPCM_Wakeup_Request 3;
BA_ "GenSigTimeoutTime_BPCM" SG_ 292 BPCM_Wakeup_Request 0;
BA_ "GenSigTimeoutTime_IDCM" SG_ 292 BPCM_Wakeup_Request 0;
BA_ "GenSigTimeoutTime_SGW" SG_ 292 BPCM_Wakeup_Request 0;
BA_ "GenSigSendType" SG_ 292 BPCM_HV_ThermalRunaway 3;
BA_ "GenSigTimeoutTime_BPCM" SG_ 292 BPCM_HV_ThermalRunaway 0;
BA_ "GenSigTimeoutTime_IDCM" SG_ 292 BPCM_HV_ThermalRunaway 0;
BA_ "GenSigTimeoutTime_SGW" SG_ 292 BPCM_HV_ThermalRunaway 0;
BA_ "GenSigTimeoutTime_BPCM" SG_ 1031 Plug_And_Charge_Contract_Sts 0;
BA_ "GenSigTimeoutTime_EVCU2" SG_ 1031 Plug_And_Charge_Contract_Sts 0;
BA_ "GenSigTimeoutTime_IDCM" SG_ 1031 Plug_And_Charge_Contract_Sts 0;
BA_ "GenSigTimeoutTime_BPCM" SG_ 544 CdM_ExtFun_Relia_Design 0;
BA_ "GenSigTimeoutTime_IDCM" SG_ 544 CdM_ExtFun_Relia_Design 0;
BA_ "GenSigTimeoutTime_SGW" SG_ 544 CdM_ExtFun_Relia_Design 0;
BA_ "GenSigTimeoutTime_BPCM" SG_ 544 CdM_ExtFun_Over_Temp_Trotec_Conn 0;
BA_ "GenSigTimeoutTime_IDCM" SG_ 544 CdM_ExtFun_Over_Temp_Trotec_Conn 0;
BA_ "GenSigTimeoutTime_SGW" SG_ 544 CdM_ExtFun_Over_Temp_Trotec_Conn 0;
BA_ "GenSigTimeoutTime_BPCM" SG_ 544 CdM_ExtFun_Cur_Lim_Conn 0;
BA_ "GenSigTimeoutTime_IDCM" SG_ 544 CdM_ExtFun_Cur_Lim_Conn 0;
BA_ "GenSigTimeoutTime_BPCM" SG_ 544 CdM_ExtFun_Cur_Lim_Cable 0;
BA_ "GenSigTimeoutTime_IDCM" SG_ 544 CdM_ExtFun_Cur_Lim_Cable 0;
BA_ "GenSigTimeoutTime_SGW" SG_ 544 CdM_ExtFun_Cur_Lim_Cable 0;
BA_ "GenSigTimeoutTime_BPCM" SG_ 544 CdM_ExtFun_Cool_Func_Conn 0;
BA_ "GenSigTimeoutTime_IDCM" SG_ 544 CdM_ExtFun_Cool_Func_Conn 0;
BA_ "GenSigTimeoutTime_SGW" SG_ 544 CdM_ExtFun_Cool_Func_Conn 0;
BA_ "GenSigTimeoutTime_BPCM" SG_ 544 CdM_ExtFun_Cool_Func_Cable 0;
BA_ "GenSigTimeoutTime_IDCM" SG_ 544 CdM_ExtFun_Cool_Func_Cable 0;
BA_ "GenSigTimeoutTime_SGW" SG_ 544 CdM_ExtFun_Cool_Func_Cable 0;
BA_ "GenSigTimeoutTime_BPCM" SG_ 544 CdM_ExtFun_Char_HC_Control_Comp 0;
BA_ "GenSigTimeoutTime_IDCM" SG_ 544 CdM_ExtFun_Char_HC_Control_Comp 0;
BA_ "GenSigTimeoutTime_SGW" SG_ 544 CdM_ExtFun_Char_HC_Control_Comp 0;
BA_ "GenSigTimeoutTime_BPCM" SG_ 544 CdM_ExtFun_Reset_Max_Time 0;
BA_ "GenSigTimeoutTime_IDCM" SG_ 544 CdM_ExtFun_Reset_Max_Time 0;
BA_ "GenSigTimeoutTime_SGW" SG_ 544 CdM_ExtFun_Reset_Max_Time 0;
BA_ "GenSigTimeoutTime_BPCM" SG_ 544 CdM_ExtFun_Chr_Dyn_Control_Comp 0;
BA_ "GenSigTimeoutTime_IDCM" SG_ 544 CdM_ExtFun_Chr_Dyn_Control_Comp 0;
BA_ "GenSigTimeoutTime_SGW" SG_ 544 CdM_ExtFun_Chr_Dyn_Control_Comp 0;
BA_ "GenSigTimeoutTime_BPCM" SG_ 544 CdM_ExtFun_Oper_Cond 0;
BA_ "GenSigTimeoutTime_IDCM" SG_ 544 CdM_ExtFun_Oper_Cond 0;
BA_ "GenSigTimeoutTime_SGW" SG_ 544 CdM_ExtFun_Oper_Cond 0;
BA_ "GenSigTimeoutTime_SGW" SG_ 544 CdM_ExtFun_Cur_Lim_Conn 0;
BA_ "GenSigTimeoutTime_HCP" SG_ 544 MessageCounter_OV2 0;
BA_ "GenSigTimeoutTime_PPIM" SG_ 544 MessageCounter_OV2 0;
BA_ "GenSigTimeoutTime_APM2" SG_ 544 MessageCounter_OV2 0;
BA_ "GenSigTimeoutTime_BPCM" SG_ 544 MessageCounter_OV2 0;
BA_ "GenSigTimeoutTime_IDCM" SG_ 544 MessageCounter_OV2 0;
BA_ "GenSigTimeoutTime_SGW" SG_ 544 MessageCounter_OV2 0;
BA_ "GenSigTimeoutTime_HCP" SG_ 544 CRC_OV2 0;
BA_ "GenSigTimeoutTime_PPIM" SG_ 544 CRC_OV2 0;
BA_ "GenSigTimeoutTime_APM2" SG_ 544 CRC_OV2 0;
BA_ "GenSigTimeoutTime_BPCM" SG_ 544 CRC_OV2 0;
BA_ "GenSigTimeoutTime_IDCM" SG_ 544 CRC_OV2 0;
BA_ "GenSigTimeoutTime_SGW" SG_ 544 CRC_OV2 0;
BA_ "GenSigTimeoutTime_HCP" SG_ 544 EVSE_NotificationMaxDelay 0;
BA_ "GenSigTimeoutTime_PPIM" SG_ 544 EVSE_NotificationMaxDelay 0;
BA_ "GenSigTimeoutTime_APM2" SG_ 544 EVSE_NotificationMaxDelay 0;
BA_ "GenSigTimeoutTime_VDCM" SG_ 544 EVSE_NotificationMaxDelay 0;
BA_ "GenSigStartValue" SG_ 544 EVSE_NotificationMaxDelay 1;
BA_ "GenSigTimeoutTime_BPCM" SG_ 544 EVSE_NotificationMaxDelay 0;
BA_ "GenSigTimeoutTime_IDCM" SG_ 544 EVSE_NotificationMaxDelay 0;
BA_ "GenSigTimeoutTime_SGW" SG_ 544 EVSE_NotificationMaxDelay 0;
BA_ "GenSigTimeoutTime_HCP" SG_ 546 MessageCounter_VO2 0;
BA_ "GenSigTimeoutTime_PPIM" SG_ 546 MessageCounter_VO2 0;
BA_ "GenSigTimeoutTime_APM2" SG_ 546 MessageCounter_VO2 0;
BA_ "GenSigTimeoutTime_HCP" SG_ 546 CRC_VO2 0;
BA_ "GenSigTimeoutTime_PPIM" SG_ 546 CRC_VO2 0;
BA_ "GenSigTimeoutTime_APM2" SG_ 546 CRC_VO2 0;
BA_ "GenSigTimeoutTime_HCP" SG_ 546 SelectedSecurityProtocol 0;
BA_ "GenSigTimeoutTime_PPIM" SG_ 546 SelectedSecurityProtocol 0;
BA_ "GenSigTimeoutTime_APM2" SG_ 546 SelectedSecurityProtocol 0;
BA_ "GenSigTimeoutTime_VDCM" SG_ 546 SelectedSecurityProtocol 0;
BA_ "GenSigTimeoutTime_HCP" SG_ 546 SelectedAppProtocol 0;
BA_ "GenSigTimeoutTime_PPIM" SG_ 546 SelectedAppProtocol 0;
BA_ "GenSigTimeoutTime_APM2" SG_ 546 SelectedAppProtocol 0;
BA_ "GenSigTimeoutTime_VDCM" SG_ 546 SelectedAppProtocol 0;
BA_ "GenSigTimeoutTime_BPCM" SG_ 546 SelectedAppProtocol 0;
BA_ "GenSigTimeoutTime_EVCU2" SG_ 546 SelectedAppProtocol 0;
BA_ "GenSigTimeoutTime_SGW" SG_ 546 SelectedAppProtocol 0;
BA_ "GenSigTimeoutTime_BPCM" SG_ 546 SelectedSecurityProtocol 0;
BA_ "GenSigTimeoutTime_EVCU2" SG_ 546 SelectedSecurityProtocol 0;
BA_ "GenSigTimeoutTime_SGW" SG_ 546 SelectedSecurityProtocol 0;
BA_ "GenSigTimeoutTime_EVCU2" SG_ 546 CRC_VO2 0;
BA_ "GenSigTimeoutTime_SGW" SG_ 546 CRC_VO2 0;
BA_ "GenSigTimeoutTime_EVCU2" SG_ 546 MessageCounter_VO2 0;
BA_ "GenSigTimeoutTime_SGW" SG_ 546 MessageCounter_VO2 0;
BA_ "GenSigTimeoutTime_HCP" SG_ 292 BPCM_HV_Battery_GFD_Sts 0;
BA_ "GenSigTimeoutTime_PPIM" SG_ 292 BPCM_HV_Battery_GFD_Sts 0;
BA_ "GenSigTimeoutTime_APM2" SG_ 292 BPCM_HV_Battery_GFD_Sts 0;
BA_ "GenSigTimeoutTime_VDCM" SG_ 292 BPCM_HV_Battery_GFD_Sts 0;
BA_ "GenSigTimeoutTime_HCP" SG_ 292 BPCM_HV_Capacity 0;
BA_ "GenSigTimeoutTime_PPIM" SG_ 292 BPCM_HV_Capacity 0;
BA_ "GenSigTimeoutTime_APM2" SG_ 292 BPCM_HV_Capacity 0;
BA_ "GenSigTimeoutTime_VDCM" SG_ 292 BPCM_HV_Capacity 0;
BA_ "GenSigTimeoutTime_HCP" SG_ 292 BPCM_HV_Current 0;
BA_ "GenSigTimeoutTime_PPIM" SG_ 292 BPCM_HV_Current 0;
BA_ "GenSigTimeoutTime_APM2" SG_ 292 BPCM_HV_Current 0;
BA_ "GenSigTimeoutTime_VDCM" SG_ 292 BPCM_HV_Current 0;
BA_ "GenSigTimeoutTime_HCP" SG_ 292 BPCM_HV_Inlet_Temp 0;
BA_ "GenSigTimeoutTime_PPIM" SG_ 292 BPCM_HV_Inlet_Temp 0;
BA_ "GenSigTimeoutTime_APM2" SG_ 292 BPCM_HV_Inlet_Temp 0;
BA_ "GenSigTimeoutTime_VDCM" SG_ 292 BPCM_HV_Inlet_Temp 0;
BA_ "GenSigTimeoutTime_HCP" SG_ 292 BPCM_HV_InternalVoltage 0;
BA_ "GenSigTimeoutTime_PPIM" SG_ 292 BPCM_HV_InternalVoltage 0;
BA_ "GenSigTimeoutTime_APM2" SG_ 292 BPCM_HV_InternalVoltage 0;
BA_ "GenSigTimeoutTime_VDCM" SG_ 292 BPCM_HV_InternalVoltage 0;
BA_ "GenSigTimeoutTime_HCP" SG_ 292 BPCM_HV_Outlet_Temp 0;
BA_ "GenSigTimeoutTime_PPIM" SG_ 292 BPCM_HV_Outlet_Temp 0;
BA_ "GenSigTimeoutTime_APM2" SG_ 292 BPCM_HV_Outlet_Temp 0;
BA_ "GenSigTimeoutTime_VDCM" SG_ 292 BPCM_HV_Outlet_Temp 0;
BA_ "GenSigTimeoutTime_HCP" SG_ 292 BPCM_HV_SOC 0;
BA_ "GenSigTimeoutTime_PPIM" SG_ 292 BPCM_HV_SOC 0;
BA_ "GenSigTimeoutTime_APM2" SG_ 292 BPCM_HV_SOC 0;
BA_ "GenSigTimeoutTime_VDCM" SG_ 292 BPCM_HV_SOC 0;
BA_ "GenSigTimeoutTime_SGW" SG_ 292 BPCM_HV_SOC 0;
BA_ "GenSigTimeoutTime_HCP" SG_ 292 BPCM_HV_Temperature_Avg 0;
BA_ "GenSigTimeoutTime_PPIM" SG_ 292 BPCM_HV_Temperature_Avg 0;
BA_ "GenSigTimeoutTime_APM2" SG_ 292 BPCM_HV_Temperature_Avg 0;
BA_ "GenSigTimeoutTime_VDCM" SG_ 292 BPCM_HV_Temperature_Avg 0;
BA_ "GenSigTimeoutTime_HCP" SG_ 292 BPCM_HV_Temperature_Min 0;
BA_ "GenSigTimeoutTime_PPIM" SG_ 292 BPCM_HV_Temperature_Min 0;
BA_ "GenSigTimeoutTime_APM2" SG_ 292 BPCM_HV_Temperature_Min 0;
BA_ "GenSigTimeoutTime_VDCM" SG_ 292 BPCM_HV_Temperature_Min 0;
BA_ "GenSigTimeoutTime_HCP" SG_ 292 BPCM_HV_Temperature_Max 0;
BA_ "GenSigTimeoutTime_PPIM" SG_ 292 BPCM_HV_Temperature_Max 0;
BA_ "GenSigTimeoutTime_APM2" SG_ 292 BPCM_HV_Temperature_Max 0;
BA_ "GenSigTimeoutTime_VDCM" SG_ 292 BPCM_HV_Temperature_Max 0;
BA_ "GenSigTimeoutTime_HCP" SG_ 292 BPCM_HV_BatIntrlk_InternalStat 0;
BA_ "GenSigTimeoutTime_PPIM" SG_ 292 BPCM_HV_BatIntrlk_InternalStat 0;
BA_ "GenSigTimeoutTime_APM2" SG_ 292 BPCM_HV_BatIntrlk_InternalStat 0;
BA_ "GenSigTimeoutTime_VDCM" SG_ 292 BPCM_HV_BatIntrlk_InternalStat 0;
BA_ "GenSigTimeoutTime_HCP" SG_ 292 BPCMInterlockSts 0;
BA_ "GenSigTimeoutTime_PPIM" SG_ 292 BPCMInterlockSts 0;
BA_ "GenSigTimeoutTime_APM2" SG_ 292 BPCMInterlockSts 0;
BA_ "GenSigTimeoutTime_VDCM" SG_ 292 BPCMInterlockSts 0;
BA_ "GenSigTimeoutTime_HCP" SG_ 292 HVBatLastSlept 0;
BA_ "GenSigTimeoutTime_PPIM" SG_ 292 HVBatLastSlept 0;
BA_ "GenSigTimeoutTime_APM2" SG_ 292 HVBatLastSlept 0;
BA_ "GenSigTimeoutTime_VDCM" SG_ 292 HVBatLastSlept 0;
BA_ "GenSigTimeoutTime_HCP" SG_ 292 HVBatContactorOpenTime 0;
BA_ "GenSigTimeoutTime_PPIM" SG_ 292 HVBatContactorOpenTime 0;
BA_ "GenSigTimeoutTime_APM2" SG_ 292 HVBatContactorOpenTime 0;
BA_ "GenSigTimeoutTime_VDCM" SG_ 292 HVBatContactorOpenTime 0;
BA_ "GenSigTimeoutTime_HCP" SG_ 292 BPCM_HV_SOH 0;
BA_ "GenSigTimeoutTime_PPIM" SG_ 292 BPCM_HV_SOH 0;
BA_ "GenSigTimeoutTime_APM2" SG_ 292 BPCM_HV_SOH 0;
BA_ "GenSigTimeoutTime_VDCM" SG_ 292 BPCM_HV_SOH 0;
BA_ "GenSigTimeoutTime_SGW" SG_ 292 BPCM_HV_SOH 0;
BA_ "GenSigTimeoutTime_HCP" SG_ 292 MessageCounter_BATT_HV_STATUS1 0;
BA_ "GenSigTimeoutTime_PPIM" SG_ 292 MessageCounter_BATT_HV_STATUS1 0;
BA_ "GenSigTimeoutTime_APM2" SG_ 292 MessageCounter_BATT_HV_STATUS1 0;
BA_ "GenSigTimeoutTime_VDCM" SG_ 292 MessageCounter_BATT_HV_STATUS1 0;
BA_ "GenSigTimeoutTime_IDCM" SG_ 292 MessageCounter_BATT_HV_STATUS1 0;
BA_ "GenSigTimeoutTime_HCP" SG_ 292 HVBatContactorWeldCheck 0;
BA_ "GenSigTimeoutTime_PPIM" SG_ 292 HVBatContactorWeldCheck 0;
BA_ "GenSigTimeoutTime_APM2" SG_ 292 HVBatContactorWeldCheck 0;
BA_ "GenSigTimeoutTime_VDCM" SG_ 292 HVBatContactorWeldCheck 0;
BA_ "GenSigTimeoutTime_HCP" SG_ 292 CRC_BATT_HV_STATUS1 0;
BA_ "GenSigTimeoutTime_PPIM" SG_ 292 CRC_BATT_HV_STATUS1 0;
BA_ "GenSigTimeoutTime_APM2" SG_ 292 CRC_BATT_HV_STATUS1 0;
BA_ "GenSigTimeoutTime_VDCM" SG_ 292 CRC_BATT_HV_STATUS1 0;
BA_ "GenSigTimeoutTime_IDCM" SG_ 292 CRC_BATT_HV_STATUS1 0;
BA_ "GenSigTimeoutTime_HCP" SG_ 292 BPCM_HV_Char_Main_Contac_Sts 0;
BA_ "GenSigTimeoutTime_PPIM" SG_ 292 BPCM_HV_Char_Main_Contac_Sts 0;
BA_ "GenSigTimeoutTime_APM2" SG_ 292 BPCM_HV_Char_Main_Contac_Sts 0;
BA_ "GenSigTimeoutTime_VDCM" SG_ 292 BPCM_HV_Char_Main_Contac_Sts 0;
BA_ "GenSigTimeoutTime_HCP" SG_ 292 BPCM_DC_CntctrsShtTrmOpeningWarn 0;
BA_ "GenSigTimeoutTime_PPIM" SG_ 292 BPCM_DC_CntctrsShtTrmOpeningWarn 0;
BA_ "GenSigTimeoutTime_APM2" SG_ 292 BPCM_DC_CntctrsShtTrmOpeningWarn 0;
BA_ "GenSigTimeoutTime_VDCM" SG_ 292 BPCM_DC_CntctrsShtTrmOpeningWarn 0;
BA_ "GenSigTimeoutTime_HCP" SG_ 292 BPCM_DC_CntctrsMidTrmOpeningWarn 0;
BA_ "GenSigTimeoutTime_PPIM" SG_ 292 BPCM_DC_CntctrsMidTrmOpeningWarn 0;
BA_ "GenSigTimeoutTime_APM2" SG_ 292 BPCM_DC_CntctrsMidTrmOpeningWarn 0;
BA_ "GenSigTimeoutTime_VDCM" SG_ 292 BPCM_DC_CntctrsMidTrmOpeningWarn 0;
BA_ "GenSigTimeoutTime_HCP" SG_ 292 HVBatReady 0;
BA_ "GenSigTimeoutTime_PPIM" SG_ 292 HVBatReady 0;
BA_ "GenSigTimeoutTime_APM2" SG_ 292 HVBatReady 0;
BA_ "GenSigTimeoutTime_VDCM" SG_ 292 HVBatReady 0;
BA_ "GenSigTimeoutTime_HCP" SG_ 292 BPCM_HV_SOH_Low 0;
BA_ "GenSigTimeoutTime_PPIM" SG_ 292 BPCM_HV_SOH_Low 0;
BA_ "GenSigTimeoutTime_APM2" SG_ 292 BPCM_HV_SOH_Low 0;
BA_ "GenSigTimeoutTime_VDCM" SG_ 292 BPCM_HV_SOH_Low 0;
BA_ "GenSigTimeoutTime_HCP" SG_ 292 BPCM_HV_Char_Bus_Sts 0;
BA_ "GenSigTimeoutTime_PPIM" SG_ 292 BPCM_HV_Char_Bus_Sts 0;
BA_ "GenSigTimeoutTime_APM2" SG_ 292 BPCM_HV_Char_Bus_Sts 0;
BA_ "GenSigTimeoutTime_VDCM" SG_ 292 BPCM_HV_Char_Bus_Sts 0;
BA_ "GenSigTimeoutTime_HCP" SG_ 292 BPCM_HV_Trac_Bus_Sts 0;
BA_ "GenSigTimeoutTime_PPIM" SG_ 292 BPCM_HV_Trac_Bus_Sts 0;
BA_ "GenSigTimeoutTime_APM2" SG_ 292 BPCM_HV_Trac_Bus_Sts 0;
BA_ "GenSigTimeoutTime_VDCM" SG_ 292 BPCM_HV_Trac_Bus_Sts 0;
BA_ "GenSigTimeoutTime_HCP" SG_ 292 BPCM_Pwr_Limp_Home_On 0;
BA_ "GenSigTimeoutTime_PPIM" SG_ 292 BPCM_Pwr_Limp_Home_On 0;
BA_ "GenSigTimeoutTime_APM2" SG_ 292 BPCM_Pwr_Limp_Home_On 0;
BA_ "GenSigTimeoutTime_VDCM" SG_ 292 BPCM_Pwr_Limp_Home_On 0;
BA_ "GenSigTimeoutTime_BPCM" SG_ 292 BPCM_HV_TractionBusVoltage 0;
BA_ "GenSigTimeoutTime_SGW" SG_ 292 BPCM_HV_TractionBusVoltage 0;
BA_ "GenSigTimeoutTime_HCP" SG_ 292 BPCM_HV_TractionBusVoltage 0;
BA_ "GenSigTimeoutTime_PPIM" SG_ 292 BPCM_HV_TractionBusVoltage 0;
BA_ "GenSigTimeoutTime_APM2" SG_ 292 BPCM_HV_TractionBusVoltage 0;
BA_ "GenSigTimeoutTime_VDCM" SG_ 292 BPCM_HV_TractionBusVoltage 0;
BA_ "GenSigTimeoutTime_BPCM" SG_ 292 BPCM_HV_ChargingBusVoltage 0;
BA_ "GenSigTimeoutTime_IDCM" SG_ 292 BPCM_HV_ChargingBusVoltage 0;
BA_ "GenSigTimeoutTime_HCP" SG_ 292 BPCM_HV_ChargingBusVoltage 0;
BA_ "GenSigTimeoutTime_PPIM" SG_ 292 BPCM_HV_ChargingBusVoltage 0;
BA_ "GenSigTimeoutTime_APM2" SG_ 292 BPCM_HV_ChargingBusVoltage 0;
BA_ "GenSigTimeoutTime_VDCM" SG_ 292 BPCM_HV_ChargingBusVoltage 0;
BA_ "GenSigTimeoutTime_HCP" SG_ 292 BPCM_HV_BalancingMode 0;
BA_ "GenSigTimeoutTime_PPIM" SG_ 292 BPCM_HV_BalancingMode 0;
BA_ "GenSigTimeoutTime_APM2" SG_ 292 BPCM_HV_BalancingMode 0;
BA_ "GenSigTimeoutTime_VDCM" SG_ 292 BPCM_HV_BalancingMode 0;
BA_ "GenSigTimeoutTime_HCP" SG_ 292 BPCM_HV_Trac_Main_Contac_Sts 0;
BA_ "GenSigTimeoutTime_PPIM" SG_ 292 BPCM_HV_Trac_Main_Contac_Sts 0;
BA_ "GenSigTimeoutTime_APM2" SG_ 292 BPCM_HV_Trac_Main_Contac_Sts 0;
BA_ "GenSigTimeoutTime_VDCM" SG_ 292 BPCM_HV_Trac_Main_Contac_Sts 0;
BA_ "GenSigTimeoutTime_BPCM" SG_ 292 BPCM_HV_Trac_Main_Contac_Sts 0;
BA_ "GenSigTimeoutTime_SGW" SG_ 292 BPCM_HV_Trac_Main_Contac_Sts 0;
BA_ "GenSigTimeoutTime_BPCM" SG_ 292 BPCM_HV_BalancingMode 0;
BA_ "GenSigTimeoutTime_IDCM" SG_ 292 BPCM_HV_BalancingMode 0;
BA_ "GenSigTimeoutTime_SGW" SG_ 292 BPCM_HV_BalancingMode 0;
BA_ "GenSigTimeoutTime_SGW" SG_ 292 BPCM_HV_ChargingBusVoltage 0;
BA_ "GenSigTimeoutTime_BPCM" SG_ 292 BPCM_Pwr_Limp_Home_On 0;
BA_ "GenSigTimeoutTime_IDCM" SG_ 292 BPCM_Pwr_Limp_Home_On 0;
BA_ "GenSigTimeoutTime_SGW" SG_ 292 BPCM_Pwr_Limp_Home_On 0;
BA_ "GenSigTimeoutTime_BPCM" SG_ 292 BPCM_HV_Trac_Bus_Sts 0;
BA_ "GenSigTimeoutTime_SGW" SG_ 292 BPCM_HV_Trac_Bus_Sts 0;
BA_ "GenSigTimeoutTime_BPCM" SG_ 292 BPCM_HV_Char_Bus_Sts 0;
BA_ "GenSigTimeoutTime_IDCM" SG_ 292 BPCM_HV_Char_Bus_Sts 0;
BA_ "GenSigTimeoutTime_SGW" SG_ 292 BPCM_HV_Char_Bus_Sts 0;
BA_ "GenSigTimeoutTime_BPCM" SG_ 292 BPCM_HV_SOH_Low 0;
BA_ "GenSigTimeoutTime_IDCM" SG_ 292 BPCM_HV_SOH_Low 0;
BA_ "GenSigTimeoutTime_SGW" SG_ 292 BPCM_HV_SOH_Low 0;
BA_ "GenSigTimeoutTime_BPCM" SG_ 292 HVBatReady 0;
BA_ "GenSigTimeoutTime_IDCM" SG_ 292 HVBatReady 0;
BA_ "GenSigTimeoutTime_SGW" SG_ 292 HVBatReady 0;
BA_ "GenSigTimeoutTime_BPCM" SG_ 292 BPCM_DC_CntctrsMidTrmOpeningWarn 0;
BA_ "GenSigTimeoutTime_IDCM" SG_ 292 BPCM_DC_CntctrsMidTrmOpeningWarn 0;
BA_ "GenSigTimeoutTime_SGW" SG_ 292 BPCM_DC_CntctrsMidTrmOpeningWarn 0;
BA_ "GenSigTimeoutTime_BPCM" SG_ 292 BPCM_DC_CntctrsShtTrmOpeningWarn 0;
BA_ "GenSigTimeoutTime_IDCM" SG_ 292 BPCM_DC_CntctrsShtTrmOpeningWarn 0;
BA_ "GenSigTimeoutTime_SGW" SG_ 292 BPCM_DC_CntctrsShtTrmOpeningWarn 0;
BA_ "GenSigTimeoutTime_BPCM" SG_ 292 BPCM_HV_Char_Main_Contac_Sts 0;
BA_ "GenSigTimeoutTime_IDCM" SG_ 292 BPCM_HV_Char_Main_Contac_Sts 0;
BA_ "GenSigTimeoutTime_SGW" SG_ 292 BPCM_HV_Char_Main_Contac_Sts 0;
BA_ "GenSigTimeoutTime_BPCM" SG_ 292 CRC_BATT_HV_STATUS1 0;
BA_ "GenSigTimeoutTime_SGW" SG_ 292 CRC_BATT_HV_STATUS1 0;
BA_ "GenSigTimeoutTime_BPCM" SG_ 292 HVBatContactorWeldCheck 0;
BA_ "GenSigTimeoutTime_IDCM" SG_ 292 HVBatContactorWeldCheck 0;
BA_ "GenSigTimeoutTime_SGW" SG_ 292 HVBatContactorWeldCheck 0;
BA_ "GenSigTimeoutTime_BPCM" SG_ 292 MessageCounter_BATT_HV_STATUS1 0;
BA_ "GenSigTimeoutTime_SGW" SG_ 292 MessageCounter_BATT_HV_STATUS1 0;
BA_ "GenSigTimeoutTime_HCP" SG_ 2564486421 N_PDU_18DAF515 0;
BA_ "GenSigTimeoutTime_PPIM" SG_ 2564486421 N_PDU_18DAF515 0;
BA_ "GenSigTimeoutTime_APM2" SG_ 2564486421 N_PDU_18DAF515 0;
BA_ "GenSigTimeoutTime_VDCM" SG_ 2564486421 N_PDU_18DAF515 0;
BA_ "GenSigTimeoutTime_BPCM" SG_ 2564486421 N_PDU_18DAF515 0;
BA_ "GenSigTimeoutTime_EVCU2" SG_ 2564486421 N_PDU_18DAF515 0;
BA_ "GenSigTimeoutTime_IDCM" SG_ 2564486421 N_PDU_18DAF515 0;
BA_ "GenSigTimeoutTime_SGW" SG_ 2564486421 N_PDU_18DAF515 0;
BA_ "GenSigTimeoutTime_HCP" SG_ 2564486480 N_PDU_18DAF550 0;
BA_ "GenSigTimeoutTime_PPIM" SG_ 2564486480 N_PDU_18DAF550 0;
BA_ "GenSigTimeoutTime_APM2" SG_ 2564486480 N_PDU_18DAF550 0;
BA_ "GenSigTimeoutTime_VDCM" SG_ 2564486480 N_PDU_18DAF550 0;
BA_ "GenSigTimeoutTime_BPCM" SG_ 2564486480 N_PDU_18DAF550 0;
BA_ "GenSigTimeoutTime_EVCU2" SG_ 2564486480 N_PDU_18DAF550 0;
BA_ "GenSigTimeoutTime_IDCM" SG_ 2564486480 N_PDU_18DAF550 0;
BA_ "GenSigTimeoutTime_SGW" SG_ 2564486480 N_PDU_18DAF550 0;
BA_ "GenSigTimeoutTime_HCP" SG_ 2564554485 N_PDU_18DBFEF5 0;
BA_ "GenSigTimeoutTime_PPIM" SG_ 2564554485 N_PDU_18DBFEF5 0;
BA_ "GenSigTimeoutTime_APM2" SG_ 2564554485 N_PDU_18DBFEF5 0;
BA_ "GenSigTimeoutTime_VDCM" SG_ 2564554485 N_PDU_18DBFEF5 0;
BA_ "GenSigTimeoutTime_BPCM" SG_ 2564554485 N_PDU_18DBFEF5 0;
BA_ "GenSigTimeoutTime_EVCU2" SG_ 2564554485 N_PDU_18DBFEF5 0;
BA_ "GenSigTimeoutTime_IDCM" SG_ 2564554485 N_PDU_18DBFEF5 0;
BA_ "GenSigTimeoutTime_SGW" SG_ 2564554485 N_PDU_18DBFEF5 0;
BA_ "GenSigTimeoutTime_BPCM" SG_ 292 BPCM_HV_SOH 0;
BA_ "GenSigTimeoutTime_IDCM" SG_ 292 BPCM_HV_SOH 0;
BA_ "GenSigTimeoutTime_BPCM" SG_ 292 HVBatContactorOpenTime 0;
BA_ "GenSigTimeoutTime_IDCM" SG_ 292 HVBatContactorOpenTime 0;
BA_ "GenSigTimeoutTime_SGW" SG_ 292 HVBatContactorOpenTime 0;
BA_ "GenSigTimeoutTime_BPCM" SG_ 292 HVBatLastSlept 0;
BA_ "GenSigTimeoutTime_IDCM" SG_ 292 HVBatLastSlept 0;
BA_ "GenSigTimeoutTime_SGW" SG_ 292 HVBatLastSlept 0;
BA_ "GenSigTimeoutTime_HCP" SG_ 2564429045 N_PDU_18DA14F5 0;
BA_ "GenSigTimeoutTime_PPIM" SG_ 2564429045 N_PDU_18DA14F5 0;
BA_ "GenSigTimeoutTime_APM2" SG_ 2564429045 N_PDU_18DA14F5 0;
BA_ "GenSigTimeoutTime_VDCM" SG_ 2564429045 N_PDU_18DA14F5 0;
BA_ "GenSigTimeoutTime_BPCM" SG_ 2564429045 N_PDU_18DA14F5 0;
BA_ "GenSigTimeoutTime_EVCU2" SG_ 2564429045 N_PDU_18DA14F5 0;
BA_ "GenSigTimeoutTime_IDCM" SG_ 2564429045 N_PDU_18DA14F5 0;
BA_ "GenSigTimeoutTime_SGW" SG_ 2564429045 N_PDU_18DA14F5 0;
BA_ "GenSigTimeoutTime_HCP" SG_ 2564486420 N_PDU_18DAF514 0;
BA_ "GenSigTimeoutTime_PPIM" SG_ 2564486420 N_PDU_18DAF514 0;
BA_ "GenSigTimeoutTime_APM2" SG_ 2564486420 N_PDU_18DAF514 0;
BA_ "GenSigTimeoutTime_VDCM" SG_ 2564486420 N_PDU_18DAF514 0;
BA_ "GenSigTimeoutTime_BPCM" SG_ 2564486420 N_PDU_18DAF514 0;
BA_ "GenSigTimeoutTime_EVCU2" SG_ 2564486420 N_PDU_18DAF514 0;
BA_ "GenSigTimeoutTime_IDCM" SG_ 2564486420 N_PDU_18DAF514 0;
BA_ "GenSigTimeoutTime_SGW" SG_ 2564486420 N_PDU_18DAF514 0;
BA_ "GenSigTimeoutTime_HCP" SG_ 1063 MCPB_Temp 0;
BA_ "GenSigTimeoutTime_PPIM" SG_ 1063 MCPB_Temp 0;
BA_ "GenSigTimeoutTime_APM2" SG_ 1063 MCPB_Temp 0;
BA_ "GenSigTimeoutTime_VDCM" SG_ 1063 MCPB_Temp 0;
BA_ "GenSigStartValue" SG_ 1063 MCPB_Temp 40;
BA_ "GenSigTimeoutTime_BPCM" SG_ 1063 MCPB_Temp 0;
BA_ "GenSigTimeoutTime_EVCU2" SG_ 1063 MCPB_Temp 0;
BA_ "GenSigTimeoutTime_BPCM" SG_ 292 BPCMInterlockSts 0;
BA_ "GenSigTimeoutTime_IDCM" SG_ 292 BPCMInterlockSts 0;
BA_ "GenSigTimeoutTime_SGW" SG_ 292 BPCMInterlockSts 0;
BA_ "GenSigTimeoutTime_HCP" SG_ 2564441333 N_PDU_18DA44F5 0;
BA_ "GenSigTimeoutTime_PPIM" SG_ 2564441333 N_PDU_18DA44F5 0;
BA_ "GenSigTimeoutTime_APM2" SG_ 2564441333 N_PDU_18DA44F5 0;
BA_ "GenSigTimeoutTime_VDCM" SG_ 2564441333 N_PDU_18DA44F5 0;
BA_ "GenSigTimeoutTime_BPCM" SG_ 2564441333 N_PDU_18DA44F5 0;
BA_ "GenSigTimeoutTime_EVCU2" SG_ 2564441333 N_PDU_18DA44F5 0;
BA_ "GenSigTimeoutTime_IDCM" SG_ 2564441333 N_PDU_18DA44F5 0;
BA_ "GenSigTimeoutTime_SGW" SG_ 2564441333 N_PDU_18DA44F5 0;
BA_ "GenSigTimeoutTime_HCP" SG_ 2564444405 N_PDU_18DA50F5 0;
BA_ "GenSigTimeoutTime_PPIM" SG_ 2564444405 N_PDU_18DA50F5 0;
BA_ "GenSigTimeoutTime_APM2" SG_ 2564444405 N_PDU_18DA50F5 0;
BA_ "GenSigTimeoutTime_VDCM" SG_ 2564444405 N_PDU_18DA50F5 0;
BA_ "GenSigTimeoutTime_BPCM" SG_ 2564444405 N_PDU_18DA50F5 0;
BA_ "GenSigTimeoutTime_EVCU2" SG_ 2564444405 N_PDU_18DA50F5 0;
BA_ "GenSigTimeoutTime_IDCM" SG_ 2564444405 N_PDU_18DA50F5 0;
BA_ "GenSigTimeoutTime_SGW" SG_ 2564444405 N_PDU_18DA50F5 0;
BA_ "GenSigTimeoutTime_APM2" SG_ 2564429301 N_PDU_18DA15F5 0;
BA_ "GenSigTimeoutTime_VDCM" SG_ 2564429301 N_PDU_18DA15F5 0;
BA_ "GenSigTimeoutTime_BPCM" SG_ 2564429301 N_PDU_18DA15F5 0;
BA_ "GenSigTimeoutTime_EVCU2" SG_ 2564429301 N_PDU_18DA15F5 0;
BA_ "GenSigTimeoutTime_IDCM" SG_ 2564429301 N_PDU_18DA15F5 0;
BA_ "GenSigTimeoutTime_SGW" SG_ 2564429301 N_PDU_18DA15F5 0;
BA_ "GenSigTimeoutTime_HCP" SG_ 2564429301 N_PDU_18DA15F5 0;
BA_ "GenSigTimeoutTime_PPIM" SG_ 2564429301 N_PDU_18DA15F5 0;
BA_ "GenSigTimeoutTime_BPCM" SG_ 292 BPCM_HV_BatIntrlk_InternalStat 0;
BA_ "GenSigTimeoutTime_IDCM" SG_ 292 BPCM_HV_BatIntrlk_InternalStat 0;
BA_ "GenSigTimeoutTime_SGW" SG_ 292 BPCM_HV_BatIntrlk_InternalStat 0;
BA_ "GenSigTimeoutTime_BPCM" SG_ 292 BPCM_HV_Temperature_Max 0;
BA_ "GenSigTimeoutTime_IDCM" SG_ 292 BPCM_HV_Temperature_Max 0;
BA_ "GenSigTimeoutTime_SGW" SG_ 292 BPCM_HV_Temperature_Max 0;
BA_ "GenSigTimeoutTime_BPCM" SG_ 292 BPCM_HV_Temperature_Min 0;
BA_ "GenSigTimeoutTime_IDCM" SG_ 292 BPCM_HV_Temperature_Min 0;
BA_ "GenSigTimeoutTime_SGW" SG_ 292 BPCM_HV_Temperature_Min 0;
BA_ "GenSigTimeoutTime_BPCM" SG_ 292 BPCM_HV_Temperature_Avg 0;
BA_ "GenSigTimeoutTime_IDCM" SG_ 292 BPCM_HV_Temperature_Avg 0;
BA_ "GenSigTimeoutTime_SGW" SG_ 292 BPCM_HV_Temperature_Avg 0;
BA_ "GenSigTimeoutTime_BPCM" SG_ 292 BPCM_HV_SOC 0;
BA_ "GenSigTimeoutTime_IDCM" SG_ 292 BPCM_HV_SOC 0;
BA_ "GenSigStartValue" SG_ 292 BPCM_HV_Outlet_Temp 40;
BA_ "GenSigTimeoutTime_BPCM" SG_ 292 BPCM_HV_Outlet_Temp 0;
BA_ "GenSigTimeoutTime_IDCM" SG_ 292 BPCM_HV_Outlet_Temp 0;
BA_ "GenSigTimeoutTime_SGW" SG_ 292 BPCM_HV_Outlet_Temp 0;
BA_ "GenSigTimeoutTime_BPCM" SG_ 292 BPCM_HV_InternalVoltage 0;
BA_ "GenSigTimeoutTime_IDCM" SG_ 292 BPCM_HV_InternalVoltage 0;
BA_ "GenSigTimeoutTime_SGW" SG_ 292 BPCM_HV_InternalVoltage 0;
BA_ "GenSigStartValue" SG_ 292 BPCM_HV_Inlet_Temp 40;
BA_ "GenSigTimeoutTime_BPCM" SG_ 292 BPCM_HV_Inlet_Temp 0;
BA_ "GenSigTimeoutTime_IDCM" SG_ 292 BPCM_HV_Inlet_Temp 0;
BA_ "GenSigTimeoutTime_SGW" SG_ 292 BPCM_HV_Inlet_Temp 0;
BA_ "GenSigTimeoutTime_BPCM" SG_ 292 BPCM_HV_Current 0;
BA_ "GenSigTimeoutTime_IDCM" SG_ 292 BPCM_HV_Current 0;
BA_ "GenSigTimeoutTime_SGW" SG_ 292 BPCM_HV_Current 0;
BA_ "GenSigTimeoutTime_BPCM" SG_ 292 BPCM_HV_Capacity 0;
BA_ "GenSigTimeoutTime_IDCM" SG_ 292 BPCM_HV_Capacity 0;
BA_ "GenSigTimeoutTime_SGW" SG_ 292 BPCM_HV_Capacity 0;
BA_ "GenSigTimeoutTime_BPCM" SG_ 292 BPCM_HV_Battery_GFD_Sts 0;
BA_ "GenSigTimeoutTime_IDCM" SG_ 292 BPCM_HV_Battery_GFD_Sts 0;
BA_ "GenSigTimeoutTime_SGW" SG_ 292 BPCM_HV_Battery_GFD_Sts 0;
BA_ "GenSigTimeoutTime_HCP" SG_ 1062 MCPA_Temp 0;
BA_ "GenSigTimeoutTime_PPIM" SG_ 1062 MCPA_Temp 0;
BA_ "GenSigTimeoutTime_APM2" SG_ 1062 MCPA_Temp 0;
BA_ "GenSigTimeoutTime_VDCM" SG_ 1062 MCPA_Temp 0;
BA_ "GenSigTimeoutTime_SGW" SG_ 1062 MCPA_Temp 0;
BA_ "GenSigStartValue" SG_ 1062 MCPA_Temp 40;
BA_ "GenSigTimeoutTime_BPCM" SG_ 1062 MCPA_Temp 0;
BA_ "GenSigTimeoutTime_EVCU2" SG_ 1062 MCPA_Temp 0;
BA_ "GenSigTimeoutTime_IDCM" SG_ 1062 MCPA_Temp 0;
BA_ "GenSigTimeoutTime_BPCM" SG_ 1031 BatterySideVoltage 0;
BA_ "GenSigTimeoutTime_IDCM" SG_ 1031 BatterySideVoltage 0;
BA_ "GenSigTimeoutTime_SGW" SG_ 1031 BatterySideVoltage 0;
BA_ "GenSigTimeoutTime_BPCM" SG_ 1031 CRC_HV_CHARGER1 0;
BA_ "GenSigTimeoutTime_IDCM" SG_ 1031 CRC_HV_CHARGER1 0;
BA_ "GenSigTimeoutTime_SGW" SG_ 1031 CRC_HV_CHARGER1 0;
BA_ "GenSigTimeoutTime_BPCM" SG_ 1031 EVCC_FailureReason 0;
BA_ "GenSigTimeoutTime_IDCM" SG_ 1031 EVCC_FailureReason 0;
BA_ "GenSigTimeoutTime_SGW" SG_ 1031 EVCC_FailureReason 0;
BA_ "GenSigTimeoutTime_BPCM" SG_ 1031 MessageCounter_HV_CHARGER1 0;
BA_ "GenSigTimeoutTime_IDCM" SG_ 1031 MessageCounter_HV_CHARGER1 0;
BA_ "GenSigTimeoutTime_SGW" SG_ 1031 MessageCounter_HV_CHARGER1 0;
BA_ "GenSigTimeoutTime_BPCM" SG_ 1031 Supported_ProtocolName 0;
BA_ "GenSigTimeoutTime_IDCM" SG_ 1031 Supported_ProtocolName 0;
BA_ "GenSigTimeoutTime_SGW" SG_ 1031 Supported_ProtocolName 0;
BA_ "GenSigTimeoutTime_BPCM" SG_ 1031 Supported_SchemaID 0;
BA_ "GenSigTimeoutTime_IDCM" SG_ 1031 Supported_SchemaID 0;
BA_ "GenSigTimeoutTime_SGW" SG_ 1031 Supported_SchemaID 0;
BA_ "GenSigTimeoutTime_BPCM" SG_ 1031 Supported_VerNumberMajor 0;
BA_ "GenSigTimeoutTime_IDCM" SG_ 1031 Supported_VerNumberMajor 0;
BA_ "GenSigTimeoutTime_SGW" SG_ 1031 Supported_VerNumberMajor 0;
BA_ "GenSigTimeoutTime_BPCM" SG_ 1031 Supported_VerNumberMinor 0;
BA_ "GenSigTimeoutTime_IDCM" SG_ 1031 Supported_VerNumberMinor 0;
BA_ "GenSigTimeoutTime_SGW" SG_ 1031 Supported_VerNumberMinor 0;
BA_ "GenSigTimeoutTime_HCP" SG_ 1790 BMS_HV_SOC_Max 0;
BA_ "GenSigTimeoutTime_PPIM" SG_ 1790 BMS_HV_SOC_Max 0;
BA_ "GenSigTimeoutTime_APM2" SG_ 1790 BMS_HV_SOC_Max 0;
BA_ "GenSigTimeoutTime_VDCM" SG_ 1790 BMS_HV_SOC_Max 0;
BA_ "GenSigStartValue" SG_ 1790 BMS_HV_SOC_Max 50;
BA_ "GenSigSendType" SG_ 1790 BMS_HV_SOC_Max 3;
BA_ "GenSigTimeoutTime_BPCM" SG_ 1790 BMS_HV_SOC_Max 0;
BA_ "GenSigTimeoutTime_IDCM" SG_ 1790 BMS_HV_SOC_Max 0;
BA_ "GenSigTimeoutTime_SGW" SG_ 1790 BMS_HV_SOC_Max 0;
BA_ "GenSigTimeoutTime_HCP" SG_ 1790 BMS_HV_SOC_Min 0;
BA_ "GenSigTimeoutTime_PPIM" SG_ 1790 BMS_HV_SOC_Min 0;
BA_ "GenSigTimeoutTime_APM2" SG_ 1790 BMS_HV_SOC_Min 0;
BA_ "GenSigTimeoutTime_VDCM" SG_ 1790 BMS_HV_SOC_Min 0;
BA_ "GenSigStartValue" SG_ 1790 BMS_HV_SOC_Min 50;
BA_ "GenSigSendType" SG_ 1790 BMS_HV_SOC_Min 3;
BA_ "GenSigTimeoutTime_BPCM" SG_ 1790 BMS_HV_SOC_Min 0;
BA_ "GenSigTimeoutTime_IDCM" SG_ 1790 BMS_HV_SOC_Min 0;
BA_ "GenSigTimeoutTime_SGW" SG_ 1790 BMS_HV_SOC_Min 0;
BA_ "GenSigTimeoutTime_HCP" SG_ 1790 HEV_OnRq_BPCM 0;
BA_ "GenSigTimeoutTime_PPIM" SG_ 1790 HEV_OnRq_BPCM 0;
BA_ "GenSigTimeoutTime_APM2" SG_ 1790 HEV_OnRq_BPCM 0;
BA_ "GenSigTimeoutTime_VDCM" SG_ 1790 HEV_OnRq_BPCM 0;
BA_ "GenSigSendType" SG_ 1790 HEV_OnRq_BPCM 3;
BA_ "GenSigTimeoutTime_BPCM" SG_ 1790 HEV_OnRq_BPCM 0;
BA_ "GenSigTimeoutTime_IDCM" SG_ 1790 HEV_OnRq_BPCM 0;
BA_ "GenSigTimeoutTime_SGW" SG_ 1790 HEV_OnRq_BPCM 0;
BA_ "GenSigTimeoutTime_HCP" SG_ 1790 HVBatCell_Voltage_High_Thrsh 0;
BA_ "GenSigTimeoutTime_PPIM" SG_ 1790 HVBatCell_Voltage_High_Thrsh 0;
BA_ "GenSigTimeoutTime_APM2" SG_ 1790 HVBatCell_Voltage_High_Thrsh 0;
BA_ "GenSigTimeoutTime_VDCM" SG_ 1790 HVBatCell_Voltage_High_Thrsh 0;
BA_ "GenSigTimeoutTime_BPCM" SG_ 1790 HVBatCell_Voltage_High_Thrsh 0;
BA_ "GenSigTimeoutTime_IDCM" SG_ 1790 HVBatCell_Voltage_High_Thrsh 0;
BA_ "GenSigTimeoutTime_SGW" SG_ 1790 HVBatCell_Voltage_High_Thrsh 0;
BA_ "GenSigTimeoutTime_BPCM" SG_ 1031 AC_LnLow 0;
BA_ "GenSigTimeoutTime_EVCU2" SG_ 1031 AC_LnLow 0;
BA_ "GenSigTimeoutTime_IDCM" SG_ 1031 AC_LnLow 0;
BA_ "GenSigTimeoutTime_SGW" SG_ 1031 AC_LnLow 0;
BA_ "GenSigTimeoutTime_HCP" SG_ 1790 HVBatCell_Voltage_Low_Thrsh 0;
BA_ "GenSigTimeoutTime_PPIM" SG_ 1790 HVBatCell_Voltage_Low_Thrsh 0;
BA_ "GenSigTimeoutTime_APM2" SG_ 1790 HVBatCell_Voltage_Low_Thrsh 0;
BA_ "GenSigTimeoutTime_VDCM" SG_ 1790 HVBatCell_Voltage_Low_Thrsh 0;
BA_ "GenSigTimeoutTime_BPCM" SG_ 1790 HVBatCell_Voltage_Low_Thrsh 0;
BA_ "GenSigTimeoutTime_IDCM" SG_ 1790 HVBatCell_Voltage_Low_Thrsh 0;
BA_ "GenSigTimeoutTime_SGW" SG_ 1790 HVBatCell_Voltage_Low_Thrsh 0;
BA_ "GenSigTimeoutTime_BPCM" SG_ 1031 AC_LnHi 0;
BA_ "GenSigTimeoutTime_EVCU2" SG_ 1031 AC_LnHi 0;
BA_ "GenSigTimeoutTime_IDCM" SG_ 1031 AC_LnHi 0;
BA_ "GenSigTimeoutTime_SGW" SG_ 1031 AC_LnHi 0;
BA_ "GenSigTimeoutTime_HCP" SG_ 1790 BMS_HV_High_Temp_Thrsh 0;
BA_ "GenSigTimeoutTime_PPIM" SG_ 1790 BMS_HV_High_Temp_Thrsh 0;
BA_ "GenSigTimeoutTime_APM2" SG_ 1790 BMS_HV_High_Temp_Thrsh 0;
BA_ "GenSigTimeoutTime_VDCM" SG_ 1790 BMS_HV_High_Temp_Thrsh 0;
BA_ "GenSigTimeoutTime_BPCM" SG_ 1790 BMS_HV_High_Temp_Thrsh 0;
BA_ "GenSigTimeoutTime_IDCM" SG_ 1790 BMS_HV_High_Temp_Thrsh 0;
BA_ "GenSigTimeoutTime_SGW" SG_ 1790 BMS_HV_High_Temp_Thrsh 0;
BA_ "GenSigTimeoutTime_HCP" SG_ 105 ClrLgsDiagInfo 0;
BA_ "GenSigTimeoutTime_PPIM" SG_ 105 ClrLgsDiagInfo 0;
BA_ "GenSigTimeoutTime_APM2" SG_ 105 ClrLgsDiagInfo 0;
BA_ "GenSigTimeoutTime_VDCM" SG_ 105 ClrLgsDiagInfo 0;
BA_ "GenSigTimeoutTime_BPCM" SG_ 105 ClrLgsDiagInfo 0;
BA_ "GenSigTimeoutTime_EVCU2" SG_ 105 ClrLgsDiagInfo 0;
BA_ "GenSigTimeoutTime_SGW" SG_ 105 ClrLgsDiagInfo 0;
BA_ "GenSigTimeoutTime_HCP" SG_ 1790 BMS_HV_Low_Temp_Thrsh 0;
BA_ "GenSigTimeoutTime_PPIM" SG_ 1790 BMS_HV_Low_Temp_Thrsh 0;
BA_ "GenSigTimeoutTime_APM2" SG_ 1790 BMS_HV_Low_Temp_Thrsh 0;
BA_ "GenSigTimeoutTime_VDCM" SG_ 1790 BMS_HV_Low_Temp_Thrsh 0;
BA_ "GenSigTimeoutTime_BPCM" SG_ 1790 BMS_HV_Low_Temp_Thrsh 0;
BA_ "GenSigTimeoutTime_IDCM" SG_ 1790 BMS_HV_Low_Temp_Thrsh 0;
BA_ "GenSigTimeoutTime_SGW" SG_ 1790 BMS_HV_Low_Temp_Thrsh 0;
BA_ "GenSigTimeoutTime_HCP" SG_ 1790 BMS_HV_SOC_AccuracySts 0;
BA_ "GenSigTimeoutTime_PPIM" SG_ 1790 BMS_HV_SOC_AccuracySts 0;
BA_ "GenSigTimeoutTime_APM2" SG_ 1790 BMS_HV_SOC_AccuracySts 0;
BA_ "GenSigTimeoutTime_VDCM" SG_ 1790 BMS_HV_SOC_AccuracySts 0;
BA_ "GenSigSendType" SG_ 1790 BMS_HV_SOC_AccuracySts 3;
BA_ "GenSigTimeoutTime_BPCM" SG_ 1790 BMS_HV_SOC_AccuracySts 0;
BA_ "GenSigTimeoutTime_IDCM" SG_ 1790 BMS_HV_SOC_AccuracySts 0;
BA_ "GenSigTimeoutTime_SGW" SG_ 1790 BMS_HV_SOC_AccuracySts 0;
BA_ "GenSigTimeoutTime_BPCM" SG_ 1031 AC_Side_Volt3 0;
BA_ "GenSigTimeoutTime_EVCU2" SG_ 1031 AC_Side_Volt3 0;
BA_ "GenSigTimeoutTime_IDCM" SG_ 1031 AC_Side_Volt3 0;
BA_ "GenSigTimeoutTime_SGW" SG_ 1031 AC_Side_Volt3 0;
BA_ "GenSigTimeoutTime_BPCM" SG_ 1031 AC_Side_Volt1 0;
BA_ "GenSigTimeoutTime_EVCU2" SG_ 1031 AC_Side_Volt1 0;
BA_ "GenSigTimeoutTime_IDCM" SG_ 1031 AC_Side_Volt1 0;
BA_ "GenSigTimeoutTime_SGW" SG_ 1031 AC_Side_Volt1 0;
BA_ "GenSigTimeoutTime_BPCM" SG_ 1031 AC_Side_Volt2 0;
BA_ "GenSigTimeoutTime_EVCU2" SG_ 1031 AC_Side_Volt2 0;
BA_ "GenSigTimeoutTime_IDCM" SG_ 1031 AC_Side_Volt2 0;
BA_ "GenSigTimeoutTime_SGW" SG_ 1031 AC_Side_Volt2 0;
BA_ "GenSigStartValue" SG_ 1031 AC_Side_Curr3 1000;
BA_ "GenSigTimeoutTime_BPCM" SG_ 1031 AC_Side_Curr3 0;
BA_ "GenSigTimeoutTime_EVCU2" SG_ 1031 AC_Side_Curr3 0;
BA_ "GenSigTimeoutTime_IDCM" SG_ 1031 AC_Side_Curr3 0;
BA_ "GenSigTimeoutTime_SGW" SG_ 1031 AC_Side_Curr3 0;
BA_ "GenSigStartValue" SG_ 1031 AC_Side_Curr2 1000;
BA_ "GenSigTimeoutTime_BPCM" SG_ 1031 AC_Side_Curr2 0;
BA_ "GenSigTimeoutTime_EVCU2" SG_ 1031 AC_Side_Curr2 0;
BA_ "GenSigTimeoutTime_IDCM" SG_ 1031 AC_Side_Curr2 0;
BA_ "GenSigTimeoutTime_SGW" SG_ 1031 AC_Side_Curr2 0;
BA_ "GenSigTimeoutTime_BPCM" SG_ 1031 AC_HighLoadWarning 0;
BA_ "GenSigTimeoutTime_EVCU2" SG_ 1031 AC_HighLoadWarning 0;
BA_ "GenSigTimeoutTime_IDCM" SG_ 1031 AC_HighLoadWarning 0;
BA_ "GenSigTimeoutTime_SGW" SG_ 1031 AC_HighLoadWarning 0;
BA_ "GenSigTimeoutTime_BPCM" SG_ 1031 ChargeCurrentAvailable 0;
BA_ "GenSigTimeoutTime_EVCU2" SG_ 1031 ChargeCurrentAvailable 0;
BA_ "GenSigTimeoutTime_IDCM" SG_ 1031 ChargeCurrentAvailable 0;
BA_ "GenSigTimeoutTime_SGW" SG_ 1031 ChargeCurrentAvailable 0;
BA_ "GenSigTimeoutTime_BPCM" SG_ 1031 ChargeEnableSts 0;
BA_ "GenSigTimeoutTime_EVCU2" SG_ 1031 ChargeEnableSts 0;
BA_ "GenSigTimeoutTime_IDCM" SG_ 1031 ChargeEnableSts 0;
BA_ "GenSigTimeoutTime_SGW" SG_ 1031 ChargeEnableSts 0;
BA_ "GenSigTimeoutTime_BPCM" SG_ 1031 ControlPilotSts 0;
BA_ "GenSigTimeoutTime_IDCM" SG_ 1031 ControlPilotSts 0;
BA_ "GenSigTimeoutTime_SGW" SG_ 1031 ControlPilotSts 0;
BA_ "GenSigTimeoutTime_BPCM" SG_ 1031 InputCurrentAvailable 0;
BA_ "GenSigTimeoutTime_EVCU2" SG_ 1031 InputCurrentAvailable 0;
BA_ "GenSigTimeoutTime_IDCM" SG_ 1031 InputCurrentAvailable 0;
BA_ "GenSigTimeoutTime_SGW" SG_ 1031 InputCurrentAvailable 0;
BA_ "GenSigTimeoutTime_HCP" SG_ 544 CC2VoltDetError 0;
BA_ "GenSigTimeoutTime_PPIM" SG_ 544 CC2VoltDetError 0;
BA_ "GenSigTimeoutTime_APM2" SG_ 544 CC2VoltDetError 0;
BA_ "GenSigTimeoutTime_VDCM" SG_ 544 CC2VoltDetError 0;
BA_ "GenSigStartValue" SG_ 544 CC2VoltDetError 2;
BA_ "GenSigTimeoutTime_BPCM" SG_ 544 CC2VoltDetError 0;
BA_ "GenSigTimeoutTime_IDCM" SG_ 544 CC2VoltDetError 0;
BA_ "GenSigTimeoutTime_SGW" SG_ 544 CC2VoltDetError 0;
BA_ "GenSigTimeoutTime_HCP" SG_ 544 Charger_FaultStates 0;
BA_ "GenSigTimeoutTime_PPIM" SG_ 544 Charger_FaultStates 0;
BA_ "GenSigTimeoutTime_APM2" SG_ 544 Charger_FaultStates 0;
BA_ "GenSigTimeoutTime_VDCM" SG_ 544 Charger_FaultStates 0;
BA_ "GenSigStartValue" SG_ 544 Charger_FaultStates 14;
BA_ "GenSigTimeoutTime_BPCM" SG_ 544 Charger_FaultStates 0;
BA_ "GenSigTimeoutTime_IDCM" SG_ 544 Charger_FaultStates 0;
BA_ "GenSigTimeoutTime_SGW" SG_ 544 Charger_FaultStates 0;
BA_ "GenSigTimeoutTime_HCP" SG_ 544 Charger_StndbyReq 0;
BA_ "GenSigTimeoutTime_PPIM" SG_ 544 Charger_StndbyReq 0;
BA_ "GenSigTimeoutTime_APM2" SG_ 544 Charger_StndbyReq 0;
BA_ "GenSigTimeoutTime_VDCM" SG_ 544 Charger_StndbyReq 0;
BA_ "GenSigStartValue" SG_ 544 Charger_StndbyReq 2;
BA_ "GenSigTimeoutTime_BPCM" SG_ 544 Charger_StndbyReq 0;
BA_ "GenSigTimeoutTime_IDCM" SG_ 544 Charger_StndbyReq 0;
BA_ "GenSigTimeoutTime_SGW" SG_ 544 Charger_StndbyReq 0;
BA_ "GenSigTimeoutTime_HCP" SG_ 544 Charger_StndbyReqReason 0;
BA_ "GenSigTimeoutTime_PPIM" SG_ 544 Charger_StndbyReqReason 0;
BA_ "GenSigTimeoutTime_APM2" SG_ 544 Charger_StndbyReqReason 0;
BA_ "GenSigTimeoutTime_VDCM" SG_ 544 Charger_StndbyReqReason 0;
BA_ "GenSigStartValue" SG_ 544 Charger_StndbyReqReason 6;
BA_ "GenSigTimeoutTime_BPCM" SG_ 544 Charger_StndbyReqReason 0;
BA_ "GenSigTimeoutTime_IDCM" SG_ 544 Charger_StndbyReqReason 0;
BA_ "GenSigTimeoutTime_SGW" SG_ 544 Charger_StndbyReqReason 0;
BA_ "GenSigTimeoutTime_HCP" SG_ 544 Charger_WeldingDetectAvail 0;
BA_ "GenSigTimeoutTime_PPIM" SG_ 544 Charger_WeldingDetectAvail 0;
BA_ "GenSigTimeoutTime_APM2" SG_ 544 Charger_WeldingDetectAvail 0;
BA_ "GenSigTimeoutTime_VDCM" SG_ 544 Charger_WeldingDetectAvail 0;
BA_ "GenSigStartValue" SG_ 544 Charger_WeldingDetectAvail 2;
BA_ "GenSigTimeoutTime_BPCM" SG_ 544 Charger_WeldingDetectAvail 0;
BA_ "GenSigTimeoutTime_IDCM" SG_ 544 Charger_WeldingDetectAvail 0;
BA_ "GenSigTimeoutTime_SGW" SG_ 544 Charger_WeldingDetectAvail 0;
BA_ "GenSigTimeoutTime_HCP" SG_ 544 EVSE_ChrgStopControl 0;
BA_ "GenSigTimeoutTime_PPIM" SG_ 544 EVSE_ChrgStopControl 0;
BA_ "GenSigTimeoutTime_APM2" SG_ 544 EVSE_ChrgStopControl 0;
BA_ "GenSigTimeoutTime_VDCM" SG_ 544 EVSE_ChrgStopControl 0;
BA_ "GenSigStartValue" SG_ 544 EVSE_ChrgStopControl 2;
BA_ "GenSigTimeoutTime_BPCM" SG_ 544 EVSE_ChrgStopControl 0;
BA_ "GenSigTimeoutTime_IDCM" SG_ 544 EVSE_ChrgStopControl 0;
BA_ "GenSigTimeoutTime_SGW" SG_ 544 EVSE_ChrgStopControl 0;
BA_ "GenSigTimeoutTime_HCP" SG_ 546 VDCM_ChargeCurrIsOOR 0;
BA_ "GenSigTimeoutTime_HCP" SG_ 546 ReadyToChargeState 0;
BA_ "GenSigTimeoutTime_PPIM" SG_ 546 ReadyToChargeState 0;
BA_ "GenSigTimeoutTime_APM2" SG_ 546 ReadyToChargeState 0;
BA_ "GenSigTimeoutTime_VDCM" SG_ 546 ReadyToChargeState 0;
BA_ "GenSigTimeoutTime_HCP" SG_ 546 VDCM_BattTempIsOOR 0;
BA_ "GenSigTimeoutTime_PPIM" SG_ 546 VDCM_BattTempIsOOR 0;
BA_ "GenSigTimeoutTime_APM2" SG_ 546 VDCM_BattTempIsOOR 0;
BA_ "GenSigTimeoutTime_VDCM" SG_ 546 VDCM_BattTempIsOOR 0;
BA_ "GenSigTimeoutTime_HCP" SG_ 546 VDCM_CellVoltIsOOR 0;
BA_ "GenSigTimeoutTime_PPIM" SG_ 546 VDCM_CellVoltIsOOR 0;
BA_ "GenSigTimeoutTime_APM2" SG_ 546 VDCM_CellVoltIsOOR 0;
BA_ "GenSigTimeoutTime_VDCM" SG_ 546 VDCM_CellVoltIsOOR 0;
BA_ "GenSigTimeoutTime_HCP" SG_ 544 OBCM_CSSts 0;
BA_ "GenSigTimeoutTime_PPIM" SG_ 544 OBCM_CSSts 0;
BA_ "GenSigTimeoutTime_APM2" SG_ 544 OBCM_CSSts 0;
BA_ "GenSigTimeoutTime_VDCM" SG_ 544 OBCM_CSSts 0;
BA_ "GenSigTimeoutTime_BPCM" SG_ 544 OBCM_CSSts 0;
BA_ "GenSigTimeoutTime_IDCM" SG_ 544 OBCM_CSSts 0;
BA_ "GenSigTimeoutTime_SGW" SG_ 544 OBCM_CSSts 0;
BA_ "GenSigTimeoutTime_HCP" SG_ 544 OBCM_CP3Sts 0;
BA_ "GenSigTimeoutTime_PPIM" SG_ 544 OBCM_CP3Sts 0;
BA_ "GenSigTimeoutTime_APM2" SG_ 544 OBCM_CP3Sts 0;
BA_ "GenSigTimeoutTime_VDCM" SG_ 544 OBCM_CP3Sts 0;
BA_ "GenSigTimeoutTime_BPCM" SG_ 544 OBCM_CP3Sts 0;
BA_ "GenSigTimeoutTime_IDCM" SG_ 544 OBCM_CP3Sts 0;
BA_ "GenSigTimeoutTime_SGW" SG_ 544 OBCM_CP3Sts 0;
BA_ "GenSigTimeoutTime_HCP" SG_ 544 OBCM_APAMSts 0;
BA_ "GenSigTimeoutTime_PPIM" SG_ 544 OBCM_APAMSts 0;
BA_ "GenSigTimeoutTime_APM2" SG_ 544 OBCM_APAMSts 0;
BA_ "GenSigTimeoutTime_VDCM" SG_ 544 OBCM_APAMSts 0;
BA_ "GenSigTimeoutTime_BPCM" SG_ 544 OBCM_APAMSts 0;
BA_ "GenSigTimeoutTime_IDCM" SG_ 544 OBCM_APAMSts 0;
BA_ "GenSigTimeoutTime_SGW" SG_ 544 OBCM_APAMSts 0;
BA_ "GenSigTimeoutTime_HCP" SG_ 544 OBCM_CCSts 0;
BA_ "GenSigTimeoutTime_PPIM" SG_ 544 OBCM_CCSts 0;
BA_ "GenSigTimeoutTime_APM2" SG_ 544 OBCM_CCSts 0;
BA_ "GenSigTimeoutTime_VDCM" SG_ 544 OBCM_CCSts 0;
BA_ "GenSigTimeoutTime_BPCM" SG_ 544 OBCM_CCSts 0;
BA_ "GenSigTimeoutTime_IDCM" SG_ 544 OBCM_CCSts 0;
BA_ "GenSigTimeoutTime_SGW" SG_ 544 OBCM_CCSts 0;
BA_ "GenSigTimeoutTime_HCP" SG_ 544 OBCM_CP2Sts 0;
BA_ "GenSigTimeoutTime_PPIM" SG_ 544 OBCM_CP2Sts 0;
BA_ "GenSigTimeoutTime_APM2" SG_ 544 OBCM_CP2Sts 0;
BA_ "GenSigTimeoutTime_VDCM" SG_ 544 OBCM_CP2Sts 0;
BA_ "GenSigTimeoutTime_BPCM" SG_ 544 OBCM_CP2Sts 0;
BA_ "GenSigTimeoutTime_IDCM" SG_ 544 OBCM_CP2Sts 0;
BA_ "GenSigTimeoutTime_SGW" SG_ 544 OBCM_CP2Sts 0;
BA_ "GenSigTimeoutTime_BPCM" SG_ 544 Plug_Locked_by_EVSE 0;
BA_ "GenSigTimeoutTime_IDCM" SG_ 544 Plug_Locked_by_EVSE 0;
BA_ "GenSigTimeoutTime_SGW" SG_ 544 Plug_Locked_by_EVSE 0;
BA_ "GenSigTimeoutTime_HCP" SG_ 544 Plug_Locked_by_EVSE 0;
BA_ "GenSigTimeoutTime_PPIM" SG_ 544 Plug_Locked_by_EVSE 0;
BA_ "GenSigTimeoutTime_APM2" SG_ 544 Plug_Locked_by_EVSE 0;
BA_ "GenSigTimeoutTime_VDCM" SG_ 544 Plug_Locked_by_EVSE 0;
BA_ "GenSigStartValue" SG_ 544 Plug_Locked_by_EVSE 2;
BA_ "GenSigTimeoutTime_HCP" SG_ 544 HVCMS_EVSEID 0;
BA_ "GenSigTimeoutTime_PPIM" SG_ 544 HVCMS_EVSEID 0;
BA_ "GenSigTimeoutTime_APM2" SG_ 544 HVCMS_EVSEID 0;
BA_ "GenSigTimeoutTime_VDCM" SG_ 544 HVCMS_EVSEID 0;
BA_ "GenSigTimeoutTime_BPCM" SG_ 544 HVCMS_EVSEID 0;
BA_ "GenSigTimeoutTime_IDCM" SG_ 544 HVCMS_EVSEID 0;
BA_ "GenSigTimeoutTime_SGW" SG_ 544 HVCMS_EVSEID 0;
BA_ "GenSigTimeoutTime_HCP" SG_ 544 EVSE_Error 0;
BA_ "GenSigTimeoutTime_PPIM" SG_ 544 EVSE_Error 0;
BA_ "GenSigTimeoutTime_APM2" SG_ 544 EVSE_Error 0;
BA_ "GenSigTimeoutTime_VDCM" SG_ 544 EVSE_Error 0;
BA_ "GenSigStartValue" SG_ 544 EVSE_Error 2;
BA_ "GenSigTimeoutTime_BPCM" SG_ 544 EVSE_Error 0;
BA_ "GenSigTimeoutTime_IDCM" SG_ 544 EVSE_Error 0;
BA_ "GenSigTimeoutTime_SGW" SG_ 544 EVSE_Error 0;
BA_ "GenSigTimeoutTime_HCP" SG_ 544 ExtChargerSts 0;
BA_ "GenSigTimeoutTime_PPIM" SG_ 544 ExtChargerSts 0;
BA_ "GenSigTimeoutTime_APM2" SG_ 544 ExtChargerSts 0;
BA_ "GenSigTimeoutTime_VDCM" SG_ 544 ExtChargerSts 0;
BA_ "GenSigStartValue" SG_ 544 ExtChargerSts 2;
BA_ "GenSigTimeoutTime_BPCM" SG_ 544 ExtChargerSts 0;
BA_ "GenSigTimeoutTime_IDCM" SG_ 544 ExtChargerSts 0;
BA_ "GenSigTimeoutTime_SGW" SG_ 544 ExtChargerSts 0;
BA_ "GenSigTimeoutTime_HCP" SG_ 546 CPIM_Error 0;
BA_ "GenSigTimeoutTime_PPIM" SG_ 546 CPIM_Error 0;
BA_ "GenSigTimeoutTime_APM2" SG_ 546 CPIM_Error 0;
BA_ "GenSigTimeoutTime_VDCM" SG_ 546 CPIM_Error 0;
BA_ "GenSigTimeoutTime_HCP" SG_ 546 CPIM_Over_Temperature 0;
BA_ "GenSigTimeoutTime_PPIM" SG_ 546 CPIM_Over_Temperature 0;
BA_ "GenSigTimeoutTime_APM2" SG_ 546 CPIM_Over_Temperature 0;
BA_ "GenSigTimeoutTime_VDCM" SG_ 546 CPIM_Over_Temperature 0;
BA_ "GenSigTimeoutTime_HCP" SG_ 546 VDCM_BattFullSOC_prc 0;
BA_ "GenSigTimeoutTime_PPIM" SG_ 546 VDCM_BattFullSOC_prc 0;
BA_ "GenSigTimeoutTime_APM2" SG_ 546 VDCM_BattFullSOC_prc 0;
BA_ "GenSigTimeoutTime_VDCM" SG_ 546 VDCM_BattFullSOC_prc 0;
BA_ "GenSigTimeoutTime_HCP" SG_ 546 VDCM_BattOverVolt 0;
BA_ "GenSigTimeoutTime_PPIM" SG_ 546 VDCM_BattOverVolt 0;
BA_ "GenSigTimeoutTime_APM2" SG_ 546 VDCM_BattOverVolt 0;
BA_ "GenSigTimeoutTime_VDCM" SG_ 546 VDCM_BattOverVolt 0;
BA_ "GenSigTimeoutTime_HCP" SG_ 546 VDCM_BattUnderVolt 0;
BA_ "GenSigTimeoutTime_PPIM" SG_ 546 VDCM_BattUnderVolt 0;
BA_ "GenSigTimeoutTime_APM2" SG_ 546 VDCM_BattUnderVolt 0;
BA_ "GenSigTimeoutTime_VDCM" SG_ 546 VDCM_BattUnderVolt 0;
BA_ "GenSigTimeoutTime_HCP" SG_ 546 VDCM_ChrgCompleteReason 0;
BA_ "GenSigTimeoutTime_PPIM" SG_ 546 VDCM_ChrgCompleteReason 0;
BA_ "GenSigTimeoutTime_APM2" SG_ 546 VDCM_ChrgCompleteReason 0;
BA_ "GenSigTimeoutTime_VDCM" SG_ 546 VDCM_ChrgCompleteReason 0;
BA_ "GenSigTimeoutTime_HCP" SG_ 544 GBT_EVSE_Charge_Permitting 0;
BA_ "GenSigTimeoutTime_PPIM" SG_ 544 GBT_EVSE_Charge_Permitting 0;
BA_ "GenSigTimeoutTime_APM2" SG_ 544 GBT_EVSE_Charge_Permitting 0;
BA_ "GenSigTimeoutTime_VDCM" SG_ 544 GBT_EVSE_Charge_Permitting 0;
BA_ "GenSigTimeoutTime_BPCM" SG_ 544 GBT_EVSE_Charge_Permitting 0;
BA_ "GenSigTimeoutTime_IDCM" SG_ 544 GBT_EVSE_Charge_Permitting 0;
BA_ "GenSigTimeoutTime_SGW" SG_ 544 GBT_EVSE_Charge_Permitting 0;
BA_ "GenSigTimeoutTime_HCP" SG_ 544 CC2_VoltageValue 0;
BA_ "GenSigTimeoutTime_PPIM" SG_ 544 CC2_VoltageValue 0;
BA_ "GenSigTimeoutTime_APM2" SG_ 544 CC2_VoltageValue 0;
BA_ "GenSigTimeoutTime_VDCM" SG_ 544 CC2_VoltageValue 0;
BA_ "GenSigTimeoutTime_BPCM" SG_ 544 CC2_VoltageValue 0;
BA_ "GenSigTimeoutTime_IDCM" SG_ 544 CC2_VoltageValue 0;
BA_ "GenSigTimeoutTime_SGW" SG_ 544 CC2_VoltageValue 0;
BA_ "GenSigTimeoutTime_HCP" SG_ 544 EVCC_FailureSts 0;
BA_ "GenSigTimeoutTime_PPIM" SG_ 544 EVCC_FailureSts 0;
BA_ "GenSigTimeoutTime_APM2" SG_ 544 EVCC_FailureSts 0;
BA_ "GenSigTimeoutTime_VDCM" SG_ 544 EVCC_FailureSts 0;
BA_ "GenSigTimeoutTime_BPCM" SG_ 544 EVCC_FailureSts 0;
BA_ "GenSigTimeoutTime_IDCM" SG_ 544 EVCC_FailureSts 0;
BA_ "GenSigTimeoutTime_SGW" SG_ 544 EVCC_FailureSts 0;
BA_ "GenSigTimeoutTime_HCP" SG_ 544 OBCM_Timeout 0;
BA_ "GenSigTimeoutTime_PPIM" SG_ 544 OBCM_Timeout 0;
BA_ "GenSigTimeoutTime_APM2" SG_ 544 OBCM_Timeout 0;
BA_ "GenSigTimeoutTime_VDCM" SG_ 544 OBCM_Timeout 0;
BA_ "GenSigTimeoutTime_BPCM" SG_ 544 OBCM_Timeout 0;
BA_ "GenSigTimeoutTime_IDCM" SG_ 544 OBCM_Timeout 0;
BA_ "GenSigTimeoutTime_SGW" SG_ 544 OBCM_Timeout 0;
BA_ "GenSigTimeoutTime_HCP" SG_ 544 TxGBTMessageRequest 0;
BA_ "GenSigTimeoutTime_PPIM" SG_ 544 TxGBTMessageRequest 0;
BA_ "GenSigTimeoutTime_APM2" SG_ 544 TxGBTMessageRequest 0;
BA_ "GenSigTimeoutTime_VDCM" SG_ 544 TxGBTMessageRequest 0;
BA_ "GenSigTimeoutTime_BPCM" SG_ 544 TxGBTMessageRequest 0;
BA_ "GenSigTimeoutTime_IDCM" SG_ 544 TxGBTMessageRequest 0;
BA_ "GenSigTimeoutTime_SGW" SG_ 544 TxGBTMessageRequest 0;
BA_ "GenSigTimeoutTime_HCP" SG_ 544 TxGBTMessageResponse 0;
BA_ "GenSigTimeoutTime_PPIM" SG_ 544 TxGBTMessageResponse 0;
BA_ "GenSigTimeoutTime_APM2" SG_ 544 TxGBTMessageResponse 0;
BA_ "GenSigTimeoutTime_VDCM" SG_ 544 TxGBTMessageResponse 0;
BA_ "GenSigTimeoutTime_BPCM" SG_ 544 TxGBTMessageResponse 0;
BA_ "GenSigTimeoutTime_IDCM" SG_ 544 TxGBTMessageResponse 0;
BA_ "GenSigTimeoutTime_SGW" SG_ 544 TxGBTMessageResponse 0;
BA_ "GenSigTimeoutTime_HCP" SG_ 544 OBCM_CP1Sts 0;
BA_ "GenSigTimeoutTime_PPIM" SG_ 544 OBCM_CP1Sts 0;
BA_ "GenSigTimeoutTime_APM2" SG_ 544 OBCM_CP1Sts 0;
BA_ "GenSigTimeoutTime_VDCM" SG_ 544 OBCM_CP1Sts 0;
BA_ "GenSigTimeoutTime_BPCM" SG_ 544 OBCM_CP1Sts 0;
BA_ "GenSigTimeoutTime_IDCM" SG_ 544 OBCM_CP1Sts 0;
BA_ "GenSigTimeoutTime_SGW" SG_ 544 OBCM_CP1Sts 0;
BA_ "GenSigTimeoutTime_HCP" SG_ 544 TCP_Communication_Terminated 0;
BA_ "GenSigTimeoutTime_PPIM" SG_ 544 TCP_Communication_Terminated 0;
BA_ "GenSigTimeoutTime_APM2" SG_ 544 TCP_Communication_Terminated 0;
BA_ "GenSigTimeoutTime_VDCM" SG_ 544 TCP_Communication_Terminated 0;
BA_ "GenSigTimeoutTime_BPCM" SG_ 544 TCP_Communication_Terminated 0;
BA_ "GenSigTimeoutTime_IDCM" SG_ 544 TCP_Communication_Terminated 0;
BA_ "GenSigTimeoutTime_SGW" SG_ 544 TCP_Communication_Terminated 0;
BA_ "GenSigTimeoutTime_HCP" SG_ 546 BMS_HV_BatActualPower_VDCM 0;
BA_ "GenSigTimeoutTime_PPIM" SG_ 546 BMS_HV_BatActualPower_VDCM 0;
BA_ "GenSigTimeoutTime_APM2" SG_ 546 BMS_HV_BatActualPower_VDCM 0;
BA_ "GenSigTimeoutTime_VDCM" SG_ 546 BMS_HV_BatActualPower_VDCM 0;
BA_ "GenSigTimeoutTime_BPCM" SG_ 546 BMS_HV_BatActualPower_VDCM 0;
BA_ "GenSigTimeoutTime_HCP" SG_ 546 BMS_HV_BatState_VDCM 0;
BA_ "GenSigTimeoutTime_PPIM" SG_ 546 BMS_HV_BatState_VDCM 0;
BA_ "GenSigTimeoutTime_APM2" SG_ 546 BMS_HV_BatState_VDCM 0;
BA_ "GenSigTimeoutTime_VDCM" SG_ 546 BMS_HV_BatState_VDCM 0;
BA_ "GenSigTimeoutTime_BPCM" SG_ 546 BMS_HV_BatState_VDCM 0;
BA_ "GenSigTimeoutTime_HCP" SG_ 546 BMS_HV_Char_Bus_Sts_VDCM 0;
BA_ "GenSigTimeoutTime_PPIM" SG_ 546 BMS_HV_Char_Bus_Sts_VDCM 0;
BA_ "GenSigTimeoutTime_APM2" SG_ 546 BMS_HV_Char_Bus_Sts_VDCM 0;
BA_ "GenSigTimeoutTime_VDCM" SG_ 546 BMS_HV_Char_Bus_Sts_VDCM 0;
BA_ "GenSigTimeoutTime_BPCM" SG_ 546 BMS_HV_Char_Bus_Sts_VDCM 0;
BA_ "GenSigTimeoutTime_HCP" SG_ 546 BMS_HV_ChargingBusVoltage_VDCM 0;
BA_ "GenSigTimeoutTime_PPIM" SG_ 546 BMS_HV_ChargingBusVoltage_VDCM 0;
BA_ "GenSigTimeoutTime_APM2" SG_ 546 BMS_HV_ChargingBusVoltage_VDCM 0;
BA_ "GenSigTimeoutTime_VDCM" SG_ 546 BMS_HV_ChargingBusVoltage_VDCM 0;
BA_ "GenSigTimeoutTime_BPCM" SG_ 546 BMS_HV_ChargingBusVoltage_VDCM 0;
BA_ "GenSigTimeoutTime_HCP" SG_ 546 BMS_HV_Trac_Bus_Sts_VDCM 0;
BA_ "GenSigTimeoutTime_PPIM" SG_ 546 BMS_HV_Trac_Bus_Sts_VDCM 0;
BA_ "GenSigTimeoutTime_APM2" SG_ 546 BMS_HV_Trac_Bus_Sts_VDCM 0;
BA_ "GenSigTimeoutTime_VDCM" SG_ 546 BMS_HV_Trac_Bus_Sts_VDCM 0;
BA_ "GenSigTimeoutTime_BPCM" SG_ 546 BMS_HV_Trac_Bus_Sts_VDCM 0;
BA_ "GenSigTimeoutTime_HCP" SG_ 546 BMS_HV_TractionBusVoltage_VDCM 0;
BA_ "GenSigTimeoutTime_PPIM" SG_ 546 BMS_HV_TractionBusVoltage_VDCM 0;
BA_ "GenSigTimeoutTime_APM2" SG_ 546 BMS_HV_TractionBusVoltage_VDCM 0;
BA_ "GenSigTimeoutTime_VDCM" SG_ 546 BMS_HV_TractionBusVoltage_VDCM 0;
BA_ "GenSigTimeoutTime_BPCM" SG_ 546 BMS_HV_TractionBusVoltage_VDCM 0;
BA_ "GenSigTimeoutTime_HCP" SG_ 546 GBT_Charger_Active_Interruption 0;
BA_ "GenSigTimeoutTime_PPIM" SG_ 546 GBT_Charger_Active_Interruption 0;
BA_ "GenSigTimeoutTime_APM2" SG_ 546 GBT_Charger_Active_Interruption 0;
BA_ "GenSigTimeoutTime_VDCM" SG_ 546 GBT_Charger_Active_Interruption 0;
BA_ "GenSigTimeoutTime_HCP" SG_ 546 GBT_Desired_SOC_Reached 0;
BA_ "GenSigTimeoutTime_PPIM" SG_ 546 GBT_Desired_SOC_Reached 0;
BA_ "GenSigTimeoutTime_APM2" SG_ 546 GBT_Desired_SOC_Reached 0;
BA_ "GenSigTimeoutTime_VDCM" SG_ 546 GBT_Desired_SOC_Reached 0;
BA_ "GenSigTimeoutTime_HCP" SG_ 546 GBT_Ready_to_Charge 0;
BA_ "GenSigTimeoutTime_PPIM" SG_ 546 GBT_Ready_to_Charge 0;
BA_ "GenSigTimeoutTime_APM2" SG_ 546 GBT_Ready_to_Charge 0;
BA_ "GenSigTimeoutTime_VDCM" SG_ 546 GBT_Ready_to_Charge 0;
BA_ "GenSigTimeoutTime_HCP" SG_ 546 GBT_Target_Cell_Voltage_Reached 0;
BA_ "GenSigTimeoutTime_PPIM" SG_ 546 GBT_Target_Cell_Voltage_Reached 0;
BA_ "GenSigTimeoutTime_APM2" SG_ 546 GBT_Target_Cell_Voltage_Reached 0;
BA_ "GenSigTimeoutTime_VDCM" SG_ 546 GBT_Target_Cell_Voltage_Reached 0;
BA_ "GenSigTimeoutTime_HCP" SG_ 546 GBT_Target_Voltage_Reached 0;
BA_ "GenSigTimeoutTime_PPIM" SG_ 546 GBT_Target_Voltage_Reached 0;
BA_ "GenSigTimeoutTime_APM2" SG_ 546 GBT_Target_Voltage_Reached 0;
BA_ "GenSigTimeoutTime_VDCM" SG_ 546 GBT_Target_Voltage_Reached 0;
BA_ "GenSigTimeoutTime_HCP" SG_ 546 VDCM_ChargingPermitting 0;
BA_ "GenSigTimeoutTime_PPIM" SG_ 546 VDCM_ChargingPermitting 0;
BA_ "GenSigTimeoutTime_APM2" SG_ 546 VDCM_ChargingPermitting 0;
BA_ "GenSigTimeoutTime_VDCM" SG_ 546 VDCM_ChargingPermitting 0;
BA_ "GenSigTimeoutTime_HCP" SG_ 546 BMS_HV_Char_Main_Contac_Sts_VDCM 0;
BA_ "GenSigTimeoutTime_PPIM" SG_ 546 BMS_HV_Char_Main_Contac_Sts_VDCM 0;
BA_ "GenSigTimeoutTime_VDCM" SG_ 546 BMS_HV_Char_Main_Contac_Sts_VDCM 0;
BA_ "GenSigTimeoutTime_BPCM" SG_ 546 BMS_HV_Char_Main_Contac_Sts_VDCM 0;
BA_ "GenSigTimeoutTime_HCP" SG_ 546 BMS_HV_Char_PreCha_Contac_Sts_V 0;
BA_ "GenSigTimeoutTime_PPIM" SG_ 546 BMS_HV_Char_PreCha_Contac_Sts_V 0;
BA_ "GenSigTimeoutTime_VDCM" SG_ 546 BMS_HV_Char_PreCha_Contac_Sts_V 0;
BA_ "GenSigTimeoutTime_BPCM" SG_ 546 BMS_HV_Char_PreCha_Contac_Sts_V 0;
BA_ "GenSigTimeoutTime_SGW" SG_ 546 VDCM_ChrgCompleteReason 0;
BA_ "GenSigTimeoutTime_BPCM" SG_ 546 VDCM_ChrgCompleteReason 0;
BA_ "GenSigTimeoutTime_EVCU2" SG_ 546 VDCM_ChrgCompleteReason 0;
BA_ "GenSigTimeoutTime_BPCM" SG_ 546 VDCM_BattUnderVolt 0;
BA_ "GenSigTimeoutTime_EVCU2" SG_ 546 VDCM_BattUnderVolt 0;
BA_ "GenSigTimeoutTime_SGW" SG_ 546 VDCM_BattUnderVolt 0;
BA_ "GenSigTimeoutTime_HCP" SG_ 546 VDCM_ChrgCurrDeviationErr 0;
BA_ "GenSigTimeoutTime_PPIM" SG_ 546 VDCM_ChrgCurrDeviationErr 0;
BA_ "GenSigTimeoutTime_APM2" SG_ 546 VDCM_ChrgCurrDeviationErr 0;
BA_ "GenSigTimeoutTime_VDCM" SG_ 546 VDCM_ChrgCurrDeviationErr 0;
BA_ "GenSigTimeoutTime_HCP" SG_ 546 VDCM_ChrgMode_Req 0;
BA_ "GenSigTimeoutTime_PPIM" SG_ 546 VDCM_ChrgMode_Req 0;
BA_ "GenSigTimeoutTime_APM2" SG_ 546 VDCM_ChrgMode_Req 0;
BA_ "GenSigTimeoutTime_VDCM" SG_ 546 VDCM_ChrgMode_Req 0;
BA_ "GenSigTimeoutTime_BPCM" SG_ 546 VDCM_BattOverVolt 0;
BA_ "GenSigTimeoutTime_EVCU2" SG_ 546 VDCM_BattOverVolt 0;
BA_ "GenSigTimeoutTime_SGW" SG_ 546 VDCM_BattOverVolt 0;
BA_ "GenSigStartValue" SG_ 546 VDCM_BattFullSOC_prc 100;
BA_ "GenSigTimeoutTime_BPCM" SG_ 546 VDCM_BattFullSOC_prc 0;
BA_ "GenSigTimeoutTime_EVCU2" SG_ 546 VDCM_BattFullSOC_prc 0;
BA_ "GenSigTimeoutTime_SGW" SG_ 546 VDCM_BattFullSOC_prc 0;
BA_ "GenSigTimeoutTime_BPCM" SG_ 546 CPIM_Over_Temperature 0;
BA_ "GenSigTimeoutTime_EVCU2" SG_ 546 CPIM_Over_Temperature 0;
BA_ "GenSigTimeoutTime_SGW" SG_ 546 CPIM_Over_Temperature 0;
BA_ "GenSigTimeoutTime_BPCM" SG_ 546 CPIM_Error 0;
BA_ "GenSigTimeoutTime_EVCU2" SG_ 546 CPIM_Error 0;
BA_ "GenSigTimeoutTime_SGW" SG_ 546 CPIM_Error 0;
BA_ "GenSigTimeoutTime_HCP" SG_ 546 VDCM_EstChrgTime_min 0;
BA_ "GenSigTimeoutTime_PPIM" SG_ 546 VDCM_EstChrgTime_min 0;
BA_ "GenSigTimeoutTime_APM2" SG_ 546 VDCM_EstChrgTime_min 0;
BA_ "GenSigTimeoutTime_VDCM" SG_ 546 VDCM_EstChrgTime_min 0;
BA_ "GenSigTimeoutTime_HCP" SG_ 546 VDCM_EV_Batt_Max_T_Limit 0;
BA_ "GenSigTimeoutTime_PPIM" SG_ 546 VDCM_EV_Batt_Max_T_Limit 0;
BA_ "GenSigTimeoutTime_APM2" SG_ 546 VDCM_EV_Batt_Max_T_Limit 0;
BA_ "GenSigTimeoutTime_VDCM" SG_ 546 VDCM_EV_Batt_Max_T_Limit 0;
BA_ "GenSigTimeoutTime_HCP" SG_ 546 VDCM_MaxChrgTime_min 0;
BA_ "GenSigTimeoutTime_PPIM" SG_ 546 VDCM_MaxChrgTime_min 0;
BA_ "GenSigTimeoutTime_APM2" SG_ 546 VDCM_MaxChrgTime_min 0;
BA_ "GenSigTimeoutTime_VDCM" SG_ 546 VDCM_MaxChrgTime_min 0;
BA_ "GenSigTimeoutTime_HCP" SG_ 546 VDCM_MaxChrgTime_sec 0;
BA_ "GenSigTimeoutTime_PPIM" SG_ 546 VDCM_MaxChrgTime_sec 0;
BA_ "GenSigTimeoutTime_APM2" SG_ 546 VDCM_MaxChrgTime_sec 0;
BA_ "GenSigTimeoutTime_VDCM" SG_ 546 VDCM_MaxChrgTime_sec 0;
BA_ "GenSigTimeoutTime_HCP" SG_ 546 AC_Chrg_Branch_Voltage_VDCM 0;
BA_ "GenSigTimeoutTime_PPIM" SG_ 546 AC_Chrg_Branch_Voltage_VDCM 0;
BA_ "GenSigTimeoutTime_APM2" SG_ 546 AC_Chrg_Branch_Voltage_VDCM 0;
BA_ "GenSigTimeoutTime_VDCM" SG_ 546 AC_Chrg_Branch_Voltage_VDCM 0;
BA_ "GenSigTimeoutTime_HCP" SG_ 546 BMS_Cell_Volt_Max_VDCM 0;
BA_ "GenSigTimeoutTime_PPIM" SG_ 546 BMS_Cell_Volt_Max_VDCM 0;
BA_ "GenSigTimeoutTime_APM2" SG_ 546 BMS_Cell_Volt_Max_VDCM 0;
BA_ "GenSigTimeoutTime_VDCM" SG_ 546 BMS_Cell_Volt_Max_VDCM 0;
BA_ "GenSigTimeoutTime_HCP" SG_ 546 BMS_Cell_Volt_Max_Vldty_VDCM 0;
BA_ "GenSigTimeoutTime_PPIM" SG_ 546 BMS_Cell_Volt_Max_Vldty_VDCM 0;
BA_ "GenSigTimeoutTime_APM2" SG_ 546 BMS_Cell_Volt_Max_Vldty_VDCM 0;
BA_ "GenSigTimeoutTime_VDCM" SG_ 546 BMS_Cell_Volt_Max_Vldty_VDCM 0;
BA_ "GenSigTimeoutTime_HCP" SG_ 546 BMS_Cell_Volt_Min_VDCM 0;
BA_ "GenSigTimeoutTime_PPIM" SG_ 546 BMS_Cell_Volt_Min_VDCM 0;
BA_ "GenSigTimeoutTime_APM2" SG_ 546 BMS_Cell_Volt_Min_VDCM 0;
BA_ "GenSigTimeoutTime_VDCM" SG_ 546 BMS_Cell_Volt_Min_VDCM 0;
BA_ "GenSigTimeoutTime_HCP" SG_ 546 BMS_Cell_Volt_Min_Vldty_VDCM 0;
BA_ "GenSigTimeoutTime_PPIM" SG_ 546 BMS_Cell_Volt_Min_Vldty_VDCM 0;
BA_ "GenSigTimeoutTime_APM2" SG_ 546 BMS_Cell_Volt_Min_Vldty_VDCM 0;
BA_ "GenSigTimeoutTime_VDCM" SG_ 546 BMS_Cell_Volt_Min_Vldty_VDCM 0;
BA_ "GenSigTimeoutTime_HCP" SG_ 546 BMS_HV_AC_Char_Main_Contac_Sts_ 0;
BA_ "GenSigTimeoutTime_PPIM" SG_ 546 BMS_HV_AC_Char_Main_Contac_Sts_ 0;
BA_ "GenSigTimeoutTime_APM2" SG_ 546 BMS_HV_AC_Char_Main_Contac_Sts_ 0;
BA_ "GenSigTimeoutTime_VDCM" SG_ 546 BMS_HV_AC_Char_Main_Contac_Sts_ 0;
BA_ "GenSigTimeoutTime_BPCM" SG_ 546 BMS_HV_AC_Char_Main_Contac_Sts_ 0;
BA_ "GenSigTimeoutTime_HCP" SG_ 546 BMS_HV_BatIntrlk_InternalStat_V 0;
BA_ "GenSigTimeoutTime_PPIM" SG_ 546 BMS_HV_BatIntrlk_InternalStat_V 0;
BA_ "GenSigTimeoutTime_APM2" SG_ 546 BMS_HV_BatIntrlk_InternalStat_V 0;
BA_ "GenSigTimeoutTime_VDCM" SG_ 546 BMS_HV_BatIntrlk_InternalStat_V 0;
BA_ "GenSigTimeoutTime_BPCM" SG_ 546 BMS_HV_BatIntrlk_InternalStat_V 0;
BA_ "GenSigTimeoutTime_HCP" SG_ 546 BMS_HV_Battery_GFD_Sts_VDCM 0;
BA_ "GenSigTimeoutTime_PPIM" SG_ 546 BMS_HV_Battery_GFD_Sts_VDCM 0;
BA_ "GenSigTimeoutTime_APM2" SG_ 546 BMS_HV_Battery_GFD_Sts_VDCM 0;
BA_ "GenSigTimeoutTime_VDCM" SG_ 546 BMS_HV_Battery_GFD_Sts_VDCM 0;
BA_ "GenSigTimeoutTime_BPCM" SG_ 546 BMS_HV_Battery_GFD_Sts_VDCM 0;
BA_ "GenSigTimeoutTime_HCP" SG_ 546 BMS_HV_Common_Contactor_Sts_VDCM 0;
BA_ "GenSigTimeoutTime_PPIM" SG_ 546 BMS_HV_Common_Contactor_Sts_VDCM 0;
BA_ "GenSigTimeoutTime_APM2" SG_ 546 BMS_HV_Common_Contactor_Sts_VDCM 0;
BA_ "GenSigTimeoutTime_VDCM" SG_ 546 BMS_HV_Common_Contactor_Sts_VDCM 0;
BA_ "GenSigTimeoutTime_BPCM" SG_ 546 BMS_HV_Common_Contactor_Sts_VDCM 0;
BA_ "GenSigTimeoutTime_HCP" SG_ 546 BMS_HV_High_Temp_Thrsh_VDCM 0;
BA_ "GenSigTimeoutTime_PPIM" SG_ 546 BMS_HV_High_Temp_Thrsh_VDCM 0;
BA_ "GenSigTimeoutTime_APM2" SG_ 546 BMS_HV_High_Temp_Thrsh_VDCM 0;
BA_ "GenSigTimeoutTime_VDCM" SG_ 546 BMS_HV_High_Temp_Thrsh_VDCM 0;
BA_ "GenSigTimeoutTime_HCP" SG_ 546 BMS_HV_InternalVoltage_VDCM 0;
BA_ "GenSigTimeoutTime_PPIM" SG_ 546 BMS_HV_InternalVoltage_VDCM 0;
BA_ "GenSigTimeoutTime_VDCM" SG_ 546 BMS_HV_InternalVoltage_VDCM 0;
BA_ "GenSigTimeoutTime_BPCM" SG_ 546 BMS_HV_InternalVoltage_VDCM 0;
BA_ "GenSigTimeoutTime_IDCM" SG_ 546 BMS_HV_InternalVoltage_VDCM 0;
BA_ "GenSigTimeoutTime_HCP" SG_ 546 BMS_HV_Low_Temp_Thrsh_VDCM 0;
BA_ "GenSigTimeoutTime_PPIM" SG_ 546 BMS_HV_Low_Temp_Thrsh_VDCM 0;
BA_ "GenSigTimeoutTime_APM2" SG_ 546 BMS_HV_Low_Temp_Thrsh_VDCM 0;
BA_ "GenSigTimeoutTime_VDCM" SG_ 546 BMS_HV_Low_Temp_Thrsh_VDCM 0;
BA_ "GenSigTimeoutTime_HCP" SG_ 546 BMS_HV_NumCellMaxTemp_VDCM 0;
BA_ "GenSigTimeoutTime_PPIM" SG_ 546 BMS_HV_NumCellMaxTemp_VDCM 0;
BA_ "GenSigTimeoutTime_APM2" SG_ 546 BMS_HV_NumCellMaxTemp_VDCM 0;
BA_ "GenSigTimeoutTime_VDCM" SG_ 546 BMS_HV_NumCellMaxTemp_VDCM 0;
BA_ "GenSigTimeoutTime_HCP" SG_ 546 BMS_HV_NumCellMaxVolt_VDCM 0;
BA_ "GenSigTimeoutTime_PPIM" SG_ 546 BMS_HV_NumCellMaxVolt_VDCM 0;
BA_ "GenSigTimeoutTime_APM2" SG_ 546 BMS_HV_NumCellMaxVolt_VDCM 0;
BA_ "GenSigTimeoutTime_VDCM" SG_ 546 BMS_HV_NumCellMaxVolt_VDCM 0;
BA_ "GenSigTimeoutTime_HCP" SG_ 546 BMS_HV_NumCellMinTemp_VDCM 0;
BA_ "GenSigTimeoutTime_PPIM" SG_ 546 BMS_HV_NumCellMinTemp_VDCM 0;
BA_ "GenSigTimeoutTime_APM2" SG_ 546 BMS_HV_NumCellMinTemp_VDCM 0;
BA_ "GenSigTimeoutTime_VDCM" SG_ 546 BMS_HV_NumCellMinTemp_VDCM 0;
BA_ "GenSigTimeoutTime_HCP" SG_ 546 BMS_HV_SOC_AccuracySts_VDCM 0;
BA_ "GenSigTimeoutTime_PPIM" SG_ 546 BMS_HV_SOC_AccuracySts_VDCM 0;
BA_ "GenSigTimeoutTime_APM2" SG_ 546 BMS_HV_SOC_AccuracySts_VDCM 0;
BA_ "GenSigTimeoutTime_VDCM" SG_ 546 BMS_HV_SOC_AccuracySts_VDCM 0;
BA_ "GenSigTimeoutTime_HCP" SG_ 546 BMS_HV_Temperature_Max_VDCM 0;
BA_ "GenSigTimeoutTime_PPIM" SG_ 546 BMS_HV_Temperature_Max_VDCM 0;
BA_ "GenSigTimeoutTime_APM2" SG_ 546 BMS_HV_Temperature_Max_VDCM 0;
BA_ "GenSigTimeoutTime_VDCM" SG_ 546 BMS_HV_Temperature_Max_VDCM 0;
BA_ "GenSigTimeoutTime_HCP" SG_ 546 BMS_HV_Temperature_Min_VDCM 0;
BA_ "GenSigTimeoutTime_PPIM" SG_ 546 BMS_HV_Temperature_Min_VDCM 0;
BA_ "GenSigTimeoutTime_APM2" SG_ 546 BMS_HV_Temperature_Min_VDCM 0;
BA_ "GenSigTimeoutTime_VDCM" SG_ 546 BMS_HV_Temperature_Min_VDCM 0;
BA_ "GenSigTimeoutTime_HCP" SG_ 546 BMS_HV_Trac_Main_Contac_Sts_VDCM 0;
BA_ "GenSigTimeoutTime_PPIM" SG_ 546 BMS_HV_Trac_Main_Contac_Sts_VDCM 0;
BA_ "GenSigTimeoutTime_APM2" SG_ 546 BMS_HV_Trac_Main_Contac_Sts_VDCM 0;
BA_ "GenSigTimeoutTime_VDCM" SG_ 546 BMS_HV_Trac_Main_Contac_Sts_VDCM 0;
BA_ "GenSigTimeoutTime_BPCM" SG_ 546 BMS_HV_Trac_Main_Contac_Sts_VDCM 0;
BA_ "GenSigTimeoutTime_HCP" SG_ 546 BMS_HV_Trac_PreCha_Contac_Sts_V 0;
BA_ "GenSigTimeoutTime_PPIM" SG_ 546 BMS_HV_Trac_PreCha_Contac_Sts_V 0;
BA_ "GenSigTimeoutTime_APM2" SG_ 546 BMS_HV_Trac_PreCha_Contac_Sts_V 0;
BA_ "GenSigTimeoutTime_VDCM" SG_ 546 BMS_HV_Trac_PreCha_Contac_Sts_V 0;
BA_ "GenSigTimeoutTime_BPCM" SG_ 546 BMS_HV_Trac_PreCha_Contac_Sts_V 0;
BA_ "GenSigTimeoutTime_HCP" SG_ 546 BMS_Max_Cell_Volt_Allowed_VDCM 0;
BA_ "GenSigTimeoutTime_PPIM" SG_ 546 BMS_Max_Cell_Volt_Allowed_VDCM 0;
BA_ "GenSigTimeoutTime_APM2" SG_ 546 BMS_Max_Cell_Volt_Allowed_VDCM 0;
BA_ "GenSigTimeoutTime_VDCM" SG_ 546 BMS_Max_Cell_Volt_Allowed_VDCM 0;
BA_ "GenSigTimeoutTime_HCP" SG_ 546 BMS_Max_Cell_Volt_Allowed_Vldty 0;
BA_ "GenSigTimeoutTime_PPIM" SG_ 546 BMS_Max_Cell_Volt_Allowed_Vldty 0;
BA_ "GenSigTimeoutTime_APM2" SG_ 546 BMS_Max_Cell_Volt_Allowed_Vldty 0;
BA_ "GenSigTimeoutTime_VDCM" SG_ 546 BMS_Max_Cell_Volt_Allowed_Vldty 0;
BA_ "GenSigTimeoutTime_HCP" SG_ 546 BMS_Max_Pk_Volt_Allowed_VDCM 0;
BA_ "GenSigTimeoutTime_PPIM" SG_ 546 BMS_Max_Pk_Volt_Allowed_VDCM 0;
BA_ "GenSigTimeoutTime_APM2" SG_ 546 BMS_Max_Pk_Volt_Allowed_VDCM 0;
BA_ "GenSigTimeoutTime_VDCM" SG_ 546 BMS_Max_Pk_Volt_Allowed_VDCM 0;
BA_ "GenSigTimeoutTime_HCP" SG_ 546 DCChrg_BatSideCurrent_VDCM 0;
BA_ "GenSigTimeoutTime_PPIM" SG_ 546 DCChrg_BatSideCurrent_VDCM 0;
BA_ "GenSigTimeoutTime_VDCM" SG_ 546 DCChrg_BatSideCurrent_VDCM 0;
BA_ "GenSigTimeoutTime_HCP" SG_ 546 HCP_DC_Retry 0;
BA_ "GenSigTimeoutTime_PPIM" SG_ 546 HCP_DC_Retry 0;
BA_ "GenSigTimeoutTime_APM2" SG_ 546 HCP_DC_Retry 0;
BA_ "GenSigTimeoutTime_VDCM" SG_ 546 HCP_DC_Retry 0;
BA_ "GenSigTimeoutTime_BPCM" SG_ 546 VDCM_CellVoltIsOOR 0;
BA_ "GenSigTimeoutTime_EVCU2" SG_ 546 VDCM_CellVoltIsOOR 0;
BA_ "GenSigTimeoutTime_SGW" SG_ 546 VDCM_CellVoltIsOOR 0;
BA_ "GenSigTimeoutTime_BPCM" SG_ 546 VDCM_BattTempIsOOR 0;
BA_ "GenSigTimeoutTime_EVCU2" SG_ 546 VDCM_BattTempIsOOR 0;
BA_ "GenSigTimeoutTime_SGW" SG_ 546 VDCM_BattTempIsOOR 0;
BA_ "GenSigTimeoutTime_BPCM" SG_ 546 ReadyToChargeState 0;
BA_ "GenSigTimeoutTime_EVCU2" SG_ 546 ReadyToChargeState 0;
BA_ "GenSigTimeoutTime_SGW" SG_ 546 ReadyToChargeState 0;
BA_ "GenSigTimeoutTime_HCP" SG_ 546 HCP_SessionStopCmd 0;
BA_ "GenSigTimeoutTime_PPIM" SG_ 546 HCP_SessionStopCmd 0;
BA_ "GenSigTimeoutTime_APM2" SG_ 546 HCP_SessionStopCmd 0;
BA_ "GenSigTimeoutTime_VDCM" SG_ 546 HCP_SessionStopCmd 0;
BA_ "GenSigTimeoutTime_PPIM" SG_ 546 VDCM_ChargeCurrIsOOR 0;
BA_ "GenSigTimeoutTime_APM2" SG_ 546 VDCM_ChargeCurrIsOOR 0;
BA_ "GenSigTimeoutTime_VDCM" SG_ 546 VDCM_ChargeCurrIsOOR 0;
BA_ "GenSigTimeoutTime_BPCM" SG_ 546 VDCM_ChargeCurrIsOOR 0;
BA_ "GenSigTimeoutTime_EVCU2" SG_ 546 VDCM_ChargeCurrIsOOR 0;
BA_ "GenSigTimeoutTime_SGW" SG_ 546 VDCM_ChargeCurrIsOOR 0;
BA_ "GenSigTimeoutTime_HCP" SG_ 546 VDCM_SOCIsOOR 0;
BA_ "GenSigTimeoutTime_PPIM" SG_ 546 VDCM_SOCIsOOR 0;
BA_ "GenSigTimeoutTime_APM2" SG_ 546 VDCM_SOCIsOOR 0;
BA_ "GenSigTimeoutTime_VDCM" SG_ 546 VDCM_SOCIsOOR 0;
BA_ "GenSigTimeoutTime_BPCM" SG_ 546 VDCM_SOCIsOOR 0;
BA_ "GenSigTimeoutTime_EVCU2" SG_ 546 VDCM_SOCIsOOR 0;
BA_ "GenSigTimeoutTime_SGW" SG_ 546 VDCM_SOCIsOOR 0;
BA_ "GenSigTimeoutTime_HCP" SG_ 546 WeldCheck_Complete 0;
BA_ "GenSigTimeoutTime_PPIM" SG_ 546 WeldCheck_Complete 0;
BA_ "GenSigTimeoutTime_APM2" SG_ 546 WeldCheck_Complete 0;
BA_ "GenSigTimeoutTime_VDCM" SG_ 546 WeldCheck_Complete 0;
BA_ "GenSigTimeoutTime_BPCM" SG_ 546 WeldCheck_Complete 0;
BA_ "GenSigTimeoutTime_EVCU2" SG_ 546 WeldCheck_Complete 0;
BA_ "GenSigTimeoutTime_SGW" SG_ 546 WeldCheck_Complete 0;
BA_ "GenSigTimeoutTime_BPCM" SG_ 546 HCP_SessionStopCmd 0;
BA_ "GenSigTimeoutTime_EVCU2" SG_ 546 HCP_SessionStopCmd 0;
BA_ "GenSigTimeoutTime_SGW" SG_ 546 HCP_SessionStopCmd 0;
BA_ "GenSigTimeoutTime_BPCM" SG_ 546 HCP_DC_Retry 0;
BA_ "GenSigTimeoutTime_EVCU2" SG_ 546 HCP_DC_Retry 0;
BA_ "GenSigTimeoutTime_SGW" SG_ 546 HCP_DC_Retry 0;
BA_ "GenSigStartValue" SG_ 546 DCChrg_BatSideCurrent_VDCM 50;
BA_ "GenSigTimeoutTime_BPCM" SG_ 546 DCChrg_BatSideCurrent_VDCM 0;
BA_ "GenSigTimeoutTime_EVCU2" SG_ 546 DCChrg_BatSideCurrent_VDCM 0;
BA_ "GenSigTimeoutTime_SGW" SG_ 546 DCChrg_BatSideCurrent_VDCM 0;
BA_ "GenSigTimeoutTime_BPCM" SG_ 546 BMS_Max_Pk_Volt_Allowed_VDCM 0;
BA_ "GenSigTimeoutTime_EVCU2" SG_ 546 BMS_Max_Pk_Volt_Allowed_VDCM 0;
BA_ "GenSigTimeoutTime_SGW" SG_ 546 BMS_Max_Pk_Volt_Allowed_VDCM 0;
BA_ "SystemSignalLongSymbol" SG_ 546 BMS_Max_Cell_Volt_Allowed_Vldty "BMS_Max_Cell_Volt_Allowed_Vldty_VDCM";
BA_ "GenSigTimeoutTime_BPCM" SG_ 546 BMS_Max_Cell_Volt_Allowed_Vldty 0;
BA_ "GenSigTimeoutTime_EVCU2" SG_ 546 BMS_Max_Cell_Volt_Allowed_Vldty 0;
BA_ "GenSigTimeoutTime_SGW" SG_ 546 BMS_Max_Cell_Volt_Allowed_Vldty 0;
BA_ "GenSigTimeoutTime_BPCM" SG_ 546 BMS_Max_Cell_Volt_Allowed_VDCM 0;
BA_ "GenSigTimeoutTime_EVCU2" SG_ 546 BMS_Max_Cell_Volt_Allowed_VDCM 0;
BA_ "GenSigTimeoutTime_SGW" SG_ 546 BMS_Max_Cell_Volt_Allowed_VDCM 0;
BA_ "SystemSignalLongSymbol" SG_ 546 BMS_HV_Trac_PreCha_Contac_Sts_V "BMS_HV_Trac_PreCha_Contac_Sts_VDCM";
BA_ "GenSigTimeoutTime_EVCU2" SG_ 546 BMS_HV_Trac_PreCha_Contac_Sts_V 0;
BA_ "GenSigTimeoutTime_SGW" SG_ 546 BMS_HV_Trac_PreCha_Contac_Sts_V 0;
BA_ "GenSigTimeoutTime_EVCU2" SG_ 546 BMS_HV_Trac_Main_Contac_Sts_VDCM 0;
BA_ "GenSigTimeoutTime_SGW" SG_ 546 BMS_HV_Trac_Main_Contac_Sts_VDCM 0;
BA_ "GenSigTimeoutTime_BPCM" SG_ 546 BMS_HV_Temperature_Min_VDCM 0;
BA_ "GenSigTimeoutTime_EVCU2" SG_ 546 BMS_HV_Temperature_Min_VDCM 0;
BA_ "GenSigTimeoutTime_SGW" SG_ 546 BMS_HV_Temperature_Min_VDCM 0;
BA_ "GenSigTimeoutTime_BPCM" SG_ 546 BMS_HV_Temperature_Max_VDCM 0;
BA_ "GenSigTimeoutTime_EVCU2" SG_ 546 BMS_HV_Temperature_Max_VDCM 0;
BA_ "GenSigTimeoutTime_SGW" SG_ 546 BMS_HV_Temperature_Max_VDCM 0;
BA_ "GenSigSendType" SG_ 546 BMS_HV_SOC_AccuracySts_VDCM 3;
BA_ "GenSigTimeoutTime_BPCM" SG_ 546 BMS_HV_SOC_AccuracySts_VDCM 0;
BA_ "GenSigTimeoutTime_EVCU2" SG_ 546 BMS_HV_SOC_AccuracySts_VDCM 0;
BA_ "GenSigTimeoutTime_SGW" SG_ 546 BMS_HV_SOC_AccuracySts_VDCM 0;
BA_ "GenSigTimeoutTime_BPCM" SG_ 546 BMS_HV_NumCellMinTemp_VDCM 0;
BA_ "GenSigTimeoutTime_EVCU2" SG_ 546 BMS_HV_NumCellMinTemp_VDCM 0;
BA_ "GenSigTimeoutTime_SGW" SG_ 546 BMS_HV_NumCellMinTemp_VDCM 0;
BA_ "GenSigTimeoutTime_BPCM" SG_ 546 BMS_HV_NumCellMaxVolt_VDCM 0;
BA_ "GenSigTimeoutTime_EVCU2" SG_ 546 BMS_HV_NumCellMaxVolt_VDCM 0;
BA_ "GenSigTimeoutTime_SGW" SG_ 546 BMS_HV_NumCellMaxVolt_VDCM 0;
BA_ "GenSigTimeoutTime_BPCM" SG_ 546 BMS_HV_NumCellMaxTemp_VDCM 0;
BA_ "GenSigTimeoutTime_EVCU2" SG_ 546 BMS_HV_NumCellMaxTemp_VDCM 0;
BA_ "GenSigTimeoutTime_SGW" SG_ 546 BMS_HV_NumCellMaxTemp_VDCM 0;
BA_ "GenSigTimeoutTime_BPCM" SG_ 546 BMS_HV_Low_Temp_Thrsh_VDCM 0;
BA_ "GenSigTimeoutTime_EVCU2" SG_ 546 BMS_HV_Low_Temp_Thrsh_VDCM 0;
BA_ "GenSigTimeoutTime_SGW" SG_ 546 BMS_HV_Low_Temp_Thrsh_VDCM 0;
BA_ "GenSigTimeoutTime_EVCU2" SG_ 546 BMS_HV_InternalVoltage_VDCM 0;
BA_ "GenSigTimeoutTime_SGW" SG_ 546 BMS_HV_InternalVoltage_VDCM 0;
BA_ "GenSigTimeoutTime_BPCM" SG_ 546 BMS_HV_High_Temp_Thrsh_VDCM 0;
BA_ "GenSigTimeoutTime_EVCU2" SG_ 546 BMS_HV_High_Temp_Thrsh_VDCM 0;
BA_ "GenSigTimeoutTime_SGW" SG_ 546 BMS_HV_High_Temp_Thrsh_VDCM 0;
BA_ "GenSigTimeoutTime_EVCU2" SG_ 546 BMS_HV_Common_Contactor_Sts_VDCM 0;
BA_ "GenSigTimeoutTime_SGW" SG_ 546 BMS_HV_Common_Contactor_Sts_VDCM 0;
BA_ "GenSigTimeoutTime_EVCU2" SG_ 546 BMS_HV_Battery_GFD_Sts_VDCM 0;
BA_ "GenSigTimeoutTime_SGW" SG_ 546 BMS_HV_Battery_GFD_Sts_VDCM 0;
BA_ "SystemSignalLongSymbol" SG_ 546 BMS_HV_BatIntrlk_InternalStat_V "BMS_HV_BatIntrlk_InternalStat_VDCM";
BA_ "GenSigTimeoutTime_EVCU2" SG_ 546 BMS_HV_BatIntrlk_InternalStat_V 0;
BA_ "GenSigTimeoutTime_SGW" SG_ 546 BMS_HV_BatIntrlk_InternalStat_V 0;
BA_ "SystemSignalLongSymbol" SG_ 546 BMS_HV_AC_Char_Main_Contac_Sts_ "BMS_HV_AC_Char_Main_Contac_Sts_VDCM";
BA_ "GenSigTimeoutTime_EVCU2" SG_ 546 BMS_HV_AC_Char_Main_Contac_Sts_ 0;
BA_ "GenSigTimeoutTime_SGW" SG_ 546 BMS_HV_AC_Char_Main_Contac_Sts_ 0;
BA_ "GenSigTimeoutTime_BPCM" SG_ 546 BMS_Cell_Volt_Min_Vldty_VDCM 0;
BA_ "GenSigTimeoutTime_EVCU2" SG_ 546 BMS_Cell_Volt_Min_Vldty_VDCM 0;
BA_ "GenSigTimeoutTime_SGW" SG_ 546 BMS_Cell_Volt_Min_Vldty_VDCM 0;
BA_ "GenSigTimeoutTime_BPCM" SG_ 546 BMS_Cell_Volt_Min_VDCM 0;
BA_ "GenSigTimeoutTime_EVCU2" SG_ 546 BMS_Cell_Volt_Min_VDCM 0;
BA_ "GenSigTimeoutTime_SGW" SG_ 546 BMS_Cell_Volt_Min_VDCM 0;
BA_ "GenSigTimeoutTime_BPCM" SG_ 546 BMS_Cell_Volt_Max_Vldty_VDCM 0;
BA_ "GenSigTimeoutTime_EVCU2" SG_ 546 BMS_Cell_Volt_Max_Vldty_VDCM 0;
BA_ "GenSigTimeoutTime_SGW" SG_ 546 BMS_Cell_Volt_Max_Vldty_VDCM 0;
BA_ "GenSigTimeoutTime_BPCM" SG_ 546 BMS_Cell_Volt_Max_VDCM 0;
BA_ "GenSigTimeoutTime_EVCU2" SG_ 546 BMS_Cell_Volt_Max_VDCM 0;
BA_ "GenSigTimeoutTime_SGW" SG_ 546 BMS_Cell_Volt_Max_VDCM 0;
BA_ "GenSigTimeoutTime_BPCM" SG_ 546 AC_Chrg_Branch_Voltage_VDCM 0;
BA_ "GenSigTimeoutTime_EVCU2" SG_ 546 AC_Chrg_Branch_Voltage_VDCM 0;
BA_ "GenSigTimeoutTime_SGW" SG_ 546 AC_Chrg_Branch_Voltage_VDCM 0;
BA_ "GenSigStartValue" SG_ 546 VDCM_MaxChrgTime_sec 255;
BA_ "GenSigTimeoutTime_BPCM" SG_ 546 VDCM_MaxChrgTime_sec 0;
BA_ "GenSigTimeoutTime_EVCU2" SG_ 546 VDCM_MaxChrgTime_sec 0;
BA_ "GenSigTimeoutTime_SGW" SG_ 546 VDCM_MaxChrgTime_sec 0;
BA_ "GenSigStartValue" SG_ 546 VDCM_MaxChrgTime_min 255;
BA_ "GenSigTimeoutTime_BPCM" SG_ 546 VDCM_MaxChrgTime_min 0;
BA_ "GenSigTimeoutTime_EVCU2" SG_ 546 VDCM_MaxChrgTime_min 0;
BA_ "GenSigTimeoutTime_SGW" SG_ 546 VDCM_MaxChrgTime_min 0;
BA_ "GenSigStartValue" SG_ 546 VDCM_EV_Batt_Max_T_Limit 60;
BA_ "GenSigTimeoutTime_BPCM" SG_ 546 VDCM_EV_Batt_Max_T_Limit 0;
BA_ "GenSigTimeoutTime_EVCU2" SG_ 546 VDCM_EV_Batt_Max_T_Limit 0;
BA_ "GenSigTimeoutTime_SGW" SG_ 546 VDCM_EV_Batt_Max_T_Limit 0;
BA_ "GenSigStartValue" SG_ 546 VDCM_EstChrgTime_min 255;
BA_ "GenSigTimeoutTime_BPCM" SG_ 546 VDCM_EstChrgTime_min 0;
BA_ "GenSigTimeoutTime_EVCU2" SG_ 546 VDCM_EstChrgTime_min 0;
BA_ "GenSigTimeoutTime_SGW" SG_ 546 VDCM_EstChrgTime_min 0;
BA_ "GenSigTimeoutTime_BPCM" SG_ 546 VDCM_ChrgMode_Req 0;
BA_ "GenSigTimeoutTime_EVCU2" SG_ 546 VDCM_ChrgMode_Req 0;
BA_ "GenSigTimeoutTime_SGW" SG_ 546 VDCM_ChrgMode_Req 0;
BA_ "GenSigTimeoutTime_BPCM" SG_ 546 VDCM_ChrgCurrDeviationErr 0;
BA_ "GenSigTimeoutTime_EVCU2" SG_ 546 VDCM_ChrgCurrDeviationErr 0;
BA_ "GenSigTimeoutTime_SGW" SG_ 546 VDCM_ChrgCurrDeviationErr 0;
BA_ "SystemSignalLongSymbol" SG_ 546 BMS_HV_Char_PreCha_Contac_Sts_V "BMS_HV_Char_PreCha_Contac_Sts_VDCM";
BA_ "GenSigTimeoutTime_EVCU2" SG_ 546 BMS_HV_Char_PreCha_Contac_Sts_V 0;
BA_ "GenSigTimeoutTime_SGW" SG_ 546 BMS_HV_Char_PreCha_Contac_Sts_V 0;
BA_ "GenSigTimeoutTime_EVCU2" SG_ 546 BMS_HV_Char_Main_Contac_Sts_VDCM 0;
BA_ "GenSigTimeoutTime_SGW" SG_ 546 BMS_HV_Char_Main_Contac_Sts_VDCM 0;
BA_ "GenSigTimeoutTime_BPCM" SG_ 546 VDCM_ChargingPermitting 0;
BA_ "GenSigTimeoutTime_EVCU2" SG_ 546 VDCM_ChargingPermitting 0;
BA_ "GenSigTimeoutTime_SGW" SG_ 546 VDCM_ChargingPermitting 0;
BA_ "GenSigTimeoutTime_BPCM" SG_ 546 GBT_Target_Voltage_Reached 0;
BA_ "GenSigTimeoutTime_EVCU2" SG_ 546 GBT_Target_Voltage_Reached 0;
BA_ "GenSigTimeoutTime_SGW" SG_ 546 GBT_Target_Voltage_Reached 0;
BA_ "GenSigTimeoutTime_BPCM" SG_ 546 GBT_Target_Cell_Voltage_Reached 0;
BA_ "GenSigTimeoutTime_EVCU2" SG_ 546 GBT_Target_Cell_Voltage_Reached 0;
BA_ "GenSigTimeoutTime_SGW" SG_ 546 GBT_Target_Cell_Voltage_Reached 0;
BA_ "GenSigTimeoutTime_BPCM" SG_ 546 GBT_Ready_to_Charge 0;
BA_ "GenSigTimeoutTime_EVCU2" SG_ 546 GBT_Ready_to_Charge 0;
BA_ "GenSigTimeoutTime_SGW" SG_ 546 GBT_Ready_to_Charge 0;
BA_ "GenSigTimeoutTime_BPCM" SG_ 546 GBT_Desired_SOC_Reached 0;
BA_ "GenSigTimeoutTime_EVCU2" SG_ 546 GBT_Desired_SOC_Reached 0;
BA_ "GenSigTimeoutTime_SGW" SG_ 546 GBT_Desired_SOC_Reached 0;
BA_ "GenSigTimeoutTime_BPCM" SG_ 546 GBT_Charger_Active_Interruption 0;
BA_ "GenSigTimeoutTime_EVCU2" SG_ 546 GBT_Charger_Active_Interruption 0;
BA_ "GenSigTimeoutTime_SGW" SG_ 546 GBT_Charger_Active_Interruption 0;
BA_ "GenSigTimeoutTime_EVCU2" SG_ 546 BMS_HV_TractionBusVoltage_VDCM 0;
BA_ "GenSigTimeoutTime_SGW" SG_ 546 BMS_HV_TractionBusVoltage_VDCM 0;
BA_ "GenSigTimeoutTime_EVCU2" SG_ 546 BMS_HV_Trac_Bus_Sts_VDCM 0;
BA_ "GenSigTimeoutTime_SGW" SG_ 546 BMS_HV_Trac_Bus_Sts_VDCM 0;
BA_ "GenSigTimeoutTime_EVCU2" SG_ 546 BMS_HV_ChargingBusVoltage_VDCM 0;
BA_ "GenSigTimeoutTime_SGW" SG_ 546 BMS_HV_ChargingBusVoltage_VDCM 0;
BA_ "GenSigTimeoutTime_EVCU2" SG_ 546 BMS_HV_Char_Bus_Sts_VDCM 0;
BA_ "GenSigTimeoutTime_SGW" SG_ 546 BMS_HV_Char_Bus_Sts_VDCM 0;
BA_ "GenSigTimeoutTime_EVCU2" SG_ 546 BMS_HV_BatState_VDCM 0;
BA_ "GenSigTimeoutTime_SGW" SG_ 546 BMS_HV_BatState_VDCM 0;
BA_ "GenSigTimeoutTime_EVCU2" SG_ 546 BMS_HV_BatActualPower_VDCM 0;
BA_ "GenSigTimeoutTime_SGW" SG_ 546 BMS_HV_BatActualPower_VDCM 0;
BA_ "GenSigTimeoutTime_HCP" SG_ 1031 Plug_And_Charge_Contract_Sts 0;
BA_ "GenSigTimeoutTime_PPIM" SG_ 1031 Plug_And_Charge_Contract_Sts 0;
BA_ "GenSigTimeoutTime_APM2" SG_ 1031 Plug_And_Charge_Contract_Sts 0;
BA_ "GenSigTimeoutTime_VDCM" SG_ 1031 Plug_And_Charge_Contract_Sts 0;
BA_ "GenSigTimeoutTime_HCP" SG_ 1031 Pilot_DutyCycle 0;
BA_ "GenSigTimeoutTime_PPIM" SG_ 1031 Pilot_DutyCycle 0;
BA_ "GenSigTimeoutTime_APM2" SG_ 1031 Pilot_DutyCycle 0;
BA_ "GenSigTimeoutTime_VDCM" SG_ 1031 Pilot_DutyCycle 0;
BA_ "GenSigTimeoutTime_BPCM" SG_ 1031 Pilot_DutyCycle 0;
BA_ "GenSigTimeoutTime_IDCM" SG_ 1031 Pilot_DutyCycle 0;
BA_ "GenSigTimeoutTime_SGW" SG_ 1031 Pilot_DutyCycle 0;
BA_ "GenSigTimeoutTime_HCP" SG_ 1031 EVSEMaxCurrent 0;
BA_ "GenSigTimeoutTime_PPIM" SG_ 1031 EVSEMaxCurrent 0;
BA_ "GenSigTimeoutTime_APM2" SG_ 1031 EVSEMaxCurrent 0;
BA_ "GenSigTimeoutTime_VDCM" SG_ 1031 EVSEMaxCurrent 0;
BA_ "GenSigTimeoutTime_BPCM" SG_ 1031 EVSEMaxCurrent 0;
BA_ "GenSigTimeoutTime_IDCM" SG_ 1031 EVSEMaxCurrent 0;
BA_ "GenSigTimeoutTime_SGW" SG_ 1031 EVSEMaxCurrent 0;
BA_ "GenSigTimeoutTime_HCP" SG_ 1031 RCD 0;
BA_ "GenSigTimeoutTime_PPIM" SG_ 1031 RCD 0;
BA_ "GenSigTimeoutTime_APM2" SG_ 1031 RCD 0;
BA_ "GenSigTimeoutTime_VDCM" SG_ 1031 RCD 0;
BA_ "GenSigTimeoutTime_BPCM" SG_ 1031 RCD 0;
BA_ "GenSigTimeoutTime_IDCM" SG_ 1031 RCD 0;
BA_ "GenSigTimeoutTime_SGW" SG_ 1031 RCD 0;
BA_ "GenSigTimeoutTime_HCP" SG_ 1031 EVSENominalVoltage 0;
BA_ "GenSigTimeoutTime_PPIM" SG_ 1031 EVSENominalVoltage 0;
BA_ "GenSigTimeoutTime_APM2" SG_ 1031 EVSENominalVoltage 0;
BA_ "GenSigTimeoutTime_VDCM" SG_ 1031 EVSENominalVoltage 0;
BA_ "GenSigTimeoutTime_BPCM" SG_ 1031 EVSENominalVoltage 0;
BA_ "GenSigTimeoutTime_IDCM" SG_ 1031 EVSENominalVoltage 0;
BA_ "GenSigTimeoutTime_SGW" SG_ 1031 EVSENominalVoltage 0;
BA_ "GenSigTimeoutTime_HCP" SG_ 835 N_PDU_343 0;
BA_ "GenSigTimeoutTime_PPIM" SG_ 835 N_PDU_343 0;
BA_ "GenSigTimeoutTime_APM2" SG_ 835 N_PDU_343 0;
BA_ "GenSigTimeoutTime_BPCM" SG_ 835 N_PDU_343 0;
BA_ "GenSigTimeoutTime_IDCM" SG_ 835 N_PDU_343 0;
BA_ "GenSigTimeoutTime_SGW" SG_ 835 N_PDU_343 0;
BA_ "GenSigTimeoutTime_BPCM" SG_ 834 N_PDU_342 0;
BA_ "GenSigTimeoutTime_EVCU2" SG_ 834 N_PDU_342 0;
BA_ "GenSigTimeoutTime_IDCM" SG_ 834 N_PDU_342 0;
BA_ "GenSigTimeoutTime_HCP" SG_ 834 N_PDU_342 0;
BA_ "GenSigTimeoutTime_PPIM" SG_ 834 N_PDU_342 0;
BA_ "GenSigTimeoutTime_APM2" SG_ 834 N_PDU_342 0;
VAL_ 1031 InputCurrentAvailable 511 "SNA";
VAL_ 1031 AC_Side_Volt3 8191 "SNA";
VAL_ 1031 AC_Side_Volt2 8191 "SNA";
VAL_ 1031 AC_Side_Volt1 8191 "SNA";
VAL_ 1031 AC_Side_Curr3 2047 "SNA";
VAL_ 1031 AC_Side_Curr2 2047 "SNA";
VAL_ 1031 AC_Side_Curr1 2047 "SNA";
VAL_ 1031 ProximitySts 0 "PROX_LO" 1 "Prox_Out" 2 "Prox_In" 3 "Prox_Un" 4 "VOOR" 5 "PROX_HI";
VAL_ 1031 OBCM_SlacSts 0 "SLAC_NOT_PERFORMED" 1 "EVSE_FOUND" 2 "EVSE_NOT_FOUND" 3 "FAILURE";
VAL_ 1031 OBCM_SdpSts 0 "SPD_NOT_PERFORMED" 1 "CONN_ESTABLISHED" 2 "CONN_NOT_ESTABLISHED" 3 "FAILURE";
VAL_ 1031 OBCInterlockSts 0 "Not_Performed" 1 "OK" 2 "Fail" 3 "Invalid";
VAL_ 1031 OBC_DeratingReason 0 "No_Derating" 1 "High_Temp_Derating" 2 "Low_Temp_Derating" 3 "Input_Voltage_Limit" 4 "Input_Current_Limit" 5 "Output_Voltage_Limit" 6 "Output_Current_Limit" 7 "Internal_Fault_Derating" 8 "High_Charge_Inlet_Temperature";
VAL_ 1031 J1772_State 0 "STATE_A" 1 "STATE_B" 2 "STATE_C" 3 "STATE_D" 4 "STATE_E" 5 "STATE_F" 7 "SNA";
VAL_ 1031 J1772_S2_Sts 0 "Open" 1 "Closed";
VAL_ 1031 ControlPilotSts 0 "NO_EVSE" 1 "CP_DET" 2 "VOOR" 3 "EVSE_NO_AC" 4 "HW_FAULT" 5 "EVSE_FAULT";
VAL_ 1031 ChargeEnableSts 0 "NotCharging" 1 "Charging" 3 "SNA";
VAL_ 1031 ChargeCurrentAvailable 1023 "SNA";
VAL_ 1031 ChargeCurrent 1023 "SNA";
VAL_ 1031 BatterySideCurrent 2047 "SNA";
VAL_ 1031 AC_Present 0 "AC not detected" 1 "AC detected";
VAL_ 253 VltgChgEVSE 16383 "SNA";
VAL_ 253 PwrEff 1023 "SNA";
VAL_ 253 CurrEVSE 16383 "SNA";
VAL_ 253 APM2InterlockSts 0 "Not_Performed" 1 "OK" 2 "Fail" 3 "Invalid";
VAL_ 253 APM2_ModeSts_Fbk 0 "NOT_CHARGING" 1 "IDLE" 2 "SYNC" 3 "BYPASS" 4 "BOOST" 5 "CHARGE INTERRUPT" 6 "STOP_FAILURE" 7 "FORCED_SHUTDOWN" 8 "ACTIVE DISCHARGE" 9 "L1_CHARGING" 10 "L2_CHARGING" 15 "SNA";
VAL_ 253 APM2_FaultSts 0 "NO_FAULT" 1 "APM2_FAULT" 2 "TEMP_SENSOR_FAULT" 3 "SNA";
VAL_ 253 APM2_DeratRsnSts 0 "No_Derating" 1 "High_Temp_Derating" 2 "Low_Temp_Derating" 3 "Not_Used" 4 "Available_Input_Power_Limit" 5 "Output_Voltage_limit" 6 "Output_Current_Limit" 7 "Last_Request_Derating";
VAL_ 253 APM2_DcChEnaSts_Fdbk 0 "DC_charging_not_enabled" 1 "DC_charging_enabled";
VAL_ 546 VDCM_EV_Batt_Max_T_Limit 255 "SNA";
VAL_ 546 VDCM_ChrgMode_Req 0 "init" 1 "constant voltage charge" 2 "constant curent charge" 255 "SNA";
VAL_ 546 VDCM_ChrgCurrDeviationErr 0 "Charge Current  OK" 1 "Charge current in error";
VAL_ 546 VDCM_ChrgCompleteReason 0 "SOC_tgt_reached" 1 "Vcell_tgt_reached" 2 "Vbat_tgt_reached" 3 "User_req";
VAL_ 546 VDCM_BattUnderVolt 0 "Voltage OK" 1 "Battery Under Voltage";
VAL_ 546 VDCM_BattOverVolt 0 "Voltage OK" 1 "Battery Over Voltage";
VAL_ 546 VDCM_BattFullSOC_prc 255 "SNA";
VAL_ 546 CPIM_Over_Temperature 0 "Battery_OK" 1 "Over_temperature";
VAL_ 546 CPIM_Error 0 "CPIM_OK" 1 "CPIM_error";
VAL_ 544 Plug_Locked_by_EVSE 0 "EVSE_Not_Locked" 1 "EVSE_Locked" 2 "Init" 3 "SNA";
VAL_ 544 HVCMS_EVSEID 4294967295 "SNA";
VAL_ 544 ExtChargerSts 0 "Standby" 1 "Charging" 2 "Init" 3 "SNA";
VAL_ 544 EVSE_Error 0 "No_Error" 1 "Error" 2 "Init" 3 "SNA";
VAL_ 544 EVSE_ChrgStopControl 0 "No_Chrg_Stp_Cntrl" 1 "Chrg_Stop_Cntrl" 2 "Init" 3 "SNA";
VAL_ 544 Charger_WeldingDetectAvail 0 "Not_Available" 1 "Available" 2 "Init" 3 "SNA";
VAL_ 544 Charger_StndbyReqReason 0 "SetUpCond_Reached" 1 "BMS_Req" 2 "Charger_Fault" 3 "User_Req" 6 "Init" 7 "SNA";
VAL_ 544 Charger_StndbyReq 0 "Stnby_Not_Requested" 1 "Stnby_Requested" 2 "Init" 3 "SNA";
VAL_ 544 Charger_FaultStates 0 "NoFault" 1 "EmergencyShdwnFault" 2 "UnableToSupplyReqPower" 3 "OverTemperature" 4 "InnerOverTemperature" 5 "AbnormalVoltage" 6 "CurrentNotMatching" 7 "ConnectorFault" 8 "OtherFault" 14 "Init" 15 "SNA";
VAL_ 544 CC2VoltDetError 0 "Volt_Det_ok" 1 "Volt_Det_Error" 2 "Init" 3 "SNA";
VAL_ 1790 BMS_HV_SOC_AccuracySts 0 "Invalid" 1 "High_Accuracy_SOC" 2 "Low_Accuracy_SOC" 3 "SNA";
VAL_ 253 APM2_RecoveryAction 0 "NoRecoveryNeeded" 1 "FullComponentInhibited" 2 "BoostStageInhibited" 3 "BypassStageInhibited" 4 "Recovery4" 5 "Recovery5" 6 "Recovery6" 7 "SNA";
VAL_ 105 ClrLgsDiagInfo 0 "FALSE" 1 "TRUE";
VAL_ 546 WeldCheck_Complete 0 "FALSE" 1 "TRUE";
VAL_ 546 VDCM_SOCIsOOR 0 "Normal" 1 "Too_Low" 2 "Too High" 3 "SNA";
VAL_ 546 VDCM_ChargeCurrIsOOR 0 "Normal" 1 "Too_Low" 2 "Too High" 3 "SNA";
VAL_ 546 VDCM_CellVoltIsOOR 0 "Normal" 1 "Too_Low" 2 "Too High" 3 "SNA";
VAL_ 546 VDCM_BattTempIsOOR 0 "Normal" 1 "Too_Low" 2 "Too High" 3 "SNA";
VAL_ 546 ReadyToChargeState 0 "FALSE" 1 "TRUE";
VAL_ 546 HCP_SessionStopCmd 0 "FALSE" 1 "TRUE";
VAL_ 546 HCP_DC_Retry 0 "No_Rety_Command" 1 "SupportedAppProtocolReq" 2 "SessionSetupRrq" 3 "ServiceDiscoveryReq." 4 "ServicePaymentSelectionReq" 5 "Contract_AuthenticationReq" 6 "ChargeParameterDiscoveryReq" 7 "CableCheckReq" 8 "Pre_ChargeReq" 9 "PowerDeliveryReq_Precharge" 10 "CurrentDemandReq" 11 "PowerDeliveryReq_EnergyTransfer" 12 "WeldingDetectionReq" 13 "SessionStopReq" 31 "SNA";
VAL_ 546 BMS_Max_Pk_Volt_Allowed_VDCM 1023 "SNA";
VAL_ 546 BMS_Max_Cell_Volt_Allowed_Vldty 0 "Valid" 1 "Not_Valid";
VAL_ 546 BMS_Max_Cell_Volt_Allowed_VDCM 8191 "SNA";
VAL_ 546 BMS_HV_Trac_PreCha_Contac_Sts_V 0 "Open" 1 "Closed" 3 "Error_Stuck_Open" 4 "Error_Stuck_Closed" 7 "SNA";
VAL_ 546 BMS_HV_Trac_Main_Contac_Sts_VDCM 0 "Open" 1 "Closed" 3 "Error_Stuck_Open" 4 "Error_Stuck_Closed" 7 "SNA";
VAL_ 546 BMS_HV_Temperature_Min_VDCM 2047 "SNA";
VAL_ 546 BMS_HV_Temperature_Max_VDCM 2047 "SNA";
VAL_ 546 BMS_HV_SOC_AccuracySts_VDCM 0 "Invalid" 1 "High_Accuracy_SOC" 2 "Low_Accuracy_SOC" 3 "SNA";
VAL_ 546 BMS_HV_NumCellMinTemp_VDCM 511 "SNA";
VAL_ 546 BMS_HV_NumCellMaxVolt_VDCM 255 "SNA";
VAL_ 546 BMS_HV_NumCellMaxTemp_VDCM 511 "SNA";
VAL_ 546 BMS_HV_InternalVoltage_VDCM 8191 "SNA";
VAL_ 546 BMS_HV_Common_Contactor_Sts_VDCM 0 "Open" 1 "Closed" 2 "Error_Stuck_Open" 3 "Error_Stuck_Closed" 7 "SNA";
VAL_ 546 BMS_HV_Battery_GFD_Sts_VDCM 0 "GFD_Not_Performed" 1 "GFD_OK" 2 "GFD_Fail" 3 "GFD_INVALID_meas_noise";
VAL_ 546 BMS_HV_BatIntrlk_InternalStat_V 0 "Not_Performed" 1 "OK" 2 "Fail" 3 "Invalid";
VAL_ 546 BMS_HV_AC_Char_Main_Contac_Sts_ 0 "Open" 1 "Closed" 3 "Error_Stuck_Open" 4 "Error_Stuck_Closed" 7 "SNA";
VAL_ 546 BMS_Cell_Volt_Min_Vldty_VDCM 0 "Valid" 1 "Not_Valid";
VAL_ 546 BMS_Cell_Volt_Min_VDCM 8191 "SNA";
VAL_ 546 BMS_Cell_Volt_Max_Vldty_VDCM 0 "Valid" 1 "Not_Valid";
VAL_ 546 BMS_Cell_Volt_Max_VDCM 8191 "SNA";
VAL_ 544 OBCM_CSSts 0 "CS_IN" 1 "CS_OUT" 2 "CS_FAIL";
VAL_ 544 OBCM_CP3Sts 0 "Charge permission disabled" 1 "Charge permission enabled" 3 "HW_Fault";
VAL_ 544 OBCM_CP2Sts 0 "EVSE_not_ready" 1 "EVSE_ready" 2 "VOOR" 3 "HW_Fault";
VAL_ 544 OBCM_CCSts 0 "CC_LO" 1 "CC_OUT" 2 "CC_IN" 3 "CC_HI" 4 "CC_FAIL";
VAL_ 544 OBCM_APAMSts 0 "APAM_Off" 1 "APAM_On" 2 "HW_Failure";
VAL_ 1063 MCPB_Temp 255 "SNA";
VAL_ 1062 MCPA_Temp 255 "SNA";
VAL_ 1893 HVBatModuleTemp_66 255 "SNA";
VAL_ 1893 HVBatModuleTemp_65 255 "SNA";
VAL_ 1893 HVBatModuleTemp_64 255 "SNA";
VAL_ 1893 HVBatModuleTemp_63 255 "SNA";
VAL_ 1893 HVBatModuleTemp_62 255 "SNA";
VAL_ 1893 HVBatModuleTemp_61 255 "SNA";
VAL_ 1893 HVBatModuleTemp_60 255 "SNA";
VAL_ 1893 HVBatModuleTemp_59 255 "SNA";
VAL_ 1893 HVBatModuleTemp_58 255 "SNA";
VAL_ 1893 HVBatModuleTemp_57 255 "SNA";
VAL_ 1893 HVBatModuleTemp_56 255 "SNA";
VAL_ 1893 HVBatModuleTemp_55 255 "SNA";
VAL_ 1893 HVBatModuleTemp_54 255 "SNA";
VAL_ 1893 HVBatModuleTemp_41 255 "SNA";
VAL_ 1893 HVBatModuleTemp_40 255 "SNA";
VAL_ 1893 HVBatModuleTemp_39 255 "SNA";
VAL_ 1031 Supported_VerNumberMinor 0 "No_Version" 1 "Version_1" 2 "Version_2" 7 "SNA";
VAL_ 1031 Supported_VerNumberMajor 0 "No_Version" 1 "Version_1" 2 "Version_2" 7 "SNA";
VAL_ 1031 Supported_SchemaID 0 "No_Schema_ID" 1 "Schema_ID_1" 2 "Schema_ID_2" 3 "Schema_ID_3" 7 "SNA";
VAL_ 1031 Supported_ProtocolName 0 "No_Protocol" 1 "ISO_Gen2" 2 "ISO_Gen1" 3 "DIN" 7 "SNA";
VAL_ 1031 EVCC_FailureReason 0 "None" 1 "SLAC_Failed." 2 "SECCDiscoverProtocol_Failed" 3 "TransportLayer_Failed" 4 "SupportAppProtocol_Failed" 5 "SessionSetup_Failed" 6 "Session Discover_Failed" 7 "ReadContrCertChain_Failed" 8 "ServiceDetail_Failed" 9 "PaymentServiceSelection_Failed" 10 "ReadRootCerts_Failed" 11 "ReadProvCert_Failed" 12 "CertificateInstallation_Failed" 13 "CertificateUpdate_Failed" 14 "PaymentDetails_Failed" 15 "Authorization_Failed" 16 "ChargeParameterDiscovery_Failed" 17 "PowerDelivery_Failed" 18 "MeteringReceipt_Failed" 19 "ChargingStatus_Failed" 20 "CableCheck_Failed" 21 "Precharge_Failed" 22 "CurrentDemand_Failed" 23 "WeldingDetection_Failed." 24 "SessionStop_Failed." 25 "StopCommunicationSession_Failed." 26 "IPAddressWaitTime" 27 "Sequence Performancetime." 28 "CommunicationSetupTime" 29 "ReadyToChargeTime" 30 "AuthorizationOngoinTime" 31 "ChrgParaDiscoveryOngoingTime" 32 "CableCheckOngoingTime." 33 "PrechargeOngoingTime." 34 "Init_ContractSelectionFailed" 35 "SDP_NoSharedSecurityOption." 36 "SDP_InvalidEnergyTransferMode." 37 "SD_NoSharedPaymentOption" 38 "SD_NoContractAndNoCertSrvcAvail" 39 "SrvcDet_NoContr_InstallSrvcAvail" 40 "TLS_Failed" 41 "V2G_Cert_Invalid" 63 "SNA";
VAL_ 1031 BatterySideVoltage 16383 "SNA";
VAL_ 1031 AC_LnLow 0 "voltage_in_range" 1 "voltage_above_threshold";
VAL_ 1031 AC_LnHi 0 "voltage_in_range" 1 "voltage_above_threshold";
VAL_ 1790 HEV_OnRq_BPCM 0 "FALSE" 1 "TRUE";
VAL_ 253 APM2_Service_Lamp_Request 0 "FALSE" 1 "TRUE";
VAL_ 253 APM2_IInpMaxCnvr 16383 "SNA";
VAL_ 253 APM2_DisChargedSts_Fdbk 0 "Not_Active" 1 "Active";
VAL_ 253 APM2_ContactorFault 0 "Fail_Not_Present" 1 "Fail_Present" 2 "No_valid_result" 3 "SNA";
VAL_ 253 APM2_BoostSwitchSts 0 "Open" 1 "Closed";
VAL_ 546 BMS_HV_Char_PreCha_Contac_Sts_V 0 "Open" 1 "Closed" 3 "Error_Stuck_Open" 4 "Error_Stuck_Closed" 7 "SNA";
VAL_ 546 BMS_HV_Char_Main_Contac_Sts_VDCM 0 "Open" 1 "Closed" 3 "Error_Stuck_Open" 4 "Error_Stuck_Closed" 7 "SNA";
VAL_ 546 BMS_HV_TractionBusVoltage_VDCM 1023 "SNA";
VAL_ 546 BMS_HV_Trac_Bus_Sts_VDCM 0 "OPEN" 1 "CLOSED" 2 "PRECHARGING" 3 "PRECHARGING FAILED" 4 "PRECHARGING INHIBITED" 7 "SNA";
VAL_ 546 BMS_HV_ChargingBusVoltage_VDCM 1023 "SNA";
VAL_ 546 BMS_HV_Char_Bus_Sts_VDCM 0 "OPEN" 1 "CLOSED" 2 "PRECHARGING" 3 "PRECHARGING FAILED" 4 "PRECHARGING INHIBITED" 7 "SNA";
VAL_ 546 BMS_HV_BatState_VDCM 0 "Sleep" 1 "Initialization" 2 "Idle" 3 "Bus_Acv_Deac" 5 "Ready_Main" 6 "Ready_Aux" 7 "Ready_Full" 10 "Deactivation" 13 "Powerlatch" 14 "Service_Mode" 15 "CRITICAL_ERROR";
VAL_ 546 BMS_HV_BatActualPower_VDCM 32767 "SNA";
VAL_ 544 TCP_Communication_Terminated 0 "FALSE" 1 "TRUE";
VAL_ 544 OBCM_CP1Sts 0 "NO_EVSE" 1 "CP_DET" 2 "VOOR" 3 "EVSE_NO_AC" 4 "HW_FAULT";
VAL_ 1893 HVBatModuleVoltage_NumMin 63 "SNA";
VAL_ 1893 HVBatModuleVoltage_NumMax 63 "SNA";
VAL_ 1893 HVBatModuleTemp_53 255 "SNA";
VAL_ 1893 HVBatModuleTemp_52 255 "SNA";
VAL_ 1893 HVBatModuleTemp_51 255 "SNA";
VAL_ 1893 HVBatModuleTemp_50 255 "SNA";
VAL_ 1893 HVBatModuleTemp_49 255 "SNA";
VAL_ 1893 HVBatModuleTemp_48 255 "SNA";
VAL_ 1893 HVBatModuleTemp_47 255 "SNA";
VAL_ 1893 HVBatModuleTemp_46 255 "SNA";
VAL_ 1893 HVBatModuleTemp_45 255 "SNA";
VAL_ 1893 HVBatModuleTemp_44 255 "SNA";
VAL_ 1893 HVBatModuleTemp_43 255 "SNA";
VAL_ 1893 HVBatModuleTemp_42 255 "SNA";
VAL_ 253 VltgChgInt 16383 "SNA";
VAL_ 253 APM2_TempInlet 2047 "SNA";
VAL_ 253 APM2_K7_WldgDtnSts 0 "INVALID" 1 "OK" 2 "NOT_OK";
VAL_ 253 APM2_K6_WldgDtnSts 0 "INVALID" 1 "OK" 2 "NOT_OK";
VAL_ 544 TxGBTMessageResponse 0 "EVSE_Not_Connected" 1 "CHM" 2 "CRM.BMS cant be recognized" 3 "CRM.BMS recognized" 4 "CML" 5 "CRO.Charger not ready" 6 "CRO.Charger ready" 7 "CCS" 8 "CST" 9 "CSD" 31 "SNA";
VAL_ 544 TxGBTMessageRequest 0 "EVSE_Not_Connected" 1 "BHM" 2 "BRM" 3 "BCP" 4 "BRO_BMS_Not_Ready" 5 "BRO_BMS_Ready" 6 "BCL" 7 "BCS" 8 "BSM" 9 "BST" 10 "BSD" 31 "SNA";
VAL_ 544 OBCM_Timeout 0 "False" 1 "True";
VAL_ 544 EVCC_FailureSts 0 "No_Failure" 1 "Failure";
VAL_ 544 CC2_VoltageValue 255 "SNA";
VAL_ 546 VDCM_ChargingPermitting 0 "Forbidden" 1 "Permissive";
VAL_ 546 GBT_Target_Voltage_Reached 0 "Not_Reached" 1 "Reached" 2 "SNA";
VAL_ 546 GBT_Target_Cell_Voltage_Reached 0 "Not_Reached" 1 "Reached" 2 "SNA";
VAL_ 546 GBT_Ready_to_Charge 0 "False" 1 "True";
VAL_ 546 GBT_Desired_SOC_Reached 0 "Not_Reached" 1 "Reached" 2 "SNA";
VAL_ 546 GBT_Charger_Active_Interruption 0 "No_Charger_Interruption" 1 "Charger_Interruption" 2 "SNA";
VAL_ 544 GBT_EVSE_Charge_Permitting 0 "Pause" 1 "Permissive";
VAL_ 292 HVBatContactorWeldCheck 0 "Not_Complete" 1 "Complete";
VAL_ 292 HVBatReady 0 "False" 1 "True";
VAL_ 292 BPCM_DC_CntctrsMidTrmOpeningWarn 0 "False" 1 "True";
VAL_ 292 BPCM_DC_CntctrsShtTrmOpeningWarn 0 "False" 1 "True";
VAL_ 292 BPCM_HV_Char_Main_Contac_Sts 0 "Open" 1 "Closed" 3 "Error_Stuck_Open" 4 "Error_Stuck_Closed" 7 "SNA";
VAL_ 292 BPCM_HV_Trac_Main_Contac_Sts 0 "Open" 1 "Closed" 3 "Error_Stuck_Open" 4 "Error_Stuck_Closed" 7 "SNA";
VAL_ 292 BPCM_HV_BalancingMode 0 "No_balancing" 1 "Balancing_in_progress" 2 "Balancing_complete" 3 "Balancing_Error";
VAL_ 292 BPCM_HV_ChargingBusVoltage 2047 "SNA";
VAL_ 292 BPCM_HV_TractionBusVoltage 2047 "SNA";
VAL_ 292 BPCM_Pwr_Limp_Home_On 0 "Disable" 1 "Enable";
VAL_ 292 BPCM_HV_Trac_Bus_Sts 0 "Open" 1 "Closed" 2 "Precharging" 3 "Precharging_Failed" 4 "Precharging_Inhibited" 7 "SNA";
VAL_ 292 BPCM_HV_Char_Bus_Sts 0 "Open" 1 "Closed" 2 "Precharging" 3 "Precharging_Failed" 4 "Precharging_Inhibited" 7 "SNA";
VAL_ 292 BPCM_HV_SOH_Low 127 "SNA";
VAL_ 292 BPCM_HV_SOH 127 "SNA";
VAL_ 292 BPCMInterlockSts 0 "Not_Performed" 1 "OK" 2 "Fail" 3 "Invalid" 4 "Service_Disconnect";
VAL_ 292 BPCM_HV_BatIntrlk_InternalStat 0 "Not_Performed" 1 "OK" 2 "Fail" 3 "Invalid";
VAL_ 292 BPCM_HV_Temperature_Min 2047 "SNA";
VAL_ 292 BPCM_HV_Temperature_Max 2047 "SNA";
VAL_ 292 BPCM_HV_Temperature_Avg 2047 "SNA";
VAL_ 292 BPCM_HV_SOC 1023 "SNA";
VAL_ 292 BPCM_HV_Outlet_Temp 2047 "SNA";
VAL_ 292 BPCM_HV_InternalVoltage 16383 "SNA";
VAL_ 292 BPCM_HV_Inlet_Temp 2047 "SNA";
VAL_ 292 BPCM_HV_Current 65535 "SNA";
VAL_ 292 BPCM_HV_Capacity 4095 "SNA";
VAL_ 292 BPCM_HV_Battery_GFD_Sts 0 "GFD_Not_Performed" 1 "GFD_OK" 2 "GFD_Fail" 3 "GFD_INVALID_meas_noise" 4 "Disabled";
VAL_ 292 BPCM_Wakeup_Request 0 "No_Event" 1 "Wakeup_Event";
VAL_ 292 BPCM_HV_ThermalRunaway 0 "Default" 1 "No_Thermal_Runaway" 2 "Thermal_Runaway_Detected" 3 "SNA";
VAL_ 1031 Plug_And_Charge_Contract_Sts 0 "No_Contract" 1 "Transfer_In_Progress" 2 "Contract_Load_Failed" 3 "Contract_Success";
VAL_ 1031 RCD 0 "No_Error" 1 "Error";
VAL_ 1031 EVSENominalVoltage 1023 "SNA";
VAL_ 1031 EVSEMaxCurrent 511 "SNA";
VAL_ 292 HVBP_Busbar_Temp 255 "SNA";
VAL_ 292 HVBP_BDU_Busbar_Temp 255 "SNA";
VAL_ 292 DC_Charge_Type_Status 1 "Ready_to_charge_at_800V" 2 "Ready_to_charge_at_400V" 3 "FAILED" 4 "Weldcheck_in_progress_800V" 7 "SNA";
VAL_ 292 BPCM_Request_for_Aux_Load_off 0 "False" 1 "True";
VAL_ 292 BPCM_HV_Trac_Main_Contac_Config 1 "Closed_Parallel" 2 "Closed_Single_B1" 3 "Closed_Single_B2" 7 "SNA";
VAL_ 292 BPCM_HV_DCFC_Isolation_Sts 0 "Not_Performed" 1 "No_Failure" 3 "Failure" 4 "Error" 7 "SNA";
VAL_ 292 BPCM_HV_Trac_PreCha_Contac_Sts 0 "Not_Performed" 1 "No_Failure" 3 "Failure" 4 "Error" 7 "SNA";
VAL_ 292 BPCM_HV_Current_String2 65535 "SNA";
VAL_ 546 SelectedSecurityProtocol 0 "No_TLS" 1 "TLS";
VAL_ 546 SelectedAppProtocol 0 "DIN" 1 "ISO_Gen1";
VAL_ 1031 Pilot_DutyCycle 255 "SNA";
VAL_ 544 CdM_ExtFun_Reset_Max_Time 0 "enable" 1 "disable";
VAL_ 544 CdM_ExtFun_Relia_Design 0 "NOT_CAPABLE" 1 "CAPABLE";
VAL_ 544 CdM_ExtFun_Over_Temp_Trotec_Conn 0 "NOT_COMPATIBLE" 1 "COMPATIBLE";
VAL_ 544 CdM_ExtFun_Oper_Cond 0 "Ext_I_is_less_or_same_as_rated_I" 1 "Ext_I_exceeds_rated_I_of_cable";
VAL_ 544 CdM_ExtFun_Cur_Lim_Conn 0 "NOT_COMPATIBLE" 1 "COMPATIBLE";
VAL_ 544 CdM_ExtFun_Cur_Lim_Cable 0 "NOT_COMPATIBLE" 1 "COMPATIBLE";
VAL_ 544 CdM_ExtFun_Cool_Func_Conn 0 "NOT_COMPATIBLE" 1 "COMPATIBLE";
VAL_ 544 CdM_ExtFun_Cool_Func_Cable 0 "NOT_COMPATIBLE" 1 "COMPATIBLE";
VAL_ 544 CdM_ExtFun_Chr_Dyn_Control_Comp 0 "No_dyn_cntrl_of_extd_function" 1 "Dyn_cntrl_of_extd_function";
VAL_ 544 CdM_ExtFun_Char_HC_Control_Comp 0 "High_current_cntrl_not_applied" 1 "High_current_cntrl_is_applied";
SIG_GROUP_ 544 OBCM_VDCM2_Pkt 1 : Plug_Locked_by_EVSE HVCMS_EVSEID ExtChargerSts EVSE_Error EVSE_ChrgStopControl Charger_WeldingDetectAvail Charger_StndbyReqReason Charger_StndbyReq Charger_FaultStates CC2VoltDetError OBCM_CSSts OBCM_CP3Sts OBCM_CP2Sts OBCM_CCSts OBCM_APAMSts TCP_Communication_Terminated OBCM_CP1Sts TxGBTMessageResponse TxGBTMessageRequest OBCM_Timeout EVCC_FailureSts CC2_VoltageValue GBT_EVSE_Charge_Permitting MessageCounter_OV2 CRC_OV2 EVSE_NotificationMaxDelay CdM_ExtFun_Reset_Max_Time CdM_ExtFun_Relia_Design CdM_ExtFun_Over_Temp_Trotec_Conn CdM_ExtFun_Oper_Cond CdM_ExtFun_Cur_Lim_Conn CdM_ExtFun_Cur_Lim_Cable CdM_ExtFun_Cool_Func_Conn CdM_ExtFun_Cool_Func_Cable CdM_ExtFun_Chr_Dyn_Control_Comp CdM_ExtFun_Char_HC_Control_Comp;
SIG_GROUP_ 546 VDCM_OBCM2_Pkt 1 : WeldCheck_Complete VDCM_SOCIsOOR VDCM_MaxChrgTime_sec VDCM_MaxChrgTime_min VDCM_EV_Batt_Max_T_Limit VDCM_EstChrgTime_min VDCM_ChrgMode_Req VDCM_ChrgCurrDeviationErr VDCM_ChrgCompleteReason VDCM_ChargeCurrIsOOR VDCM_CellVoltIsOOR VDCM_BattUnderVolt VDCM_BattTempIsOOR VDCM_BattOverVolt VDCM_BattFullSOC_prc ReadyToChargeState HCP_SessionStopCmd HCP_DC_Retry DCChrg_BatSideCurrent_VDCM CPIM_Over_Temperature CPIM_Error BMS_Max_Pk_Volt_Allowed_VDCM BMS_Max_Cell_Volt_Allowed_VDCM BMS_HV_TractionBusVoltage_VDCM BMS_HV_Trac_Main_Contac_Sts_VDCM BMS_HV_Trac_Bus_Sts_VDCM BMS_HV_Temperature_Min_VDCM BMS_HV_Temperature_Max_VDCM BMS_HV_SOC_AccuracySts_VDCM BMS_HV_NumCellMinTemp_VDCM BMS_HV_NumCellMaxVolt_VDCM BMS_HV_NumCellMaxTemp_VDCM BMS_HV_Low_Temp_Thrsh_VDCM BMS_HV_InternalVoltage_VDCM BMS_HV_High_Temp_Thrsh_VDCM BMS_HV_Common_Contactor_Sts_VDCM BMS_HV_ChargingBusVoltage_VDCM BMS_HV_Char_Main_Contac_Sts_VDCM BMS_HV_Char_Bus_Sts_VDCM BMS_HV_Battery_GFD_Sts_VDCM BMS_HV_BatState_VDCM BMS_HV_BatActualPower_VDCM BMS_Cell_Volt_Min_Vldty_VDCM BMS_Cell_Volt_Min_VDCM BMS_Cell_Volt_Max_Vldty_VDCM BMS_Cell_Volt_Max_VDCM AC_Chrg_Branch_Voltage_VDCM GBT_Charger_Active_Interruption GBT_Desired_SOC_Reached GBT_Ready_to_Charge GBT_Target_Cell_Voltage_Reached GBT_Target_Voltage_Reached VDCM_ChargingPermitting BMS_HV_Char_PreCha_Contac_Sts_V BMS_HV_AC_Char_Main_Contac_Sts_ BMS_HV_BatIntrlk_InternalStat_V BMS_HV_Trac_PreCha_Contac_Sts_V BMS_Max_Cell_Volt_Allowed_Vldty MessageCounter_VO2 CRC_VO2 SelectedSecurityProtocol SelectedAppProtocol;
SIG_GROUP_ 1031 HV_CHARGER1_Pkt 1 : InputCurrentAvailable AC_Side_Volt3 AC_Side_Volt2 AC_Side_Volt1 AC_Side_Curr3 AC_Side_Curr2 AC_Side_Curr1 ProximitySts OBCM_SlacSts OBCM_SdpSts OBCInterlockSts OBC_DeratingReason J1772_State J1772_S2_Sts InputVoltage_isAC InputVoltage_is60Hz HV_Overvoltage HV_Overcurrent ControlPilotSts ChargeEnableSts ChargeCurrentAvailable ChargeCurrent BatterySideCurrent AC_Present AC_HighLoadWarning Supported_VerNumberMinor Supported_VerNumberMajor Supported_SchemaID Supported_ProtocolName MessageCounter_HV_CHARGER1 EVCC_FailureReason CRC_HV_CHARGER1 BatterySideVoltage AC_LnLow AC_LnHi Plug_And_Charge_Contract_Sts RCD EVSENominalVoltage EVSEMaxCurrent Pilot_DutyCycle;
SIG_GROUP_ 292 BATTERY_HV_STATUS1_Pkt 1 : MessageCounter_BATT_HV_STATUS1 CRC_BATT_HV_STATUS1 HVBatContactorWeldCheck HVBatReady BPCM_DC_CntctrsMidTrmOpeningWarn BPCM_DC_CntctrsShtTrmOpeningWarn BPCM_HV_Char_Main_Contac_Sts BPCM_HV_Trac_Main_Contac_Sts BPCM_HV_BalancingMode BPCM_HV_ChargingBusVoltage BPCM_HV_TractionBusVoltage BPCM_Pwr_Limp_Home_On BPCM_HV_Trac_Bus_Sts BPCM_HV_Char_Bus_Sts BPCM_HV_SOH_Low BPCM_HV_SOH HVBatContactorOpenTime HVBatLastSlept BPCMInterlockSts BPCM_HV_BatIntrlk_InternalStat BPCM_HV_Temperature_Min BPCM_HV_Temperature_Max BPCM_HV_Temperature_Avg BPCM_HV_SOC BPCM_HV_Outlet_Temp BPCM_HV_InternalVoltage BPCM_HV_Inlet_Temp BPCM_HV_Current BPCM_HV_Capacity BPCM_HV_Battery_GFD_Sts BPCM_Wakeup_Request BPCM_HV_ThermalRunaway HVBP_Busbar_Temp HVBP_BDU_Busbar_Temp DC_Charge_Type_Status BPCM_Series_Voltage BPCM_Request_for_Aux_Load_off BPCM_HV_Trac_Main_Contac_Config BPCM_HV_InternalVoltageString2 BPCM_HV_InternalVoltageString1 BPCM_HV_DCFC_Isolation_Sts BPCM_HV_Trac_PreCha_Contac_Sts BPCM_HV_Current_String2;

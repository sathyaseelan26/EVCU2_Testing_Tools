/*@!Encoding:1252*/
includes
{

}

variables
{
	message FD3::BRAKE_FD_2 BRAKE_FD_2_TX;
	message FD11::BRAKE_FD_2 BRAKE_FD_2_RX;
	message FD3::BRAKE_FD_4 BRAKE_FD_4_TX;
	message FD11::BRAKE_FD_4 BRAKE_FD_4_RX;
	message FD3::BCM_FD_2 BCM_FD_2_TX;
	message FD11::BCM_FD_2 BCM_FD_2_RX;
	message FD3::BCM_FD_3 BCM_FD_3_TX;
	message FD11::BCM_FD_3 BCM_FD_3_RX;
	message FD3::BCM_FD_7 BCM_FD_7_TX;
	message FD11::BCM_FD_7 BCM_FD_7_RX;
	message FD3::BCM_FD_9 BCM_FD_9_TX;
	message FD11::BCM_FD_9 BCM_FD_9_RX;
	message FD3::BCM_FD_10 BCM_FD_10_TX;
	message FD11::BCM_FD_10 BCM_FD_10_RX;
	message FD3::ENGINE_FD_2 ENGINE_FD_2_TX;
	message FD11::ENGINE_FD_2 ENGINE_FD_2_RX;
	message FD3::IPC_FD_1 IPC_FD_1_TX;
	message FD11::IPC_FD_1 IPC_FD_1_RX;
	message FD3::TELEMATIC_FD_1 TELEMATIC_FD_1_TX;
	message FD11::TELEMATIC_FD_1 TELEMATIC_FD_1_RX;
	message FD3::VIN VIN_TX;
	message FD11::VIN VIN_RX;
}

testcase VehicleSpeedVSOSig()
{
	testCaseComment("Writing to 0 on FD3");
	BRAKE_FD_2_TX.VehicleSpeedVSOSig = 0;
	output(BRAKE_FD_2_TX);
	testWaitForMessage(FD11::BRAKE_FD_2,1000);
	if (BRAKE_FD_2_RX.VehicleSpeedVSOSig == 0)
	{
		testStepPass("Pass");
	}
		else
	{
		testStepFail("Fail");
	}

	testCaseComment("Writing to 54.9375 on FD3");
	BRAKE_FD_2_TX.VehicleSpeedVSOSig = 879;
	output(BRAKE_FD_2_TX);
	testWaitForMessage(FD11::BRAKE_FD_2,1000);
	if (BRAKE_FD_2_RX.VehicleSpeedVSOSig == 879)
	{
		testStepPass("Pass");
	}
		else
	{
		testStepFail("Fail");
	}

	testCaseComment("Writing to 511.875 on FD3");
	BRAKE_FD_2_TX.VehicleSpeedVSOSig = 8190;
	output(BRAKE_FD_2_TX);
	testWaitForMessage(FD11::BRAKE_FD_2,1000);
	if (BRAKE_FD_2_RX.VehicleSpeedVSOSig == 8190)
	{
		testStepPass("Pass");
	}
		else
	{
		testStepFail("Fail");
	}
}

testcase EPBSts()
{
	testCaseComment("Writing to 0 on FD3");
	BRAKE_FD_4_TX.EPBSts = 0;
	output(BRAKE_FD_4_TX);
	testWaitForMessage(FD11::BRAKE_FD_4,1000);
	if (BRAKE_FD_4_RX.EPBSts == 0)
	{
		testStepPass("Pass");
	}
		else
	{
		testStepFail("Fail");
	}

	testCaseComment("Writing to 10 on FD3");
	BRAKE_FD_4_TX.EPBSts = 10;
	output(BRAKE_FD_4_TX);
	testWaitForMessage(FD11::BRAKE_FD_4,1000);
	if (BRAKE_FD_4_RX.EPBSts == 10)
	{
		testStepPass("Pass");
	}
		else
	{
		testStepFail("Fail");
	}

	testCaseComment("Writing to 14 on FD3");
	BRAKE_FD_4_TX.EPBSts = 14;
	output(BRAKE_FD_4_TX);
	testWaitForMessage(FD11::BRAKE_FD_4,1000);
	if (BRAKE_FD_4_RX.EPBSts == 14)
	{
		testStepPass("Pass");
	}
		else
	{
		testStepFail("Fail");
	}
}

testcase OperationalModeSts()
{
	testCaseComment("Writing to 0 on FD3");
	BCM_FD_2_TX.OperationalModeSts = 0;
	output(BCM_FD_2_TX);
	testWaitForMessage(FD11::BCM_FD_2,1000);
	if (BCM_FD_2_RX.OperationalModeSts == 0)
	{
		testStepPass("Pass");
	}
		else
	{
		testStepFail("Fail");
	}

	testCaseComment("Writing to 12 on FD3");
	BCM_FD_2_TX.OperationalModeSts = 12;
	output(BCM_FD_2_TX);
	testWaitForMessage(FD11::BCM_FD_2,1000);
	if (BCM_FD_2_RX.OperationalModeSts == 12)
	{
		testStepPass("Pass");
	}
		else
	{
		testStepFail("Fail");
	}

	testCaseComment("Writing to 15 on FD3");
	BCM_FD_2_TX.OperationalModeSts = 15;
	output(BCM_FD_2_TX);
	testWaitForMessage(FD11::BCM_FD_2,1000);
	if (BCM_FD_2_RX.OperationalModeSts == 15)
	{
		testStepPass("Pass");
	}
		else
	{
		testStepFail("Fail");
	}
}

testcase Battery_Volt_1()
{
	testCaseComment("Writing to 5 on FD3");
	BCM_FD_3_TX.Battery_Volt_1 = 0;
	output(BCM_FD_3_TX);
	testWaitForMessage(FD11::BCM_FD_3,1000);
	if (BCM_FD_3_RX.Battery_Volt_1 == 0)
	{
		testStepPass("Pass");
	}
		else
	{
		testStepFail("Fail");
	}

	testCaseComment("Writing to 14.575000000000001 on FD3");
	BCM_FD_3_TX.Battery_Volt_1 = 383;
	output(BCM_FD_3_TX);
	testWaitForMessage(FD11::BCM_FD_3,1000);
	if (BCM_FD_3_RX.Battery_Volt_1 == 383)
	{
		testStepPass("Pass");
	}
		else
	{
		testStepFail("Fail");
	}

	testCaseComment("Writing to 17.75 on FD3");
	BCM_FD_3_TX.Battery_Volt_1 = 510;
	output(BCM_FD_3_TX);
	testWaitForMessage(FD11::BCM_FD_3,1000);
	if (BCM_FD_3_RX.Battery_Volt_1 == 510)
	{
		testStepPass("Pass");
	}
		else
	{
		testStepFail("Fail");
	}
}

testcase IgnitionOnCounter()
{
	testCaseComment("Writing to 0 on FD3");
	BCM_FD_7_TX.IgnitionOnCounter = 0;
	output(BCM_FD_7_TX);
	testWaitForMessage(FD11::BCM_FD_7,1000);
	if (BCM_FD_7_RX.IgnitionOnCounter == 0)
	{
		testStepPass("Pass");
	}
		else
	{
		testStepFail("Fail");
	}

	testCaseComment("Writing to 38150 on FD3");
	BCM_FD_7_TX.IgnitionOnCounter = 38150;
	output(BCM_FD_7_TX);
	testWaitForMessage(FD11::BCM_FD_7,1000);
	if (BCM_FD_7_RX.IgnitionOnCounter == 38150)
	{
		testStepPass("Pass");
	}
		else
	{
		testStepFail("Fail");
	}

	testCaseComment("Writing to 65535 on FD3");
	BCM_FD_7_TX.IgnitionOnCounter = 65535;
	output(BCM_FD_7_TX);
	testWaitForMessage(FD11::BCM_FD_7,1000);
	if (BCM_FD_7_RX.IgnitionOnCounter == 65535)
	{
		testStepPass("Pass");
	}
		else
	{
		testStepFail("Fail");
	}
}

testcase ExternalTemperature()
{
	testCaseComment("Writing to -85 on FD3");
	BCM_FD_9_TX.ExternalTemperature = 0;
	output(BCM_FD_9_TX);
	testWaitForMessage(FD11::BCM_FD_9,1000);
	if (BCM_FD_9_RX.ExternalTemperature == 0)
	{
		testStepPass("Pass");
	}
		else
	{
		testStepFail("Fail");
	}

	testCaseComment("Writing to 12.0 on FD3");
	BCM_FD_9_TX.ExternalTemperature = 194;
	output(BCM_FD_9_TX);
	testWaitForMessage(FD11::BCM_FD_9,1000);
	if (BCM_FD_9_RX.ExternalTemperature == 194)
	{
		testStepPass("Pass");
	}
		else
	{
		testStepFail("Fail");
	}

	testCaseComment("Writing to 170 on FD3");
	BCM_FD_9_TX.ExternalTemperature = 510;
	output(BCM_FD_9_TX);
	testWaitForMessage(FD11::BCM_FD_9,1000);
	if (BCM_FD_9_RX.ExternalTemperature == 510)
	{
		testStepPass("Pass");
	}
		else
	{
		testStepFail("Fail");
	}
}

testcase ExternalTemperatureC()
{
	testCaseComment("Writing to -85 on FD3");
	BCM_FD_10_TX.ExternalTemperatureC = 0;
	output(BCM_FD_10_TX);
	testWaitForMessage(FD11::BCM_FD_10,1000);
	if (BCM_FD_10_RX.ExternalTemperatureC == 0)
	{
		testStepPass("Pass");
	}
		else
	{
		testStepFail("Fail");
	}

	testCaseComment("Writing to -43.5 on FD3");
	BCM_FD_10_TX.ExternalTemperatureC = 83;
	output(BCM_FD_10_TX);
	testWaitForMessage(FD11::BCM_FD_10,1000);
	if (BCM_FD_10_RX.ExternalTemperatureC == 83)
	{
		testStepPass("Pass");
	}
		else
	{
		testStepFail("Fail");
	}

	testCaseComment("Writing to 170 on FD3");
	BCM_FD_10_TX.ExternalTemperatureC = 510;
	output(BCM_FD_10_TX);
	testWaitForMessage(FD11::BCM_FD_10,1000);
	if (BCM_FD_10_RX.ExternalTemperatureC == 510)
	{
		testStepPass("Pass");
	}
		else
	{
		testStepFail("Fail");
	}
}

testcase CmdIgnSts()
{
	testCaseComment("Writing to 0 on FD3");
	BCM_FD_10_TX.CmdIgnSts = 0;
	output(BCM_FD_10_TX);
	testWaitForMessage(FD11::BCM_FD_10,1000);
	if (BCM_FD_10_RX.CmdIgnSts == 0)
	{
		testStepPass("Pass");
	}
		else
	{
		testStepFail("Fail");
	}

	testCaseComment("Writing to 2 on FD3");
	BCM_FD_10_TX.CmdIgnSts = 2;
	output(BCM_FD_10_TX);
	testWaitForMessage(FD11::BCM_FD_10,1000);
	if (BCM_FD_10_RX.CmdIgnSts == 2)
	{
		testStepPass("Pass");
	}
		else
	{
		testStepFail("Fail");
	}

	testCaseComment("Writing to 7 on FD3");
	BCM_FD_10_TX.CmdIgnSts = 7;
	output(BCM_FD_10_TX);
	testWaitForMessage(FD11::BCM_FD_10,1000);
	if (BCM_FD_10_RX.CmdIgnSts == 7)
	{
		testStepPass("Pass");
	}
		else
	{
		testStepFail("Fail");
	}
}

testcase EngineSpeed_W()
{
	testCaseComment("Writing to 0 on FD3");
	ENGINE_FD_2_TX.EngineSpeed_W = 0;
	output(ENGINE_FD_2_TX);
	testWaitForMessage(FD11::ENGINE_FD_2,1000);
	if (ENGINE_FD_2_RX.EngineSpeed_W == 0)
	{
		testStepPass("Pass");
	}
		else
	{
		testStepFail("Fail");
	}

	testCaseComment("Writing to 8628 on FD3");
	ENGINE_FD_2_TX.EngineSpeed_W = 8628;
	output(ENGINE_FD_2_TX);
	testWaitForMessage(FD11::ENGINE_FD_2,1000);
	if (ENGINE_FD_2_RX.EngineSpeed_W == 8628)
	{
		testStepPass("Pass");
	}
		else
	{
		testStepFail("Fail");
	}

	testCaseComment("Writing to 16382 on FD3");
	ENGINE_FD_2_TX.EngineSpeed_W = 16382;
	output(ENGINE_FD_2_TX);
	testWaitForMessage(FD11::ENGINE_FD_2,1000);
	if (ENGINE_FD_2_RX.EngineSpeed_W == 16382)
	{
		testStepPass("Pass");
	}
		else
	{
		testStepFail("Fail");
	}
}

testcase PowertrainPrplsnActv()
{
	testCaseComment("Writing to 0 on FD3");
	ENGINE_FD_2_TX.PowertrainPrplsnActv = 0;
	output(ENGINE_FD_2_TX);
	testWaitForMessage(FD11::ENGINE_FD_2,1000);
	if (ENGINE_FD_2_RX.PowertrainPrplsnActv == 0)
	{
		testStepPass("Pass");
	}
		else
	{
		testStepFail("Fail");
	}

	testCaseComment("Writing to 1 on FD3");
	ENGINE_FD_2_TX.PowertrainPrplsnActv = 1;
	output(ENGINE_FD_2_TX);
	testWaitForMessage(FD11::ENGINE_FD_2,1000);
	if (ENGINE_FD_2_RX.PowertrainPrplsnActv == 1)
	{
		testStepPass("Pass");
	}
		else
	{
		testStepFail("Fail");
	}

	testCaseComment("Writing to 1 on FD3");
	ENGINE_FD_2_TX.PowertrainPrplsnActv = 1;
	output(ENGINE_FD_2_TX);
	testWaitForMessage(FD11::ENGINE_FD_2,1000);
	if (ENGINE_FD_2_RX.PowertrainPrplsnActv == 1)
	{
		testStepPass("Pass");
	}
		else
	{
		testStepFail("Fail");
	}
}

testcase TotalOdometer()
{
	testCaseComment("Writing to 0 on FD3");
	IPC_FD_1_TX.TotalOdometer = 0;
	output(IPC_FD_1_TX);
	testWaitForMessage(FD11::IPC_FD_1,1000);
	if (IPC_FD_1_RX.TotalOdometer == 0)
	{
		testStepPass("Pass");
	}
		else
	{
		testStepFail("Fail");
	}

	testCaseComment("Writing to 937367 on FD3");
	IPC_FD_1_TX.TotalOdometer = 937367;
	output(IPC_FD_1_TX);
	testWaitForMessage(FD11::IPC_FD_1,1000);
	if (IPC_FD_1_RX.TotalOdometer == 937367)
	{
		testStepPass("Pass");
	}
		else
	{
		testStepFail("Fail");
	}

	testCaseComment("Writing to 1048575 on FD3");
	IPC_FD_1_TX.TotalOdometer = 1048575;
	output(IPC_FD_1_TX);
	testWaitForMessage(FD11::IPC_FD_1,1000);
	if (IPC_FD_1_RX.TotalOdometer == 1048575)
	{
		testStepPass("Pass");
	}
		else
	{
		testStepFail("Fail");
	}
}

testcase GPS_UTC_Minute()
{
	testCaseComment("Writing to 0 on FD3");
	TELEMATIC_FD_1_TX.GPS_UTC_Minute = 0;
	output(TELEMATIC_FD_1_TX);
	testWaitForMessage(FD11::TELEMATIC_FD_1,1000);
	if (TELEMATIC_FD_1_RX.GPS_UTC_Minute == 0)
	{
		testStepPass("Pass");
	}
		else
	{
		testStepFail("Fail");
	}

	testCaseComment("Writing to 22 on FD3");
	TELEMATIC_FD_1_TX.GPS_UTC_Minute = 22;
	output(TELEMATIC_FD_1_TX);
	testWaitForMessage(FD11::TELEMATIC_FD_1,1000);
	if (TELEMATIC_FD_1_RX.GPS_UTC_Minute == 22)
	{
		testStepPass("Pass");
	}
		else
	{
		testStepFail("Fail");
	}

	testCaseComment("Writing to 59 on FD3");
	TELEMATIC_FD_1_TX.GPS_UTC_Minute = 59;
	output(TELEMATIC_FD_1_TX);
	testWaitForMessage(FD11::TELEMATIC_FD_1,1000);
	if (TELEMATIC_FD_1_RX.GPS_UTC_Minute == 59)
	{
		testStepPass("Pass");
	}
		else
	{
		testStepFail("Fail");
	}
}

testcase GPS_UTC_Hour()
{
	testCaseComment("Writing to 0 on FD3");
	TELEMATIC_FD_1_TX.GPS_UTC_Hour = 0;
	output(TELEMATIC_FD_1_TX);
	testWaitForMessage(FD11::TELEMATIC_FD_1,1000);
	if (TELEMATIC_FD_1_RX.GPS_UTC_Hour == 0)
	{
		testStepPass("Pass");
	}
		else
	{
		testStepFail("Fail");
	}

	testCaseComment("Writing to 21 on FD3");
	TELEMATIC_FD_1_TX.GPS_UTC_Hour = 21;
	output(TELEMATIC_FD_1_TX);
	testWaitForMessage(FD11::TELEMATIC_FD_1,1000);
	if (TELEMATIC_FD_1_RX.GPS_UTC_Hour == 21)
	{
		testStepPass("Pass");
	}
		else
	{
		testStepFail("Fail");
	}

	testCaseComment("Writing to 23 on FD3");
	TELEMATIC_FD_1_TX.GPS_UTC_Hour = 23;
	output(TELEMATIC_FD_1_TX);
	testWaitForMessage(FD11::TELEMATIC_FD_1,1000);
	if (TELEMATIC_FD_1_RX.GPS_UTC_Hour == 23)
	{
		testStepPass("Pass");
	}
		else
	{
		testStepFail("Fail");
	}
}

testcase GPS_Date_Day()
{
	testCaseComment("Writing to 1 on FD3");
	TELEMATIC_FD_1_TX.GPS_Date_Day = 1;
	output(TELEMATIC_FD_1_TX);
	testWaitForMessage(FD11::TELEMATIC_FD_1,1000);
	if (TELEMATIC_FD_1_RX.GPS_Date_Day == 1)
	{
		testStepPass("Pass");
	}
		else
	{
		testStepFail("Fail");
	}

	testCaseComment("Writing to 2 on FD3");
	TELEMATIC_FD_1_TX.GPS_Date_Day = 2;
	output(TELEMATIC_FD_1_TX);
	testWaitForMessage(FD11::TELEMATIC_FD_1,1000);
	if (TELEMATIC_FD_1_RX.GPS_Date_Day == 2)
	{
		testStepPass("Pass");
	}
		else
	{
		testStepFail("Fail");
	}

	testCaseComment("Writing to 31 on FD3");
	TELEMATIC_FD_1_TX.GPS_Date_Day = 31;
	output(TELEMATIC_FD_1_TX);
	testWaitForMessage(FD11::TELEMATIC_FD_1,1000);
	if (TELEMATIC_FD_1_RX.GPS_Date_Day == 31)
	{
		testStepPass("Pass");
	}
		else
	{
		testStepFail("Fail");
	}
}

testcase GPS_Date_Month()
{
	testCaseComment("Writing to 1 on FD3");
	TELEMATIC_FD_1_TX.GPS_Date_Month = 1;
	output(TELEMATIC_FD_1_TX);
	testWaitForMessage(FD11::TELEMATIC_FD_1,1000);
	if (TELEMATIC_FD_1_RX.GPS_Date_Month == 1)
	{
		testStepPass("Pass");
	}
		else
	{
		testStepFail("Fail");
	}

	testCaseComment("Writing to 7 on FD3");
	TELEMATIC_FD_1_TX.GPS_Date_Month = 7;
	output(TELEMATIC_FD_1_TX);
	testWaitForMessage(FD11::TELEMATIC_FD_1,1000);
	if (TELEMATIC_FD_1_RX.GPS_Date_Month == 7)
	{
		testStepPass("Pass");
	}
		else
	{
		testStepFail("Fail");
	}

	testCaseComment("Writing to 12 on FD3");
	TELEMATIC_FD_1_TX.GPS_Date_Month = 12;
	output(TELEMATIC_FD_1_TX);
	testWaitForMessage(FD11::TELEMATIC_FD_1,1000);
	if (TELEMATIC_FD_1_RX.GPS_Date_Month == 12)
	{
		testStepPass("Pass");
	}
		else
	{
		testStepFail("Fail");
	}
}

testcase GPS_UTC_Second()
{
	testCaseComment("Writing to 0 on FD3");
	TELEMATIC_FD_1_TX.GPS_UTC_Second = 0;
	output(TELEMATIC_FD_1_TX);
	testWaitForMessage(FD11::TELEMATIC_FD_1,1000);
	if (TELEMATIC_FD_1_RX.GPS_UTC_Second == 0)
	{
		testStepPass("Pass");
	}
		else
	{
		testStepFail("Fail");
	}

	testCaseComment("Writing to 7.2700000000000005 on FD3");
	TELEMATIC_FD_1_TX.GPS_UTC_Second = 727;
	output(TELEMATIC_FD_1_TX);
	testWaitForMessage(FD11::TELEMATIC_FD_1,1000);
	if (TELEMATIC_FD_1_RX.GPS_UTC_Second == 727)
	{
		testStepPass("Pass");
	}
		else
	{
		testStepFail("Fail");
	}

	testCaseComment("Writing to 59.99 on FD3");
	TELEMATIC_FD_1_TX.GPS_UTC_Second = 5999;
	output(TELEMATIC_FD_1_TX);
	testWaitForMessage(FD11::TELEMATIC_FD_1,1000);
	if (TELEMATIC_FD_1_RX.GPS_UTC_Second == 5999)
	{
		testStepPass("Pass");
	}
		else
	{
		testStepFail("Fail");
	}
}

testcase GPS_Date_Year()
{
	testCaseComment("Writing to 0 on FD3");
	TELEMATIC_FD_1_TX.GPS_Date_Year = 0;
	output(TELEMATIC_FD_1_TX);
	testWaitForMessage(FD11::TELEMATIC_FD_1,1000);
	if (TELEMATIC_FD_1_RX.GPS_Date_Year == 0)
	{
		testStepPass("Pass");
	}
		else
	{
		testStepFail("Fail");
	}

	testCaseComment("Writing to 6661 on FD3");
	TELEMATIC_FD_1_TX.GPS_Date_Year = 6661;
	output(TELEMATIC_FD_1_TX);
	testWaitForMessage(FD11::TELEMATIC_FD_1,1000);
	if (TELEMATIC_FD_1_RX.GPS_Date_Year == 6661)
	{
		testStepPass("Pass");
	}
		else
	{
		testStepFail("Fail");
	}

	testCaseComment("Writing to 65534 on FD3");
	TELEMATIC_FD_1_TX.GPS_Date_Year = 65534;
	output(TELEMATIC_FD_1_TX);
	testWaitForMessage(FD11::TELEMATIC_FD_1,1000);
	if (TELEMATIC_FD_1_RX.GPS_Date_Year == 65534)
	{
		testStepPass("Pass");
	}
		else
	{
		testStepFail("Fail");
	}
}

testcase VIN_MSG()
{
	testCaseComment("Writing to 0 on FD3");
	VIN_TX.VIN_MSG = 0;
	output(VIN_TX);
	testWaitForMessage(FD11::VIN,1000);
	if (VIN_RX.VIN_MSG == 0)
	{
		testStepPass("Pass");
	}
		else
	{
		testStepFail("Fail");
	}

	testCaseComment("Writing to 1 on FD3");
	VIN_TX.VIN_MSG = 1;
	output(VIN_TX);
	testWaitForMessage(FD11::VIN,1000);
	if (VIN_RX.VIN_MSG == 1)
	{
		testStepPass("Pass");
	}
		else
	{
		testStepFail("Fail");
	}

	testCaseComment("Writing to 3 on FD3");
	VIN_TX.VIN_MSG = 3;
	output(VIN_TX);
	testWaitForMessage(FD11::VIN,1000);
	if (VIN_RX.VIN_MSG == 3)
	{
		testStepPass("Pass");
	}
		else
	{
		testStepFail("Fail");
	}
}

testcase VIN_DATA()
{
	testCaseComment("Writing to 0 on FD3");
	VIN_TX.VIN_DATA = 0;
	output(VIN_TX);
	testWaitForMessage(FD11::VIN,1000);
	if (VIN_RX.VIN_DATA == 0)
	{
		testStepPass("Pass");
	}
		else
	{
		testStepFail("Fail");
	}

	testCaseComment("Writing to 4906896397700368 on FD3");
	VIN_TX.VIN_DATA = 4906896397700368;
	output(VIN_TX);
	testWaitForMessage(FD11::VIN,1000);
	if (VIN_RX.VIN_DATA == 4906896397700368)
	{
		testStepPass("Pass");
	}
		else
	{
		testStepFail("Fail");
	}

	testCaseComment("Writing to 72057594037927900 on FD3");
	VIN_TX.VIN_DATA = 72057594037927904;
	output(VIN_TX);
	testWaitForMessage(FD11::VIN,1000);
	if (VIN_RX.VIN_DATA == 72057594037927904)
	{
		testStepPass("Pass");
	}
		else
	{
		testStepFail("Fail");
	}
}

on message FD11::BRAKE_FD_2
{
	BRAKE_FD_2_RX.VehicleSpeedVSOSig = this.VehicleSpeedVSOSig;
}

on message FD11::BRAKE_FD_4
{
	BRAKE_FD_4_RX.EPBSts = this.EPBSts;
}

on message FD11::BCM_FD_2
{
	BCM_FD_2_RX.OperationalModeSts = this.OperationalModeSts;
}

on message FD11::BCM_FD_3
{
	BCM_FD_3_RX.Battery_Volt_1 = this.Battery_Volt_1;
}

on message FD11::BCM_FD_7
{
	BCM_FD_7_RX.IgnitionOnCounter = this.IgnitionOnCounter;
}

on message FD11::BCM_FD_9
{
	BCM_FD_9_RX.ExternalTemperature = this.ExternalTemperature;
}

on message FD11::BCM_FD_10
{
	BCM_FD_10_RX.ExternalTemperatureC = this.ExternalTemperatureC;
	BCM_FD_10_RX.CmdIgnSts = this.CmdIgnSts;
}

on message FD11::ENGINE_FD_2
{
	ENGINE_FD_2_RX.EngineSpeed_W = this.EngineSpeed_W;
	ENGINE_FD_2_RX.PowertrainPrplsnActv = this.PowertrainPrplsnActv;
}

on message FD11::IPC_FD_1
{
	IPC_FD_1_RX.TotalOdometer = this.TotalOdometer;
}

on message FD11::TELEMATIC_FD_1
{
	TELEMATIC_FD_1_RX.GPS_UTC_Minute = this.GPS_UTC_Minute;
	TELEMATIC_FD_1_RX.GPS_UTC_Hour = this.GPS_UTC_Hour;
	TELEMATIC_FD_1_RX.GPS_Date_Day = this.GPS_Date_Day;
	TELEMATIC_FD_1_RX.GPS_Date_Month = this.GPS_Date_Month;
	TELEMATIC_FD_1_RX.GPS_UTC_Second = this.GPS_UTC_Second;
	TELEMATIC_FD_1_RX.GPS_Date_Year = this.GPS_Date_Year;
}

on message FD11::VIN
{
	VIN_RX.VIN_MSG = this.VIN_MSG;
	VIN_RX.VIN_DATA = this.VIN_DATA;
}

void MainTest ()
{
	testGroupBegin("BRAKE_FD_2","");
	VehicleSpeedVSOSig();
	testGroupEnd();
	testGroupBegin("BRAKE_FD_4","");
	EPBSts();
	testGroupEnd();
	testGroupBegin("BCM_FD_2","");
	OperationalModeSts();
	testGroupEnd();
	testGroupBegin("BCM_FD_3","");
	Battery_Volt_1();
	testGroupEnd();
	testGroupBegin("BCM_FD_7","");
	IgnitionOnCounter();
	testGroupEnd();
	testGroupBegin("BCM_FD_9","");
	ExternalTemperature();
	testGroupEnd();
	testGroupBegin("BCM_FD_10","");
	ExternalTemperatureC();
	CmdIgnSts();
	testGroupEnd();
	testGroupBegin("ENGINE_FD_2","");
	EngineSpeed_W();
	PowertrainPrplsnActv();
	testGroupEnd();
	testGroupBegin("IPC_FD_1","");
	TotalOdometer();
	testGroupEnd();
	testGroupBegin("TELEMATIC_FD_1","");
	GPS_UTC_Minute();
	GPS_UTC_Hour();
	GPS_Date_Day();
	GPS_Date_Month();
	GPS_UTC_Second();
	GPS_Date_Year();
	testGroupEnd();
	testGroupBegin("VIN","");
	VIN_MSG();
	VIN_DATA();
	testGroupEnd();
}

VERSION ""

NS_ :

BS_:

BU_: MPAD CVADAS ADCAM ORC EVCU2 EPS ECM CVPAM CADM BSM2 BSM

BO_ 274 ORC_FD_3: 32 ORC
 SG_ YawRate : 163|12@0+ (0.08,-163.84) [-163.84|163.68] "deg/s"  ADCAM,MPAD,EVCU2,CADM,BSM
 SG_ LongAcceleration : 131|12@0+ (0.02,-40.96) [-40.96|40.92] "m/s^2"  ADCAM,MPAD,EVCU2,CADM,BSM
 SG_ LatAcceleration : 147|12@0+ (0.02,-40.96) [-40.96|40.92] "m/s^2"  ADCAM,MPAD,EVCU2,CADM,BSM
 SG_ YawRateFailSts : 181|1@0+ (1,0) [0|1] "-"  ADCAM,MPAD,EVCU2,CADM,BSM
 SG_ MessageCounter_ORC3 : 179|4@0+ (1,0) [0|15] "-"  ADCAM,MPAD,EVCU2,CADM,BSM
 SG_ LongAccelerationFailSts : 183|1@0+ (1,0) [0|1] "-"  ADCAM,MPAD,EVCU2,CADM,BSM
 SG_ LatAccelerationFailSts : 182|1@0+ (1,0) [0|1] "-"  ADCAM,MPAD,EVCU2,CADM,BSM
 SG_ CRC_ORC3 : 191|8@0+ (1,0) [0|255] "-"  ADCAM,MPAD,EVCU2,CADM,BSM
 SG_ InternalError : 165|1@0+ (1,0) [0|1] "-"  ADCAM,MPAD,CADM,BSM
 SG_ YawRate_HR_Sign : 7|1@0+ (1,0) [0|1] "deg/s"  ADCAM,MPAD,CADM
 SG_ YawRate_HR : 10|3@0+ (0.02,0) [0|0.06] "deg/s"  ADCAM,MPAD,CADM
 SG_ StbmTimestampSec_ORC : 79|32@0+ (1,0) [0|4294967295] "sec"  MPAD
 SG_ StbmTimestampNSec_ORC : 47|32@0+ (1,0) [0|4294967295] "nsec"  MPAD
 SG_ StbmSyncState_ORC : 31|8@0+ (1,0) [0|255] "No_Unit"  MPAD
 SG_ IMUTemperature : 23|8@0+ (1,-40) [-40|215] "°C"  MPAD

BO_ 1954 ORC_FD_2: 32 ORC
 SG_ ORCIdentification : 87|32@0+ (1,0) [0|4294967295] "-"  BSM
 SG_ MessageCounter_ORC2 : 179|4@0+ (1,0) [0|15] "-"  BSM
 SG_ CRC_ORC2 : 191|8@0+ (1,0) [0|255] "-"  BSM

BO_ 611 ORC_FD_1: 32 ORC
 SG_ SBR1RowDriverSeatSts : 94|2@0+ (1,0) [0|2] "-"  ADCAM,MPAD,EVCU2,CADM,BSM
 SG_ MessageCounter_ORC1 : 179|4@0+ (1,0) [0|15] "-"  ADCAM,MPAD,EVCU2,CADM,BSM
 SG_ CRC_ORC1 : 191|8@0+ (1,0) [0|255] "-"  ADCAM,MPAD,EVCU2,CADM,BSM

BO_ 1626 IMPACT_INFO: 32 ORC
 SG_ IMPACTConfirm : 81|1@0+ (1,0) [0|1] "-"  MPAD,EVCU2,CADM
 SG_ IMPACTCommand : 80|1@0+ (1,0) [0|1] "-"  MPAD,EVCU2,CADM
 SG_ IMPACTThreshold : 103|1@0+ (1,0) [0|1] "-"  Vector__XXX
 SG_ MessageCounter_IMPACTINFO : 179|4@0+ (1,0) [0|15] "-"  MPAD,EVCU2
 SG_ CRC_IMPACTINFO : 191|8@0+ (1,0) [0|255] "-"  MPAD,EVCU2
 SG_ IMPACTFailSts : 82|1@0+ (1,0) [0|1] "-"  Vector__XXX
 SG_ IMPACT_M : 94|1@0+ (1,0) [0|1] "-"  MPAD
 SG_ IMPACT_K : 92|1@0+ (1,0) [0|1] "-"  MPAD
 SG_ IMPACT_I : 91|1@0+ (1,0) [0|1] "-"  MPAD
 SG_ IMPACT_F : 88|1@0+ (1,0) [0|1] "-"  MPAD
 SG_ IMPACT_C : 85|1@0+ (1,0) [0|1] "-"  MPAD
 SG_ IMPACT_B : 84|1@0+ (1,0) [0|1] "-"  MPAD
 SG_ Non_deployment : 102|2@0+ (1,0) [0|3] "" MPAD,CADM

BO_ 1056 EPS_FD_2: 32 EPS
 SG_ EPS_Warn_Disp_Rq : 87|3@0+ (1,0) [0|3] "" Vector__XXX
 SG_ EPS_MODE_STAT : 7|3@0+ (1,0) [0|3] "" Vector__XXX
 SG_ MessageCounter_EPS2 : 179|4@0+ (1,0) [0|15] ""  CVADAS,CVPAM
 SG_ CRC_EPS2 : 191|8@0+ (1,0) [0|255] ""  CVADAS,CVPAM
 SG_ EPS_SteeringTouq_Resp : 3|2@0+ (1,0) [0|1] "" CVADAS,CVPAM
 SG_ EPS_SteeringTouchStat : 4|1@0+ (1,0) [0|1] "" CVADAS,CVPAM
 SG_ THA_SteeringTouchStat : 15|2@0+ (1,0) [0|1] "" CVADAS
 SG_ EPS_THA_SteeringTorqueResp : 13|3@0+ (1,0) [0|6] "" CVADAS
 SG_ EPS_THA_DriverTorqueOverride : 1|2@0+ (1,0) [0|1] "" CVADAS

BO_ 264 EPS_FD_1: 32 EPS
 SG_ LwsAngle : 7|16@0+ (0.1,-720) [-720|720] "°"  CVADAS,ADCAM,MPAD,EVCU2,CVPAM,CADM,BSM,ECM
 SG_ LwsSpeed : 19|12@0+ (1,-2000) [-2000|2094] "°/s"  CVADAS,ADCAM,MPAD,EVCU2,CVPAM,CADM
 SG_ MessageCounter_EPS1 : 179|4@0+ (1,0) [0|15] "-"  CVADAS,ADCAM,MPAD,CVPAM,CADM,BSM,ORC
 SG_ CRC_EPS1 : 191|8@0+ (1,0) [0|255] "-"  CVADAS,ADCAM,MPAD,CVPAM,CADM,BSM,ORC
 SG_ LwsCalibration : 36|1@0+ (1,0) [0|1] "-"  ADCAM,MPAD,CADM,BSM
 SG_ LwsAngleType : 52|2@0+ (1,0) [0|2] "-"  CVADAS,MPAD,CVPAM,CADM,BSM
 SG_ EngineFanRequestActivation : 38|1@0+ (1,0) [0|1] "-"  Vector__XXX
 SG_ ElectricSteeringFailSts : 37|1@0+ (1,0) [0|1] "-"  MPAD,EVCU2
 SG_ EPS_Curr : 87|8@0+ (1,-50) [-50|204] "Amp"  Vector__XXX
 SG_ SteeringVibration_Status : 23|1@0+ (1,0) [0|1] "-"  ADCAM,MPAD,CADM,ORC
 SG_ SteeringVibration_Fault : 39|1@0+ (1,0) [0|1] "-"  ADCAM,MPAD,CADM
 SG_ Steering_OpStat_Prim : 111|3@0+ (1,0) [0|5] "" MPAD,CADM,ORC
 SG_ Steering_Column_Torque : 50|11@0+ (0.0078125,-8) [-8|7.984375] "NM"  CVADAS,ADCAM,MPAD,CVPAM,CADM
 SG_ SPM_Lat_Ctrl_ResponseSts : 103|2@0+ (1,0) [0|3] "-"  CVADAS,CVPAM,ORC
 SG_ EPS_HandsOnRecognition : 22|1@0+ (1,0) [0|1] "-"  CVADAS,MPAD,CVPAM,ORC
 SG_ EPS_Hands_On_Sts : 67|1@0+ (1,0) [0|1] "-"  ADCAM,MPAD,CADM,ORC
 SG_ EPS_AsstStat : 55|3@0+ (1,0) [0|6] "-"  MPAD,CADM
 SG_ EPS_ADAS_IMC_Fault : 69|1@0+ (1,0) [0|1] "" MPAD,CADM
 SG_ HAS_LAT_CTRL_ResponseSts : 101|3@0+ (1,0) [0|7] "-"  ADCAM,MPAD,CADM,ORC
 SG_ EPSMotorTorque : 66|11@0+ (0.004882815,-5) [-5|4.99023949] "Nm"  ADCAM,MPAD,CADM,ORC
 SG_ ESA_LAT_CTRL_ResponseSts : 135|3@0+ (1,0) [0|6] "-"  CADM,BSM
 SG_ LKA_LAT_CTRL_ResponseSts_108 : 71|2@0+ (1,0) [0|3] "-"  ADCAM,MPAD,CADM,ORC

BO_ 1448 ENGINE_FD_7: 32 ECM
 SG_ MessageCounter_ENGINE7 : 179|4@0+ (1,0) [0|15] "-"  CVADAS,CVPAM
 SG_ CRC_ENGINE7 : 191|8@0+ (1,0) [0|255] "-"  CVADAS,CVPAM
 SG_ ECM_TRSC_Resp : 7|2@0+ (1,0) [0|2] "-"  CVADAS,CVPAM
 SG_ ECM_THA_Resp : 73|2@0+ (1,0) [0|2] "-"  CVADAS

BO_ 518 ENGINE_FD_5: 32 ECM
 SG_ RPMOverRev_W : 115|1@0+ (1,0) [0|1] "-"  ADCAM,CADM
 SG_ PdlPosActual : 87|8@0+ (0.4,0) [0|100] "%"  CVADAS,ADCAM,BSM2,CVPAM,CADM,BSM
 SG_ MessageCounter_ENGINE5 : 179|4@0+ (1,0) [0|15] "-"  ADCAM,BSM2,CADM,BSM
 SG_ CRC_ENGINE5 : 191|8@0+ (1,0) [0|255] "-"  ADCAM,BSM2,CADM,BSM

BO_ 1054 ENGINE_FD_1: 32 ECM
 SG_ ThermalManagementActive_W : 1|1@0+ (1,0) [0|1] "-"  ADCAM,CADM
 SG_ MessageCounter_ENGINE1 : 179|4@0+ (1,0) [0|15] "-"  CADM
 SG_ CRC_ENGINE1 : 191|8@0+ (1,0) [0|255] "-"  CADM

BO_ 514 BRAKE_FD_7: 32 BSM
 SG_ PAM_Brk_Rq_RspSts : 28|2@0+ (1,0) [0|3] "-"  CVADAS,CVPAM
 SG_ MessageCounter_BRAKE7 : 179|4@0+ (1,0) [0|15] "-"  CVADAS,ADCAM,EVCU2,BSM2,CVPAM,CADM
 SG_ CRC_BRAKE7 : 191|8@0+ (1,0) [0|255] "-"  CVADAS,ADCAM,EVCU2,BSM2,CVPAM,CADM
 SG_ BrkPdl_Stat : 85|2@0+ (1,0) [0|2] "-"  CVADAS,ADCAM,MPAD,EVCU2,BSM2,CVPAM,CADM,ECM
 SG_ BrkPdl_Flt : 86|1@0+ (1,0) [0|1] "-"  ADCAM,MPAD,EVCU2,CADM,ECM
 SG_ BrakePdlPosn : 63|8@0+ (0.4,0) [0|100] "%"  EVCU2,BSM2,CADM,ECM
 SG_ BSM_OpStat : 74|3@0+ (1,0) [0|5] "" MPAD,BSM2,CADM
 SG_ Brake_OpStat_Prim : 82|3@0+ (1,0) [0|5] "" MPAD,CADM,ORC
 SG_ BSM_HEALTH_CHECK : 7|8@0+ (1,0) [0|255] "" BSM2
 SG_ AEB_Type_Brk_202 : 67|4@0+ (1,0) [0|14] "-"  ADCAM,MPAD,BSM2,CADM,ORC

BO_ 1155 BRAKE_FD_5: 32 BSM
 SG_ TSCActive : 110|1@0+ (1,0) [0|1] "-"  Vector__XXX
 SG_ RollsModeAct : 91|1@0+ (1,0) [0|1] "-"  ADCAM,MPAD,EVCU2,BSM2,CADM
 SG_ FunctionIntervention : 80|1@0+ (1,0) [0|1] "-"  Vector__XXX
 SG_ FunctionFailSts : 81|1@0+ (1,0) [0|1] "-"  EVCU2,ORC
 SG_ Function2Sts : 94|1@0+ (1,0) [0|1] "-"  MPAD
 SG_ ESCFailSts : 83|1@0+ (1,0) [0|1] "-"  ADCAM,MPAD,EVCU2,CVPAM,CADM
 SG_ ERMActive : 111|1@0+ (1,0) [0|1] "-"  Vector__XXX
 SG_ EBDFailSts : 84|1@0+ (1,0) [0|1] "-"  Vector__XXX
 SG_ CMMIntervention : 86|1@0+ (1,0) [0|1] "-"  MPAD,ECM
 SG_ BSMSysSts : 89|2@0+ (1,0) [0|3] "-"  ADCAM,MPAD,CADM
 SG_ ACCEngaged : 92|1@0+ (1,0) [0|1] "-"  EVCU2,ECM
 SG_ ABSFailSts : 87|1@0+ (1,0) [0|1] "-"  MPAD,EVCU2,CVPAM,ECM
 SG_ MessageCounter_BRAKE5 : 179|4@0+ (1,0) [0|15] "-"  CVADAS,ADCAM,EVCU2,BSM2,CVPAM,CADM,ECM
 SG_ CRC_BRAKE5 : 191|8@0+ (1,0) [0|255] "-"  CVADAS,ADCAM,EVCU2,BSM2,CVPAM,CADM,ECM
 SG_ FunctionSts : 95|1@0+ (1,0) [0|1] "-"  ADCAM,MPAD,CADM
 SG_ ESC_TRSC_Brk_Resp : 5|2@0+ (1,0) [0|2] "-"  CVADAS,CVPAM
 SG_ BSM_THA_Brk_Resp : 15|2@0+ (1,0) [0|3] "-"  CVADAS

BO_ 609 BRAKE_FD_4: 32 BSM
 SG_ TravelDistance : 87|8@0+ (1,0) [0|255] "m"  Vector__XXX
 SG_ MSRActive : 92|1@0+ (1,0) [0|1] "-"  MPAD,EVCU2
 SG_ EPBSts : 115|4@0+ (1,0) [0|14] "-"  CVADAS,ADCAM,MPAD,EVCU2,CVPAM,CADM
 SG_ ASRActive : 90|1@0+ (1,0) [0|1] "-"  EVCU2,CVPAM
 SG_ MessageCounter_BRAKE4 : 179|4@0+ (1,0) [0|15] "-"  CVADAS,ADCAM,MPAD,EVCU2,CVPAM,CADM
 SG_ CRC_BRAKE4 : 191|8@0+ (1,0) [0|255] "-"  CVADAS,ADCAM,MPAD,EVCU2,CVPAM,CADM
 SG_ ESC_OFF_Hrd_Sft_Button_sts : 151|3@0+ (1,0) [0|6] "-"  Vector__XXX
 SG_ BSM_LnchMode : 55|3@0+ (1,0) [0|6] "-"  Vector__XXX
 SG_ BSM_LnchCtrl_SftBtn_SelectSts : 0|1@0+ (1,0) [0|1] "-"  Vector__XXX
 SG_ BSM_LnchAbrtSts : 33|2@0+ (1,0) [0|2] "-"  Vector__XXX
 SG_ LaunchRPMsetting_BSM : 63|6@0+ (100,1000) [1000|7300] "rpm"  Vector__XXX

BO_ 259 BRAKE_FD_3: 32 BSM
 SG_ RHR_WheelSensorFailSts : 103|1@0+ (1,0) [0|1] "-"  CVADAS,ADCAM,MPAD,EVCU2,BSM2,CVPAM,CADM,EPS
 SG_ RHR_Spin : 102|2@0+ (1,0) [0|3] "-"  CVADAS,ADCAM,MPAD,EVCU2,BSM2,CVPAM,CADM
 SG_ RHR_FastPulseCounter : 159|8@0+ (1,0) [0|255] "pulse"  CVADAS,ADCAM,MPAD,EVCU2,BSM2,CVPAM,CADM,EPS
 SG_ RHF_WheelSensorFailSts : 182|1@0+ (1,0) [0|1] "-"  CVADAS,ADCAM,MPAD,EVCU2,BSM2,CVPAM,CADM,EPS
 SG_ RHF_FastPulseCounter : 175|8@0+ (1,0) [0|255] "pulse"  CVADAS,ADCAM,MPAD,EVCU2,BSM2,CVPAM,CADM,EPS
 SG_ LHR_WheelSensorFailSts : 87|1@0+ (1,0) [0|1] "-"  CVADAS,ADCAM,MPAD,EVCU2,BSM2,CVPAM,CADM,EPS
 SG_ LHR_Spin : 86|2@0+ (1,0) [0|3] "-"  CVADAS,ADCAM,MPAD,EVCU2,BSM2,CVPAM,CADM
 SG_ LHR_FastPulseCounter : 151|8@0+ (1,0) [0|255] "pulse"  CVADAS,ADCAM,MPAD,EVCU2,BSM2,CVPAM,CADM,EPS
 SG_ LHF_WheelSensorFailSts : 181|1@0+ (1,0) [0|1] "-"  CVADAS,ADCAM,MPAD,EVCU2,BSM2,CVPAM,CADM,EPS
 SG_ LHF_FastPulseCounter : 167|8@0+ (1,0) [0|255] "pulse"  CVADAS,ADCAM,MPAD,EVCU2,BSM2,CVPAM,CADM,EPS
 SG_ RHRWheelSpeed : 68|13@0+ (0.0625,0) [0|511.875] "Km/h"  CVADAS,ADCAM,MPAD,EVCU2,BSM2,CVPAM,CADM,EPS
 SG_ RHFWheelSpeed : 52|13@0+ (0.0625,0) [0|511.875] "Km/h"  CVADAS,ADCAM,MPAD,EVCU2,BSM2,CVPAM,CADM,EPS
 SG_ RHF_Spin : 7|2@0+ (1,0) [0|3] "-"  CVADAS,ADCAM,MPAD,EVCU2,BSM2,CVPAM,CADM,EPS
 SG_ MessageCounter_BRAKE3 : 179|4@0+ (1,0) [0|15] "-"  CVADAS,ADCAM,MPAD,EVCU2,BSM2,CVPAM,CADM,EPS
 SG_ LHRWheelSpeed : 4|13@0+ (0.0625,0) [0|511.875] "Km/h"  CVADAS,ADCAM,MPAD,EVCU2,BSM2,CVPAM,CADM,EPS
 SG_ LHFWheelSpeed : 20|13@0+ (0.0625,0) [0|511.875] "Km/h"  CVADAS,ADCAM,MPAD,EVCU2,BSM2,CVPAM,CADM,EPS
 SG_ LHF_Spin : 23|2@0+ (1,0) [0|3] "-"  CVADAS,ADCAM,MPAD,EVCU2,BSM2,CVPAM,CADM,EPS
 SG_ CRC__BRAKE3 : 191|8@0+ (1,0) [0|255] "-"  CVADAS,ADCAM,MPAD,EVCU2,BSM2,CVPAM,CADM,EPS
 SG_ LongAccelerationOffset_BSM : 119|8@0+ (0.02,-2.56) [-2.56|2.52] "m/s^2"  CVADAS,EVCU2,BSM2,CVPAM
 SG_ LatAccelerationOffset_BSM : 127|8@0+ (0.02,-2.56) [-2.56|2.52] "m/s^2"  CVADAS,EVCU2,BSM2,CVPAM
 SG_ YawRateOffset_BSM : 111|8@0+ (0.08,-10.24) [-6.96|6.96] "°/s"  EVCU2,BSM2
 SG_ LwsAngleOffset_BSM : 81|10@0+ (0.1,-51.1) [-51.1|51.1] "°"  ADCAM,MPAD,BSM2,CADM

BO_ 513 BRAKE_FD_1: 32 BSM
 SG_ VehicleStandStillSts : 111|2@0+ (1,0) [0|2] "-"  CVADAS,ADCAM,MPAD,BSM2,CVPAM,CADM,EPS
 SG_ GrMin_Rq_BSM : 139|4@0+ (1,0) [0|15] "-"  Vector__XXX
 SG_ GrMax_Rq_BSM : 123|4@0+ (1,0) [0|15] "-"  ADCAM,EVCU2,CADM
 SG_ ExternalBrkRequestsDisabled : 109|2@0+ (1,0) [0|2] "-"  CVADAS,ADCAM,MPAD,EVCU2,CVPAM,CADM
 SG_ BrkTrq_Driver : 150|15@0+ (3,0) [0|98301] "Nm"  CVADAS,ADCAM,MPAD,EVCU2,BSM2,CVPAM,CADM
 SG_ BrkTrq : 94|15@0+ (3,0) [0|98301] "Nm"  CVADAS,ADCAM,MPAD,EVCU2,CVPAM,CADM
 SG_ Brk_Thermdl : 151|1@0+ (1,0) [0|1] "-"  ADCAM,MPAD,EVCU2,CADM
 SG_ SelSpdLmp : 59|2@0+ (1,0) [0|0] "-"  Vector__XXX
 SG_ SelectSpdSts : 165|2@0+ (1,0) [0|2] "-"  Vector__XXX
 SG_ REF_VEH_SPEED : 57|10@0+ (0.5,0) [0|511] "kph"  CVADAS,EVCU2,CVPAM
 SG_ MessageCounter_BRAKE1 : 179|4@0+ (1,0) [0|15] "-"  CVADAS,ADCAM,MPAD,EVCU2,BSM2,CVPAM,CADM
 SG_ CRC_BRAKE1 : 191|8@0+ (1,0) [0|255] "-"  CVADAS,ADCAM,MPAD,EVCU2,BSM2,CVPAM,CADM
 SG_ Brk_Jrk_Resp : 60|1@0+ (1,0) [0|1] "-"  ADCAM,MPAD,CADM,ORC
 SG_ EngSpdIntervReq : 95|1@0+ (1,0) [0|1] "-"  Vector__XXX
 SG_ EngSpdInterv : 163|16@0+ (1,0) [0|65535] "rpm"  Vector__XXX
 SG_ RRCC_Cancel_Req_201 : 23|2@0+ (1,0) [0|2] "-"  ADCAM,MPAD,CADM
 SG_ ACCFSafe_201 : 7|8@0+ (1,0) [0|255] "-"  ADCAM,MPAD,EVCU2,BSM2,CADM
 SG_ DASEngReqPos_201 : 61|1@0+ (1,0) [0|1] "-"  ADCAM,MPAD,EVCU2,CADM

BO_ 255 PT_TORQUE_FD_1: 48 EVCU2
 SG_ SumTorqueStatic : 98|11@0+ (1,-500) [-500|1546] "Nm"  Vector__XXX
 SG_ SumTorqueSel_D_TTC : 82|11@0+ (1,-500) [-500|1546] "Nm"  Vector__XXX
 SG_ SumTorqueMin : 66|11@0+ (1,-500) [-500|1546] "Nm"  Vector__XXX
 SG_ SumTorqueMax : 50|11@0+ (1,-500) [-500|1546] "Nm"  Vector__XXX
 SG_ SumTorqueExp : 34|11@0+ (1,-500) [-500|1546] "Nm"  Vector__XXX
 SG_ SumTorque_DrvReqMod : 20|13@0+ (0.25,-500) [-500|1547.5] "Nm"  Vector__XXX
 SG_ MessageCounter_PT_TORQUE_FD_1 : 307|4@0+ (1,0) [0|15] "-"  CVADAS,ADCAM,MPAD,CADM,BSM,EPS
 SG_ CRC_PT_TORQUE_FD_1 : 319|8@0+ (1,0) [0|255] "-"  CVADAS,ADCAM,MPAD,CADM,BSM,EPS
 SG_ SSC_TrqEnblRq_Allowed : 22|1@0+ (1,0) [0|1] "-"  Vector__XXX
 SG_ PPPA_TrqEnblRq_Allowed : 21|1@0+ (1,0) [0|1] "-"  CVADAS,CVPAM,BSM
 SG_ ESC_TrqEnblRq_Allowed : 38|1@0+ (1,0) [0|1] "-"  Vector__XXX
 SG_ Accel_Pedal_Override : 37|1@0+ (1,0) [0|1] "-"  CVADAS,ADCAM,MPAD,CVPAM,CADM,BSM
 SG_ ACC_NCC_TrqEnblRq_Allowed : 23|1@0+ (1,0) [0|1] "-"  ADCAM,MPAD,CADM
 SG_ Total_AxleTorque_Static : 151|16@0+ (2,-65534) [-65534|65536] "Nm"  ADCAM,MPAD,CADM
 SG_ RRCC_TrqEnblRq_Allowed : 39|1@0+ (1,0) [0|1] "-"  ADCAM,CADM
 SG_ Rear_AxleTorque_Static : 183|16@0+ (2,-65534) [-65534|65536] "Nm"  MPAD
 SG_ Front_AxleTorque_Static : 167|16@0+ (2,-65534) [-65534|65536] "Nm"  MPAD,EPS

BO_ 1036 ENGINE_FD_3: 32 ECM
 SG_ MessageCounter_ENGINE3 : 179|4@0+ (1,0) [0|15] "-"  CADM,BSM
 SG_ CRC_ENGINE3 : 191|8@0+ (1,0) [0|255] "-"  CADM,BSM

BO_ 950 CVPAM_FD_Info: 32 CVADAS
 SG_ ParkingManeuverActive : 66|3@0+ (1,0) [0|6] "-"  BSM
 SG_ MessageCounter_CVPAM_FD_Info : 179|4@0+ (1,0) [0|15] "-"  BSM
 SG_ CRC_CVPAM_FD_Info : 191|8@0+ (1,0) [0|255] "-"  BSM

BO_ 275 CVPAM_FD_Control: 32 CVADAS
 SG_ RR_PAM_Brk_RqSts : 150|1@0+ (1,0) [0|1] "-"  BSM
 SG_ MessageCounter_CVPAM_FD_Control : 179|4@0+ (1,0) [0|15] "-"  BSM,EPS
 SG_ CRC_CVPAM_FD_Control : 191|8@0+ (1,0) [0|255] "-"  BSM,EPS
 SG_ RR_PAM_Dist : 161|10@0+ (1,0) [0|1022] "cm"  BSM
 SG_ SPM_Lat_Ctrl_RequestSts : 148|2@0+ (1,0) [0|2] "-"  BSM,ORC,EPS
 SG_ ManoeuvrePhase : 149|1@0+ (1,0) [0|1] "-"  EPS
 SG_ PPPA_TargetDistance : 129|10@0+ (1,0) [0|1022] "cm"  BSM
 SG_ PPPA_StandstillRqst : 180|1@0+ (1,0) [0|1] "-"  BSM
 SG_ PPPA_MaxSpeed : 127|8@0+ (0.0625,0) [0|15.875] "kph"  BSM
 SG_ PPPA_JerkDecelMin : 61|6@0+ (0.05,0) [0|3.15] "m/s3"  BSM
 SG_ PPPA_JerkDecelMax : 69|6@0+ (0.05,0) [0|3.15] "m/s3"  BSM
 SG_ PPPA_JerkAccelMin : 77|6@0+ (0.05,0) [0|3.15] "m/s3"  BSM
 SG_ PPPA_JerkAccelMax : 85|6@0+ (0.05,0) [0|3.15] "m/s3"  BSM
 SG_ PPPA_Interface_BSM : 182|2@0+ (1,0) [0|2] "-"  BSM
 SG_ PPPA_DecelMin : 92|5@0+ (0.1,0) [0|3.1] "m/s2"  BSM
 SG_ PPPA_DecelMax : 100|5@0+ (0.1,0) [0|3.1] "m/s2"  BSM
 SG_ PPPA_AccelMin : 108|5@0+ (0.1,0) [0|3.1] "m/s2"  BSM
 SG_ PPPA_AccelMax : 116|5@0+ (0.1,0) [0|3.1] "m/s2"  BSM
 SG_ ParkingGearShiftReq : 164|3@0+ (1,0) [0|6] "-"  BSM
 SG_ TorqueOverlaySteeringReq_SPM : 146|11@0+ (0.0078125,-8) [-8|7.9921875] "Nm"  ORC,EPS

BO_TX_BU_ 255 : EVCU2,ECM;
BO_TX_BU_ 950 : CVADAS,CVPAM;
BO_TX_BU_ 275 : CVADAS,CVPAM;

CM_ "Project_WS26_ProjectStandard_FD-CAN14 [CS00155_FD]";
CM_ SG_ 264 LwsAngle "This signal indicates the steering angle value, counterclockwise positive.";
CM_ SG_ 264 LwsSpeed "This signal indicates the steering speed value, counterclockwise positive.";
CM_ SG_ 274 YawRate "This signal indicates the Yaw Rate Value";
CM_ SG_ 274 LongAcceleration "This signal indicates the Longitudinal Acceleration Value";
CM_ SG_ 274 LatAcceleration "This signal indicates the Lateral Acceleration Value";
CM_ SG_ 1954 ORCIdentification "ORC identification number.";
CM_ SG_ 611 SBR1RowDriverSeatSts "First row driver seatbelt switch status";
CM_ SG_ 1626 IMPACTConfirm "This signal is used to confirm that a crash happened";
CM_ SG_ 1626 IMPACTCommand "This signal is used to indicate that a crash happened";
CM_ SG_ 1155 TSCActive "This signal is set to \"active\" when Trailer Sway Control functionality is acting";
CM_ SG_ 1155 RollsModeAct "This signal indicates when the brake system module is in the Rolls Test mode.";
CM_ SG_ 1155 FunctionIntervention "This signal indicates the BSM is actively controlling the vehicle through either engine torque management or brake pressure modulation.";
CM_ SG_ 1155 FunctionFailSts "This signal indicates the health status of the traction control system. [0]: Fail_Not_Present, [1]: Fail_Present";
CM_ SG_ 1155 Function2Sts "Indicates the partial off status of the ESC/TCS system. [0]: Not_Active - Indicates that the ESC/TCS system is enabled, [1]: Active - Indicates that the ESC/TCS engine management is disabled";
CM_ SG_ 1155 ESCFailSts "0";
CM_ SG_ 1155 ERMActive "This signal is set to \"active\" when Electronic Roll Mitigation functionality is acting.";
CM_ SG_ 1155 EBDFailSts "0";
CM_ SG_ 1155 CMMIntervention "0";
CM_ SG_ 1155 BSMSysSts "This signal is used by BSM to indicate its mode";
CM_ SG_ 1155 ACCEngaged "ACC is engaged";
CM_ SG_ 1155 ABSFailSts "0";
CM_ SG_ 609 TravelDistance "This signal indicates the travel distance value.";
CM_ SG_ 609 MSRActive "0";
CM_ SG_ 609 EPBSts "0";
CM_ SG_ 609 ASRActive "This signal is set to Active when the intervention by ASR is Active";
CM_ SG_ 259 RHR_WheelSensorFailSts "This signal indicates the fail status of RHR sensor";
CM_ SG_ 259 RHR_Spin "This signal indicates the right hand rear wheel status";
CM_ SG_ 259 RHR_FastPulseCounter "This signal is the right rear wheel pulse counter.";
CM_ SG_ 259 RHF_WheelSensorFailSts "This signal indicates the fail status of RHF sensor";
CM_ SG_ 259 RHF_FastPulseCounter "This signal is the right front wheel pulse counter.";
CM_ SG_ 259 LHR_WheelSensorFailSts "This signal indicates the fail status of LHR sensor";
CM_ SG_ 259 LHR_Spin "This signal indicates the left hand rear wheel status";
CM_ SG_ 259 LHR_FastPulseCounter "This signal is the left rear wheel pulse counter.";
CM_ SG_ 259 LHF_WheelSensorFailSts "This signal indicates the fail status of LHF sensor";
CM_ SG_ 259 LHF_FastPulseCounter "This signal is the left front wheel pulse counter.";
CM_ SG_ 513 VehicleStandStillSts "This signal indicates if the car is in stand still condition";
CM_ SG_ 513 GrMin_Rq_BSM "Requested gear, lower limit";
CM_ SG_ 513 GrMax_Rq_BSM "Requested gear, upper limit";
CM_ SG_ 513 ExternalBrkRequestsDisabled "0";
CM_ SG_ 513 BrkTrq_Driver "0";
CM_ SG_ 513 BrkTrq "0";
CM_ SG_ 513 Brk_Thermdl "This signal indicate when the estimated brake temperature is over a predefined threshold.";
CM_ SG_ 255 SumTorqueStatic "Static sum torque (effective sum torque)";
CM_ SG_ 255 SumTorqueSel_D_TTC "Corrected (substitute) driver torque demand";
CM_ SG_ 255 SumTorqueMin "Minimum sum torque";
CM_ SG_ 255 SumTorqueMax "Maximum sum torque";
CM_ SG_ 255 SumTorqueExp "Expected sum torque based on target transmission input speed";
CM_ SG_ 255 SumTorque_DrvReqMod "Driver requested sum torque modified";
CM_ SG_ 274 YawRateFailSts "This signal indicates the Status of Yaw Rate Signal";
CM_ SG_ 274 MessageCounter_ORC3 "This signal is a counter used for safety checks strategies. This counter is incremented of 1 (one) unit at each frame transmission.";
CM_ SG_ 274 LongAccelerationFailSts "This signal indicates the status of Longitudinal acceleration signal";
CM_ SG_ 274 LatAccelerationFailSts "This signal indicates the status of Lateral Acceleration Signal";
CM_ SG_ 274 CRC_ORC3 "CRC according to SAE J1850 standard at each frame transmission.";
CM_ SG_ 611 MessageCounter_ORC1 "This signal is a counter used for safety checks strategies. This counter is incremented of 1 (one) unit at each frame transmission.";
CM_ SG_ 611 CRC_ORC1 "CRC according to SAE J1850 standard at each frame transmission.";
CM_ SG_ 1626 IMPACTThreshold "Upon a crash, the ORC Calibration Threshold was either \"Met\" or \"Not_Met\".";
CM_ SG_ 264 MessageCounter_EPS1 "This signal is a counter used for safety checks strategies. This counter is incremented of 1 (one) unit at each frame transmission.";
CM_ SG_ 264 CRC_EPS1 "CRC according to SAE J1850 standard at each frame transmission.";
CM_ SG_ 518 RPMOverRev_W "-";
CM_ SG_ 518 PdlPosActual "Actual pedal position.";
CM_ SG_ 518 MessageCounter_ENGINE5 "This signal is a counter used for safety checks strategies. This counter is incremented of 1 (one) unit at each frame transmission.";
CM_ SG_ 518 CRC_ENGINE5 "CRC according to SAE J1850 standard at each frame transmission.";
CM_ SG_ 1036 MessageCounter_ENGINE3 "This signal is a counter used for safety checks strategies. This counter is incremented of 1 (one) unit at each frame transmission.";
CM_ SG_ 1036 CRC_ENGINE3 "CRC according to SAE J1850 standard at each frame transmission.";
CM_ SG_ 1054 ThermalManagementActive_W "-";
CM_ SG_ 1054 MessageCounter_ENGINE1 "This signal is a counter used for safety checks strategies. This counter is incremented of 1 (one) unit at each frame transmission.";
CM_ SG_ 1054 CRC_ENGINE1 "CRC according to SAE J1850 standard at each frame transmission.";
CM_ SG_ 275 RR_PAM_Brk_RqSts "PAM rear brake request";
CM_ SG_ 275 MessageCounter_CVPAM_FD_Control "This signal is a counter used for safety checks strategies. This counter is incremented of 1 (one) unit at each frame transmission.";
CM_ SG_ 275 CRC_CVPAM_FD_Control "CRC according to SAE J1850 standard at each frame transmission.";
CM_ SG_ 514 PAM_Brk_Rq_RspSts "PAM Brake Request Response Status made by the BSM for Park Assist with Stop.";
CM_ SG_ 514 MessageCounter_BRAKE7 "This signal is a counter used for safety checks strategies. This counter is incremented of 1 (one) unit at each frame transmission.";
CM_ SG_ 514 CRC_BRAKE7 "CRC according to SAE J1850 standard at each frame transmission.";
CM_ SG_ 514 BrkPdl_Stat "Brake pedal state";
CM_ SG_ 514 BrkPdl_Flt "Brake Pedal Fault is active, 1=Faulted";
CM_ SG_ 514 BrakePdlPosn "Brake pedal travel sensor 0-100% (0 = upstop)";
CM_ SG_ 1155 MessageCounter_BRAKE5 "This signal is a counter used for safety checks strategies. This counter is incremented of 1 (one) unit at each frame transmission.";
CM_ SG_ 1155 CRC_BRAKE5 "CRC according to SAE J1850 standard at each frame transmission.";
CM_ SG_ 609 MessageCounter_BRAKE4 "This signal is a counter used for safety checks strategies. This counter is incremented of 1 (one) unit at each frame transmission.";
CM_ SG_ 609 CRC_BRAKE4 "CRC according to SAE J1850 standard at each frame transmission.";
CM_ SG_ 259 RHRWheelSpeed "This is the value of the right rear wheel speed";
CM_ SG_ 259 RHFWheelSpeed "This is the value of the right front wheel speed";
CM_ SG_ 259 RHF_Spin "This signal indicates the right hand front wheel status";
CM_ SG_ 259 MessageCounter_BRAKE3 "This signal is a counter used for safety checks strategies. This counter is incremented of 1 (one) unit at each frame transmission.";
CM_ SG_ 259 LHRWheelSpeed "This is the value of the left rear wheel speed";
CM_ SG_ 259 LHFWheelSpeed "This is the value of the left front wheel speed";
CM_ SG_ 259 LHF_Spin "This signal indicates the left hand front wheel status";
CM_ SG_ 259 CRC__BRAKE3 "CRC according to SAE J1850 standard at each frame transmission.";
CM_ SG_ 513 SelSpdLmp "Select speed lamp status";
CM_ SG_ 513 SelectSpdSts "0";
CM_ SG_ 513 REF_VEH_SPEED "0";
CM_ SG_ 513 MessageCounter_BRAKE1 "This signal is a counter used for safety checks strategies. This counter is incremented of 1 (one) unit at each frame transmission.";
CM_ SG_ 513 CRC_BRAKE1 "CRC according to SAE J1850 standard at each frame transmission.";
CM_ SG_ 1954 MessageCounter_ORC2 "This signal is a counter used for safety checks strategies. This counter is incremented of 1 (one) unit at each frame transmission.";
CM_ SG_ 1954 CRC_ORC2 "CRC according to SAE J1850 standard at each frame transmission.";
CM_ SG_ 1626 MessageCounter_IMPACTINFO "This signal is a counter used for safety checks strategies. This counter is incremented of 1 (one) unit at each frame transmission.";
CM_ SG_ 1626 CRC_IMPACTINFO "CRC according to SAE J1850 standard at each frame transmission.";
CM_ SG_ 264 LwsCalibration "This signal indicates if the sensor has been calibrated and therefore the steering angle value is exported over Can.";
CM_ SG_ 264 LwsAngleType "This signal indicates whether the angle sensor is absolute (all the possible turns/degrees) or not absolute (relative, torque only, etc.).";
CM_ SG_ 264 EngineFanRequestActivation "This signal is used to activate the cooling fun by the electric power steering.";
CM_ SG_ 264 ElectricSteeringFailSts "It indicates if system EPS has an internal fault.";
CM_ SG_ 1448 MessageCounter_ENGINE7 "This signal is a counter used for safety checks strategies. This counter is incremented of 1 (one) unit at each frame transmission.";
CM_ SG_ 1448 CRC_ENGINE7 "CRC according to SAE J1850 standard at each frame transmission.";
CM_ SG_ 275 RR_PAM_Dist "Rear Distance to Nearest Obstacle";
CM_ SG_ 274 InternalError "This signal indicates if an internal error has been processed";
CM_ SG_ 1626 IMPACTFailSts "This signal is used to inform that an internal fault is present in the ORC";
CM_ SG_ 1626 IMPACT_M "EARS Passenger/Right Side Event";
CM_ SG_ 1626 IMPACT_K "EARS Driver/Left Side Event";
CM_ SG_ 1626 IMPACT_I "EARS RolloverEvent";
CM_ SG_ 1626 IMPACT_F "EARS Lower Severity Front Event";
CM_ SG_ 1626 IMPACT_C "EARS Higher Severity Front Event";
CM_ SG_ 1626 IMPACT_B "EARS Rear Event";
CM_ SG_ 264 EPS_Curr "Electric power steering current";
CM_ SG_ 275 SPM_Lat_Ctrl_RequestSts "SPM Lat Ctrl Request Sts";
CM_ SG_ 275 ManoeuvrePhase "It indicates the vehicle movement estimated by SPM during semiautomatic parking manoeuvre.";
CM_ SG_ 513 Brk_Jrk_Resp "0";
CM_ SG_ 255 MessageCounter_PT_TORQUE_FD_1 "This signal is a counter used for safety checks strategies. This counter is incremented of 1 (one) unit at each frame transmission.";
CM_ SG_ 255 CRC_PT_TORQUE_FD_1 "CRC according to SAE J1850 standard at each frame transmission.";
CM_ SG_ 1056 EPS_Warn_Disp_Rq "Electric Power Steering Warning Display Request";
CM_ SG_ 514 BSM_OpStat "Capability of the primary brake control module to provide deceleration and/or stability control";
CM_ SG_ 514 Brake_OpStat_Prim "Capability of the Braking system to perform deceleration and/or stability control as reported by primary actuator";
CM_ SG_ 950 ParkingManeuverActive "Parking information active";
CM_ SG_ 950 MessageCounter_CVPAM_FD_Info "This signal is a counter used for safety checks strategies. This counter is incremented of 1 (one) unit at each frame transmission.";
CM_ SG_ 950 CRC_CVPAM_FD_Info "CRC according to SAE J1850 standard at each frame transmission.";
CM_ SG_ 1155 FunctionSts "Indicates the full off status of the ESC/TCS system. [0]: Not_Active - Indicates that the ESC/TCS system is enabled, [1]: Active - Indicates that the ESC/TCS system is completely disabled";
CM_ SG_ 274 YawRate_HR_Sign "Sign of High resolution Yaw Rate signal. 0 = Negative [-]. 1 = Positive [+].";
CM_ SG_ 274 YawRate_HR "Yaw Rate Additional signal for high resolution.";
CM_ SG_ 1056 EPS_MODE_STAT "EPS mode personalization status";
CM_ SG_ 264 SteeringVibration_Status "EPS Steering Wheel vibration status";
CM_ SG_ 264 SteeringVibration_Fault "EPS Steering Wheel vibration fault status";
CM_ SG_ 264 Steering_OpStat_Prim "Capability of the Steering system to steer the vehicle as reported by primary actuator";
CM_ SG_ 264 Steering_Column_Torque "Steering Column Torque";
CM_ SG_ 264 SPM_Lat_Ctrl_ResponseSts "SPM Lat Ctrl Response Sts";
CM_ SG_ 264 EPS_HandsOnRecognition "EPS Hands On Recognition";
CM_ SG_ 264 EPS_Hands_On_Sts "EPS Hands on steering wheel status; Hands on steering wheel detected = [1]";
CM_ SG_ 264 EPS_AsstStat "Electric Power Steering Assistance Status";
CM_ SG_ 264 EPS_ADAS_IMC_Fault "Status of the EPS Intra-Module Communciation channel as reported by the primary EPS unit";
CM_ SG_ 275 PPPA_StandstillRqst "Request for vehicle standstill";
CM_ SG_ 275 PPPA_JerkDecelMin "Minimum decelerating jerk rate (absolute value) during a fully autonomous parking maneuver";
CM_ SG_ 275 PPPA_JerkDecelMax "Maximum decelerating jerk rate (absolute value) during a fully autonomous parking maneuver";
CM_ SG_ 275 PPPA_JerkAccelMin "Minimum accelerating jerk rate during a fully autonomous parking maneuver";
CM_ SG_ 275 PPPA_JerkAccelMax "Maximum accelerating jerk rate during a fully autonomous parking maneuver";
CM_ SG_ 275 PPPA_Interface_BSM "Fully Autonomous Parking Interface status with CVPAM and BSM";
CM_ SG_ 275 PPPA_DecelMin "Minimum deceleration (absolute value) during a fully autonomous parking maneuver";
CM_ SG_ 275 PPPA_DecelMax "Maximum deceleration (absolute value) during a fully autonomous parking maneuver";
CM_ SG_ 275 PPPA_AccelMin "Minimum acceleration during a fully autonomous parking maneuver";
CM_ SG_ 275 PPPA_AccelMax "Maximum acceleration during a fully autonomous parking maneuver";
CM_ SG_ 275 ParkingGearShiftReq "CVPAM Request to autonomously shift gears";
CM_ SG_ 264 HAS_LAT_CTRL_ResponseSts "HAS LAT CTRL Response Sts";
CM_ SG_ 514 BSM_HEALTH_CHECK "BSM_HEALTH_CHECK";
CM_ SG_ 275 TorqueOverlaySteeringReq_SPM "This signal indicates the value of the torque requested by the SPM torque overlay.";
CM_ SG_ 259 LongAccelerationOffset_BSM "LongAccelerationOffset_BSM";
CM_ SG_ 259 LatAccelerationOffset_BSM "LatAccelerationOffset_BSM";
CM_ SG_ 259 YawRateOffset_BSM "YawRateOffset_BSM";
CM_ SG_ 264 EPSMotorTorque "It represents the torque on the EPS motor output shaft at all times";
CM_ SG_ 259 LwsAngleOffset_BSM "LwsAngleOffset_BSM";
CM_ SG_ 609 ESC_OFF_Hrd_Sft_Button_sts "ESC hard button status";
CM_ SG_ 1056 MessageCounter_EPS2 "This signal is a counter used for safety checks strategies. This counter is incremented of 1 (one) unit at each frame transmission.";
CM_ SG_ 1056 CRC_EPS2 "CRC according to SAE J1850 standard at each frame transmission.";
CM_ SG_ 1448 ECM_TRSC_Resp "Engine break activation response";
CM_ SG_ 1448 ECM_THA_Resp "ECM speed limiting availability response for trailer hitch assist";
CM_ SG_ 1155 ESC_TRSC_Brk_Resp "ESC break activation response";
CM_ SG_ 1155 BSM_THA_Brk_Resp "BSM braking status for trailer hitch assist";
CM_ SG_ 609 BSM_LnchMode "Launch Control Status";
CM_ SG_ 609 BSM_LnchCtrl_SftBtn_SelectSts "Soft button launch selected; Launch selected = [1]";
CM_ SG_ 609 BSM_LnchAbrtSts "Launch Control Abort Status";
CM_ SG_ 513 EngSpdIntervReq "Engine speed intervention request (1=active)";
CM_ SG_ 513 EngSpdInterv "Engine speed intervention value";
CM_ SG_ 255 SSC_TrqEnblRq_Allowed "SCC Torque request allowed. True =[1]";
CM_ SG_ 255 PPPA_TrqEnblRq_Allowed "PPPA Torque request allowed. True =[1]";
CM_ SG_ 255 ESC_TrqEnblRq_Allowed "ESC Torque request allowed. True =[1]";
CM_ SG_ 255 Accel_Pedal_Override "Driver Accelerator Pedal Override. True =[1]";
CM_ SG_ 255 ACC_NCC_TrqEnblRq_Allowed "ACC/NCC Torque request allowed. True =[1]";
CM_ SG_ 255 Total_AxleTorque_Static "Static Axle Torque (effective total Axle torque)";
CM_ SG_ 609 LaunchRPMsetting_BSM "BSM  Launch RPM setting";
CM_ SG_ 255 RRCC_TrqEnblRq_Allowed "RRCC Torque request allowed. True =[1]";
CM_ SG_ 255 Rear_AxleTorque_Static "Static Rear Axle Torque";
CM_ SG_ 255 Front_AxleTorque_Static "Static Front Axle Torqu";
CM_ SG_ 1056 EPS_SteeringTouq_Resp "EPS steering torque overlay activation response";
CM_ SG_ 1056 EPS_SteeringTouchStat "EPS Driver interference during the TRSC event; True = [1] , False= [0]";
CM_ SG_ 264 ESA_LAT_CTRL_ResponseSts "ESA Lateral Response Status";
CM_ SG_ 274 StbmTimestampSec_ORC "Timestamp in nanoseconds from the ORC Stbm,  [0 - 4294967294].";
CM_ SG_ 274 StbmTimestampNSec_ORC "Timestamp in nanoseconds from the ORC Stbm, [0 - 999999999].";
CM_ SG_ 274 StbmSyncState_ORC "Sync status of the ORC Stbm";
CM_ SG_ 274 IMUTemperature "Temperature of Yaw Rate IMU sensor";
CM_ SG_ 1626 Non_deployment "This signal is used to confirm that non-deployment event happened";
CM_ SG_ 1056 THA_SteeringTouchStat "EPS hands on status for trailer hitch assist";
CM_ SG_ 1056 EPS_THA_SteeringTorqueResp "EPS steering torque overlay availability response for trailer hitch assist";
CM_ SG_ 1056 EPS_THA_DriverTorqueOverride "Determines if EPS driver torque on hand wheel is large enough to  override THA";
CM_ SG_ 264 LKA_LAT_CTRL_ResponseSts_108 "LKA LAT CTRL Response Sts";
CM_ SG_ 514 AEB_Type_Brk_202 "AEB type brake signal";
CM_ SG_ 513 ACCFSafe_201 "0";
CM_ SG_ 513 DASEngReqPos_201 "0";
BA_DEF_ SG_ "GenSigTimeoutTime_MPAD" INT 0 65535;
BA_DEF_ SG_ "GenSigTimeoutTime_ADCAM" INT 0 65535;
BA_DEF_ SG_ "GenSigTimeoutTime_CVADAS" INT 0 65535;
BA_DEF_ SG_ "GenSigTimeoutTime_VDCM" INT 0 65535;
BA_DEF_ SG_ "GenSigStartValue" INT 0 2147483647;
BA_DEF_ SG_ "GenSigInactiveValue" INT 0 2147483647;
BA_DEF_ SG_ "GenSigSendType" ENUM "NotUsed","OnWrite","OnWriteWithRepetition","OnChange","OnChangeWithRepetition","IfActive","IfActiveWithRepetition","NoSigSendType";
BA_DEF_ SG_ "SystemSignalLongSymbol" STRING ;
BA_DEF_ SG_ "GenSigTimeoutTime_BSM" INT 0 65535;
BA_DEF_ SG_ "GenSigTimeoutTime_BSM2" INT 0 65535;
BA_DEF_ SG_ "GenSigTimeoutTime_CADM" INT 0 65535;
BA_DEF_ SG_ "GenSigTimeoutTime_CVPAM" INT 0 65535;
BA_DEF_ SG_ "GenSigTimeoutTime_ECM" INT 0 65535;
BA_DEF_ SG_ "GenSigTimeoutTime_EPS" INT 0 65535;
BA_DEF_ SG_ "GenSigTimeoutTime_EVCU2" INT 0 65535;
BA_DEF_ SG_ "GenSigTimeoutTime_ORC" INT 0 65535;
BA_DEF_ BO_ "DiagRequest" ENUM "No","Yes";
BA_DEF_ BO_ "Type" ENUM "P","C","PE","COC","PE_Cntrl","E","E_Cntrl","OC","S","BAF","DC","EM","MM","ISO-TP","-";
BA_DEF_ BO_ "DiagResponse" ENUM "No","Yes";
BA_DEF_ BO_ "NmMessage" ENUM "No","Yes";
BA_DEF_ BO_ "GenMsgSendType" ENUM "Cyclic","NotUsed","NotUsed","NotUsed","NotUsed","NotUsed","NotUsed","NotUsed","NoMsgSendType";
BA_DEF_ BO_ "GenMsgNrOfRepetition" INT 0 255;
BA_DEF_ BO_ "GenMsgILSupport" ENUM "No","Yes";
BA_DEF_ BO_ "GenMsgStartDelayTime" INT 0 65535;
BA_DEF_ BO_ "GenMsgCycleTimeFast" INT 0 65535;
BA_DEF_ BO_ "GenMsgCycleTime" INT 0 65535;
BA_DEF_ BO_ "GenMsgDelayTime" INT 0 65535;
BA_DEF_ BO_ "NmAsrMessage" ENUM "No","Yes";
BA_DEF_ BO_ "DiagState" ENUM "No","Yes";
BA_DEF_ BO_ "DiagConnection" HEX 0 65535;
BA_DEF_ BO_ "VFrameFormat" ENUM "StandardCAN","ExtendedCAN","reserved","reserved","reserved","reserved","reserved","reserved","reserved","reserved","reserved","reserved","reserved","reserved","StandardCAN_FD","ExtendedCAN_FD";
BA_DEF_ BO_ "CANFD_BRS" ENUM "0","1";
BA_DEF_ "Manufacturer" ENUM "DBAG","VAG","BWVAG","PAG","GM";
BA_DEF_ "NmType" STRING ;
BA_DEF_ "BusType" STRING ;
BA_DEF_ "Baudrate" INT 0 1000000;
BA_DEF_ "DBName" STRING ;
BA_DEF_ "NmAsrTimeoutTime" INT 1 65535;
BA_DEF_ "NmAsrWaitBusSleepTime" INT 1 65535;
BA_DEF_ "NmAsrRepeatMessageTime" INT 1 65535;
BA_DEF_ "NmAsrMessageCount" INT 1 256;
BA_DEF_ "NmAsrBaseAddress" HEX 235487232 2147483647;
BA_DEF_ "NmAsrCanMsgCycleTime" INT 1 65535;
BA_DEF_ "Version" HEX 0 255;
BA_DEF_ "VersionWeek" INT 0 53;
BA_DEF_ "VersionYear" INT 0 99;
BA_DEF_ BU_ "Description" STRING ;
BA_DEF_ BU_ "NmStationAddress" HEX 0 255;
BA_DEF_ BU_ "NmNode" ENUM "No","Yes";
BA_DEF_ BU_ "NmAsrNode" ENUM "No","Yes";
BA_DEF_ BU_ "NmAsrNodeIdentifier" HEX 0 255;
BA_DEF_ BU_ "NmAsrCanMsgReducedTime" INT 1 65535;
BA_DEF_ BU_ "NmNodeType" ENUM "+15_NotWakeable","+30_Wakeable","+30_NotWakeable","kMaster","kSlave15","kSlave30","none";
BA_DEF_ BU_ "NwmNodeType" ENUM "+15_NotWakeable","+30_Wakeable","+30_NotWakeable","kMaster","kSlave15","kSlave30","none";
BA_DEF_DEF_ "GenSigTimeoutTime_MPAD" 2500;
BA_DEF_DEF_ "GenSigTimeoutTime_ADCAM" 2500;
BA_DEF_DEF_ "GenSigTimeoutTime_CVADAS" 2500;
BA_DEF_DEF_ "GenSigTimeoutTime_VDCM" 2500;
BA_DEF_DEF_ "GenSigStartValue" 0;
BA_DEF_DEF_ "GenSigInactiveValue" 0;
BA_DEF_DEF_ "GenSigSendType" "NoSigSendType";
BA_DEF_DEF_ "SystemSignalLongSymbol" "";
BA_DEF_DEF_ "GenSigTimeoutTime_BSM" 2500;
BA_DEF_DEF_ "GenSigTimeoutTime_BSM2" 2500;
BA_DEF_DEF_ "GenSigTimeoutTime_CADM" 2500;
BA_DEF_DEF_ "GenSigTimeoutTime_CVPAM" 2500;
BA_DEF_DEF_ "GenSigTimeoutTime_ECM" 2500;
BA_DEF_DEF_ "GenSigTimeoutTime_EPS" 2500;
BA_DEF_DEF_ "GenSigTimeoutTime_EVCU2" 2500;
BA_DEF_DEF_ "GenSigTimeoutTime_ORC" 2500;
BA_DEF_DEF_ "DiagRequest" "No";
BA_DEF_DEF_ "Type" "-";
BA_DEF_DEF_ "DiagResponse" "No";
BA_DEF_DEF_ "NmMessage" "No";
BA_DEF_DEF_ "GenMsgSendType" "NoMsgSendType";
BA_DEF_DEF_ "GenMsgNrOfRepetition" 0;
BA_DEF_DEF_ "GenMsgILSupport" "No";
BA_DEF_DEF_ "GenMsgStartDelayTime" 0;
BA_DEF_DEF_ "GenMsgCycleTimeFast" 0;
BA_DEF_DEF_ "GenMsgCycleTime" 0;
BA_DEF_DEF_ "GenMsgDelayTime" 0;
BA_DEF_DEF_ "NmAsrMessage" "No";
BA_DEF_DEF_ "DiagState" "No";
BA_DEF_DEF_ "DiagConnection" 0;
BA_DEF_DEF_ "VFrameFormat" "StandardCAN_FD";
BA_DEF_DEF_ "CANFD_BRS" "0";
BA_DEF_DEF_ "Manufacturer" "DBAG";
BA_DEF_DEF_ "NmType" "";
BA_DEF_DEF_ "BusType" "CAN";
BA_DEF_DEF_ "Baudrate" 500000;
BA_DEF_DEF_ "DBName" "CAN";
BA_DEF_DEF_ "NmAsrTimeoutTime" 1000;
BA_DEF_DEF_ "NmAsrWaitBusSleepTime" 750;
BA_DEF_DEF_ "NmAsrRepeatMessageTime" 800;
BA_DEF_DEF_ "NmAsrMessageCount" 256;
BA_DEF_DEF_ "NmAsrBaseAddress" 506724352;
BA_DEF_DEF_ "NmAsrCanMsgCycleTime" 200;
BA_DEF_DEF_ "Version" 160;
BA_DEF_DEF_ "VersionWeek" 46;
BA_DEF_DEF_ "VersionYear" 23;
BA_DEF_DEF_ "Description" "";
BA_DEF_DEF_ "NmStationAddress" 0;
BA_DEF_DEF_ "NmNode" "Yes";
BA_DEF_DEF_ "NmAsrNode" "Yes";
BA_DEF_DEF_ "NmAsrNodeIdentifier" 0;
BA_DEF_DEF_ "NmAsrCanMsgReducedTime" 100;
BA_DEF_DEF_ "NmNodeType" "none";
BA_DEF_DEF_ "NwmNodeType" "none";
BA_ "NmType" "NmAsr";
BA_ "BusType" "CAN FD";
BA_ "DBName" "FDCAN14";
BA_ "NmAsrTimeoutTime" 8000;
BA_ "NmAsrWaitBusSleepTime" 1000;
BA_ "NmAsrRepeatMessageTime" 5000;
BA_ "NmAsrBaseAddress" 507002880;
BA_ "NmAsrCanMsgCycleTime" 1000;
BA_ "Description" BU_ MPAD "Mid Platform Automated Driving";
BA_ "NmStationAddress" BU_ MPAD 173;
BA_ "NmAsrNodeIdentifier" BU_ MPAD 173;
BA_ "NmAsrCanMsgReducedTime" BU_ MPAD 650;
BA_ "NmNodeType" BU_ MPAD 2;
BA_ "NwmNodeType" BU_ MPAD 2;
BA_ "Description" BU_ CVADAS "Central Vision ADAS";
BA_ "NmStationAddress" BU_ CVADAS 24;
BA_ "NmAsrNodeIdentifier" BU_ CVADAS 24;
BA_ "NmAsrCanMsgReducedTime" BU_ CVADAS 675;
BA_ "NmNodeType" BU_ CVADAS 2;
BA_ "NwmNodeType" BU_ CVADAS 2;
BA_ "Description" BU_ ADCAM "ADas CAmera Module";
BA_ "NmStationAddress" BU_ ADCAM 161;
BA_ "NmAsrNodeIdentifier" BU_ ADCAM 161;
BA_ "NmAsrCanMsgReducedTime" BU_ ADCAM 875;
BA_ "NmNodeType" BU_ ADCAM 2;
BA_ "NwmNodeType" BU_ ADCAM 2;
BA_ "Description" BU_ ORC "Occupant Restraint Control";
BA_ "NmStationAddress" BU_ ORC 26;
BA_ "NmAsrNodeIdentifier" BU_ ORC 26;
BA_ "NmAsrCanMsgReducedTime" BU_ ORC 925;
BA_ "NmNodeType" BU_ ORC 2;
BA_ "NwmNodeType" BU_ ORC 2;
BA_ "Description" BU_ EVCU2 "Electric Vehicle Control Unit 2";
BA_ "NmStationAddress" BU_ EVCU2 64;
BA_ "NmAsrNodeIdentifier" BU_ EVCU2 64;
BA_ "NmAsrCanMsgReducedTime" BU_ EVCU2 950;
BA_ "NmNodeType" BU_ EVCU2 2;
BA_ "NwmNodeType" BU_ EVCU2 2;
BA_ "Description" BU_ EPS "Electric Power Steering";
BA_ "NmStationAddress" BU_ EPS 2;
BA_ "NmAsrNodeIdentifier" BU_ EPS 2;
BA_ "NmAsrCanMsgReducedTime" BU_ EPS 600;
BA_ "NmNodeType" BU_ EPS 2;
BA_ "NwmNodeType" BU_ EPS 2;
BA_ "Description" BU_ ECM "Engine Control Module";
BA_ "NmStationAddress" BU_ ECM 1;
BA_ "NmAsrNodeIdentifier" BU_ ECM 1;
BA_ "NmAsrCanMsgReducedTime" BU_ ECM 575;
BA_ "NmNodeType" BU_ ECM 2;
BA_ "NwmNodeType" BU_ ECM 2;
BA_ "Description" BU_ CVPAM "Central Vision Park Assist Module";
BA_ "NmStationAddress" BU_ CVPAM 24;
BA_ "NmAsrNodeIdentifier" BU_ CVPAM 24;
BA_ "NmAsrCanMsgReducedTime" BU_ CVPAM 675;
BA_ "NmNodeType" BU_ CVPAM 2;
BA_ "NwmNodeType" BU_ CVPAM 2;
BA_ "Description" BU_ CADM "Central ADAS Decision Module";
BA_ "NmStationAddress" BU_ CADM 141;
BA_ "NmAsrNodeIdentifier" BU_ CADM 141;
BA_ "NmAsrCanMsgReducedTime" BU_ CADM 650;
BA_ "NmNodeType" BU_ CADM 2;
BA_ "NwmNodeType" BU_ CADM 2;
BA_ "Description" BU_ BSM2 "Brake System Module 2";
BA_ "NmStationAddress" BU_ BSM2 148;
BA_ "NmAsrNodeIdentifier" BU_ BSM2 148;
BA_ "NmAsrCanMsgReducedTime" BU_ BSM2 625;
BA_ "NmNodeType" BU_ BSM2 2;
BA_ "NwmNodeType" BU_ BSM2 2;
BA_ "Description" BU_ BSM "Braking System Module";
BA_ "NmStationAddress" BU_ BSM 6;
BA_ "NmAsrNodeIdentifier" BU_ BSM 6;
BA_ "NmAsrCanMsgReducedTime" BU_ BSM 525;
BA_ "NmNodeType" BU_ BSM 2;
BA_ "NwmNodeType" BU_ BSM 2;
BA_ "Type" BO_ 274 1;
BA_ "GenMsgSendType" BO_ 274 0;
BA_ "GenMsgILSupport" BO_ 274 1;
BA_ "GenMsgCycleTime" BO_ 274 10;
BA_ "CANFD_BRS" BO_ 274 1;
BA_ "Type" BO_ 1954 3;
BA_ "GenMsgSendType" BO_ 1954 0;
BA_ "GenMsgILSupport" BO_ 1954 1;
BA_ "GenMsgCycleTime" BO_ 1954 1000;
BA_ "CANFD_BRS" BO_ 1954 1;
BA_ "Type" BO_ 611 3;
BA_ "GenMsgSendType" BO_ 611 0;
BA_ "GenMsgILSupport" BO_ 611 1;
BA_ "GenMsgCycleTime" BO_ 611 100;
BA_ "GenMsgDelayTime" BO_ 611 20;
BA_ "CANFD_BRS" BO_ 611 1;
BA_ "Type" BO_ 1626 10;
BA_ "GenMsgSendType" BO_ 1626 0;
BA_ "GenMsgILSupport" BO_ 1626 1;
BA_ "GenMsgCycleTimeFast" BO_ 1626 10;
BA_ "GenMsgCycleTime" BO_ 1626 500;
BA_ "CANFD_BRS" BO_ 1626 1;
BA_ "Type" BO_ 1056 1;
BA_ "GenMsgSendType" BO_ 1056 0;
BA_ "GenMsgILSupport" BO_ 1056 1;
BA_ "GenMsgCycleTime" BO_ 1056 100;
BA_ "CANFD_BRS" BO_ 1056 1;
BA_ "Type" BO_ 264 1;
BA_ "GenMsgSendType" BO_ 264 0;
BA_ "GenMsgILSupport" BO_ 264 1;
BA_ "GenMsgCycleTime" BO_ 264 10;
BA_ "CANFD_BRS" BO_ 264 1;
BA_ "Type" BO_ 1448 3;
BA_ "GenMsgSendType" BO_ 1448 0;
BA_ "GenMsgNrOfRepetition" BO_ 1448 2;
BA_ "GenMsgILSupport" BO_ 1448 1;
BA_ "GenMsgCycleTimeFast" BO_ 1448 20;
BA_ "GenMsgCycleTime" BO_ 1448 1000;
BA_ "GenMsgDelayTime" BO_ 1448 20;
BA_ "CANFD_BRS" BO_ 1448 1;
BA_ "Type" BO_ 518 1;
BA_ "GenMsgSendType" BO_ 518 0;
BA_ "GenMsgILSupport" BO_ 518 1;
BA_ "GenMsgCycleTime" BO_ 518 20;
BA_ "CANFD_BRS" BO_ 518 1;
BA_ "Type" BO_ 1054 1;
BA_ "GenMsgSendType" BO_ 1054 0;
BA_ "GenMsgILSupport" BO_ 1054 1;
BA_ "GenMsgCycleTime" BO_ 1054 100;
BA_ "CANFD_BRS" BO_ 1054 1;
BA_ "Type" BO_ 514 1;
BA_ "GenMsgSendType" BO_ 514 0;
BA_ "GenMsgILSupport" BO_ 514 1;
BA_ "GenMsgCycleTime" BO_ 514 20;
BA_ "CANFD_BRS" BO_ 514 1;
BA_ "GenMsgDelayTime" BO_ 1155 20;
BA_ "CANFD_BRS" BO_ 1155 1;
BA_ "Type" BO_ 1155 3;
BA_ "GenMsgSendType" BO_ 1155 0;
BA_ "GenMsgNrOfRepetition" BO_ 1155 2;
BA_ "GenMsgILSupport" BO_ 1155 1;
BA_ "GenMsgCycleTimeFast" BO_ 1155 20;
BA_ "GenMsgCycleTime" BO_ 1155 500;
BA_ "Type" BO_ 609 3;
BA_ "GenMsgSendType" BO_ 609 0;
BA_ "GenMsgNrOfRepetition" BO_ 609 2;
BA_ "GenMsgILSupport" BO_ 609 1;
BA_ "GenMsgCycleTimeFast" BO_ 609 20;
BA_ "GenMsgCycleTime" BO_ 609 100;
BA_ "CANFD_BRS" BO_ 609 1;
BA_ "Type" BO_ 259 1;
BA_ "GenMsgSendType" BO_ 259 0;
BA_ "GenMsgILSupport" BO_ 259 1;
BA_ "GenMsgCycleTime" BO_ 259 10;
BA_ "CANFD_BRS" BO_ 259 1;
BA_ "Type" BO_ 513 1;
BA_ "GenMsgSendType" BO_ 513 0;
BA_ "GenMsgILSupport" BO_ 513 1;
BA_ "GenMsgCycleTime" BO_ 513 20;
BA_ "CANFD_BRS" BO_ 513 1;
BA_ "Type" BO_ 255 1;
BA_ "GenMsgSendType" BO_ 255 0;
BA_ "GenMsgILSupport" BO_ 255 1;
BA_ "GenMsgCycleTime" BO_ 255 10;
BA_ "CANFD_BRS" BO_ 255 1;
BA_ "Type" BO_ 1036 3;
BA_ "GenMsgSendType" BO_ 1036 0;
BA_ "GenMsgNrOfRepetition" BO_ 1036 2;
BA_ "GenMsgILSupport" BO_ 1036 1;
BA_ "GenMsgCycleTimeFast" BO_ 1036 20;
BA_ "GenMsgCycleTime" BO_ 1036 100;
BA_ "GenMsgDelayTime" BO_ 1036 20;
BA_ "CANFD_BRS" BO_ 1036 1;
BA_ "Type" BO_ 950 3;
BA_ "GenMsgSendType" BO_ 950 0;
BA_ "GenMsgILSupport" BO_ 950 1;
BA_ "GenMsgCycleTime" BO_ 950 250;
BA_ "CANFD_BRS" BO_ 950 1;
BA_ "Type" BO_ 275 1;
BA_ "GenMsgSendType" BO_ 275 0;
BA_ "GenMsgILSupport" BO_ 275 1;
BA_ "GenMsgCycleTime" BO_ 275 10;
BA_ "CANFD_BRS" BO_ 275 1;
BA_ "GenSigTimeoutTime_BSM2" SG_ 275 PPPA_MaxSpeed 0;
BA_ "GenSigTimeoutTime_CADM" SG_ 275 PPPA_MaxSpeed 0;
BA_ "GenSigTimeoutTime_CVPAM" SG_ 275 PPPA_MaxSpeed 0;
BA_ "GenSigTimeoutTime_ECM" SG_ 275 PPPA_MaxSpeed 0;
BA_ "GenSigTimeoutTime_EPS" SG_ 275 PPPA_MaxSpeed 0;
BA_ "GenSigTimeoutTime_EVCU2" SG_ 275 PPPA_MaxSpeed 0;
BA_ "GenSigTimeoutTime_ORC" SG_ 275 PPPA_MaxSpeed 0;
BA_ "GenSigTimeoutTime_MPAD" SG_ 275 PPPA_MaxSpeed 0;
BA_ "GenSigTimeoutTime_ADCAM" SG_ 275 PPPA_MaxSpeed 0;
BA_ "GenSigTimeoutTime_CVADAS" SG_ 275 PPPA_MaxSpeed 0;
BA_ "GenSigTimeoutTime_BSM2" SG_ 275 PPPA_StandstillRqst 0;
BA_ "GenSigTimeoutTime_CADM" SG_ 275 PPPA_StandstillRqst 0;
BA_ "GenSigTimeoutTime_CVPAM" SG_ 275 PPPA_StandstillRqst 0;
BA_ "GenSigTimeoutTime_ECM" SG_ 275 PPPA_StandstillRqst 0;
BA_ "GenSigTimeoutTime_EPS" SG_ 275 PPPA_StandstillRqst 0;
BA_ "GenSigTimeoutTime_EVCU2" SG_ 275 PPPA_StandstillRqst 0;
BA_ "GenSigTimeoutTime_ORC" SG_ 275 PPPA_StandstillRqst 0;
BA_ "GenSigTimeoutTime_BSM2" SG_ 275 PPPA_JerkAccelMin 0;
BA_ "GenSigTimeoutTime_CADM" SG_ 275 PPPA_JerkAccelMin 0;
BA_ "GenSigTimeoutTime_CVPAM" SG_ 275 PPPA_JerkAccelMin 0;
BA_ "GenSigTimeoutTime_ECM" SG_ 275 PPPA_JerkAccelMin 0;
BA_ "GenSigTimeoutTime_EPS" SG_ 275 PPPA_JerkAccelMin 0;
BA_ "GenSigTimeoutTime_EVCU2" SG_ 275 PPPA_JerkAccelMin 0;
BA_ "GenSigTimeoutTime_ORC" SG_ 275 PPPA_JerkAccelMin 0;
BA_ "GenSigTimeoutTime_BSM2" SG_ 275 PPPA_JerkDecelMax 0;
BA_ "GenSigTimeoutTime_CADM" SG_ 275 PPPA_JerkDecelMax 0;
BA_ "GenSigTimeoutTime_CVPAM" SG_ 275 PPPA_JerkDecelMax 0;
BA_ "GenSigTimeoutTime_ECM" SG_ 275 PPPA_JerkDecelMax 0;
BA_ "GenSigTimeoutTime_EPS" SG_ 275 PPPA_JerkDecelMax 0;
BA_ "GenSigTimeoutTime_EVCU2" SG_ 275 PPPA_JerkDecelMax 0;
BA_ "GenSigTimeoutTime_ORC" SG_ 275 PPPA_JerkDecelMax 0;
BA_ "GenSigTimeoutTime_ECM" SG_ 275 PPPA_JerkDecelMin 0;
BA_ "GenSigTimeoutTime_EPS" SG_ 275 PPPA_JerkDecelMin 0;
BA_ "GenSigTimeoutTime_EVCU2" SG_ 275 PPPA_JerkDecelMin 0;
BA_ "GenSigTimeoutTime_ORC" SG_ 275 PPPA_JerkDecelMin 0;
BA_ "GenSigTimeoutTime_BSM2" SG_ 275 PPPA_JerkDecelMin 0;
BA_ "GenSigTimeoutTime_CADM" SG_ 275 PPPA_JerkDecelMin 0;
BA_ "GenSigTimeoutTime_CVPAM" SG_ 275 PPPA_JerkDecelMin 0;
BA_ "GenSigTimeoutTime_MPAD" SG_ 275 TorqueOverlaySteeringReq_SPM 0;
BA_ "GenSigTimeoutTime_ADCAM" SG_ 275 TorqueOverlaySteeringReq_SPM 0;
BA_ "GenSigTimeoutTime_CVADAS" SG_ 275 TorqueOverlaySteeringReq_SPM 0;
BA_ "GenSigTimeoutTime_MPAD" SG_ 275 ParkingGearShiftReq 0;
BA_ "GenSigTimeoutTime_ADCAM" SG_ 275 ParkingGearShiftReq 0;
BA_ "GenSigTimeoutTime_CVADAS" SG_ 275 ParkingGearShiftReq 0;
BA_ "GenSigTimeoutTime_BSM2" SG_ 275 PPPA_AccelMax 0;
BA_ "GenSigTimeoutTime_CADM" SG_ 275 PPPA_AccelMax 0;
BA_ "GenSigTimeoutTime_CVPAM" SG_ 275 PPPA_AccelMax 0;
BA_ "GenSigTimeoutTime_MPAD" SG_ 275 PPPA_Interface_BSM 0;
BA_ "GenSigTimeoutTime_ADCAM" SG_ 275 PPPA_Interface_BSM 0;
BA_ "GenSigTimeoutTime_CVADAS" SG_ 275 PPPA_Interface_BSM 0;
BA_ "GenSigTimeoutTime_MPAD" SG_ 275 ManoeuvrePhase 0;
BA_ "GenSigTimeoutTime_ADCAM" SG_ 275 ManoeuvrePhase 0;
BA_ "GenSigTimeoutTime_CVADAS" SG_ 275 ManoeuvrePhase 0;
BA_ "GenSigTimeoutTime_MPAD" SG_ 275 SPM_Lat_Ctrl_RequestSts 0;
BA_ "GenSigTimeoutTime_ADCAM" SG_ 275 SPM_Lat_Ctrl_RequestSts 0;
BA_ "GenSigTimeoutTime_CVADAS" SG_ 275 SPM_Lat_Ctrl_RequestSts 0;
BA_ "GenSigTimeoutTime_BSM" SG_ 275 SPM_Lat_Ctrl_RequestSts 0;
BA_ "GenSigTimeoutTime_MPAD" SG_ 275 RR_PAM_Dist 0;
BA_ "GenSigTimeoutTime_ADCAM" SG_ 275 RR_PAM_Dist 0;
BA_ "GenSigTimeoutTime_CVADAS" SG_ 275 RR_PAM_Dist 0;
BA_ "GenSigTimeoutTime_VDCM" SG_ 275 RR_PAM_Dist 0;
BA_ "GenSigTimeoutTime_MPAD" SG_ 275 CRC_CVPAM_FD_Control 0;
BA_ "GenSigTimeoutTime_ADCAM" SG_ 275 CRC_CVPAM_FD_Control 0;
BA_ "GenSigTimeoutTime_CVADAS" SG_ 275 CRC_CVPAM_FD_Control 0;
BA_ "GenSigTimeoutTime_VDCM" SG_ 275 CRC_CVPAM_FD_Control 0;
BA_ "GenSigTimeoutTime_BSM" SG_ 275 CRC_CVPAM_FD_Control 0;
BA_ "GenSigTimeoutTime_EPS" SG_ 275 CRC_CVPAM_FD_Control 0;
BA_ "GenSigTimeoutTime_MPAD" SG_ 275 MessageCounter_CVPAM_FD_Control 0;
BA_ "GenSigTimeoutTime_ADCAM" SG_ 275 MessageCounter_CVPAM_FD_Control 0;
BA_ "GenSigTimeoutTime_CVADAS" SG_ 275 MessageCounter_CVPAM_FD_Control 0;
BA_ "GenSigTimeoutTime_VDCM" SG_ 275 MessageCounter_CVPAM_FD_Control 0;
BA_ "GenSigTimeoutTime_BSM" SG_ 275 MessageCounter_CVPAM_FD_Control 0;
BA_ "GenSigTimeoutTime_EPS" SG_ 275 MessageCounter_CVPAM_FD_Control 0;
BA_ "GenSigTimeoutTime_MPAD" SG_ 275 RR_PAM_Brk_RqSts 0;
BA_ "GenSigTimeoutTime_ADCAM" SG_ 275 RR_PAM_Brk_RqSts 0;
BA_ "GenSigTimeoutTime_CVADAS" SG_ 275 RR_PAM_Brk_RqSts 0;
BA_ "GenSigTimeoutTime_VDCM" SG_ 275 RR_PAM_Brk_RqSts 0;
BA_ "GenSigStartValue" SG_ 274 LatAcceleration 4095;
BA_ "GenSigTimeoutTime_BSM2" SG_ 274 LatAcceleration 0;
BA_ "GenSigTimeoutTime_CVPAM" SG_ 274 LatAcceleration 0;
BA_ "GenSigTimeoutTime_ECM" SG_ 274 LatAcceleration 0;
BA_ "GenSigTimeoutTime_EPS" SG_ 274 LatAcceleration 0;
BA_ "GenSigTimeoutTime_ORC" SG_ 274 LatAcceleration 0;
BA_ "GenSigStartValue" SG_ 274 LongAcceleration 4095;
BA_ "GenSigTimeoutTime_BSM2" SG_ 274 LongAcceleration 0;
BA_ "GenSigTimeoutTime_CVPAM" SG_ 274 LongAcceleration 0;
BA_ "GenSigTimeoutTime_ECM" SG_ 274 LongAcceleration 0;
BA_ "GenSigTimeoutTime_EPS" SG_ 274 LongAcceleration 0;
BA_ "GenSigTimeoutTime_ORC" SG_ 274 LongAcceleration 0;
BA_ "GenSigStartValue" SG_ 274 YawRate 4095;
BA_ "GenSigTimeoutTime_BSM2" SG_ 274 YawRate 0;
BA_ "GenSigTimeoutTime_CVPAM" SG_ 274 YawRate 0;
BA_ "GenSigTimeoutTime_ECM" SG_ 274 YawRate 0;
BA_ "GenSigTimeoutTime_EPS" SG_ 274 YawRate 0;
BA_ "GenSigTimeoutTime_ORC" SG_ 274 YawRate 0;
BA_ "GenSigTimeoutTime_BSM2" SG_ 274 LongAccelerationFailSts 0;
BA_ "GenSigTimeoutTime_CVPAM" SG_ 274 LongAccelerationFailSts 0;
BA_ "GenSigTimeoutTime_ECM" SG_ 274 LongAccelerationFailSts 0;
BA_ "GenSigTimeoutTime_EPS" SG_ 274 LongAccelerationFailSts 0;
BA_ "GenSigTimeoutTime_ORC" SG_ 274 LongAccelerationFailSts 0;
BA_ "GenSigTimeoutTime_BSM2" SG_ 274 MessageCounter_ORC3 0;
BA_ "GenSigTimeoutTime_CVPAM" SG_ 274 MessageCounter_ORC3 0;
BA_ "GenSigTimeoutTime_ECM" SG_ 274 MessageCounter_ORC3 0;
BA_ "GenSigTimeoutTime_EPS" SG_ 274 MessageCounter_ORC3 0;
BA_ "GenSigTimeoutTime_ORC" SG_ 274 MessageCounter_ORC3 0;
BA_ "GenSigTimeoutTime_BSM2" SG_ 274 YawRateFailSts 0;
BA_ "GenSigTimeoutTime_CVPAM" SG_ 274 YawRateFailSts 0;
BA_ "GenSigTimeoutTime_ECM" SG_ 274 YawRateFailSts 0;
BA_ "GenSigTimeoutTime_EPS" SG_ 274 YawRateFailSts 0;
BA_ "GenSigTimeoutTime_ORC" SG_ 274 YawRateFailSts 0;
BA_ "GenSigTimeoutTime_ADCAM" SG_ 255 SumTorque_DrvReqMod 0;
BA_ "GenSigTimeoutTime_CVADAS" SG_ 255 SumTorque_DrvReqMod 0;
BA_ "GenSigTimeoutTime_VDCM" SG_ 255 SumTorque_DrvReqMod 0;
BA_ "GenSigTimeoutTime_CVADAS" SG_ 255 SumTorqueExp 0;
BA_ "GenSigTimeoutTime_BSM" SG_ 255 SumTorqueExp 0;
BA_ "GenSigTimeoutTime_BSM2" SG_ 255 SumTorqueExp 0;
BA_ "GenSigTimeoutTime_CADM" SG_ 255 SumTorqueExp 0;
BA_ "GenSigTimeoutTime_ECM" SG_ 255 SumTorqueExp 0;
BA_ "GenSigTimeoutTime_EPS" SG_ 255 SumTorqueExp 0;
BA_ "GenSigTimeoutTime_EVCU2" SG_ 255 SumTorqueExp 0;
BA_ "GenSigTimeoutTime_ORC" SG_ 255 SumTorqueExp 0;
BA_ "GenSigTimeoutTime_ADCAM" SG_ 255 SumTorqueMax 0;
BA_ "GenSigTimeoutTime_CVADAS" SG_ 255 SumTorqueMax 0;
BA_ "GenSigTimeoutTime_VDCM" SG_ 255 SumTorqueMax 0;
BA_ "GenSigTimeoutTime_ADCAM" SG_ 255 SumTorqueMin 0;
BA_ "GenSigTimeoutTime_CVADAS" SG_ 255 SumTorqueMin 0;
BA_ "GenSigTimeoutTime_VDCM" SG_ 255 SumTorqueMin 0;
BA_ "GenSigTimeoutTime_ADCAM" SG_ 255 SumTorqueSel_D_TTC 0;
BA_ "GenSigTimeoutTime_CVADAS" SG_ 255 SumTorqueSel_D_TTC 0;
BA_ "GenSigTimeoutTime_VDCM" SG_ 255 SumTorqueSel_D_TTC 0;
BA_ "GenSigTimeoutTime_ADCAM" SG_ 255 SumTorqueStatic 0;
BA_ "GenSigTimeoutTime_CVADAS" SG_ 255 SumTorqueStatic 0;
BA_ "GenSigTimeoutTime_VDCM" SG_ 255 SumTorqueStatic 0;
BA_ "GenSigTimeoutTime_BSM2" SG_ 275 RR_PAM_Brk_RqSts 0;
BA_ "GenSigTimeoutTime_CADM" SG_ 275 RR_PAM_Brk_RqSts 0;
BA_ "GenSigTimeoutTime_CVPAM" SG_ 275 RR_PAM_Brk_RqSts 0;
BA_ "GenSigTimeoutTime_ECM" SG_ 275 RR_PAM_Brk_RqSts 0;
BA_ "GenSigTimeoutTime_EPS" SG_ 275 RR_PAM_Brk_RqSts 0;
BA_ "GenSigTimeoutTime_EVCU2" SG_ 275 RR_PAM_Brk_RqSts 0;
BA_ "GenSigTimeoutTime_ORC" SG_ 275 RR_PAM_Brk_RqSts 0;
BA_ "GenSigTimeoutTime_BSM2" SG_ 275 MessageCounter_CVPAM_FD_Control 0;
BA_ "GenSigTimeoutTime_CADM" SG_ 275 MessageCounter_CVPAM_FD_Control 0;
BA_ "GenSigTimeoutTime_CVPAM" SG_ 275 MessageCounter_CVPAM_FD_Control 0;
BA_ "GenSigTimeoutTime_ECM" SG_ 275 MessageCounter_CVPAM_FD_Control 0;
BA_ "GenSigTimeoutTime_EVCU2" SG_ 275 MessageCounter_CVPAM_FD_Control 0;
BA_ "GenSigTimeoutTime_ORC" SG_ 275 MessageCounter_CVPAM_FD_Control 0;
BA_ "GenSigTimeoutTime_BSM2" SG_ 275 CRC_CVPAM_FD_Control 0;
BA_ "GenSigTimeoutTime_CADM" SG_ 275 CRC_CVPAM_FD_Control 0;
BA_ "GenSigTimeoutTime_CVPAM" SG_ 275 CRC_CVPAM_FD_Control 0;
BA_ "GenSigTimeoutTime_ECM" SG_ 275 CRC_CVPAM_FD_Control 0;
BA_ "GenSigTimeoutTime_EVCU2" SG_ 275 CRC_CVPAM_FD_Control 0;
BA_ "GenSigTimeoutTime_ORC" SG_ 275 CRC_CVPAM_FD_Control 0;
BA_ "GenSigTimeoutTime_CVADAS" SG_ 1036 CRC_ENGINE3 0;
BA_ "GenSigTimeoutTime_CADM" SG_ 1036 CRC_ENGINE3 0;
BA_ "GenSigTimeoutTime_BSM2" SG_ 1036 CRC_ENGINE3 0;
BA_ "GenSigTimeoutTime_CVPAM" SG_ 1036 CRC_ENGINE3 0;
BA_ "GenSigTimeoutTime_ECM" SG_ 1036 CRC_ENGINE3 0;
BA_ "GenSigTimeoutTime_EPS" SG_ 1036 CRC_ENGINE3 0;
BA_ "GenSigTimeoutTime_EVCU2" SG_ 1036 CRC_ENGINE3 0;
BA_ "GenSigTimeoutTime_ORC" SG_ 1036 CRC_ENGINE3 0;
BA_ "GenSigTimeoutTime_CVADAS" SG_ 1036 MessageCounter_ENGINE3 0;
BA_ "GenSigTimeoutTime_CADM" SG_ 1036 MessageCounter_ENGINE3 0;
BA_ "GenSigTimeoutTime_BSM2" SG_ 1036 MessageCounter_ENGINE3 0;
BA_ "GenSigTimeoutTime_CVPAM" SG_ 1036 MessageCounter_ENGINE3 0;
BA_ "GenSigTimeoutTime_ECM" SG_ 1036 MessageCounter_ENGINE3 0;
BA_ "GenSigTimeoutTime_EPS" SG_ 1036 MessageCounter_ENGINE3 0;
BA_ "GenSigTimeoutTime_EVCU2" SG_ 1036 MessageCounter_ENGINE3 0;
BA_ "GenSigTimeoutTime_ORC" SG_ 1036 MessageCounter_ENGINE3 0;
BA_ "GenSigTimeoutTime_BSM2" SG_ 275 RR_PAM_Dist 0;
BA_ "GenSigTimeoutTime_CADM" SG_ 275 RR_PAM_Dist 0;
BA_ "GenSigTimeoutTime_CVPAM" SG_ 275 RR_PAM_Dist 0;
BA_ "GenSigTimeoutTime_ECM" SG_ 275 RR_PAM_Dist 0;
BA_ "GenSigTimeoutTime_EPS" SG_ 275 RR_PAM_Dist 0;
BA_ "GenSigTimeoutTime_EVCU2" SG_ 275 RR_PAM_Dist 0;
BA_ "GenSigTimeoutTime_ORC" SG_ 275 RR_PAM_Dist 0;
BA_ "GenSigTimeoutTime_BSM2" SG_ 275 SPM_Lat_Ctrl_RequestSts 0;
BA_ "GenSigTimeoutTime_CADM" SG_ 275 SPM_Lat_Ctrl_RequestSts 0;
BA_ "GenSigTimeoutTime_CVPAM" SG_ 275 SPM_Lat_Ctrl_RequestSts 0;
BA_ "GenSigTimeoutTime_ECM" SG_ 275 SPM_Lat_Ctrl_RequestSts 0;
BA_ "GenSigTimeoutTime_EVCU2" SG_ 275 SPM_Lat_Ctrl_RequestSts 0;
BA_ "GenSigTimeoutTime_BSM" SG_ 275 ManoeuvrePhase 0;
BA_ "GenSigTimeoutTime_BSM2" SG_ 275 ManoeuvrePhase 0;
BA_ "GenSigTimeoutTime_CADM" SG_ 275 ManoeuvrePhase 0;
BA_ "GenSigTimeoutTime_CVPAM" SG_ 275 ManoeuvrePhase 0;
BA_ "GenSigTimeoutTime_ECM" SG_ 275 ManoeuvrePhase 0;
BA_ "GenSigTimeoutTime_EVCU2" SG_ 275 ManoeuvrePhase 0;
BA_ "GenSigTimeoutTime_ORC" SG_ 275 ManoeuvrePhase 0;
BA_ "GenSigTimeoutTime_ADCAM" SG_ 255 CRC_PT_TORQUE_FD_1 0;
BA_ "GenSigTimeoutTime_CVADAS" SG_ 255 CRC_PT_TORQUE_FD_1 0;
BA_ "GenSigTimeoutTime_VDCM" SG_ 255 CRC_PT_TORQUE_FD_1 0;
BA_ "GenSigTimeoutTime_ADCAM" SG_ 255 MessageCounter_PT_TORQUE_FD_1 0;
BA_ "GenSigTimeoutTime_CVADAS" SG_ 255 MessageCounter_PT_TORQUE_FD_1 0;
BA_ "GenSigTimeoutTime_VDCM" SG_ 255 MessageCounter_PT_TORQUE_FD_1 0;
BA_ "GenSigTimeoutTime_BSM2" SG_ 275 PPPA_Interface_BSM 0;
BA_ "GenSigTimeoutTime_CADM" SG_ 275 PPPA_Interface_BSM 0;
BA_ "GenSigTimeoutTime_CVPAM" SG_ 275 PPPA_Interface_BSM 0;
BA_ "GenSigTimeoutTime_ECM" SG_ 275 PPPA_Interface_BSM 0;
BA_ "GenSigTimeoutTime_EPS" SG_ 275 PPPA_Interface_BSM 0;
BA_ "GenSigTimeoutTime_EVCU2" SG_ 275 PPPA_Interface_BSM 0;
BA_ "GenSigTimeoutTime_ORC" SG_ 275 PPPA_Interface_BSM 0;
BA_ "GenSigTimeoutTime_BSM2" SG_ 275 PPPA_DecelMin 0;
BA_ "GenSigTimeoutTime_CADM" SG_ 275 PPPA_DecelMin 0;
BA_ "GenSigTimeoutTime_CVPAM" SG_ 275 PPPA_DecelMin 0;
BA_ "GenSigTimeoutTime_ECM" SG_ 275 PPPA_DecelMin 0;
BA_ "GenSigTimeoutTime_EPS" SG_ 275 PPPA_DecelMin 0;
BA_ "GenSigTimeoutTime_EVCU2" SG_ 275 PPPA_DecelMin 0;
BA_ "GenSigTimeoutTime_ORC" SG_ 275 PPPA_DecelMin 0;
BA_ "GenSigTimeoutTime_BSM2" SG_ 275 PPPA_AccelMin 0;
BA_ "GenSigTimeoutTime_CADM" SG_ 275 PPPA_AccelMin 0;
BA_ "GenSigTimeoutTime_CVPAM" SG_ 275 PPPA_AccelMin 0;
BA_ "GenSigTimeoutTime_ECM" SG_ 275 PPPA_AccelMin 0;
BA_ "GenSigTimeoutTime_EPS" SG_ 275 PPPA_AccelMin 0;
BA_ "GenSigTimeoutTime_EVCU2" SG_ 275 PPPA_AccelMin 0;
BA_ "GenSigTimeoutTime_ORC" SG_ 275 PPPA_AccelMin 0;
BA_ "GenSigTimeoutTime_BSM2" SG_ 275 PPPA_DecelMax 0;
BA_ "GenSigTimeoutTime_CADM" SG_ 275 PPPA_DecelMax 0;
BA_ "GenSigTimeoutTime_CVPAM" SG_ 275 PPPA_DecelMax 0;
BA_ "GenSigTimeoutTime_ECM" SG_ 275 PPPA_DecelMax 0;
BA_ "GenSigTimeoutTime_EPS" SG_ 275 PPPA_DecelMax 0;
BA_ "GenSigTimeoutTime_EVCU2" SG_ 275 PPPA_DecelMax 0;
BA_ "GenSigTimeoutTime_ORC" SG_ 275 PPPA_DecelMax 0;
BA_ "GenSigTimeoutTime_ECM" SG_ 275 PPPA_AccelMax 0;
BA_ "GenSigTimeoutTime_EPS" SG_ 275 PPPA_AccelMax 0;
BA_ "GenSigTimeoutTime_EVCU2" SG_ 275 PPPA_AccelMax 0;
BA_ "GenSigTimeoutTime_ORC" SG_ 275 PPPA_AccelMax 0;
BA_ "GenSigTimeoutTime_BSM2" SG_ 275 ParkingGearShiftReq 0;
BA_ "GenSigTimeoutTime_CADM" SG_ 275 ParkingGearShiftReq 0;
BA_ "GenSigTimeoutTime_CVPAM" SG_ 275 ParkingGearShiftReq 0;
BA_ "GenSigTimeoutTime_ECM" SG_ 275 ParkingGearShiftReq 0;
BA_ "GenSigTimeoutTime_EPS" SG_ 275 ParkingGearShiftReq 0;
BA_ "GenSigTimeoutTime_EVCU2" SG_ 275 ParkingGearShiftReq 0;
BA_ "GenSigTimeoutTime_ORC" SG_ 275 ParkingGearShiftReq 0;
BA_ "GenSigStartValue" SG_ 275 TorqueOverlaySteeringReq_SPM 1024;
BA_ "GenSigTimeoutTime_BSM" SG_ 275 TorqueOverlaySteeringReq_SPM 0;
BA_ "GenSigTimeoutTime_BSM2" SG_ 275 TorqueOverlaySteeringReq_SPM 0;
BA_ "GenSigTimeoutTime_CADM" SG_ 275 TorqueOverlaySteeringReq_SPM 0;
BA_ "GenSigTimeoutTime_CVPAM" SG_ 275 TorqueOverlaySteeringReq_SPM 0;
BA_ "GenSigTimeoutTime_ECM" SG_ 275 TorqueOverlaySteeringReq_SPM 0;
BA_ "GenSigTimeoutTime_EVCU2" SG_ 275 TorqueOverlaySteeringReq_SPM 0;
BA_ "GenSigTimeoutTime_CVPAM" SG_ 255 ACC_NCC_TrqEnblRq_Allowed 0;
BA_ "GenSigTimeoutTime_ECM" SG_ 255 ACC_NCC_TrqEnblRq_Allowed 0;
BA_ "GenSigTimeoutTime_EPS" SG_ 255 ACC_NCC_TrqEnblRq_Allowed 0;
BA_ "GenSigTimeoutTime_EVCU2" SG_ 255 ACC_NCC_TrqEnblRq_Allowed 0;
BA_ "GenSigTimeoutTime_ORC" SG_ 255 ACC_NCC_TrqEnblRq_Allowed 0;
BA_ "GenSigTimeoutTime_CVADAS" SG_ 255 ACC_NCC_TrqEnblRq_Allowed 0;
BA_ "GenSigTimeoutTime_VDCM" SG_ 255 ACC_NCC_TrqEnblRq_Allowed 0;
BA_ "GenSigTimeoutTime_BSM" SG_ 255 ACC_NCC_TrqEnblRq_Allowed 0;
BA_ "GenSigTimeoutTime_BSM2" SG_ 255 ACC_NCC_TrqEnblRq_Allowed 0;
BA_ "GenSigTimeoutTime_BSM2" SG_ 255 Accel_Pedal_Override 0;
BA_ "GenSigTimeoutTime_ECM" SG_ 255 Accel_Pedal_Override 0;
BA_ "GenSigTimeoutTime_EPS" SG_ 255 Accel_Pedal_Override 0;
BA_ "GenSigTimeoutTime_EVCU2" SG_ 255 Accel_Pedal_Override 0;
BA_ "GenSigTimeoutTime_ORC" SG_ 255 Accel_Pedal_Override 0;
BA_ "GenSigTimeoutTime_CVADAS" SG_ 255 Accel_Pedal_Override 0;
BA_ "GenSigTimeoutTime_VDCM" SG_ 255 Accel_Pedal_Override 0;
BA_ "GenSigTimeoutTime_BSM" SG_ 255 SSC_TrqEnblRq_Allowed 0;
BA_ "GenSigTimeoutTime_BSM2" SG_ 255 SSC_TrqEnblRq_Allowed 0;
BA_ "GenSigTimeoutTime_CADM" SG_ 255 SSC_TrqEnblRq_Allowed 0;
BA_ "GenSigTimeoutTime_CVPAM" SG_ 255 SSC_TrqEnblRq_Allowed 0;
BA_ "GenSigTimeoutTime_MPAD" SG_ 255 SSC_TrqEnblRq_Allowed 0;
BA_ "GenSigTimeoutTime_ADCAM" SG_ 255 SSC_TrqEnblRq_Allowed 0;
BA_ "GenSigTimeoutTime_CVADAS" SG_ 255 SSC_TrqEnblRq_Allowed 0;
BA_ "GenSigTimeoutTime_VDCM" SG_ 255 SSC_TrqEnblRq_Allowed 0;
BA_ "GenSigTimeoutTime_BSM2" SG_ 255 PPPA_TrqEnblRq_Allowed 0;
BA_ "GenSigTimeoutTime_CADM" SG_ 255 PPPA_TrqEnblRq_Allowed 0;
BA_ "GenSigTimeoutTime_ECM" SG_ 255 PPPA_TrqEnblRq_Allowed 0;
BA_ "GenSigTimeoutTime_EPS" SG_ 255 PPPA_TrqEnblRq_Allowed 0;
BA_ "GenSigTimeoutTime_EVCU2" SG_ 255 PPPA_TrqEnblRq_Allowed 0;
BA_ "GenSigTimeoutTime_ORC" SG_ 255 PPPA_TrqEnblRq_Allowed 0;
BA_ "GenSigTimeoutTime_MPAD" SG_ 255 PPPA_TrqEnblRq_Allowed 0;
BA_ "GenSigTimeoutTime_ADCAM" SG_ 255 PPPA_TrqEnblRq_Allowed 0;
BA_ "GenSigTimeoutTime_CVADAS" SG_ 255 PPPA_TrqEnblRq_Allowed 0;
BA_ "GenSigTimeoutTime_VDCM" SG_ 255 PPPA_TrqEnblRq_Allowed 0;
BA_ "GenSigTimeoutTime_BSM" SG_ 255 PPPA_TrqEnblRq_Allowed 0;
BA_ "GenSigTimeoutTime_BSM" SG_ 255 ESC_TrqEnblRq_Allowed 0;
BA_ "GenSigTimeoutTime_BSM2" SG_ 255 ESC_TrqEnblRq_Allowed 0;
BA_ "GenSigTimeoutTime_CADM" SG_ 255 ESC_TrqEnblRq_Allowed 0;
BA_ "GenSigTimeoutTime_CVPAM" SG_ 255 ESC_TrqEnblRq_Allowed 0;
BA_ "GenSigTimeoutTime_ECM" SG_ 255 ESC_TrqEnblRq_Allowed 0;
BA_ "GenSigTimeoutTime_EPS" SG_ 255 ESC_TrqEnblRq_Allowed 0;
BA_ "GenSigTimeoutTime_EVCU2" SG_ 255 ESC_TrqEnblRq_Allowed 0;
BA_ "GenSigTimeoutTime_ORC" SG_ 255 ESC_TrqEnblRq_Allowed 0;
BA_ "GenSigTimeoutTime_MPAD" SG_ 255 ESC_TrqEnblRq_Allowed 0;
BA_ "GenSigTimeoutTime_ADCAM" SG_ 255 ESC_TrqEnblRq_Allowed 0;
BA_ "GenSigTimeoutTime_CVADAS" SG_ 255 ESC_TrqEnblRq_Allowed 0;
BA_ "GenSigTimeoutTime_VDCM" SG_ 255 ESC_TrqEnblRq_Allowed 0;
BA_ "GenSigTimeoutTime_MPAD" SG_ 255 RRCC_TrqEnblRq_Allowed 0;
BA_ "GenSigTimeoutTime_CVADAS" SG_ 255 RRCC_TrqEnblRq_Allowed 0;
BA_ "GenSigTimeoutTime_CVADAS" SG_ 255 Total_AxleTorque_Static 0;
BA_ "GenSigTimeoutTime_VDCM" SG_ 255 Total_AxleTorque_Static 0;
BA_ "GenSigTimeoutTime_BSM2" SG_ 275 PPPA_JerkAccelMax 0;
BA_ "GenSigTimeoutTime_CADM" SG_ 275 PPPA_JerkAccelMax 0;
BA_ "GenSigTimeoutTime_CVPAM" SG_ 275 PPPA_JerkAccelMax 0;
BA_ "GenSigTimeoutTime_ECM" SG_ 275 PPPA_JerkAccelMax 0;
BA_ "GenSigTimeoutTime_EPS" SG_ 275 PPPA_JerkAccelMax 0;
BA_ "GenSigTimeoutTime_EVCU2" SG_ 275 PPPA_JerkAccelMax 0;
BA_ "GenSigTimeoutTime_ORC" SG_ 275 PPPA_JerkAccelMax 0;
BA_ "GenSigTimeoutTime_MPAD" SG_ 950 MessageCounter_CVPAM_FD_Info 0;
BA_ "GenSigTimeoutTime_ADCAM" SG_ 950 MessageCounter_CVPAM_FD_Info 0;
BA_ "GenSigTimeoutTime_CVADAS" SG_ 950 MessageCounter_CVPAM_FD_Info 0;
BA_ "GenSigTimeoutTime_BSM2" SG_ 950 MessageCounter_CVPAM_FD_Info 0;
BA_ "GenSigTimeoutTime_CADM" SG_ 950 MessageCounter_CVPAM_FD_Info 0;
BA_ "GenSigTimeoutTime_CVPAM" SG_ 950 MessageCounter_CVPAM_FD_Info 0;
BA_ "GenSigTimeoutTime_ECM" SG_ 950 MessageCounter_CVPAM_FD_Info 0;
BA_ "GenSigTimeoutTime_EPS" SG_ 950 MessageCounter_CVPAM_FD_Info 0;
BA_ "GenSigTimeoutTime_EVCU2" SG_ 950 MessageCounter_CVPAM_FD_Info 0;
BA_ "GenSigTimeoutTime_ORC" SG_ 950 MessageCounter_CVPAM_FD_Info 0;
BA_ "GenSigTimeoutTime_MPAD" SG_ 950 ParkingManeuverActive 0;
BA_ "GenSigTimeoutTime_ADCAM" SG_ 950 ParkingManeuverActive 0;
BA_ "GenSigTimeoutTime_CVADAS" SG_ 950 ParkingManeuverActive 0;
BA_ "GenSigSendType" SG_ 950 ParkingManeuverActive 3;
BA_ "GenSigTimeoutTime_BSM2" SG_ 950 ParkingManeuverActive 0;
BA_ "GenSigTimeoutTime_CADM" SG_ 950 ParkingManeuverActive 0;
BA_ "GenSigTimeoutTime_CVPAM" SG_ 950 ParkingManeuverActive 0;
BA_ "GenSigTimeoutTime_ECM" SG_ 950 ParkingManeuverActive 0;
BA_ "GenSigTimeoutTime_EPS" SG_ 950 ParkingManeuverActive 0;
BA_ "GenSigTimeoutTime_EVCU2" SG_ 950 ParkingManeuverActive 0;
BA_ "GenSigTimeoutTime_ORC" SG_ 950 ParkingManeuverActive 0;
BA_ "GenSigTimeoutTime_MPAD" SG_ 950 CRC_CVPAM_FD_Info 0;
BA_ "GenSigTimeoutTime_ADCAM" SG_ 950 CRC_CVPAM_FD_Info 0;
BA_ "GenSigTimeoutTime_CVADAS" SG_ 950 CRC_CVPAM_FD_Info 0;
BA_ "GenSigTimeoutTime_BSM2" SG_ 950 CRC_CVPAM_FD_Info 0;
BA_ "GenSigTimeoutTime_CADM" SG_ 950 CRC_CVPAM_FD_Info 0;
BA_ "GenSigTimeoutTime_CVPAM" SG_ 950 CRC_CVPAM_FD_Info 0;
BA_ "GenSigTimeoutTime_ECM" SG_ 950 CRC_CVPAM_FD_Info 0;
BA_ "GenSigTimeoutTime_EPS" SG_ 950 CRC_CVPAM_FD_Info 0;
BA_ "GenSigTimeoutTime_EVCU2" SG_ 950 CRC_CVPAM_FD_Info 0;
BA_ "GenSigTimeoutTime_ORC" SG_ 950 CRC_CVPAM_FD_Info 0;
BA_ "GenSigTimeoutTime_MPAD" SG_ 255 Front_AxleTorque_Static 0;
BA_ "GenSigTimeoutTime_ADCAM" SG_ 255 Front_AxleTorque_Static 0;
BA_ "GenSigTimeoutTime_CVADAS" SG_ 255 Front_AxleTorque_Static 0;
BA_ "GenSigTimeoutTime_VDCM" SG_ 255 Front_AxleTorque_Static 0;
BA_ "GenSigTimeoutTime_MPAD" SG_ 255 Rear_AxleTorque_Static 0;
BA_ "GenSigTimeoutTime_ADCAM" SG_ 255 Rear_AxleTorque_Static 0;
BA_ "GenSigTimeoutTime_CVADAS" SG_ 255 Rear_AxleTorque_Static 0;
BA_ "GenSigTimeoutTime_VDCM" SG_ 255 Rear_AxleTorque_Static 0;
BA_ "GenSigStartValue" SG_ 255 Rear_AxleTorque_Static 32767;
BA_ "GenSigTimeoutTime_BSM" SG_ 255 Rear_AxleTorque_Static 0;
BA_ "GenSigTimeoutTime_BSM2" SG_ 255 Rear_AxleTorque_Static 0;
BA_ "GenSigTimeoutTime_CADM" SG_ 255 Rear_AxleTorque_Static 0;
BA_ "GenSigTimeoutTime_CVPAM" SG_ 255 Rear_AxleTorque_Static 0;
BA_ "GenSigTimeoutTime_ECM" SG_ 255 Rear_AxleTorque_Static 0;
BA_ "GenSigTimeoutTime_EPS" SG_ 255 Rear_AxleTorque_Static 0;
BA_ "GenSigTimeoutTime_EVCU2" SG_ 255 Rear_AxleTorque_Static 0;
BA_ "GenSigTimeoutTime_ORC" SG_ 255 Rear_AxleTorque_Static 0;
BA_ "GenSigStartValue" SG_ 255 Front_AxleTorque_Static 32767;
BA_ "GenSigTimeoutTime_BSM" SG_ 255 Front_AxleTorque_Static 0;
BA_ "GenSigTimeoutTime_BSM2" SG_ 255 Front_AxleTorque_Static 0;
BA_ "GenSigTimeoutTime_CADM" SG_ 255 Front_AxleTorque_Static 0;
BA_ "GenSigTimeoutTime_CVPAM" SG_ 255 Front_AxleTorque_Static 0;
BA_ "GenSigTimeoutTime_ECM" SG_ 255 Front_AxleTorque_Static 0;
BA_ "GenSigTimeoutTime_EPS" SG_ 255 Front_AxleTorque_Static 0;
BA_ "GenSigTimeoutTime_EVCU2" SG_ 255 Front_AxleTorque_Static 0;
BA_ "GenSigTimeoutTime_ORC" SG_ 255 Front_AxleTorque_Static 0;
BA_ "GenSigTimeoutTime_BSM" SG_ 513 DASEngReqPos_201 0;
BA_ "GenSigTimeoutTime_BSM2" SG_ 513 DASEngReqPos_201 0;
BA_ "GenSigTimeoutTime_CVPAM" SG_ 513 DASEngReqPos_201 0;
BA_ "GenSigTimeoutTime_ECM" SG_ 513 DASEngReqPos_201 0;
BA_ "GenSigTimeoutTime_EPS" SG_ 513 DASEngReqPos_201 0;
BA_ "GenSigTimeoutTime_EVCU2" SG_ 513 DASEngReqPos_201 0;
BA_ "GenSigTimeoutTime_ORC" SG_ 513 DASEngReqPos_201 0;
BA_ "GenSigTimeoutTime_CVADAS" SG_ 513 DASEngReqPos_201 0;
BA_ "GenSigTimeoutTime_VDCM" SG_ 513 DASEngReqPos_201 0;
BA_ "GenSigTimeoutTime_CVADAS" SG_ 513 RRCC_Cancel_Req_201 0;
BA_ "GenSigTimeoutTime_BSM" SG_ 513 RRCC_Cancel_Req_201 0;
BA_ "GenSigTimeoutTime_BSM2" SG_ 513 RRCC_Cancel_Req_201 0;
BA_ "GenSigTimeoutTime_ECM" SG_ 513 RRCC_Cancel_Req_201 0;
BA_ "GenSigTimeoutTime_EPS" SG_ 513 RRCC_Cancel_Req_201 0;
BA_ "GenSigTimeoutTime_EVCU2" SG_ 513 RRCC_Cancel_Req_201 0;
BA_ "GenSigTimeoutTime_ORC" SG_ 513 RRCC_Cancel_Req_201 0;
BA_ "GenSigTimeoutTime_BSM" SG_ 513 ACCFSafe_201 0;
BA_ "GenSigTimeoutTime_CVPAM" SG_ 513 ACCFSafe_201 0;
BA_ "GenSigTimeoutTime_ECM" SG_ 513 ACCFSafe_201 0;
BA_ "GenSigTimeoutTime_EPS" SG_ 513 ACCFSafe_201 0;
BA_ "GenSigTimeoutTime_EVCU2" SG_ 513 ACCFSafe_201 0;
BA_ "GenSigTimeoutTime_ORC" SG_ 513 ACCFSafe_201 0;
BA_ "GenSigTimeoutTime_CVADAS" SG_ 513 ACCFSafe_201 0;
BA_ "GenSigTimeoutTime_VDCM" SG_ 513 ACCFSafe_201 0;
BA_ "GenSigStartValue" SG_ 255 Total_AxleTorque_Static 32767;
BA_ "GenSigTimeoutTime_BSM" SG_ 255 Total_AxleTorque_Static 0;
BA_ "GenSigTimeoutTime_BSM2" SG_ 255 Total_AxleTorque_Static 0;
BA_ "GenSigTimeoutTime_CVPAM" SG_ 255 Total_AxleTorque_Static 0;
BA_ "GenSigTimeoutTime_ECM" SG_ 255 Total_AxleTorque_Static 0;
BA_ "GenSigTimeoutTime_EPS" SG_ 255 Total_AxleTorque_Static 0;
BA_ "GenSigTimeoutTime_EVCU2" SG_ 255 Total_AxleTorque_Static 0;
BA_ "GenSigTimeoutTime_ORC" SG_ 255 Total_AxleTorque_Static 0;
BA_ "GenSigTimeoutTime_BSM" SG_ 255 RRCC_TrqEnblRq_Allowed 0;
BA_ "GenSigTimeoutTime_BSM2" SG_ 255 RRCC_TrqEnblRq_Allowed 0;
BA_ "GenSigTimeoutTime_CADM" SG_ 255 RRCC_TrqEnblRq_Allowed 0;
BA_ "GenSigTimeoutTime_CVPAM" SG_ 255 RRCC_TrqEnblRq_Allowed 0;
BA_ "GenSigTimeoutTime_ECM" SG_ 255 RRCC_TrqEnblRq_Allowed 0;
BA_ "GenSigTimeoutTime_EPS" SG_ 255 RRCC_TrqEnblRq_Allowed 0;
BA_ "GenSigTimeoutTime_EVCU2" SG_ 255 RRCC_TrqEnblRq_Allowed 0;
BA_ "GenSigTimeoutTime_ORC" SG_ 255 RRCC_TrqEnblRq_Allowed 0;
BA_ "GenSigTimeoutTime_ECM" SG_ 255 SSC_TrqEnblRq_Allowed 0;
BA_ "GenSigTimeoutTime_EPS" SG_ 255 SSC_TrqEnblRq_Allowed 0;
BA_ "GenSigTimeoutTime_EVCU2" SG_ 255 SSC_TrqEnblRq_Allowed 0;
BA_ "GenSigTimeoutTime_ORC" SG_ 255 SSC_TrqEnblRq_Allowed 0;
BA_ "GenSigTimeoutTime_ADCAM" SG_ 513 EngSpdInterv 0;
BA_ "GenSigTimeoutTime_CVADAS" SG_ 513 EngSpdInterv 0;
BA_ "GenSigTimeoutTime_VDCM" SG_ 513 EngSpdInterv 0;
BA_ "GenSigStartValue" SG_ 513 EngSpdInterv 65535;
BA_ "GenSigTimeoutTime_BSM" SG_ 513 EngSpdInterv 0;
BA_ "GenSigTimeoutTime_BSM2" SG_ 513 EngSpdInterv 0;
BA_ "GenSigTimeoutTime_CADM" SG_ 513 EngSpdInterv 0;
BA_ "GenSigTimeoutTime_ECM" SG_ 513 EngSpdInterv 0;
BA_ "GenSigTimeoutTime_EPS" SG_ 513 EngSpdInterv 0;
BA_ "GenSigTimeoutTime_EVCU2" SG_ 513 EngSpdInterv 0;
BA_ "GenSigTimeoutTime_ORC" SG_ 513 EngSpdInterv 0;
BA_ "GenSigTimeoutTime_ADCAM" SG_ 513 EngSpdIntervReq 0;
BA_ "GenSigTimeoutTime_CVADAS" SG_ 513 EngSpdIntervReq 0;
BA_ "GenSigTimeoutTime_VDCM" SG_ 513 EngSpdIntervReq 0;
BA_ "GenSigTimeoutTime_BSM" SG_ 513 EngSpdIntervReq 0;
BA_ "GenSigTimeoutTime_BSM2" SG_ 513 EngSpdIntervReq 0;
BA_ "GenSigTimeoutTime_CADM" SG_ 513 EngSpdIntervReq 0;
BA_ "GenSigTimeoutTime_ECM" SG_ 513 EngSpdIntervReq 0;
BA_ "GenSigTimeoutTime_EPS" SG_ 513 EngSpdIntervReq 0;
BA_ "GenSigTimeoutTime_EVCU2" SG_ 513 EngSpdIntervReq 0;
BA_ "GenSigTimeoutTime_ORC" SG_ 513 EngSpdIntervReq 0;
BA_ "GenSigTimeoutTime_BSM" SG_ 255 MessageCounter_PT_TORQUE_FD_1 0;
BA_ "GenSigTimeoutTime_BSM2" SG_ 255 MessageCounter_PT_TORQUE_FD_1 0;
BA_ "GenSigTimeoutTime_CVPAM" SG_ 255 MessageCounter_PT_TORQUE_FD_1 0;
BA_ "GenSigTimeoutTime_ECM" SG_ 255 MessageCounter_PT_TORQUE_FD_1 0;
BA_ "GenSigTimeoutTime_EPS" SG_ 255 MessageCounter_PT_TORQUE_FD_1 0;
BA_ "GenSigTimeoutTime_EVCU2" SG_ 255 MessageCounter_PT_TORQUE_FD_1 0;
BA_ "GenSigTimeoutTime_ORC" SG_ 255 MessageCounter_PT_TORQUE_FD_1 0;
BA_ "GenSigTimeoutTime_BSM" SG_ 255 CRC_PT_TORQUE_FD_1 0;
BA_ "GenSigTimeoutTime_BSM2" SG_ 255 CRC_PT_TORQUE_FD_1 0;
BA_ "GenSigTimeoutTime_CVPAM" SG_ 255 CRC_PT_TORQUE_FD_1 0;
BA_ "GenSigTimeoutTime_ECM" SG_ 255 CRC_PT_TORQUE_FD_1 0;
BA_ "GenSigTimeoutTime_EPS" SG_ 255 CRC_PT_TORQUE_FD_1 0;
BA_ "GenSigTimeoutTime_EVCU2" SG_ 255 CRC_PT_TORQUE_FD_1 0;
BA_ "GenSigTimeoutTime_ORC" SG_ 255 CRC_PT_TORQUE_FD_1 0;
BA_ "GenSigTimeoutTime_BSM" SG_ 513 Brk_Jrk_Resp 0;
BA_ "GenSigTimeoutTime_BSM2" SG_ 513 Brk_Jrk_Resp 0;
BA_ "GenSigTimeoutTime_CVPAM" SG_ 513 Brk_Jrk_Resp 0;
BA_ "GenSigTimeoutTime_ECM" SG_ 513 Brk_Jrk_Resp 0;
BA_ "GenSigTimeoutTime_EPS" SG_ 513 Brk_Jrk_Resp 0;
BA_ "GenSigTimeoutTime_EVCU2" SG_ 513 Brk_Jrk_Resp 0;
BA_ "GenSigTimeoutTime_CVADAS" SG_ 513 Brk_Jrk_Resp 0;
BA_ "GenSigTimeoutTime_VDCM" SG_ 513 Brk_Jrk_Resp 0;
BA_ "GenSigTimeoutTime_CVADAS" SG_ 513 CRC_BRAKE1 0;
BA_ "GenSigTimeoutTime_VDCM" SG_ 513 CRC_BRAKE1 0;
BA_ "GenSigTimeoutTime_EVCU2" SG_ 513 CRC_BRAKE1 0;
BA_ "GenSigTimeoutTime_BSM" SG_ 513 CRC_BRAKE1 0;
BA_ "GenSigTimeoutTime_ECM" SG_ 513 CRC_BRAKE1 0;
BA_ "GenSigTimeoutTime_EPS" SG_ 513 CRC_BRAKE1 0;
BA_ "GenSigTimeoutTime_ORC" SG_ 513 CRC_BRAKE1 0;
BA_ "GenSigTimeoutTime_CVADAS" SG_ 513 MessageCounter_BRAKE1 0;
BA_ "GenSigTimeoutTime_VDCM" SG_ 513 MessageCounter_BRAKE1 0;
BA_ "GenSigTimeoutTime_EVCU2" SG_ 513 MessageCounter_BRAKE1 0;
BA_ "GenSigTimeoutTime_BSM" SG_ 513 MessageCounter_BRAKE1 0;
BA_ "GenSigTimeoutTime_ECM" SG_ 513 MessageCounter_BRAKE1 0;
BA_ "GenSigTimeoutTime_EPS" SG_ 513 MessageCounter_BRAKE1 0;
BA_ "GenSigTimeoutTime_ORC" SG_ 513 MessageCounter_BRAKE1 0;
BA_ "GenSigTimeoutTime_MPAD" SG_ 513 REF_VEH_SPEED 0;
BA_ "GenSigTimeoutTime_ADCAM" SG_ 513 REF_VEH_SPEED 0;
BA_ "GenSigTimeoutTime_CVADAS" SG_ 513 REF_VEH_SPEED 0;
BA_ "GenSigTimeoutTime_VDCM" SG_ 513 REF_VEH_SPEED 0;
BA_ "GenSigStartValue" SG_ 513 REF_VEH_SPEED 1023;
BA_ "GenSigTimeoutTime_BSM" SG_ 513 REF_VEH_SPEED 0;
BA_ "GenSigTimeoutTime_BSM2" SG_ 513 REF_VEH_SPEED 0;
BA_ "GenSigTimeoutTime_CADM" SG_ 513 REF_VEH_SPEED 0;
BA_ "GenSigTimeoutTime_ECM" SG_ 513 REF_VEH_SPEED 0;
BA_ "GenSigTimeoutTime_EPS" SG_ 513 REF_VEH_SPEED 0;
BA_ "GenSigTimeoutTime_ORC" SG_ 513 REF_VEH_SPEED 0;
BA_ "GenSigTimeoutTime_MPAD" SG_ 513 SelectSpdSts 0;
BA_ "GenSigTimeoutTime_ADCAM" SG_ 513 SelectSpdSts 0;
BA_ "GenSigTimeoutTime_CVADAS" SG_ 513 SelectSpdSts 0;
BA_ "GenSigTimeoutTime_BSM" SG_ 513 SelectSpdSts 0;
BA_ "GenSigTimeoutTime_BSM2" SG_ 513 SelectSpdSts 0;
BA_ "GenSigTimeoutTime_CADM" SG_ 513 SelectSpdSts 0;
BA_ "GenSigTimeoutTime_CVPAM" SG_ 513 SelectSpdSts 0;
BA_ "GenSigTimeoutTime_ECM" SG_ 513 SelectSpdSts 0;
BA_ "GenSigTimeoutTime_EPS" SG_ 513 SelectSpdSts 0;
BA_ "GenSigTimeoutTime_EVCU2" SG_ 513 SelectSpdSts 0;
BA_ "GenSigTimeoutTime_ORC" SG_ 513 SelectSpdSts 0;
BA_ "GenSigTimeoutTime_MPAD" SG_ 513 SelSpdLmp 0;
BA_ "GenSigTimeoutTime_ADCAM" SG_ 513 SelSpdLmp 0;
BA_ "GenSigTimeoutTime_CVADAS" SG_ 513 SelSpdLmp 0;
BA_ "GenSigTimeoutTime_BSM" SG_ 513 SelSpdLmp 0;
BA_ "GenSigTimeoutTime_BSM2" SG_ 513 SelSpdLmp 0;
BA_ "GenSigTimeoutTime_CADM" SG_ 513 SelSpdLmp 0;
BA_ "GenSigTimeoutTime_CVPAM" SG_ 513 SelSpdLmp 0;
BA_ "GenSigTimeoutTime_ECM" SG_ 513 SelSpdLmp 0;
BA_ "GenSigTimeoutTime_EPS" SG_ 513 SelSpdLmp 0;
BA_ "GenSigTimeoutTime_EVCU2" SG_ 513 SelSpdLmp 0;
BA_ "GenSigTimeoutTime_ORC" SG_ 513 SelSpdLmp 0;
BA_ "GenSigTimeoutTime_BSM" SG_ 255 SumTorqueStatic 0;
BA_ "GenSigTimeoutTime_BSM2" SG_ 255 SumTorqueStatic 0;
BA_ "GenSigTimeoutTime_CADM" SG_ 255 SumTorqueStatic 0;
BA_ "GenSigTimeoutTime_CVPAM" SG_ 255 SumTorqueStatic 0;
BA_ "GenSigTimeoutTime_ECM" SG_ 255 SumTorqueStatic 0;
BA_ "GenSigTimeoutTime_EPS" SG_ 255 SumTorqueStatic 0;
BA_ "GenSigTimeoutTime_EVCU2" SG_ 255 SumTorqueStatic 0;
BA_ "GenSigTimeoutTime_ORC" SG_ 255 SumTorqueStatic 0;
BA_ "GenSigTimeoutTime_BSM" SG_ 255 SumTorqueSel_D_TTC 0;
BA_ "GenSigTimeoutTime_BSM2" SG_ 255 SumTorqueSel_D_TTC 0;
BA_ "GenSigTimeoutTime_CADM" SG_ 255 SumTorqueSel_D_TTC 0;
BA_ "GenSigTimeoutTime_CVPAM" SG_ 255 SumTorqueSel_D_TTC 0;
BA_ "GenSigTimeoutTime_ECM" SG_ 255 SumTorqueSel_D_TTC 0;
BA_ "GenSigTimeoutTime_EPS" SG_ 255 SumTorqueSel_D_TTC 0;
BA_ "GenSigTimeoutTime_EVCU2" SG_ 255 SumTorqueSel_D_TTC 0;
BA_ "GenSigTimeoutTime_ORC" SG_ 255 SumTorqueSel_D_TTC 0;
BA_ "GenSigTimeoutTime_CVADAS" SG_ 513 Brk_Thermdl 0;
BA_ "GenSigTimeoutTime_VDCM" SG_ 513 Brk_Thermdl 0;
BA_ "GenSigTimeoutTime_BSM" SG_ 513 Brk_Thermdl 0;
BA_ "GenSigTimeoutTime_BSM2" SG_ 513 Brk_Thermdl 0;
BA_ "GenSigTimeoutTime_CVPAM" SG_ 513 Brk_Thermdl 0;
BA_ "GenSigTimeoutTime_ECM" SG_ 513 Brk_Thermdl 0;
BA_ "GenSigTimeoutTime_EPS" SG_ 513 Brk_Thermdl 0;
BA_ "GenSigTimeoutTime_ORC" SG_ 513 Brk_Thermdl 0;
BA_ "GenSigStartValue" SG_ 513 BrkTrq 32767;
BA_ "GenSigTimeoutTime_BSM" SG_ 513 BrkTrq 0;
BA_ "GenSigTimeoutTime_BSM2" SG_ 513 BrkTrq 0;
BA_ "GenSigTimeoutTime_ECM" SG_ 513 BrkTrq 0;
BA_ "GenSigTimeoutTime_EPS" SG_ 513 BrkTrq 0;
BA_ "GenSigTimeoutTime_ORC" SG_ 513 BrkTrq 0;
BA_ "GenSigTimeoutTime_CVADAS" SG_ 513 BrkTrq 0;
BA_ "GenSigTimeoutTime_VDCM" SG_ 513 BrkTrq 0;
BA_ "GenSigTimeoutTime_BSM" SG_ 255 SumTorqueMin 0;
BA_ "GenSigTimeoutTime_BSM2" SG_ 255 SumTorqueMin 0;
BA_ "GenSigTimeoutTime_CADM" SG_ 255 SumTorqueMin 0;
BA_ "GenSigTimeoutTime_CVPAM" SG_ 255 SumTorqueMin 0;
BA_ "GenSigTimeoutTime_ECM" SG_ 255 SumTorqueMin 0;
BA_ "GenSigTimeoutTime_EPS" SG_ 255 SumTorqueMin 0;
BA_ "GenSigTimeoutTime_EVCU2" SG_ 255 SumTorqueMin 0;
BA_ "GenSigTimeoutTime_ORC" SG_ 255 SumTorqueMin 0;
BA_ "GenSigTimeoutTime_BSM" SG_ 255 SumTorqueMax 0;
BA_ "GenSigTimeoutTime_BSM2" SG_ 255 SumTorqueMax 0;
BA_ "GenSigTimeoutTime_CADM" SG_ 255 SumTorqueMax 0;
BA_ "GenSigTimeoutTime_CVPAM" SG_ 255 SumTorqueMax 0;
BA_ "GenSigTimeoutTime_ECM" SG_ 255 SumTorqueMax 0;
BA_ "GenSigTimeoutTime_EPS" SG_ 255 SumTorqueMax 0;
BA_ "GenSigTimeoutTime_EVCU2" SG_ 255 SumTorqueMax 0;
BA_ "GenSigTimeoutTime_ORC" SG_ 255 SumTorqueMax 0;
BA_ "GenSigTimeoutTime_BSM" SG_ 255 SumTorque_DrvReqMod 0;
BA_ "GenSigTimeoutTime_BSM2" SG_ 255 SumTorque_DrvReqMod 0;
BA_ "GenSigTimeoutTime_CADM" SG_ 255 SumTorque_DrvReqMod 0;
BA_ "GenSigTimeoutTime_CVPAM" SG_ 255 SumTorque_DrvReqMod 0;
BA_ "GenSigTimeoutTime_ECM" SG_ 255 SumTorque_DrvReqMod 0;
BA_ "GenSigTimeoutTime_EPS" SG_ 255 SumTorque_DrvReqMod 0;
BA_ "GenSigTimeoutTime_EVCU2" SG_ 255 SumTorque_DrvReqMod 0;
BA_ "GenSigTimeoutTime_ORC" SG_ 255 SumTorque_DrvReqMod 0;
BA_ "GenSigStartValue" SG_ 513 BrkTrq_Driver 32767;
BA_ "GenSigTimeoutTime_BSM" SG_ 513 BrkTrq_Driver 0;
BA_ "GenSigTimeoutTime_ECM" SG_ 513 BrkTrq_Driver 0;
BA_ "GenSigTimeoutTime_EPS" SG_ 513 BrkTrq_Driver 0;
BA_ "GenSigTimeoutTime_CVADAS" SG_ 513 BrkTrq_Driver 0;
BA_ "GenSigTimeoutTime_VDCM" SG_ 513 BrkTrq_Driver 0;
BA_ "GenSigTimeoutTime_CVADAS" SG_ 513 ExternalBrkRequestsDisabled 0;
BA_ "GenSigTimeoutTime_VDCM" SG_ 513 ExternalBrkRequestsDisabled 0;
BA_ "GenSigTimeoutTime_MPAD" SG_ 513 GrMax_Rq_BSM 0;
BA_ "GenSigTimeoutTime_ADCAM" SG_ 513 GrMax_Rq_BSM 0;
BA_ "GenSigTimeoutTime_CVADAS" SG_ 513 GrMax_Rq_BSM 0;
BA_ "GenSigTimeoutTime_VDCM" SG_ 513 GrMax_Rq_BSM 0;
BA_ "GenSigTimeoutTime_EVCU2" SG_ 513 GrMax_Rq_BSM 0;
BA_ "GenSigTimeoutTime_CVADAS" SG_ 513 VehicleStandStillSts 0;
BA_ "GenSigTimeoutTime_VDCM" SG_ 513 VehicleStandStillSts 0;
BA_ "GenSigTimeoutTime_MPAD" SG_ 513 GrMin_Rq_BSM 0;
BA_ "GenSigTimeoutTime_ADCAM" SG_ 513 GrMin_Rq_BSM 0;
BA_ "GenSigTimeoutTime_CVADAS" SG_ 513 GrMin_Rq_BSM 0;
BA_ "GenSigTimeoutTime_VDCM" SG_ 513 GrMin_Rq_BSM 0;
BA_ "GenSigTimeoutTime_BSM" SG_ 513 GrMin_Rq_BSM 0;
BA_ "GenSigTimeoutTime_BSM2" SG_ 513 GrMin_Rq_BSM 0;
BA_ "GenSigTimeoutTime_CADM" SG_ 513 GrMin_Rq_BSM 0;
BA_ "GenSigTimeoutTime_CVPAM" SG_ 513 GrMin_Rq_BSM 0;
BA_ "GenSigTimeoutTime_ECM" SG_ 513 GrMin_Rq_BSM 0;
BA_ "GenSigTimeoutTime_EPS" SG_ 513 GrMin_Rq_BSM 0;
BA_ "GenSigTimeoutTime_EVCU2" SG_ 513 GrMin_Rq_BSM 0;
BA_ "GenSigTimeoutTime_ORC" SG_ 513 GrMin_Rq_BSM 0;
BA_ "GenSigTimeoutTime_VDCM" SG_ 259 LHF_FastPulseCounter 0;
BA_ "GenSigTimeoutTime_BSM" SG_ 259 LHF_FastPulseCounter 0;
BA_ "GenSigTimeoutTime_ECM" SG_ 259 LHF_FastPulseCounter 0;
BA_ "GenSigTimeoutTime_ORC" SG_ 259 LHF_FastPulseCounter 0;
BA_ "GenSigTimeoutTime_VDCM" SG_ 259 LHF_WheelSensorFailSts 0;
BA_ "GenSigTimeoutTime_BSM" SG_ 259 LHF_WheelSensorFailSts 0;
BA_ "GenSigTimeoutTime_ECM" SG_ 259 LHF_WheelSensorFailSts 0;
BA_ "GenSigTimeoutTime_ORC" SG_ 259 LHF_WheelSensorFailSts 0;
BA_ "GenSigStartValue" SG_ 513 VehicleStandStillSts 1;
BA_ "GenSigTimeoutTime_BSM" SG_ 513 VehicleStandStillSts 0;
BA_ "GenSigTimeoutTime_ECM" SG_ 513 VehicleStandStillSts 0;
BA_ "GenSigTimeoutTime_EPS" SG_ 513 VehicleStandStillSts 0;
BA_ "GenSigTimeoutTime_EVCU2" SG_ 513 VehicleStandStillSts 0;
BA_ "GenSigTimeoutTime_ORC" SG_ 513 VehicleStandStillSts 0;
BA_ "GenSigTimeoutTime_BSM" SG_ 513 GrMax_Rq_BSM 0;
BA_ "GenSigTimeoutTime_BSM2" SG_ 513 GrMax_Rq_BSM 0;
BA_ "GenSigTimeoutTime_CVPAM" SG_ 513 GrMax_Rq_BSM 0;
BA_ "GenSigTimeoutTime_ECM" SG_ 513 GrMax_Rq_BSM 0;
BA_ "GenSigTimeoutTime_EPS" SG_ 513 GrMax_Rq_BSM 0;
BA_ "GenSigTimeoutTime_ORC" SG_ 513 GrMax_Rq_BSM 0;
BA_ "GenSigTimeoutTime_BSM" SG_ 513 ExternalBrkRequestsDisabled 0;
BA_ "GenSigTimeoutTime_BSM2" SG_ 513 ExternalBrkRequestsDisabled 0;
BA_ "GenSigTimeoutTime_ECM" SG_ 513 ExternalBrkRequestsDisabled 0;
BA_ "GenSigTimeoutTime_EPS" SG_ 513 ExternalBrkRequestsDisabled 0;
BA_ "GenSigTimeoutTime_ORC" SG_ 513 ExternalBrkRequestsDisabled 0;
BA_ "GenSigTimeoutTime_ORC" SG_ 513 BrkTrq_Driver 0;
BA_ "GenSigTimeoutTime_VDCM" SG_ 259 LHR_FastPulseCounter 0;
BA_ "GenSigTimeoutTime_BSM" SG_ 259 LHR_FastPulseCounter 0;
BA_ "GenSigTimeoutTime_ECM" SG_ 259 LHR_FastPulseCounter 0;
BA_ "GenSigTimeoutTime_ORC" SG_ 259 LHR_FastPulseCounter 0;
BA_ "GenSigTimeoutTime_CVADAS" SG_ 259 LHR_Spin 0;
BA_ "GenSigTimeoutTime_VDCM" SG_ 259 LHR_Spin 0;
BA_ "GenSigTimeoutTime_BSM" SG_ 259 LHR_Spin 0;
BA_ "GenSigTimeoutTime_ECM" SG_ 259 LHR_Spin 0;
BA_ "GenSigTimeoutTime_EPS" SG_ 259 LHR_Spin 0;
BA_ "GenSigTimeoutTime_ORC" SG_ 259 LHR_Spin 0;
BA_ "GenSigTimeoutTime_VDCM" SG_ 259 LHR_WheelSensorFailSts 0;
BA_ "GenSigTimeoutTime_BSM" SG_ 259 LHR_WheelSensorFailSts 0;
BA_ "GenSigTimeoutTime_ECM" SG_ 259 LHR_WheelSensorFailSts 0;
BA_ "GenSigTimeoutTime_ORC" SG_ 259 LHR_WheelSensorFailSts 0;
BA_ "GenSigTimeoutTime_VDCM" SG_ 259 RHF_FastPulseCounter 0;
BA_ "GenSigTimeoutTime_BSM" SG_ 259 RHF_FastPulseCounter 0;
BA_ "GenSigTimeoutTime_ECM" SG_ 259 RHF_FastPulseCounter 0;
BA_ "GenSigTimeoutTime_ORC" SG_ 259 RHF_FastPulseCounter 0;
BA_ "GenSigTimeoutTime_VDCM" SG_ 259 RHF_WheelSensorFailSts 0;
BA_ "GenSigTimeoutTime_BSM" SG_ 259 RHF_WheelSensorFailSts 0;
BA_ "GenSigTimeoutTime_ECM" SG_ 259 RHF_WheelSensorFailSts 0;
BA_ "GenSigTimeoutTime_ORC" SG_ 259 RHF_WheelSensorFailSts 0;
BA_ "GenSigTimeoutTime_VDCM" SG_ 259 RHR_FastPulseCounter 0;
BA_ "GenSigTimeoutTime_BSM" SG_ 259 RHR_FastPulseCounter 0;
BA_ "GenSigTimeoutTime_ECM" SG_ 259 RHR_FastPulseCounter 0;
BA_ "GenSigTimeoutTime_ORC" SG_ 259 RHR_FastPulseCounter 0;
BA_ "GenSigTimeoutTime_CVADAS" SG_ 259 RHR_Spin 0;
BA_ "GenSigTimeoutTime_VDCM" SG_ 259 RHR_Spin 0;
BA_ "GenSigTimeoutTime_BSM" SG_ 259 RHR_Spin 0;
BA_ "GenSigTimeoutTime_ECM" SG_ 259 RHR_Spin 0;
BA_ "GenSigTimeoutTime_EPS" SG_ 259 RHR_Spin 0;
BA_ "GenSigTimeoutTime_ORC" SG_ 259 RHR_Spin 0;
BA_ "GenSigTimeoutTime_VDCM" SG_ 259 RHR_WheelSensorFailSts 0;
BA_ "GenSigTimeoutTime_BSM" SG_ 259 RHR_WheelSensorFailSts 0;
BA_ "GenSigTimeoutTime_ECM" SG_ 259 RHR_WheelSensorFailSts 0;
BA_ "GenSigTimeoutTime_ORC" SG_ 259 RHR_WheelSensorFailSts 0;
BA_ "GenSigTimeoutTime_MPAD" SG_ 609 ASRActive 0;
BA_ "GenSigTimeoutTime_ADCAM" SG_ 609 ASRActive 0;
BA_ "GenSigTimeoutTime_CVADAS" SG_ 609 ASRActive 0;
BA_ "GenSigTimeoutTime_VDCM" SG_ 609 ASRActive 0;
BA_ "GenSigTimeoutTime_CVADAS" SG_ 609 EPBSts 0;
BA_ "GenSigTimeoutTime_VDCM" SG_ 609 EPBSts 0;
BA_ "GenSigTimeoutTime_MPAD" SG_ 609 MSRActive 0;
BA_ "GenSigTimeoutTime_ADCAM" SG_ 609 MSRActive 0;
BA_ "GenSigTimeoutTime_CVADAS" SG_ 609 MSRActive 0;
BA_ "GenSigTimeoutTime_VDCM" SG_ 609 MSRActive 0;
BA_ "GenSigTimeoutTime_MPAD" SG_ 609 TravelDistance 0;
BA_ "GenSigTimeoutTime_ADCAM" SG_ 609 TravelDistance 0;
BA_ "GenSigTimeoutTime_CVADAS" SG_ 609 TravelDistance 0;
BA_ "GenSigTimeoutTime_VDCM" SG_ 609 TravelDistance 0;
BA_ "GenSigTimeoutTime_CVADAS" SG_ 259 CRC__BRAKE3 0;
BA_ "GenSigTimeoutTime_VDCM" SG_ 259 CRC__BRAKE3 0;
BA_ "GenSigTimeoutTime_EVCU2" SG_ 259 CRC__BRAKE3 0;
BA_ "GenSigTimeoutTime_BSM" SG_ 259 CRC__BRAKE3 0;
BA_ "GenSigTimeoutTime_ECM" SG_ 259 CRC__BRAKE3 0;
BA_ "GenSigTimeoutTime_ORC" SG_ 259 CRC__BRAKE3 0;
BA_ "GenSigTimeoutTime_VDCM" SG_ 259 LHF_Spin 0;
BA_ "GenSigTimeoutTime_BSM" SG_ 259 LHF_Spin 0;
BA_ "GenSigTimeoutTime_ECM" SG_ 259 LHF_Spin 0;
BA_ "GenSigTimeoutTime_ORC" SG_ 259 LHF_Spin 0;
BA_ "GenSigTimeoutTime_VDCM" SG_ 259 LHFWheelSpeed 0;
BA_ "GenSigTimeoutTime_BSM" SG_ 259 LHFWheelSpeed 0;
BA_ "GenSigTimeoutTime_ECM" SG_ 259 LHFWheelSpeed 0;
BA_ "GenSigTimeoutTime_ORC" SG_ 259 LHFWheelSpeed 0;
BA_ "GenSigTimeoutTime_VDCM" SG_ 259 LHRWheelSpeed 0;
BA_ "GenSigTimeoutTime_BSM" SG_ 259 LHRWheelSpeed 0;
BA_ "GenSigTimeoutTime_ECM" SG_ 259 LHRWheelSpeed 0;
BA_ "GenSigTimeoutTime_ORC" SG_ 259 LHRWheelSpeed 0;
BA_ "GenSigTimeoutTime_CVADAS" SG_ 259 MessageCounter_BRAKE3 0;
BA_ "GenSigTimeoutTime_VDCM" SG_ 259 MessageCounter_BRAKE3 0;
BA_ "GenSigTimeoutTime_EVCU2" SG_ 259 MessageCounter_BRAKE3 0;
BA_ "GenSigTimeoutTime_BSM" SG_ 259 MessageCounter_BRAKE3 0;
BA_ "GenSigTimeoutTime_ECM" SG_ 259 MessageCounter_BRAKE3 0;
BA_ "GenSigTimeoutTime_ORC" SG_ 259 MessageCounter_BRAKE3 0;
BA_ "GenSigTimeoutTime_VDCM" SG_ 259 RHF_Spin 0;
BA_ "GenSigTimeoutTime_BSM" SG_ 259 RHF_Spin 0;
BA_ "GenSigTimeoutTime_ECM" SG_ 259 RHF_Spin 0;
BA_ "GenSigTimeoutTime_ORC" SG_ 259 RHF_Spin 0;
BA_ "GenSigTimeoutTime_VDCM" SG_ 259 RHFWheelSpeed 0;
BA_ "GenSigTimeoutTime_BSM" SG_ 259 RHFWheelSpeed 0;
BA_ "GenSigTimeoutTime_ECM" SG_ 259 RHFWheelSpeed 0;
BA_ "GenSigTimeoutTime_ORC" SG_ 259 RHFWheelSpeed 0;
BA_ "GenSigTimeoutTime_VDCM" SG_ 259 RHRWheelSpeed 0;
BA_ "GenSigTimeoutTime_BSM" SG_ 259 RHRWheelSpeed 0;
BA_ "GenSigTimeoutTime_ECM" SG_ 259 RHRWheelSpeed 0;
BA_ "GenSigTimeoutTime_ORC" SG_ 259 RHRWheelSpeed 0;
BA_ "GenSigTimeoutTime_CVADAS" SG_ 609 CRC_BRAKE4 0;
BA_ "GenSigTimeoutTime_VDCM" SG_ 609 CRC_BRAKE4 0;
BA_ "GenSigTimeoutTime_EVCU2" SG_ 609 CRC_BRAKE4 0;
BA_ "GenSigTimeoutTime_CVADAS" SG_ 609 MessageCounter_BRAKE4 0;
BA_ "GenSigTimeoutTime_VDCM" SG_ 609 MessageCounter_BRAKE4 0;
BA_ "GenSigTimeoutTime_EVCU2" SG_ 609 MessageCounter_BRAKE4 0;
BA_ "GenSigTimeoutTime_CVADAS" SG_ 609 BSM_LnchAbrtSts 0;
BA_ "GenSigTimeoutTime_BSM" SG_ 609 BSM_LnchAbrtSts 0;
BA_ "GenSigTimeoutTime_BSM2" SG_ 609 BSM_LnchAbrtSts 0;
BA_ "GenSigTimeoutTime_CADM" SG_ 609 BSM_LnchAbrtSts 0;
BA_ "GenSigTimeoutTime_ECM" SG_ 609 BSM_LnchAbrtSts 0;
BA_ "GenSigTimeoutTime_EPS" SG_ 609 BSM_LnchAbrtSts 0;
BA_ "GenSigTimeoutTime_EVCU2" SG_ 609 BSM_LnchAbrtSts 0;
BA_ "GenSigTimeoutTime_ORC" SG_ 609 BSM_LnchAbrtSts 0;
BA_ "GenSigTimeoutTime_CVADAS" SG_ 609 BSM_LnchCtrl_SftBtn_SelectSts 0;
BA_ "GenSigTimeoutTime_BSM" SG_ 609 BSM_LnchCtrl_SftBtn_SelectSts 0;
BA_ "GenSigTimeoutTime_BSM2" SG_ 609 BSM_LnchCtrl_SftBtn_SelectSts 0;
BA_ "GenSigTimeoutTime_CADM" SG_ 609 BSM_LnchCtrl_SftBtn_SelectSts 0;
BA_ "GenSigTimeoutTime_ECM" SG_ 609 BSM_LnchCtrl_SftBtn_SelectSts 0;
BA_ "GenSigTimeoutTime_EPS" SG_ 609 BSM_LnchCtrl_SftBtn_SelectSts 0;
BA_ "GenSigTimeoutTime_EVCU2" SG_ 609 BSM_LnchCtrl_SftBtn_SelectSts 0;
BA_ "GenSigTimeoutTime_ORC" SG_ 609 BSM_LnchCtrl_SftBtn_SelectSts 0;
BA_ "GenSigTimeoutTime_CVADAS" SG_ 609 BSM_LnchMode 0;
BA_ "GenSigTimeoutTime_BSM" SG_ 609 BSM_LnchMode 0;
BA_ "GenSigTimeoutTime_BSM2" SG_ 609 BSM_LnchMode 0;
BA_ "GenSigTimeoutTime_CADM" SG_ 609 BSM_LnchMode 0;
BA_ "GenSigTimeoutTime_ECM" SG_ 609 BSM_LnchMode 0;
BA_ "GenSigTimeoutTime_EPS" SG_ 609 BSM_LnchMode 0;
BA_ "GenSigTimeoutTime_EVCU2" SG_ 609 BSM_LnchMode 0;
BA_ "GenSigTimeoutTime_ORC" SG_ 609 BSM_LnchMode 0;
BA_ "GenSigTimeoutTime_BSM" SG_ 609 LaunchRPMsetting_BSM 0;
BA_ "GenSigTimeoutTime_BSM2" SG_ 609 LaunchRPMsetting_BSM 0;
BA_ "GenSigTimeoutTime_CADM" SG_ 609 LaunchRPMsetting_BSM 0;
BA_ "GenSigTimeoutTime_ECM" SG_ 609 LaunchRPMsetting_BSM 0;
BA_ "GenSigTimeoutTime_EPS" SG_ 609 LaunchRPMsetting_BSM 0;
BA_ "GenSigTimeoutTime_EVCU2" SG_ 609 LaunchRPMsetting_BSM 0;
BA_ "GenSigTimeoutTime_ORC" SG_ 609 LaunchRPMsetting_BSM 0;
BA_ "GenSigTimeoutTime_ADCAM" SG_ 609 LaunchRPMsetting_BSM 0;
BA_ "GenSigTimeoutTime_CVADAS" SG_ 609 LaunchRPMsetting_BSM 0;
BA_ "GenSigTimeoutTime_VDCM" SG_ 609 LaunchRPMsetting_BSM 0;
BA_ "GenSigTimeoutTime_MPAD" SG_ 259 LongAccelerationOffset_BSM 0;
BA_ "GenSigTimeoutTime_ADCAM" SG_ 259 LongAccelerationOffset_BSM 0;
BA_ "GenSigTimeoutTime_CVADAS" SG_ 259 LongAccelerationOffset_BSM 0;
BA_ "GenSigTimeoutTime_VDCM" SG_ 259 LongAccelerationOffset_BSM 0;
BA_ "GenSigStartValue" SG_ 259 LongAccelerationOffset_BSM 255;
BA_ "GenSigTimeoutTime_BSM" SG_ 259 LongAccelerationOffset_BSM 0;
BA_ "GenSigTimeoutTime_CADM" SG_ 259 LongAccelerationOffset_BSM 0;
BA_ "GenSigTimeoutTime_ECM" SG_ 259 LongAccelerationOffset_BSM 0;
BA_ "GenSigTimeoutTime_EPS" SG_ 259 LongAccelerationOffset_BSM 0;
BA_ "GenSigTimeoutTime_ORC" SG_ 259 LongAccelerationOffset_BSM 0;
BA_ "GenSigTimeoutTime_MPAD" SG_ 259 YawRateOffset_BSM 0;
BA_ "GenSigTimeoutTime_ADCAM" SG_ 259 YawRateOffset_BSM 0;
BA_ "GenSigTimeoutTime_CVADAS" SG_ 259 YawRateOffset_BSM 0;
BA_ "GenSigTimeoutTime_VDCM" SG_ 259 YawRateOffset_BSM 0;
BA_ "GenSigStartValue" SG_ 259 YawRateOffset_BSM 255;
BA_ "GenSigTimeoutTime_BSM" SG_ 259 YawRateOffset_BSM 0;
BA_ "GenSigTimeoutTime_CADM" SG_ 259 YawRateOffset_BSM 0;
BA_ "GenSigTimeoutTime_CVPAM" SG_ 259 YawRateOffset_BSM 0;
BA_ "GenSigTimeoutTime_ECM" SG_ 259 YawRateOffset_BSM 0;
BA_ "GenSigTimeoutTime_EPS" SG_ 259 YawRateOffset_BSM 0;
BA_ "GenSigTimeoutTime_ORC" SG_ 259 YawRateOffset_BSM 0;
BA_ "GenSigTimeoutTime_MPAD" SG_ 259 LatAccelerationOffset_BSM 0;
BA_ "GenSigTimeoutTime_ADCAM" SG_ 259 LatAccelerationOffset_BSM 0;
BA_ "GenSigTimeoutTime_CVADAS" SG_ 259 LatAccelerationOffset_BSM 0;
BA_ "GenSigTimeoutTime_VDCM" SG_ 259 LatAccelerationOffset_BSM 0;
BA_ "GenSigStartValue" SG_ 259 LatAccelerationOffset_BSM 255;
BA_ "GenSigTimeoutTime_BSM" SG_ 259 LatAccelerationOffset_BSM 0;
BA_ "GenSigTimeoutTime_CADM" SG_ 259 LatAccelerationOffset_BSM 0;
BA_ "GenSigTimeoutTime_ECM" SG_ 259 LatAccelerationOffset_BSM 0;
BA_ "GenSigTimeoutTime_EPS" SG_ 259 LatAccelerationOffset_BSM 0;
BA_ "GenSigTimeoutTime_ORC" SG_ 259 LatAccelerationOffset_BSM 0;
BA_ "GenSigTimeoutTime_CVADAS" SG_ 259 LwsAngleOffset_BSM 0;
BA_ "GenSigTimeoutTime_VDCM" SG_ 259 LwsAngleOffset_BSM 0;
BA_ "GenSigStartValue" SG_ 259 LwsAngleOffset_BSM 1023;
BA_ "GenSigTimeoutTime_BSM" SG_ 259 LwsAngleOffset_BSM 0;
BA_ "GenSigTimeoutTime_CVPAM" SG_ 259 LwsAngleOffset_BSM 0;
BA_ "GenSigTimeoutTime_ECM" SG_ 259 LwsAngleOffset_BSM 0;
BA_ "GenSigTimeoutTime_EPS" SG_ 259 LwsAngleOffset_BSM 0;
BA_ "GenSigTimeoutTime_EVCU2" SG_ 259 LwsAngleOffset_BSM 0;
BA_ "GenSigTimeoutTime_ORC" SG_ 259 LwsAngleOffset_BSM 0;
BA_ "GenSigTimeoutTime_MPAD" SG_ 609 ESC_OFF_Hrd_Sft_Button_sts 0;
BA_ "GenSigTimeoutTime_ADCAM" SG_ 609 ESC_OFF_Hrd_Sft_Button_sts 0;
BA_ "GenSigTimeoutTime_CVADAS" SG_ 609 ESC_OFF_Hrd_Sft_Button_sts 0;
BA_ "GenSigTimeoutTime_VDCM" SG_ 609 ESC_OFF_Hrd_Sft_Button_sts 0;
BA_ "GenSigTimeoutTime_BSM" SG_ 609 ESC_OFF_Hrd_Sft_Button_sts 0;
BA_ "GenSigTimeoutTime_BSM2" SG_ 609 ESC_OFF_Hrd_Sft_Button_sts 0;
BA_ "GenSigTimeoutTime_CADM" SG_ 609 ESC_OFF_Hrd_Sft_Button_sts 0;
BA_ "GenSigTimeoutTime_CVPAM" SG_ 609 ESC_OFF_Hrd_Sft_Button_sts 0;
BA_ "GenSigTimeoutTime_ECM" SG_ 609 ESC_OFF_Hrd_Sft_Button_sts 0;
BA_ "GenSigTimeoutTime_EPS" SG_ 609 ESC_OFF_Hrd_Sft_Button_sts 0;
BA_ "GenSigTimeoutTime_EVCU2" SG_ 609 ESC_OFF_Hrd_Sft_Button_sts 0;
BA_ "GenSigTimeoutTime_ORC" SG_ 609 ESC_OFF_Hrd_Sft_Button_sts 0;
BA_ "GenSigTimeoutTime_MPAD" SG_ 514 BSM_HEALTH_CHECK 0;
BA_ "GenSigTimeoutTime_ADCAM" SG_ 514 BSM_HEALTH_CHECK 0;
BA_ "GenSigTimeoutTime_CVADAS" SG_ 514 BSM_HEALTH_CHECK 0;
BA_ "GenSigSendType" SG_ 1155 ESC_TRSC_Brk_Resp 3;
BA_ "GenSigTimeoutTime_BSM" SG_ 1155 ESC_TRSC_Brk_Resp 0;
BA_ "GenSigTimeoutTime_BSM2" SG_ 1155 ESC_TRSC_Brk_Resp 0;
BA_ "GenSigTimeoutTime_CADM" SG_ 1155 ESC_TRSC_Brk_Resp 0;
BA_ "GenSigTimeoutTime_ECM" SG_ 1155 ESC_TRSC_Brk_Resp 0;
BA_ "GenSigTimeoutTime_EPS" SG_ 1155 ESC_TRSC_Brk_Resp 0;
BA_ "GenSigTimeoutTime_EVCU2" SG_ 1155 ESC_TRSC_Brk_Resp 0;
BA_ "GenSigTimeoutTime_ORC" SG_ 1155 ESC_TRSC_Brk_Resp 0;
BA_ "GenSigSendType" SG_ 1155 BSM_THA_Brk_Resp 4;
BA_ "GenSigTimeoutTime_BSM" SG_ 1155 BSM_THA_Brk_Resp 0;
BA_ "GenSigTimeoutTime_BSM2" SG_ 1155 BSM_THA_Brk_Resp 0;
BA_ "GenSigTimeoutTime_CADM" SG_ 1155 BSM_THA_Brk_Resp 0;
BA_ "GenSigTimeoutTime_ECM" SG_ 1155 BSM_THA_Brk_Resp 0;
BA_ "GenSigTimeoutTime_EPS" SG_ 1155 BSM_THA_Brk_Resp 0;
BA_ "GenSigTimeoutTime_EVCU2" SG_ 1155 BSM_THA_Brk_Resp 0;
BA_ "GenSigTimeoutTime_ORC" SG_ 1155 BSM_THA_Brk_Resp 0;
BA_ "GenSigTimeoutTime_CVADAS" SG_ 1155 FunctionSts 0;
BA_ "GenSigTimeoutTime_VDCM" SG_ 1155 FunctionSts 0;
BA_ "GenSigSendType" SG_ 1155 FunctionSts 3;
BA_ "GenSigTimeoutTime_BSM" SG_ 1155 FunctionSts 0;
BA_ "GenSigTimeoutTime_BSM2" SG_ 1155 FunctionSts 0;
BA_ "GenSigTimeoutTime_CVPAM" SG_ 1155 FunctionSts 0;
BA_ "GenSigTimeoutTime_ECM" SG_ 1155 FunctionSts 0;
BA_ "GenSigTimeoutTime_EPS" SG_ 1155 FunctionSts 0;
BA_ "GenSigTimeoutTime_EVCU2" SG_ 1155 FunctionSts 0;
BA_ "GenSigTimeoutTime_ORC" SG_ 1155 FunctionSts 0;
BA_ "GenSigTimeoutTime_BSM" SG_ 609 MessageCounter_BRAKE4 0;
BA_ "GenSigTimeoutTime_BSM2" SG_ 609 MessageCounter_BRAKE4 0;
BA_ "GenSigTimeoutTime_ECM" SG_ 609 MessageCounter_BRAKE4 0;
BA_ "GenSigTimeoutTime_EPS" SG_ 609 MessageCounter_BRAKE4 0;
BA_ "GenSigTimeoutTime_ORC" SG_ 609 MessageCounter_BRAKE4 0;
BA_ "GenSigTimeoutTime_MPAD" SG_ 1155 CRC_BRAKE5 0;
BA_ "GenSigTimeoutTime_CVADAS" SG_ 1155 CRC_BRAKE5 0;
BA_ "GenSigTimeoutTime_VDCM" SG_ 1155 CRC_BRAKE5 0;
BA_ "GenSigTimeoutTime_ECM" SG_ 1155 CRC_BRAKE5 0;
BA_ "GenSigTimeoutTime_EVCU2" SG_ 1155 CRC_BRAKE5 0;
BA_ "GenSigTimeoutTime_BSM" SG_ 1155 CRC_BRAKE5 0;
BA_ "GenSigTimeoutTime_EPS" SG_ 1155 CRC_BRAKE5 0;
BA_ "GenSigTimeoutTime_ORC" SG_ 1155 CRC_BRAKE5 0;
BA_ "GenSigTimeoutTime_BSM" SG_ 609 CRC_BRAKE4 0;
BA_ "GenSigTimeoutTime_BSM2" SG_ 609 CRC_BRAKE4 0;
BA_ "GenSigTimeoutTime_ECM" SG_ 609 CRC_BRAKE4 0;
BA_ "GenSigTimeoutTime_EPS" SG_ 609 CRC_BRAKE4 0;
BA_ "GenSigTimeoutTime_ORC" SG_ 609 CRC_BRAKE4 0;
BA_ "GenSigTimeoutTime_MPAD" SG_ 514 CRC_BRAKE7 0;
BA_ "GenSigTimeoutTime_CVADAS" SG_ 514 CRC_BRAKE7 0;
BA_ "GenSigTimeoutTime_VDCM" SG_ 514 CRC_BRAKE7 0;
BA_ "GenSigTimeoutTime_MPAD" SG_ 514 MessageCounter_BRAKE7 0;
BA_ "GenSigTimeoutTime_MPAD" SG_ 1155 MessageCounter_BRAKE5 0;
BA_ "GenSigTimeoutTime_CVADAS" SG_ 1155 MessageCounter_BRAKE5 0;
BA_ "GenSigTimeoutTime_VDCM" SG_ 1155 MessageCounter_BRAKE5 0;
BA_ "GenSigTimeoutTime_ECM" SG_ 1155 MessageCounter_BRAKE5 0;
BA_ "GenSigTimeoutTime_EVCU2" SG_ 1155 MessageCounter_BRAKE5 0;
BA_ "GenSigTimeoutTime_BSM" SG_ 1155 MessageCounter_BRAKE5 0;
BA_ "GenSigTimeoutTime_EPS" SG_ 1155 MessageCounter_BRAKE5 0;
BA_ "GenSigTimeoutTime_ORC" SG_ 1155 MessageCounter_BRAKE5 0;
BA_ "GenSigTimeoutTime_MPAD" SG_ 514 BrakePdlPosn 0;
BA_ "GenSigTimeoutTime_ADCAM" SG_ 514 BrakePdlPosn 0;
BA_ "GenSigTimeoutTime_CVADAS" SG_ 514 BrakePdlPosn 0;
BA_ "GenSigTimeoutTime_VDCM" SG_ 514 BrakePdlPosn 0;
BA_ "GenSigTimeoutTime_CVADAS" SG_ 514 BrkPdl_Flt 0;
BA_ "GenSigTimeoutTime_VDCM" SG_ 514 BrkPdl_Flt 0;
BA_ "GenSigTimeoutTime_CVADAS" SG_ 514 BrkPdl_Stat 0;
BA_ "GenSigTimeoutTime_VDCM" SG_ 514 BrkPdl_Stat 0;
BA_ "GenSigTimeoutTime_BSM" SG_ 609 TravelDistance 0;
BA_ "GenSigTimeoutTime_BSM2" SG_ 609 TravelDistance 0;
BA_ "GenSigTimeoutTime_CADM" SG_ 609 TravelDistance 0;
BA_ "GenSigTimeoutTime_CVPAM" SG_ 609 TravelDistance 0;
BA_ "GenSigTimeoutTime_ECM" SG_ 609 TravelDistance 0;
BA_ "GenSigTimeoutTime_EPS" SG_ 609 TravelDistance 0;
BA_ "GenSigTimeoutTime_EVCU2" SG_ 609 TravelDistance 0;
BA_ "GenSigTimeoutTime_ORC" SG_ 609 TravelDistance 0;
BA_ "GenSigTimeoutTime_MPAD" SG_ 1155 ACCEngaged 0;
BA_ "GenSigTimeoutTime_ADCAM" SG_ 1155 ACCEngaged 0;
BA_ "GenSigTimeoutTime_CVADAS" SG_ 1155 ACCEngaged 0;
BA_ "GenSigTimeoutTime_VDCM" SG_ 1155 ACCEngaged 0;
BA_ "GenSigSendType" SG_ 1155 ACCEngaged 3;
BA_ "GenSigTimeoutTime_BSM" SG_ 1155 ACCEngaged 0;
BA_ "GenSigTimeoutTime_BSM2" SG_ 1155 ACCEngaged 0;
BA_ "GenSigTimeoutTime_CADM" SG_ 1155 ACCEngaged 0;
BA_ "GenSigTimeoutTime_CVPAM" SG_ 1155 ACCEngaged 0;
BA_ "GenSigTimeoutTime_ECM" SG_ 1155 ACCEngaged 0;
BA_ "GenSigTimeoutTime_EPS" SG_ 1155 ACCEngaged 0;
BA_ "GenSigTimeoutTime_ORC" SG_ 1155 ACCEngaged 0;
BA_ "GenSigTimeoutTime_CVADAS" SG_ 1155 BSMSysSts 0;
BA_ "GenSigTimeoutTime_VDCM" SG_ 1155 BSMSysSts 0;
BA_ "GenSigSendType" SG_ 1155 BSMSysSts 3;
BA_ "GenSigTimeoutTime_BSM" SG_ 1155 BSMSysSts 0;
BA_ "GenSigTimeoutTime_BSM2" SG_ 1155 BSMSysSts 0;
BA_ "GenSigTimeoutTime_CVPAM" SG_ 1155 BSMSysSts 0;
BA_ "GenSigTimeoutTime_ECM" SG_ 1155 BSMSysSts 0;
BA_ "GenSigTimeoutTime_EPS" SG_ 1155 BSMSysSts 0;
BA_ "GenSigTimeoutTime_EVCU2" SG_ 1155 BSMSysSts 0;
BA_ "GenSigTimeoutTime_ORC" SG_ 1155 BSMSysSts 0;
BA_ "GenSigSendType" SG_ 609 MSRActive 3;
BA_ "GenSigTimeoutTime_BSM" SG_ 609 MSRActive 0;
BA_ "GenSigTimeoutTime_BSM2" SG_ 609 MSRActive 0;
BA_ "GenSigTimeoutTime_CADM" SG_ 609 MSRActive 0;
BA_ "GenSigTimeoutTime_CVPAM" SG_ 609 MSRActive 0;
BA_ "GenSigTimeoutTime_ECM" SG_ 609 MSRActive 0;
BA_ "GenSigTimeoutTime_EPS" SG_ 609 MSRActive 0;
BA_ "GenSigTimeoutTime_ORC" SG_ 609 MSRActive 0;
BA_ "GenSigTimeoutTime_MPAD" SG_ 1155 ABSFailSts 0;
BA_ "GenSigTimeoutTime_ADCAM" SG_ 1155 ABSFailSts 0;
BA_ "GenSigTimeoutTime_CVADAS" SG_ 1155 ABSFailSts 0;
BA_ "GenSigTimeoutTime_VDCM" SG_ 1155 ABSFailSts 0;
BA_ "GenSigSendType" SG_ 1155 ABSFailSts 3;
BA_ "GenSigTimeoutTime_BSM" SG_ 1155 ABSFailSts 0;
BA_ "GenSigTimeoutTime_BSM2" SG_ 1155 ABSFailSts 0;
BA_ "GenSigTimeoutTime_CADM" SG_ 1155 ABSFailSts 0;
BA_ "GenSigTimeoutTime_EPS" SG_ 1155 ABSFailSts 0;
BA_ "GenSigTimeoutTime_ORC" SG_ 1155 ABSFailSts 0;
BA_ "GenSigSendType" SG_ 609 EPBSts 3;
BA_ "GenSigTimeoutTime_BSM" SG_ 609 EPBSts 0;
BA_ "GenSigTimeoutTime_BSM2" SG_ 609 EPBSts 0;
BA_ "GenSigTimeoutTime_ECM" SG_ 609 EPBSts 0;
BA_ "GenSigTimeoutTime_EPS" SG_ 609 EPBSts 0;
BA_ "GenSigTimeoutTime_ORC" SG_ 609 EPBSts 0;
BA_ "GenSigSendType" SG_ 609 ASRActive 3;
BA_ "GenSigTimeoutTime_BSM" SG_ 609 ASRActive 0;
BA_ "GenSigTimeoutTime_BSM2" SG_ 609 ASRActive 0;
BA_ "GenSigTimeoutTime_CADM" SG_ 609 ASRActive 0;
BA_ "GenSigTimeoutTime_ECM" SG_ 609 ASRActive 0;
BA_ "GenSigTimeoutTime_EPS" SG_ 609 ASRActive 0;
BA_ "GenSigTimeoutTime_ORC" SG_ 609 ASRActive 0;
BA_ "GenSigTimeoutTime_MPAD" SG_ 1155 CMMIntervention 0;
BA_ "GenSigTimeoutTime_ADCAM" SG_ 1155 CMMIntervention 0;
BA_ "GenSigTimeoutTime_CVADAS" SG_ 1155 CMMIntervention 0;
BA_ "GenSigTimeoutTime_VDCM" SG_ 1155 CMMIntervention 0;
BA_ "GenSigTimeoutTime_ECM" SG_ 1155 CMMIntervention 0;
BA_ "GenSigSendType" SG_ 1155 CMMIntervention 3;
BA_ "GenSigTimeoutTime_BSM" SG_ 1155 CMMIntervention 0;
BA_ "GenSigTimeoutTime_BSM2" SG_ 1155 CMMIntervention 0;
BA_ "GenSigTimeoutTime_CADM" SG_ 1155 CMMIntervention 0;
BA_ "GenSigTimeoutTime_CVPAM" SG_ 1155 CMMIntervention 0;
BA_ "GenSigTimeoutTime_EPS" SG_ 1155 CMMIntervention 0;
BA_ "GenSigTimeoutTime_EVCU2" SG_ 1155 CMMIntervention 0;
BA_ "GenSigTimeoutTime_ORC" SG_ 1155 CMMIntervention 0;
BA_ "GenSigTimeoutTime_MPAD" SG_ 1155 EBDFailSts 0;
BA_ "GenSigTimeoutTime_ADCAM" SG_ 1155 EBDFailSts 0;
BA_ "GenSigTimeoutTime_CVADAS" SG_ 1155 EBDFailSts 0;
BA_ "GenSigTimeoutTime_VDCM" SG_ 1155 EBDFailSts 0;
BA_ "GenSigSendType" SG_ 1155 EBDFailSts 3;
BA_ "GenSigTimeoutTime_BSM" SG_ 1155 EBDFailSts 0;
BA_ "GenSigTimeoutTime_BSM2" SG_ 1155 EBDFailSts 0;
BA_ "GenSigTimeoutTime_CADM" SG_ 1155 EBDFailSts 0;
BA_ "GenSigTimeoutTime_CVPAM" SG_ 1155 EBDFailSts 0;
BA_ "GenSigTimeoutTime_ECM" SG_ 1155 EBDFailSts 0;
BA_ "GenSigTimeoutTime_EPS" SG_ 1155 EBDFailSts 0;
BA_ "GenSigTimeoutTime_EVCU2" SG_ 1155 EBDFailSts 0;
BA_ "GenSigTimeoutTime_ORC" SG_ 1155 EBDFailSts 0;
BA_ "GenSigTimeoutTime_MPAD" SG_ 1155 ERMActive 0;
BA_ "GenSigTimeoutTime_ADCAM" SG_ 1155 ERMActive 0;
BA_ "GenSigTimeoutTime_CVADAS" SG_ 1155 ERMActive 0;
BA_ "GenSigTimeoutTime_VDCM" SG_ 1155 ERMActive 0;
BA_ "GenSigSendType" SG_ 1155 ERMActive 3;
BA_ "GenSigTimeoutTime_BSM" SG_ 1155 ERMActive 0;
BA_ "GenSigTimeoutTime_BSM2" SG_ 1155 ERMActive 0;
BA_ "GenSigTimeoutTime_CADM" SG_ 1155 ERMActive 0;
BA_ "GenSigTimeoutTime_CVPAM" SG_ 1155 ERMActive 0;
BA_ "GenSigTimeoutTime_ECM" SG_ 1155 ERMActive 0;
BA_ "GenSigTimeoutTime_EPS" SG_ 1155 ERMActive 0;
BA_ "GenSigTimeoutTime_EVCU2" SG_ 1155 ERMActive 0;
BA_ "GenSigTimeoutTime_ORC" SG_ 1155 ERMActive 0;
BA_ "GenSigTimeoutTime_CVADAS" SG_ 1155 ESCFailSts 0;
BA_ "GenSigTimeoutTime_VDCM" SG_ 1155 ESCFailSts 0;
BA_ "GenSigSendType" SG_ 1155 ESCFailSts 3;
BA_ "GenSigTimeoutTime_BSM" SG_ 1155 ESCFailSts 0;
BA_ "GenSigTimeoutTime_BSM2" SG_ 1155 ESCFailSts 0;
BA_ "GenSigTimeoutTime_ECM" SG_ 1155 ESCFailSts 0;
BA_ "GenSigTimeoutTime_EPS" SG_ 1155 ESCFailSts 0;
BA_ "GenSigTimeoutTime_ORC" SG_ 1155 ESCFailSts 0;
BA_ "GenSigSendType" SG_ 1155 RollsModeAct 3;
BA_ "GenSigTimeoutTime_BSM" SG_ 1155 RollsModeAct 0;
BA_ "GenSigTimeoutTime_CVPAM" SG_ 1155 RollsModeAct 0;
BA_ "GenSigTimeoutTime_ECM" SG_ 1155 RollsModeAct 0;
BA_ "GenSigTimeoutTime_EPS" SG_ 1155 RollsModeAct 0;
BA_ "GenSigTimeoutTime_ORC" SG_ 1155 RollsModeAct 0;
BA_ "GenSigTimeoutTime_CVADAS" SG_ 1155 RollsModeAct 0;
BA_ "GenSigTimeoutTime_VDCM" SG_ 1155 RollsModeAct 0;
BA_ "GenSigSendType" SG_ 1155 TSCActive 3;
BA_ "GenSigTimeoutTime_BSM" SG_ 1155 TSCActive 0;
BA_ "GenSigTimeoutTime_BSM2" SG_ 1155 TSCActive 0;
BA_ "GenSigTimeoutTime_CADM" SG_ 1155 TSCActive 0;
BA_ "GenSigTimeoutTime_CVPAM" SG_ 1155 TSCActive 0;
BA_ "GenSigTimeoutTime_ECM" SG_ 1155 TSCActive 0;
BA_ "GenSigTimeoutTime_EPS" SG_ 1155 TSCActive 0;
BA_ "GenSigTimeoutTime_EVCU2" SG_ 1155 TSCActive 0;
BA_ "GenSigTimeoutTime_ORC" SG_ 1155 TSCActive 0;
BA_ "GenSigTimeoutTime_MPAD" SG_ 1155 TSCActive 0;
BA_ "GenSigTimeoutTime_ADCAM" SG_ 1155 TSCActive 0;
BA_ "GenSigTimeoutTime_CVADAS" SG_ 1155 TSCActive 0;
BA_ "GenSigTimeoutTime_VDCM" SG_ 1155 TSCActive 0;
BA_ "GenSigTimeoutTime_MPAD" SG_ 1155 FunctionIntervention 0;
BA_ "GenSigTimeoutTime_ADCAM" SG_ 1155 FunctionIntervention 0;
BA_ "GenSigTimeoutTime_CVADAS" SG_ 1155 FunctionIntervention 0;
BA_ "GenSigTimeoutTime_VDCM" SG_ 1155 FunctionIntervention 0;
BA_ "GenSigSendType" SG_ 1155 FunctionIntervention 3;
BA_ "GenSigTimeoutTime_BSM" SG_ 1155 FunctionIntervention 0;
BA_ "GenSigTimeoutTime_BSM2" SG_ 1155 FunctionIntervention 0;
BA_ "GenSigTimeoutTime_CADM" SG_ 1155 FunctionIntervention 0;
BA_ "GenSigTimeoutTime_CVPAM" SG_ 1155 FunctionIntervention 0;
BA_ "GenSigTimeoutTime_ECM" SG_ 1155 FunctionIntervention 0;
BA_ "GenSigTimeoutTime_EPS" SG_ 1155 FunctionIntervention 0;
BA_ "GenSigTimeoutTime_EVCU2" SG_ 1155 FunctionIntervention 0;
BA_ "GenSigTimeoutTime_ORC" SG_ 1155 FunctionIntervention 0;
BA_ "GenSigTimeoutTime_MPAD" SG_ 1155 Function2Sts 0;
BA_ "GenSigTimeoutTime_ADCAM" SG_ 1155 Function2Sts 0;
BA_ "GenSigTimeoutTime_CVADAS" SG_ 1155 Function2Sts 0;
BA_ "GenSigTimeoutTime_VDCM" SG_ 1155 Function2Sts 0;
BA_ "GenSigSendType" SG_ 1155 Function2Sts 3;
BA_ "GenSigTimeoutTime_BSM" SG_ 1155 Function2Sts 0;
BA_ "GenSigTimeoutTime_BSM2" SG_ 1155 Function2Sts 0;
BA_ "GenSigTimeoutTime_CADM" SG_ 1155 Function2Sts 0;
BA_ "GenSigTimeoutTime_CVPAM" SG_ 1155 Function2Sts 0;
BA_ "GenSigTimeoutTime_ECM" SG_ 1155 Function2Sts 0;
BA_ "GenSigTimeoutTime_EPS" SG_ 1155 Function2Sts 0;
BA_ "GenSigTimeoutTime_EVCU2" SG_ 1155 Function2Sts 0;
BA_ "GenSigTimeoutTime_ORC" SG_ 1155 Function2Sts 0;
BA_ "GenSigTimeoutTime_MPAD" SG_ 1155 FunctionFailSts 0;
BA_ "GenSigTimeoutTime_ADCAM" SG_ 1155 FunctionFailSts 0;
BA_ "GenSigTimeoutTime_CVADAS" SG_ 1155 FunctionFailSts 0;
BA_ "GenSigTimeoutTime_VDCM" SG_ 1155 FunctionFailSts 0;
BA_ "GenSigSendType" SG_ 1155 FunctionFailSts 3;
BA_ "GenSigTimeoutTime_BSM" SG_ 1155 FunctionFailSts 0;
BA_ "GenSigTimeoutTime_BSM2" SG_ 1155 FunctionFailSts 0;
BA_ "GenSigTimeoutTime_CADM" SG_ 1155 FunctionFailSts 0;
BA_ "GenSigTimeoutTime_CVPAM" SG_ 1155 FunctionFailSts 0;
BA_ "GenSigTimeoutTime_ECM" SG_ 1155 FunctionFailSts 0;
BA_ "GenSigTimeoutTime_EPS" SG_ 1155 FunctionFailSts 0;
BA_ "GenSigTimeoutTime_EVCU2" SG_ 1155 FunctionFailSts 0;
BA_ "GenSigTimeoutTime_ORC" SG_ 1155 FunctionFailSts 0;
BA_ "GenSigTimeoutTime_ADCAM" SG_ 514 Brake_OpStat_Prim 0;
BA_ "GenSigTimeoutTime_CVADAS" SG_ 514 Brake_OpStat_Prim 0;
BA_ "GenSigTimeoutTime_ADCAM" SG_ 514 BSM_OpStat 0;
BA_ "GenSigTimeoutTime_CVADAS" SG_ 514 BSM_OpStat 0;
BA_ "GenSigTimeoutTime_CVADAS" SG_ 514 AEB_Type_Brk_202 0;
BA_ "GenSigTimeoutTime_VDCM" SG_ 514 AEB_Type_Brk_202 0;
BA_ "GenSigTimeoutTime_BSM" SG_ 514 AEB_Type_Brk_202 0;
BA_ "GenSigTimeoutTime_CVPAM" SG_ 514 AEB_Type_Brk_202 0;
BA_ "GenSigTimeoutTime_ECM" SG_ 514 AEB_Type_Brk_202 0;
BA_ "GenSigTimeoutTime_EPS" SG_ 514 AEB_Type_Brk_202 0;
BA_ "GenSigTimeoutTime_EVCU2" SG_ 514 AEB_Type_Brk_202 0;
BA_ "GenSigTimeoutTime_CVADAS" SG_ 264 LKA_LAT_CTRL_ResponseSts_108 0;
BA_ "GenSigTimeoutTime_VDCM" SG_ 264 LKA_LAT_CTRL_ResponseSts_108 0;
BA_ "GenSigTimeoutTime_CVADAS" SG_ 264 ESA_LAT_CTRL_ResponseSts 0;
BA_ "GenSigTimeoutTime_BSM2" SG_ 264 ESA_LAT_CTRL_ResponseSts 0;
BA_ "GenSigTimeoutTime_ECM" SG_ 264 ESA_LAT_CTRL_ResponseSts 0;
BA_ "GenSigTimeoutTime_EPS" SG_ 264 ESA_LAT_CTRL_ResponseSts 0;
BA_ "GenSigTimeoutTime_EVCU2" SG_ 264 ESA_LAT_CTRL_ResponseSts 0;
BA_ "GenSigTimeoutTime_ORC" SG_ 264 ESA_LAT_CTRL_ResponseSts 0;
BA_ "GenSigTimeoutTime_BSM" SG_ 514 BSM_OpStat 0;
BA_ "GenSigTimeoutTime_CVPAM" SG_ 514 BSM_OpStat 0;
BA_ "GenSigTimeoutTime_ECM" SG_ 514 BSM_OpStat 0;
BA_ "GenSigTimeoutTime_EPS" SG_ 514 BSM_OpStat 0;
BA_ "GenSigTimeoutTime_EVCU2" SG_ 514 BSM_OpStat 0;
BA_ "GenSigTimeoutTime_ORC" SG_ 514 BSM_OpStat 0;
BA_ "GenSigTimeoutTime_BSM" SG_ 514 Brake_OpStat_Prim 0;
BA_ "GenSigTimeoutTime_BSM2" SG_ 514 Brake_OpStat_Prim 0;
BA_ "GenSigTimeoutTime_CVPAM" SG_ 514 Brake_OpStat_Prim 0;
BA_ "GenSigTimeoutTime_ECM" SG_ 514 Brake_OpStat_Prim 0;
BA_ "GenSigTimeoutTime_EPS" SG_ 514 Brake_OpStat_Prim 0;
BA_ "GenSigTimeoutTime_EVCU2" SG_ 514 Brake_OpStat_Prim 0;
BA_ "GenSigStartValue" SG_ 264 EPS_Curr 255;
BA_ "GenSigTimeoutTime_BSM" SG_ 264 EPS_Curr 0;
BA_ "GenSigTimeoutTime_BSM2" SG_ 264 EPS_Curr 0;
BA_ "GenSigTimeoutTime_CADM" SG_ 264 EPS_Curr 0;
BA_ "GenSigTimeoutTime_CVPAM" SG_ 264 EPS_Curr 0;
BA_ "GenSigTimeoutTime_ECM" SG_ 264 EPS_Curr 0;
BA_ "GenSigTimeoutTime_EPS" SG_ 264 EPS_Curr 0;
BA_ "GenSigTimeoutTime_EVCU2" SG_ 264 EPS_Curr 0;
BA_ "GenSigTimeoutTime_ORC" SG_ 264 EPS_Curr 0;
BA_ "GenSigTimeoutTime_MPAD" SG_ 264 EPS_Curr 0;
BA_ "GenSigTimeoutTime_ADCAM" SG_ 264 EPS_Curr 0;
BA_ "GenSigTimeoutTime_CVADAS" SG_ 264 EPS_Curr 0;
BA_ "GenSigTimeoutTime_VDCM" SG_ 264 EPS_Curr 0;
BA_ "GenSigStartValue" SG_ 514 BrkPdl_Stat 3;
BA_ "GenSigTimeoutTime_BSM" SG_ 514 BrkPdl_Stat 0;
BA_ "GenSigTimeoutTime_EPS" SG_ 514 BrkPdl_Stat 0;
BA_ "GenSigTimeoutTime_ORC" SG_ 514 BrkPdl_Stat 0;
BA_ "GenSigTimeoutTime_BSM" SG_ 514 BrkPdl_Flt 0;
BA_ "GenSigTimeoutTime_BSM2" SG_ 514 BrkPdl_Flt 0;
BA_ "GenSigTimeoutTime_CVPAM" SG_ 514 BrkPdl_Flt 0;
BA_ "GenSigTimeoutTime_EPS" SG_ 514 BrkPdl_Flt 0;
BA_ "GenSigTimeoutTime_ORC" SG_ 514 BrkPdl_Flt 0;
BA_ "GenSigTimeoutTime_BSM" SG_ 514 BrakePdlPosn 0;
BA_ "GenSigTimeoutTime_CVPAM" SG_ 514 BrakePdlPosn 0;
BA_ "GenSigTimeoutTime_EPS" SG_ 514 BrakePdlPosn 0;
BA_ "GenSigTimeoutTime_ORC" SG_ 514 BrakePdlPosn 0;
BA_ "GenSigTimeoutTime_CVADAS" SG_ 514 MessageCounter_BRAKE7 0;
BA_ "GenSigTimeoutTime_VDCM" SG_ 514 MessageCounter_BRAKE7 0;
BA_ "GenSigTimeoutTime_BSM" SG_ 514 MessageCounter_BRAKE7 0;
BA_ "GenSigTimeoutTime_ECM" SG_ 514 MessageCounter_BRAKE7 0;
BA_ "GenSigTimeoutTime_EPS" SG_ 514 MessageCounter_BRAKE7 0;
BA_ "GenSigTimeoutTime_ORC" SG_ 514 MessageCounter_BRAKE7 0;
BA_ "GenSigTimeoutTime_BSM" SG_ 514 CRC_BRAKE7 0;
BA_ "GenSigTimeoutTime_ECM" SG_ 514 CRC_BRAKE7 0;
BA_ "GenSigTimeoutTime_EPS" SG_ 514 CRC_BRAKE7 0;
BA_ "GenSigTimeoutTime_ORC" SG_ 514 CRC_BRAKE7 0;
BA_ "GenSigTimeoutTime_MPAD" SG_ 514 PAM_Brk_Rq_RspSts 0;
BA_ "GenSigTimeoutTime_ADCAM" SG_ 514 PAM_Brk_Rq_RspSts 0;
BA_ "GenSigTimeoutTime_VDCM" SG_ 514 PAM_Brk_Rq_RspSts 0;
BA_ "GenSigTimeoutTime_BSM" SG_ 514 PAM_Brk_Rq_RspSts 0;
BA_ "GenSigTimeoutTime_BSM2" SG_ 514 PAM_Brk_Rq_RspSts 0;
BA_ "GenSigTimeoutTime_CADM" SG_ 514 PAM_Brk_Rq_RspSts 0;
BA_ "GenSigTimeoutTime_ECM" SG_ 514 PAM_Brk_Rq_RspSts 0;
BA_ "GenSigTimeoutTime_EPS" SG_ 514 PAM_Brk_Rq_RspSts 0;
BA_ "GenSigTimeoutTime_EVCU2" SG_ 514 PAM_Brk_Rq_RspSts 0;
BA_ "GenSigTimeoutTime_ORC" SG_ 514 PAM_Brk_Rq_RspSts 0;
BA_ "GenSigTimeoutTime_CVADAS" SG_ 518 CRC_ENGINE5 0;
BA_ "GenSigTimeoutTime_VDCM" SG_ 518 CRC_ENGINE5 0;
BA_ "GenSigTimeoutTime_BSM" SG_ 518 CRC_ENGINE5 0;
BA_ "GenSigTimeoutTime_CVPAM" SG_ 518 CRC_ENGINE5 0;
BA_ "GenSigTimeoutTime_ECM" SG_ 518 CRC_ENGINE5 0;
BA_ "GenSigTimeoutTime_EPS" SG_ 518 CRC_ENGINE5 0;
BA_ "GenSigTimeoutTime_EVCU2" SG_ 518 CRC_ENGINE5 0;
BA_ "GenSigTimeoutTime_ORC" SG_ 518 CRC_ENGINE5 0;
BA_ "GenSigTimeoutTime_CVADAS" SG_ 518 MessageCounter_ENGINE5 0;
BA_ "GenSigTimeoutTime_VDCM" SG_ 518 MessageCounter_ENGINE5 0;
BA_ "GenSigTimeoutTime_BSM" SG_ 518 MessageCounter_ENGINE5 0;
BA_ "GenSigTimeoutTime_CVPAM" SG_ 518 MessageCounter_ENGINE5 0;
BA_ "GenSigTimeoutTime_ECM" SG_ 518 MessageCounter_ENGINE5 0;
BA_ "GenSigTimeoutTime_EPS" SG_ 518 MessageCounter_ENGINE5 0;
BA_ "GenSigTimeoutTime_EVCU2" SG_ 518 MessageCounter_ENGINE5 0;
BA_ "GenSigTimeoutTime_ORC" SG_ 518 MessageCounter_ENGINE5 0;
BA_ "GenSigTimeoutTime_CVADAS" SG_ 518 PdlPosActual 0;
BA_ "GenSigTimeoutTime_VDCM" SG_ 518 PdlPosActual 0;
BA_ "GenSigStartValue" SG_ 518 PdlPosActual 1;
BA_ "GenSigTimeoutTime_ECM" SG_ 518 PdlPosActual 0;
BA_ "GenSigTimeoutTime_EPS" SG_ 518 PdlPosActual 0;
BA_ "GenSigTimeoutTime_EVCU2" SG_ 518 PdlPosActual 0;
BA_ "GenSigTimeoutTime_ORC" SG_ 518 PdlPosActual 0;
BA_ "GenSigTimeoutTime_CVADAS" SG_ 518 RPMOverRev_W 0;
BA_ "GenSigTimeoutTime_VDCM" SG_ 518 RPMOverRev_W 0;
BA_ "GenSigTimeoutTime_BSM" SG_ 518 RPMOverRev_W 0;
BA_ "GenSigTimeoutTime_BSM2" SG_ 518 RPMOverRev_W 0;
BA_ "GenSigTimeoutTime_CVPAM" SG_ 518 RPMOverRev_W 0;
BA_ "GenSigTimeoutTime_ECM" SG_ 518 RPMOverRev_W 0;
BA_ "GenSigTimeoutTime_EPS" SG_ 518 RPMOverRev_W 0;
BA_ "GenSigTimeoutTime_EVCU2" SG_ 518 RPMOverRev_W 0;
BA_ "GenSigTimeoutTime_ORC" SG_ 518 RPMOverRev_W 0;
BA_ "GenSigTimeoutTime_CVADAS" SG_ 264 CRC_EPS1 0;
BA_ "GenSigTimeoutTime_VDCM" SG_ 264 CRC_EPS1 0;
BA_ "GenSigTimeoutTime_CVADAS" SG_ 264 MessageCounter_EPS1 0;
BA_ "GenSigTimeoutTime_VDCM" SG_ 264 MessageCounter_EPS1 0;
BA_ "GenSigTimeoutTime_CVADAS" SG_ 1054 ThermalManagementActive_W 0;
BA_ "GenSigTimeoutTime_VDCM" SG_ 1054 ThermalManagementActive_W 0;
BA_ "GenSigTimeoutTime_BSM" SG_ 1054 ThermalManagementActive_W 0;
BA_ "GenSigTimeoutTime_BSM2" SG_ 1054 ThermalManagementActive_W 0;
BA_ "GenSigTimeoutTime_CVPAM" SG_ 1054 ThermalManagementActive_W 0;
BA_ "GenSigTimeoutTime_ECM" SG_ 1054 ThermalManagementActive_W 0;
BA_ "GenSigTimeoutTime_EPS" SG_ 1054 ThermalManagementActive_W 0;
BA_ "GenSigTimeoutTime_EVCU2" SG_ 1054 ThermalManagementActive_W 0;
BA_ "GenSigTimeoutTime_ORC" SG_ 1054 ThermalManagementActive_W 0;
BA_ "GenSigTimeoutTime_CVADAS" SG_ 1054 CRC_ENGINE1 0;
BA_ "GenSigTimeoutTime_BSM" SG_ 1054 CRC_ENGINE1 0;
BA_ "GenSigTimeoutTime_BSM2" SG_ 1054 CRC_ENGINE1 0;
BA_ "GenSigTimeoutTime_CVPAM" SG_ 1054 CRC_ENGINE1 0;
BA_ "GenSigTimeoutTime_ECM" SG_ 1054 CRC_ENGINE1 0;
BA_ "GenSigTimeoutTime_EPS" SG_ 1054 CRC_ENGINE1 0;
BA_ "GenSigTimeoutTime_EVCU2" SG_ 1054 CRC_ENGINE1 0;
BA_ "GenSigTimeoutTime_ORC" SG_ 1054 CRC_ENGINE1 0;
BA_ "GenSigTimeoutTime_CVADAS" SG_ 1054 MessageCounter_ENGINE1 0;
BA_ "GenSigTimeoutTime_BSM" SG_ 1054 MessageCounter_ENGINE1 0;
BA_ "GenSigTimeoutTime_BSM2" SG_ 1054 MessageCounter_ENGINE1 0;
BA_ "GenSigTimeoutTime_CVPAM" SG_ 1054 MessageCounter_ENGINE1 0;
BA_ "GenSigTimeoutTime_ECM" SG_ 1054 MessageCounter_ENGINE1 0;
BA_ "GenSigTimeoutTime_EPS" SG_ 1054 MessageCounter_ENGINE1 0;
BA_ "GenSigTimeoutTime_EVCU2" SG_ 1054 MessageCounter_ENGINE1 0;
BA_ "GenSigTimeoutTime_ORC" SG_ 1054 MessageCounter_ENGINE1 0;
BA_ "GenSigTimeoutTime_BSM" SG_ 1448 CRC_ENGINE7 0;
BA_ "GenSigTimeoutTime_BSM2" SG_ 1448 CRC_ENGINE7 0;
BA_ "GenSigTimeoutTime_CADM" SG_ 1448 CRC_ENGINE7 0;
BA_ "GenSigTimeoutTime_ECM" SG_ 1448 CRC_ENGINE7 0;
BA_ "GenSigTimeoutTime_EPS" SG_ 1448 CRC_ENGINE7 0;
BA_ "GenSigTimeoutTime_EVCU2" SG_ 1448 CRC_ENGINE7 0;
BA_ "GenSigTimeoutTime_ORC" SG_ 1448 CRC_ENGINE7 0;
BA_ "GenSigTimeoutTime_BSM" SG_ 1448 MessageCounter_ENGINE7 0;
BA_ "GenSigTimeoutTime_BSM2" SG_ 1448 MessageCounter_ENGINE7 0;
BA_ "GenSigTimeoutTime_CADM" SG_ 1448 MessageCounter_ENGINE7 0;
BA_ "GenSigTimeoutTime_ECM" SG_ 1448 MessageCounter_ENGINE7 0;
BA_ "GenSigTimeoutTime_EPS" SG_ 1448 MessageCounter_ENGINE7 0;
BA_ "GenSigTimeoutTime_EVCU2" SG_ 1448 MessageCounter_ENGINE7 0;
BA_ "GenSigTimeoutTime_ORC" SG_ 1448 MessageCounter_ENGINE7 0;
BA_ "GenSigTimeoutTime_BSM" SG_ 264 ElectricSteeringFailSts 0;
BA_ "GenSigTimeoutTime_BSM2" SG_ 264 ElectricSteeringFailSts 0;
BA_ "GenSigTimeoutTime_CADM" SG_ 264 ElectricSteeringFailSts 0;
BA_ "GenSigTimeoutTime_CVPAM" SG_ 264 ElectricSteeringFailSts 0;
BA_ "GenSigTimeoutTime_ECM" SG_ 264 ElectricSteeringFailSts 0;
BA_ "GenSigTimeoutTime_EPS" SG_ 264 ElectricSteeringFailSts 0;
BA_ "GenSigTimeoutTime_ORC" SG_ 264 ElectricSteeringFailSts 0;
BA_ "GenSigTimeoutTime_ADCAM" SG_ 264 ElectricSteeringFailSts 0;
BA_ "GenSigTimeoutTime_CVADAS" SG_ 264 ElectricSteeringFailSts 0;
BA_ "GenSigTimeoutTime_BSM" SG_ 264 EngineFanRequestActivation 0;
BA_ "GenSigTimeoutTime_BSM2" SG_ 264 EngineFanRequestActivation 0;
BA_ "GenSigTimeoutTime_CADM" SG_ 264 EngineFanRequestActivation 0;
BA_ "GenSigTimeoutTime_CVPAM" SG_ 264 EngineFanRequestActivation 0;
BA_ "GenSigTimeoutTime_ECM" SG_ 264 EngineFanRequestActivation 0;
BA_ "GenSigTimeoutTime_EPS" SG_ 264 EngineFanRequestActivation 0;
BA_ "GenSigTimeoutTime_EVCU2" SG_ 264 EngineFanRequestActivation 0;
BA_ "GenSigTimeoutTime_ORC" SG_ 264 EngineFanRequestActivation 0;
BA_ "GenSigTimeoutTime_ADCAM" SG_ 264 EngineFanRequestActivation 0;
BA_ "GenSigTimeoutTime_CVADAS" SG_ 264 EngineFanRequestActivation 0;
BA_ "GenSigTimeoutTime_VDCM" SG_ 264 EngineFanRequestActivation 0;
BA_ "GenSigTimeoutTime_ADCAM" SG_ 264 LwsAngleType 0;
BA_ "GenSigTimeoutTime_CVADAS" SG_ 264 LwsAngleType 0;
BA_ "GenSigTimeoutTime_VDCM" SG_ 264 LwsAngleType 0;
BA_ "GenSigTimeoutTime_CVADAS" SG_ 264 LwsCalibration 0;
BA_ "GenSigTimeoutTime_VDCM" SG_ 264 LwsCalibration 0;
BA_ "GenSigTimeoutTime_CVADAS" SG_ 264 SteeringVibration_Fault 0;
BA_ "GenSigTimeoutTime_VDCM" SG_ 264 SteeringVibration_Fault 0;
BA_ "GenSigTimeoutTime_CVADAS" SG_ 264 SteeringVibration_Status 0;
BA_ "GenSigTimeoutTime_VDCM" SG_ 264 SteeringVibration_Status 0;
BA_ "GenSigTimeoutTime_ADCAM" SG_ 264 EPS_ADAS_IMC_Fault 0;
BA_ "GenSigTimeoutTime_CVADAS" SG_ 264 EPS_ADAS_IMC_Fault 0;
BA_ "GenSigTimeoutTime_ADCAM" SG_ 264 EPS_AsstStat 0;
BA_ "GenSigTimeoutTime_CVADAS" SG_ 264 EPS_AsstStat 0;
BA_ "GenSigTimeoutTime_VDCM" SG_ 264 EPS_AsstStat 0;
BA_ "GenSigTimeoutTime_CVADAS" SG_ 264 EPS_Hands_On_Sts 0;
BA_ "GenSigTimeoutTime_VDCM" SG_ 264 EPS_Hands_On_Sts 0;
BA_ "GenSigTimeoutTime_ADCAM" SG_ 264 EPS_HandsOnRecognition 0;
BA_ "GenSigTimeoutTime_MPAD" SG_ 264 SPM_Lat_Ctrl_ResponseSts 0;
BA_ "GenSigTimeoutTime_ADCAM" SG_ 264 SPM_Lat_Ctrl_ResponseSts 0;
BA_ "GenSigTimeoutTime_BSM" SG_ 264 Steering_Column_Torque 0;
BA_ "GenSigTimeoutTime_BSM2" SG_ 264 Steering_Column_Torque 0;
BA_ "GenSigTimeoutTime_ECM" SG_ 264 Steering_Column_Torque 0;
BA_ "GenSigTimeoutTime_EPS" SG_ 264 Steering_Column_Torque 0;
BA_ "GenSigTimeoutTime_EVCU2" SG_ 264 Steering_Column_Torque 0;
BA_ "GenSigTimeoutTime_ORC" SG_ 264 Steering_Column_Torque 0;
BA_ "GenSigTimeoutTime_CVADAS" SG_ 264 Steering_Column_Torque 0;
BA_ "GenSigTimeoutTime_VDCM" SG_ 264 Steering_Column_Torque 0;
BA_ "GenSigTimeoutTime_ADCAM" SG_ 264 Steering_OpStat_Prim 0;
BA_ "GenSigTimeoutTime_CVADAS" SG_ 264 Steering_OpStat_Prim 0;
BA_ "GenSigSendType" SG_ 1448 ECM_THA_Resp 4;
BA_ "GenSigTimeoutTime_BSM" SG_ 1448 ECM_THA_Resp 0;
BA_ "GenSigTimeoutTime_BSM2" SG_ 1448 ECM_THA_Resp 0;
BA_ "GenSigTimeoutTime_CADM" SG_ 1448 ECM_THA_Resp 0;
BA_ "GenSigTimeoutTime_ECM" SG_ 1448 ECM_THA_Resp 0;
BA_ "GenSigTimeoutTime_EPS" SG_ 1448 ECM_THA_Resp 0;
BA_ "GenSigTimeoutTime_EVCU2" SG_ 1448 ECM_THA_Resp 0;
BA_ "GenSigTimeoutTime_ORC" SG_ 1448 ECM_THA_Resp 0;
BA_ "GenSigSendType" SG_ 1448 ECM_TRSC_Resp 3;
BA_ "GenSigTimeoutTime_BSM" SG_ 1448 ECM_TRSC_Resp 0;
BA_ "GenSigTimeoutTime_BSM2" SG_ 1448 ECM_TRSC_Resp 0;
BA_ "GenSigTimeoutTime_CADM" SG_ 1448 ECM_TRSC_Resp 0;
BA_ "GenSigTimeoutTime_ECM" SG_ 1448 ECM_TRSC_Resp 0;
BA_ "GenSigTimeoutTime_EPS" SG_ 1448 ECM_TRSC_Resp 0;
BA_ "GenSigTimeoutTime_EVCU2" SG_ 1448 ECM_TRSC_Resp 0;
BA_ "GenSigTimeoutTime_ORC" SG_ 1448 ECM_TRSC_Resp 0;
BA_ "GenSigTimeoutTime_BSM" SG_ 514 BSM_HEALTH_CHECK 0;
BA_ "GenSigTimeoutTime_CADM" SG_ 514 BSM_HEALTH_CHECK 0;
BA_ "GenSigTimeoutTime_CVPAM" SG_ 514 BSM_HEALTH_CHECK 0;
BA_ "GenSigTimeoutTime_ECM" SG_ 514 BSM_HEALTH_CHECK 0;
BA_ "GenSigTimeoutTime_EPS" SG_ 514 BSM_HEALTH_CHECK 0;
BA_ "GenSigTimeoutTime_EVCU2" SG_ 514 BSM_HEALTH_CHECK 0;
BA_ "GenSigTimeoutTime_ORC" SG_ 514 BSM_HEALTH_CHECK 0;
BA_ "GenSigTimeoutTime_CVADAS" SG_ 264 HAS_LAT_CTRL_ResponseSts 0;
BA_ "GenSigTimeoutTime_VDCM" SG_ 264 HAS_LAT_CTRL_ResponseSts 0;
BA_ "GenSigTimeoutTime_CVADAS" SG_ 264 EPSMotorTorque 0;
BA_ "GenSigTimeoutTime_VDCM" SG_ 264 EPSMotorTorque 0;
BA_ "GenSigStartValue" SG_ 264 EPSMotorTorque 1024;
BA_ "GenSigTimeoutTime_BSM" SG_ 264 EPSMotorTorque 0;
BA_ "GenSigTimeoutTime_BSM2" SG_ 264 EPSMotorTorque 0;
BA_ "GenSigTimeoutTime_CVPAM" SG_ 264 EPSMotorTorque 0;
BA_ "GenSigTimeoutTime_ECM" SG_ 264 EPSMotorTorque 0;
BA_ "GenSigTimeoutTime_EPS" SG_ 264 EPSMotorTorque 0;
BA_ "GenSigTimeoutTime_EVCU2" SG_ 264 EPSMotorTorque 0;
BA_ "GenSigTimeoutTime_BSM" SG_ 1056 CRC_EPS2 0;
BA_ "GenSigTimeoutTime_BSM2" SG_ 1056 CRC_EPS2 0;
BA_ "GenSigTimeoutTime_CADM" SG_ 1056 CRC_EPS2 0;
BA_ "GenSigTimeoutTime_ECM" SG_ 1056 CRC_EPS2 0;
BA_ "GenSigTimeoutTime_EPS" SG_ 1056 CRC_EPS2 0;
BA_ "GenSigTimeoutTime_EVCU2" SG_ 1056 CRC_EPS2 0;
BA_ "GenSigTimeoutTime_ORC" SG_ 1056 CRC_EPS2 0;
BA_ "GenSigTimeoutTime_BSM" SG_ 1056 MessageCounter_EPS2 0;
BA_ "GenSigTimeoutTime_BSM2" SG_ 1056 MessageCounter_EPS2 0;
BA_ "GenSigTimeoutTime_CADM" SG_ 1056 MessageCounter_EPS2 0;
BA_ "GenSigTimeoutTime_ECM" SG_ 1056 MessageCounter_EPS2 0;
BA_ "GenSigTimeoutTime_EPS" SG_ 1056 MessageCounter_EPS2 0;
BA_ "GenSigTimeoutTime_EVCU2" SG_ 1056 MessageCounter_EPS2 0;
BA_ "GenSigTimeoutTime_ORC" SG_ 1056 MessageCounter_EPS2 0;
BA_ "GenSigTimeoutTime_BSM" SG_ 264 HAS_LAT_CTRL_ResponseSts 0;
BA_ "GenSigTimeoutTime_BSM2" SG_ 264 HAS_LAT_CTRL_ResponseSts 0;
BA_ "GenSigTimeoutTime_CVPAM" SG_ 264 HAS_LAT_CTRL_ResponseSts 0;
BA_ "GenSigTimeoutTime_ECM" SG_ 264 HAS_LAT_CTRL_ResponseSts 0;
BA_ "GenSigTimeoutTime_EPS" SG_ 264 HAS_LAT_CTRL_ResponseSts 0;
BA_ "GenSigTimeoutTime_EVCU2" SG_ 264 HAS_LAT_CTRL_ResponseSts 0;
BA_ "GenSigTimeoutTime_BSM" SG_ 264 Steering_OpStat_Prim 0;
BA_ "GenSigTimeoutTime_BSM2" SG_ 264 Steering_OpStat_Prim 0;
BA_ "GenSigTimeoutTime_CVPAM" SG_ 264 Steering_OpStat_Prim 0;
BA_ "GenSigTimeoutTime_ECM" SG_ 264 Steering_OpStat_Prim 0;
BA_ "GenSigTimeoutTime_EPS" SG_ 264 Steering_OpStat_Prim 0;
BA_ "GenSigTimeoutTime_EVCU2" SG_ 264 Steering_OpStat_Prim 0;
BA_ "GenSigTimeoutTime_BSM" SG_ 264 SPM_Lat_Ctrl_ResponseSts 0;
BA_ "GenSigTimeoutTime_BSM2" SG_ 264 SPM_Lat_Ctrl_ResponseSts 0;
BA_ "GenSigTimeoutTime_CADM" SG_ 264 SPM_Lat_Ctrl_ResponseSts 0;
BA_ "GenSigTimeoutTime_ECM" SG_ 264 SPM_Lat_Ctrl_ResponseSts 0;
BA_ "GenSigTimeoutTime_EPS" SG_ 264 SPM_Lat_Ctrl_ResponseSts 0;
BA_ "GenSigTimeoutTime_EVCU2" SG_ 264 SPM_Lat_Ctrl_ResponseSts 0;
BA_ "GenSigTimeoutTime_BSM" SG_ 264 EPS_HandsOnRecognition 0;
BA_ "GenSigTimeoutTime_BSM2" SG_ 264 EPS_HandsOnRecognition 0;
BA_ "GenSigTimeoutTime_CADM" SG_ 264 EPS_HandsOnRecognition 0;
BA_ "GenSigTimeoutTime_ECM" SG_ 264 EPS_HandsOnRecognition 0;
BA_ "GenSigTimeoutTime_EPS" SG_ 264 EPS_HandsOnRecognition 0;
BA_ "GenSigTimeoutTime_EVCU2" SG_ 264 EPS_HandsOnRecognition 0;
BA_ "GenSigTimeoutTime_BSM" SG_ 264 EPS_Hands_On_Sts 0;
BA_ "GenSigTimeoutTime_BSM2" SG_ 264 EPS_Hands_On_Sts 0;
BA_ "GenSigTimeoutTime_CVPAM" SG_ 264 EPS_Hands_On_Sts 0;
BA_ "GenSigTimeoutTime_ECM" SG_ 264 EPS_Hands_On_Sts 0;
BA_ "GenSigTimeoutTime_EPS" SG_ 264 EPS_Hands_On_Sts 0;
BA_ "GenSigTimeoutTime_EVCU2" SG_ 264 EPS_Hands_On_Sts 0;
BA_ "GenSigStartValue" SG_ 264 EPS_AsstStat 1;
BA_ "GenSigTimeoutTime_BSM" SG_ 264 EPS_AsstStat 0;
BA_ "GenSigTimeoutTime_BSM2" SG_ 264 EPS_AsstStat 0;
BA_ "GenSigTimeoutTime_CVPAM" SG_ 264 EPS_AsstStat 0;
BA_ "GenSigTimeoutTime_ECM" SG_ 264 EPS_AsstStat 0;
BA_ "GenSigTimeoutTime_EPS" SG_ 264 EPS_AsstStat 0;
BA_ "GenSigTimeoutTime_EVCU2" SG_ 264 EPS_AsstStat 0;
BA_ "GenSigTimeoutTime_ORC" SG_ 264 EPS_AsstStat 0;
BA_ "GenSigTimeoutTime_BSM" SG_ 264 EPS_ADAS_IMC_Fault 0;
BA_ "GenSigTimeoutTime_BSM2" SG_ 264 EPS_ADAS_IMC_Fault 0;
BA_ "GenSigTimeoutTime_CVPAM" SG_ 264 EPS_ADAS_IMC_Fault 0;
BA_ "GenSigTimeoutTime_ECM" SG_ 264 EPS_ADAS_IMC_Fault 0;
BA_ "GenSigTimeoutTime_EPS" SG_ 264 EPS_ADAS_IMC_Fault 0;
BA_ "GenSigTimeoutTime_EVCU2" SG_ 264 EPS_ADAS_IMC_Fault 0;
BA_ "GenSigTimeoutTime_ORC" SG_ 264 EPS_ADAS_IMC_Fault 0;
BA_ "GenSigTimeoutTime_BSM" SG_ 264 SteeringVibration_Status 0;
BA_ "GenSigTimeoutTime_BSM2" SG_ 264 SteeringVibration_Status 0;
BA_ "GenSigTimeoutTime_CVPAM" SG_ 264 SteeringVibration_Status 0;
BA_ "GenSigTimeoutTime_ECM" SG_ 264 SteeringVibration_Status 0;
BA_ "GenSigTimeoutTime_EPS" SG_ 264 SteeringVibration_Status 0;
BA_ "GenSigTimeoutTime_EVCU2" SG_ 264 SteeringVibration_Status 0;
BA_ "GenSigTimeoutTime_BSM" SG_ 264 SteeringVibration_Fault 0;
BA_ "GenSigTimeoutTime_BSM2" SG_ 264 SteeringVibration_Fault 0;
BA_ "GenSigTimeoutTime_CVPAM" SG_ 264 SteeringVibration_Fault 0;
BA_ "GenSigTimeoutTime_ECM" SG_ 264 SteeringVibration_Fault 0;
BA_ "GenSigTimeoutTime_EPS" SG_ 264 SteeringVibration_Fault 0;
BA_ "GenSigTimeoutTime_EVCU2" SG_ 264 SteeringVibration_Fault 0;
BA_ "GenSigTimeoutTime_ORC" SG_ 264 SteeringVibration_Fault 0;
BA_ "GenSigTimeoutTime_CVADAS" SG_ 1056 EPS_MODE_STAT 0;
BA_ "GenSigTimeoutTime_BSM" SG_ 1056 EPS_MODE_STAT 0;
BA_ "GenSigTimeoutTime_BSM2" SG_ 1056 EPS_MODE_STAT 0;
BA_ "GenSigTimeoutTime_CADM" SG_ 1056 EPS_MODE_STAT 0;
BA_ "GenSigTimeoutTime_CVPAM" SG_ 1056 EPS_MODE_STAT 0;
BA_ "GenSigTimeoutTime_ECM" SG_ 1056 EPS_MODE_STAT 0;
BA_ "GenSigTimeoutTime_EPS" SG_ 1056 EPS_MODE_STAT 0;
BA_ "GenSigTimeoutTime_EVCU2" SG_ 1056 EPS_MODE_STAT 0;
BA_ "GenSigTimeoutTime_ORC" SG_ 1056 EPS_MODE_STAT 0;
BA_ "GenSigTimeoutTime_BSM2" SG_ 264 LwsCalibration 0;
BA_ "GenSigTimeoutTime_CVPAM" SG_ 264 LwsCalibration 0;
BA_ "GenSigTimeoutTime_ECM" SG_ 264 LwsCalibration 0;
BA_ "GenSigTimeoutTime_EPS" SG_ 264 LwsCalibration 0;
BA_ "GenSigTimeoutTime_EVCU2" SG_ 264 LwsCalibration 0;
BA_ "GenSigTimeoutTime_ORC" SG_ 264 LwsCalibration 0;
BA_ "GenSigTimeoutTime_BSM2" SG_ 264 LwsAngleType 0;
BA_ "GenSigTimeoutTime_ECM" SG_ 264 LwsAngleType 0;
BA_ "GenSigTimeoutTime_EPS" SG_ 264 LwsAngleType 0;
BA_ "GenSigTimeoutTime_EVCU2" SG_ 264 LwsAngleType 0;
BA_ "GenSigTimeoutTime_ORC" SG_ 264 LwsAngleType 0;
BA_ "GenSigTimeoutTime_ADCAM" SG_ 1626 CRC_IMPACTINFO 0;
BA_ "GenSigTimeoutTime_CVADAS" SG_ 1626 CRC_IMPACTINFO 0;
BA_ "GenSigTimeoutTime_BSM" SG_ 1626 CRC_IMPACTINFO 0;
BA_ "GenSigTimeoutTime_BSM2" SG_ 1626 CRC_IMPACTINFO 0;
BA_ "GenSigTimeoutTime_ECM" SG_ 1626 CRC_IMPACTINFO 0;
BA_ "GenSigTimeoutTime_EPS" SG_ 1626 CRC_IMPACTINFO 0;
BA_ "GenSigTimeoutTime_ORC" SG_ 1626 CRC_IMPACTINFO 0;
BA_ "GenSigTimeoutTime_BSM" SG_ 1626 MessageCounter_IMPACTINFO 0;
BA_ "GenSigTimeoutTime_BSM2" SG_ 1626 MessageCounter_IMPACTINFO 0;
BA_ "GenSigTimeoutTime_ECM" SG_ 1626 MessageCounter_IMPACTINFO 0;
BA_ "GenSigTimeoutTime_EPS" SG_ 1626 MessageCounter_IMPACTINFO 0;
BA_ "GenSigTimeoutTime_ORC" SG_ 1626 MessageCounter_IMPACTINFO 0;
BA_ "GenSigTimeoutTime_ADCAM" SG_ 1626 MessageCounter_IMPACTINFO 0;
BA_ "GenSigTimeoutTime_CVADAS" SG_ 1626 MessageCounter_IMPACTINFO 0;
BA_ "GenSigTimeoutTime_BSM2" SG_ 264 LwsAngle 0;
BA_ "GenSigTimeoutTime_ECM" SG_ 264 LwsAngle 0;
BA_ "GenSigTimeoutTime_EPS" SG_ 264 LwsAngle 0;
BA_ "GenSigTimeoutTime_ORC" SG_ 264 LwsAngle 0;
BA_ "GenSigTimeoutTime_BSM2" SG_ 264 MessageCounter_EPS1 0;
BA_ "GenSigTimeoutTime_ECM" SG_ 264 MessageCounter_EPS1 0;
BA_ "GenSigTimeoutTime_EPS" SG_ 264 MessageCounter_EPS1 0;
BA_ "GenSigTimeoutTime_EVCU2" SG_ 264 MessageCounter_EPS1 0;
BA_ "GenSigTimeoutTime_BSM2" SG_ 264 CRC_EPS1 0;
BA_ "GenSigTimeoutTime_ECM" SG_ 264 CRC_EPS1 0;
BA_ "GenSigTimeoutTime_EPS" SG_ 264 CRC_EPS1 0;
BA_ "GenSigTimeoutTime_EVCU2" SG_ 264 CRC_EPS1 0;
BA_ "GenSigTimeoutTime_BSM" SG_ 264 LwsSpeed 0;
BA_ "GenSigTimeoutTime_BSM2" SG_ 264 LwsSpeed 0;
BA_ "GenSigTimeoutTime_ECM" SG_ 264 LwsSpeed 0;
BA_ "GenSigTimeoutTime_EPS" SG_ 264 LwsSpeed 0;
BA_ "GenSigTimeoutTime_ORC" SG_ 264 LwsSpeed 0;
BA_ "GenSigTimeoutTime_ADCAM" SG_ 1626 IMPACTCommand 0;
BA_ "GenSigTimeoutTime_CVADAS" SG_ 1626 IMPACTCommand 0;
BA_ "GenSigTimeoutTime_VDCM" SG_ 1626 IMPACTCommand 0;
BA_ "GenSigTimeoutTime_ADCAM" SG_ 1626 IMPACTConfirm 0;
BA_ "GenSigTimeoutTime_CVADAS" SG_ 1626 IMPACTConfirm 0;
BA_ "GenSigTimeoutTime_MPAD" SG_ 1626 IMPACTThreshold 0;
BA_ "GenSigTimeoutTime_ADCAM" SG_ 1626 IMPACTThreshold 0;
BA_ "GenSigTimeoutTime_CVADAS" SG_ 1626 IMPACTThreshold 0;
BA_ "GenSigTimeoutTime_VDCM" SG_ 1626 IMPACTThreshold 0;
BA_ "GenSigTimeoutTime_ADCAM" SG_ 1626 IMPACT_B 0;
BA_ "GenSigTimeoutTime_CVADAS" SG_ 1626 IMPACT_B 0;
BA_ "GenSigTimeoutTime_VDCM" SG_ 1626 IMPACT_B 0;
BA_ "GenSigTimeoutTime_ADCAM" SG_ 1626 IMPACT_C 0;
BA_ "GenSigTimeoutTime_CVADAS" SG_ 1626 IMPACT_C 0;
BA_ "GenSigTimeoutTime_VDCM" SG_ 1626 IMPACT_C 0;
BA_ "GenSigTimeoutTime_ADCAM" SG_ 1626 IMPACT_F 0;
BA_ "GenSigTimeoutTime_CVADAS" SG_ 1626 IMPACT_F 0;
BA_ "GenSigTimeoutTime_VDCM" SG_ 1626 IMPACT_F 0;
BA_ "GenSigTimeoutTime_ADCAM" SG_ 1626 IMPACT_I 0;
BA_ "GenSigTimeoutTime_CVADAS" SG_ 1626 IMPACT_I 0;
BA_ "GenSigTimeoutTime_VDCM" SG_ 1626 IMPACT_I 0;
BA_ "GenSigTimeoutTime_ADCAM" SG_ 1626 IMPACT_K 0;
BA_ "GenSigTimeoutTime_CVADAS" SG_ 1626 IMPACT_K 0;
BA_ "GenSigTimeoutTime_VDCM" SG_ 1626 IMPACT_K 0;
BA_ "GenSigTimeoutTime_MPAD" SG_ 1626 IMPACTFailSts 0;
BA_ "GenSigTimeoutTime_ADCAM" SG_ 1626 IMPACTFailSts 0;
BA_ "GenSigTimeoutTime_CVADAS" SG_ 1626 IMPACTFailSts 0;
BA_ "GenSigTimeoutTime_VDCM" SG_ 1626 IMPACTFailSts 0;
BA_ "GenSigTimeoutTime_ADCAM" SG_ 1626 IMPACT_M 0;
BA_ "GenSigTimeoutTime_CVADAS" SG_ 1626 IMPACT_M 0;
BA_ "GenSigTimeoutTime_VDCM" SG_ 1626 IMPACT_M 0;
BA_ "GenSigTimeoutTime_CVADAS" SG_ 1056 EPS_Warn_Disp_Rq 0;
BA_ "GenSigTimeoutTime_BSM" SG_ 1056 EPS_Warn_Disp_Rq 0;
BA_ "GenSigTimeoutTime_BSM2" SG_ 1056 EPS_Warn_Disp_Rq 0;
BA_ "GenSigTimeoutTime_CADM" SG_ 1056 EPS_Warn_Disp_Rq 0;
BA_ "GenSigTimeoutTime_CVPAM" SG_ 1056 EPS_Warn_Disp_Rq 0;
BA_ "GenSigTimeoutTime_ECM" SG_ 1056 EPS_Warn_Disp_Rq 0;
BA_ "GenSigTimeoutTime_EPS" SG_ 1056 EPS_Warn_Disp_Rq 0;
BA_ "GenSigTimeoutTime_EVCU2" SG_ 1056 EPS_Warn_Disp_Rq 0;
BA_ "GenSigTimeoutTime_ORC" SG_ 1056 EPS_Warn_Disp_Rq 0;
BA_ "GenSigTimeoutTime_BSM" SG_ 1056 EPS_SteeringTouchStat 0;
BA_ "GenSigTimeoutTime_BSM2" SG_ 1056 EPS_SteeringTouchStat 0;
BA_ "GenSigTimeoutTime_CADM" SG_ 1056 EPS_SteeringTouchStat 0;
BA_ "GenSigTimeoutTime_ECM" SG_ 1056 EPS_SteeringTouchStat 0;
BA_ "GenSigTimeoutTime_EPS" SG_ 1056 EPS_SteeringTouchStat 0;
BA_ "GenSigTimeoutTime_EVCU2" SG_ 1056 EPS_SteeringTouchStat 0;
BA_ "GenSigTimeoutTime_ORC" SG_ 1056 EPS_SteeringTouchStat 0;
BA_ "GenSigTimeoutTime_BSM" SG_ 1056 EPS_SteeringTouq_Resp 0;
BA_ "GenSigTimeoutTime_BSM2" SG_ 1056 EPS_SteeringTouq_Resp 0;
BA_ "GenSigTimeoutTime_CADM" SG_ 1056 EPS_SteeringTouq_Resp 0;
BA_ "GenSigTimeoutTime_ECM" SG_ 1056 EPS_SteeringTouq_Resp 0;
BA_ "GenSigTimeoutTime_EPS" SG_ 1056 EPS_SteeringTouq_Resp 0;
BA_ "GenSigTimeoutTime_EVCU2" SG_ 1056 EPS_SteeringTouq_Resp 0;
BA_ "GenSigTimeoutTime_ORC" SG_ 1056 EPS_SteeringTouq_Resp 0;
BA_ "GenSigTimeoutTime_ADCAM" SG_ 1626 Non_deployment 0;
BA_ "GenSigTimeoutTime_CVADAS" SG_ 1626 Non_deployment 0;
BA_ "GenSigTimeoutTime_VDCM" SG_ 1626 Non_deployment 0;
BA_ "GenSigTimeoutTime_CADM" SG_ 1626 Non_deployment 0;
BA_ "GenSigTimeoutTime_BSM" SG_ 1056 THA_SteeringTouchStat 0;
BA_ "GenSigTimeoutTime_BSM2" SG_ 1056 THA_SteeringTouchStat 0;
BA_ "GenSigTimeoutTime_CADM" SG_ 1056 THA_SteeringTouchStat 0;
BA_ "GenSigTimeoutTime_ECM" SG_ 1056 THA_SteeringTouchStat 0;
BA_ "GenSigTimeoutTime_EPS" SG_ 1056 THA_SteeringTouchStat 0;
BA_ "GenSigTimeoutTime_EVCU2" SG_ 1056 THA_SteeringTouchStat 0;
BA_ "GenSigTimeoutTime_ORC" SG_ 1056 THA_SteeringTouchStat 0;
BA_ "GenSigTimeoutTime_BSM" SG_ 1056 EPS_THA_SteeringTorqueResp 0;
BA_ "GenSigTimeoutTime_BSM2" SG_ 1056 EPS_THA_SteeringTorqueResp 0;
BA_ "GenSigTimeoutTime_CADM" SG_ 1056 EPS_THA_SteeringTorqueResp 0;
BA_ "GenSigTimeoutTime_ECM" SG_ 1056 EPS_THA_SteeringTorqueResp 0;
BA_ "GenSigTimeoutTime_EPS" SG_ 1056 EPS_THA_SteeringTorqueResp 0;
BA_ "GenSigTimeoutTime_EVCU2" SG_ 1056 EPS_THA_SteeringTorqueResp 0;
BA_ "GenSigTimeoutTime_ORC" SG_ 1056 EPS_THA_SteeringTorqueResp 0;
BA_ "GenSigTimeoutTime_BSM" SG_ 1056 EPS_THA_DriverTorqueOverride 0;
BA_ "GenSigTimeoutTime_BSM2" SG_ 1056 EPS_THA_DriverTorqueOverride 0;
BA_ "GenSigTimeoutTime_CADM" SG_ 1056 EPS_THA_DriverTorqueOverride 0;
BA_ "GenSigTimeoutTime_ECM" SG_ 1056 EPS_THA_DriverTorqueOverride 0;
BA_ "GenSigTimeoutTime_EPS" SG_ 1056 EPS_THA_DriverTorqueOverride 0;
BA_ "GenSigTimeoutTime_EVCU2" SG_ 1056 EPS_THA_DriverTorqueOverride 0;
BA_ "GenSigTimeoutTime_ORC" SG_ 1056 EPS_THA_DriverTorqueOverride 0;
BA_ "GenSigTimeoutTime_BSM" SG_ 264 LKA_LAT_CTRL_ResponseSts_108 0;
BA_ "GenSigTimeoutTime_BSM2" SG_ 264 LKA_LAT_CTRL_ResponseSts_108 0;
BA_ "GenSigTimeoutTime_CVPAM" SG_ 264 LKA_LAT_CTRL_ResponseSts_108 0;
BA_ "GenSigTimeoutTime_ECM" SG_ 264 LKA_LAT_CTRL_ResponseSts_108 0;
BA_ "GenSigTimeoutTime_EPS" SG_ 264 LKA_LAT_CTRL_ResponseSts_108 0;
BA_ "GenSigTimeoutTime_EVCU2" SG_ 264 LKA_LAT_CTRL_ResponseSts_108 0;
BA_ "GenSigTimeoutTime_BSM" SG_ 1626 Non_deployment 0;
BA_ "GenSigTimeoutTime_BSM2" SG_ 1626 Non_deployment 0;
BA_ "GenSigTimeoutTime_CVPAM" SG_ 1626 Non_deployment 0;
BA_ "GenSigTimeoutTime_ECM" SG_ 1626 Non_deployment 0;
BA_ "GenSigTimeoutTime_EPS" SG_ 1626 Non_deployment 0;
BA_ "GenSigTimeoutTime_EVCU2" SG_ 1626 Non_deployment 0;
BA_ "GenSigTimeoutTime_ORC" SG_ 1626 Non_deployment 0;
BA_ "GenSigTimeoutTime_ADCAM" SG_ 274 IMUTemperature 0;
BA_ "GenSigTimeoutTime_CVADAS" SG_ 274 IMUTemperature 0;
BA_ "GenSigStartValue" SG_ 274 IMUTemperature 40;
BA_ "GenSigTimeoutTime_BSM" SG_ 274 IMUTemperature 0;
BA_ "GenSigTimeoutTime_BSM2" SG_ 274 IMUTemperature 0;
BA_ "GenSigTimeoutTime_EPS" SG_ 274 IMUTemperature 0;
BA_ "GenSigTimeoutTime_EVCU2" SG_ 274 IMUTemperature 0;
BA_ "GenSigTimeoutTime_ORC" SG_ 274 IMUTemperature 0;
BA_ "GenSigTimeoutTime_ADCAM" SG_ 274 StbmTimestampSec_ORC 0;
BA_ "GenSigTimeoutTime_CVADAS" SG_ 274 StbmTimestampSec_ORC 0;
BA_ "GenSigTimeoutTime_BSM" SG_ 274 StbmTimestampSec_ORC 0;
BA_ "GenSigTimeoutTime_BSM2" SG_ 274 StbmTimestampSec_ORC 0;
BA_ "GenSigTimeoutTime_EPS" SG_ 274 StbmTimestampSec_ORC 0;
BA_ "GenSigTimeoutTime_EVCU2" SG_ 274 StbmTimestampSec_ORC 0;
BA_ "GenSigTimeoutTime_ORC" SG_ 274 StbmTimestampSec_ORC 0;
BA_ "GenSigTimeoutTime_ADCAM" SG_ 274 StbmSyncState_ORC 0;
BA_ "GenSigTimeoutTime_CVADAS" SG_ 274 StbmSyncState_ORC 0;
BA_ "GenSigStartValue" SG_ 274 StbmSyncState_ORC 255;
BA_ "GenSigTimeoutTime_BSM" SG_ 274 StbmSyncState_ORC 0;
BA_ "GenSigTimeoutTime_BSM2" SG_ 274 StbmSyncState_ORC 0;
BA_ "GenSigTimeoutTime_EPS" SG_ 274 StbmSyncState_ORC 0;
BA_ "GenSigTimeoutTime_EVCU2" SG_ 274 StbmSyncState_ORC 0;
BA_ "GenSigTimeoutTime_ORC" SG_ 274 StbmSyncState_ORC 0;
BA_ "GenSigTimeoutTime_ADCAM" SG_ 274 StbmTimestampNSec_ORC 0;
BA_ "GenSigTimeoutTime_CVADAS" SG_ 274 StbmTimestampNSec_ORC 0;
BA_ "GenSigTimeoutTime_BSM" SG_ 274 StbmTimestampNSec_ORC 0;
BA_ "GenSigTimeoutTime_BSM2" SG_ 274 StbmTimestampNSec_ORC 0;
BA_ "GenSigTimeoutTime_EPS" SG_ 274 StbmTimestampNSec_ORC 0;
BA_ "GenSigTimeoutTime_EVCU2" SG_ 274 StbmTimestampNSec_ORC 0;
BA_ "GenSigTimeoutTime_ORC" SG_ 274 StbmTimestampNSec_ORC 0;
BA_ "GenSigTimeoutTime_BSM" SG_ 1626 IMPACT_M 0;
BA_ "GenSigTimeoutTime_BSM2" SG_ 1626 IMPACT_M 0;
BA_ "GenSigTimeoutTime_CADM" SG_ 1626 IMPACT_M 0;
BA_ "GenSigTimeoutTime_CVPAM" SG_ 1626 IMPACT_M 0;
BA_ "GenSigTimeoutTime_ECM" SG_ 1626 IMPACT_M 0;
BA_ "GenSigTimeoutTime_EPS" SG_ 1626 IMPACT_M 0;
BA_ "GenSigTimeoutTime_EVCU2" SG_ 1626 IMPACT_M 0;
BA_ "GenSigTimeoutTime_ORC" SG_ 1626 IMPACT_M 0;
BA_ "GenSigTimeoutTime_BSM2" SG_ 274 InternalError 0;
BA_ "GenSigTimeoutTime_CVPAM" SG_ 274 InternalError 0;
BA_ "GenSigTimeoutTime_ECM" SG_ 274 InternalError 0;
BA_ "GenSigTimeoutTime_EPS" SG_ 274 InternalError 0;
BA_ "GenSigTimeoutTime_EVCU2" SG_ 274 InternalError 0;
BA_ "GenSigTimeoutTime_ORC" SG_ 274 InternalError 0;
BA_ "GenSigTimeoutTime_CVADAS" SG_ 274 InternalError 0;
BA_ "GenSigTimeoutTime_VDCM" SG_ 274 InternalError 0;
BA_ "GenSigSendType" SG_ 1626 IMPACTFailSts 5;
BA_ "GenSigTimeoutTime_BSM" SG_ 1626 IMPACTFailSts 0;
BA_ "GenSigTimeoutTime_BSM2" SG_ 1626 IMPACTFailSts 0;
BA_ "GenSigTimeoutTime_CADM" SG_ 1626 IMPACTFailSts 0;
BA_ "GenSigTimeoutTime_CVPAM" SG_ 1626 IMPACTFailSts 0;
BA_ "GenSigTimeoutTime_ECM" SG_ 1626 IMPACTFailSts 0;
BA_ "GenSigTimeoutTime_EPS" SG_ 1626 IMPACTFailSts 0;
BA_ "GenSigTimeoutTime_EVCU2" SG_ 1626 IMPACTFailSts 0;
BA_ "GenSigTimeoutTime_ORC" SG_ 1626 IMPACTFailSts 0;
BA_ "GenSigTimeoutTime_BSM" SG_ 1626 IMPACT_K 0;
BA_ "GenSigTimeoutTime_BSM2" SG_ 1626 IMPACT_K 0;
BA_ "GenSigTimeoutTime_CADM" SG_ 1626 IMPACT_K 0;
BA_ "GenSigTimeoutTime_CVPAM" SG_ 1626 IMPACT_K 0;
BA_ "GenSigTimeoutTime_ECM" SG_ 1626 IMPACT_K 0;
BA_ "GenSigTimeoutTime_EPS" SG_ 1626 IMPACT_K 0;
BA_ "GenSigTimeoutTime_EVCU2" SG_ 1626 IMPACT_K 0;
BA_ "GenSigTimeoutTime_ORC" SG_ 1626 IMPACT_K 0;
BA_ "GenSigTimeoutTime_BSM" SG_ 1626 IMPACT_I 0;
BA_ "GenSigTimeoutTime_BSM2" SG_ 1626 IMPACT_I 0;
BA_ "GenSigTimeoutTime_CADM" SG_ 1626 IMPACT_I 0;
BA_ "GenSigTimeoutTime_CVPAM" SG_ 1626 IMPACT_I 0;
BA_ "GenSigTimeoutTime_ECM" SG_ 1626 IMPACT_I 0;
BA_ "GenSigTimeoutTime_EPS" SG_ 1626 IMPACT_I 0;
BA_ "GenSigTimeoutTime_EVCU2" SG_ 1626 IMPACT_I 0;
BA_ "GenSigTimeoutTime_ORC" SG_ 1626 IMPACT_I 0;
BA_ "GenSigTimeoutTime_BSM" SG_ 1626 IMPACT_F 0;
BA_ "GenSigTimeoutTime_BSM2" SG_ 1626 IMPACT_F 0;
BA_ "GenSigTimeoutTime_CADM" SG_ 1626 IMPACT_F 0;
BA_ "GenSigTimeoutTime_CVPAM" SG_ 1626 IMPACT_F 0;
BA_ "GenSigTimeoutTime_ECM" SG_ 1626 IMPACT_F 0;
BA_ "GenSigTimeoutTime_EPS" SG_ 1626 IMPACT_F 0;
BA_ "GenSigTimeoutTime_EVCU2" SG_ 1626 IMPACT_F 0;
BA_ "GenSigTimeoutTime_ORC" SG_ 1626 IMPACT_F 0;
BA_ "GenSigTimeoutTime_BSM" SG_ 1626 IMPACT_C 0;
BA_ "GenSigTimeoutTime_BSM2" SG_ 1626 IMPACT_C 0;
BA_ "GenSigTimeoutTime_CADM" SG_ 1626 IMPACT_C 0;
BA_ "GenSigTimeoutTime_CVPAM" SG_ 1626 IMPACT_C 0;
BA_ "GenSigTimeoutTime_ECM" SG_ 1626 IMPACT_C 0;
BA_ "GenSigTimeoutTime_EPS" SG_ 1626 IMPACT_C 0;
BA_ "GenSigTimeoutTime_EVCU2" SG_ 1626 IMPACT_C 0;
BA_ "GenSigTimeoutTime_ORC" SG_ 1626 IMPACT_C 0;
BA_ "GenSigTimeoutTime_BSM" SG_ 1626 IMPACT_B 0;
BA_ "GenSigTimeoutTime_BSM2" SG_ 1626 IMPACT_B 0;
BA_ "GenSigTimeoutTime_CADM" SG_ 1626 IMPACT_B 0;
BA_ "GenSigTimeoutTime_CVPAM" SG_ 1626 IMPACT_B 0;
BA_ "GenSigTimeoutTime_ECM" SG_ 1626 IMPACT_B 0;
BA_ "GenSigTimeoutTime_EPS" SG_ 1626 IMPACT_B 0;
BA_ "GenSigTimeoutTime_EVCU2" SG_ 1626 IMPACT_B 0;
BA_ "GenSigTimeoutTime_ORC" SG_ 1626 IMPACT_B 0;
BA_ "GenSigTimeoutTime_BSM" SG_ 1626 IMPACTThreshold 0;
BA_ "GenSigTimeoutTime_BSM2" SG_ 1626 IMPACTThreshold 0;
BA_ "GenSigTimeoutTime_CADM" SG_ 1626 IMPACTThreshold 0;
BA_ "GenSigTimeoutTime_CVPAM" SG_ 1626 IMPACTThreshold 0;
BA_ "GenSigTimeoutTime_ECM" SG_ 1626 IMPACTThreshold 0;
BA_ "GenSigTimeoutTime_EPS" SG_ 1626 IMPACTThreshold 0;
BA_ "GenSigTimeoutTime_EVCU2" SG_ 1626 IMPACTThreshold 0;
BA_ "GenSigTimeoutTime_ORC" SG_ 1626 IMPACTThreshold 0;
BA_ "GenSigTimeoutTime_CVADAS" SG_ 611 MessageCounter_ORC1 0;
BA_ "GenSigTimeoutTime_VDCM" SG_ 611 MessageCounter_ORC1 0;
BA_ "GenSigTimeoutTime_EVCU2" SG_ 611 MessageCounter_ORC1 0;
BA_ "GenSigTimeoutTime_BSM2" SG_ 611 MessageCounter_ORC1 0;
BA_ "GenSigTimeoutTime_CVPAM" SG_ 611 MessageCounter_ORC1 0;
BA_ "GenSigTimeoutTime_ECM" SG_ 611 MessageCounter_ORC1 0;
BA_ "GenSigTimeoutTime_EPS" SG_ 611 MessageCounter_ORC1 0;
BA_ "GenSigTimeoutTime_ORC" SG_ 611 MessageCounter_ORC1 0;
BA_ "GenSigTimeoutTime_BSM2" SG_ 274 CRC_ORC3 0;
BA_ "GenSigTimeoutTime_CVPAM" SG_ 274 CRC_ORC3 0;
BA_ "GenSigTimeoutTime_ECM" SG_ 274 CRC_ORC3 0;
BA_ "GenSigTimeoutTime_EPS" SG_ 274 CRC_ORC3 0;
BA_ "GenSigTimeoutTime_ORC" SG_ 274 CRC_ORC3 0;
BA_ "GenSigTimeoutTime_CVADAS" SG_ 274 CRC_ORC3 0;
BA_ "GenSigTimeoutTime_VDCM" SG_ 274 CRC_ORC3 0;
BA_ "GenSigTimeoutTime_EVCU2" SG_ 274 CRC_ORC3 0;
BA_ "GenSigTimeoutTime_CVADAS" SG_ 274 YawRateFailSts 0;
BA_ "GenSigTimeoutTime_CVADAS" SG_ 274 MessageCounter_ORC3 0;
BA_ "GenSigTimeoutTime_VDCM" SG_ 274 MessageCounter_ORC3 0;
BA_ "GenSigTimeoutTime_EVCU2" SG_ 274 MessageCounter_ORC3 0;
BA_ "GenSigTimeoutTime_CVADAS" SG_ 274 LongAccelerationFailSts 0;
BA_ "GenSigTimeoutTime_BSM2" SG_ 274 LatAccelerationFailSts 0;
BA_ "GenSigTimeoutTime_CVPAM" SG_ 274 LatAccelerationFailSts 0;
BA_ "GenSigTimeoutTime_ECM" SG_ 274 LatAccelerationFailSts 0;
BA_ "GenSigTimeoutTime_EPS" SG_ 274 LatAccelerationFailSts 0;
BA_ "GenSigTimeoutTime_ORC" SG_ 274 LatAccelerationFailSts 0;
BA_ "GenSigTimeoutTime_CVADAS" SG_ 274 LatAccelerationFailSts 0;
BA_ "GenSigTimeoutTime_VDCM" SG_ 1626 IMPACTConfirm 0;
BA_ "GenSigStartValue" SG_ 1626 IMPACTConfirm 1;
BA_ "GenSigInactiveValue" SG_ 1626 IMPACTConfirm 1;
BA_ "GenSigSendType" SG_ 1626 IMPACTConfirm 5;
BA_ "GenSigTimeoutTime_BSM" SG_ 1626 IMPACTConfirm 0;
BA_ "GenSigTimeoutTime_BSM2" SG_ 1626 IMPACTConfirm 0;
BA_ "GenSigTimeoutTime_CVPAM" SG_ 1626 IMPACTConfirm 0;
BA_ "GenSigTimeoutTime_ECM" SG_ 1626 IMPACTConfirm 0;
BA_ "GenSigTimeoutTime_EPS" SG_ 1626 IMPACTConfirm 0;
BA_ "GenSigTimeoutTime_ORC" SG_ 1626 IMPACTConfirm 0;
BA_ "GenSigSendType" SG_ 1626 IMPACTCommand 5;
BA_ "GenSigTimeoutTime_BSM" SG_ 1626 IMPACTCommand 0;
BA_ "GenSigTimeoutTime_BSM2" SG_ 1626 IMPACTCommand 0;
BA_ "GenSigTimeoutTime_CVPAM" SG_ 1626 IMPACTCommand 0;
BA_ "GenSigTimeoutTime_ECM" SG_ 1626 IMPACTCommand 0;
BA_ "GenSigTimeoutTime_EPS" SG_ 1626 IMPACTCommand 0;
BA_ "GenSigTimeoutTime_ORC" SG_ 1626 IMPACTCommand 0;
BA_ "GenSigTimeoutTime_CVADAS" SG_ 611 SBR1RowDriverSeatSts 0;
BA_ "GenSigTimeoutTime_VDCM" SG_ 611 SBR1RowDriverSeatSts 0;
BA_ "GenSigStartValue" SG_ 611 SBR1RowDriverSeatSts 3;
BA_ "GenSigSendType" SG_ 611 SBR1RowDriverSeatSts 3;
BA_ "GenSigTimeoutTime_BSM2" SG_ 611 SBR1RowDriverSeatSts 0;
BA_ "GenSigTimeoutTime_CVPAM" SG_ 611 SBR1RowDriverSeatSts 0;
BA_ "GenSigTimeoutTime_ECM" SG_ 611 SBR1RowDriverSeatSts 0;
BA_ "GenSigTimeoutTime_EPS" SG_ 611 SBR1RowDriverSeatSts 0;
BA_ "GenSigTimeoutTime_ORC" SG_ 611 SBR1RowDriverSeatSts 0;
BA_ "GenSigTimeoutTime_MPAD" SG_ 1954 ORCIdentification 0;
BA_ "GenSigTimeoutTime_ADCAM" SG_ 1954 ORCIdentification 0;
BA_ "GenSigTimeoutTime_CVADAS" SG_ 1954 ORCIdentification 0;
BA_ "GenSigTimeoutTime_VDCM" SG_ 1954 ORCIdentification 0;
BA_ "GenSigTimeoutTime_BSM2" SG_ 1954 ORCIdentification 0;
BA_ "GenSigTimeoutTime_CADM" SG_ 1954 ORCIdentification 0;
BA_ "GenSigTimeoutTime_CVPAM" SG_ 1954 ORCIdentification 0;
BA_ "GenSigTimeoutTime_ECM" SG_ 1954 ORCIdentification 0;
BA_ "GenSigTimeoutTime_EPS" SG_ 1954 ORCIdentification 0;
BA_ "GenSigTimeoutTime_EVCU2" SG_ 1954 ORCIdentification 0;
BA_ "GenSigTimeoutTime_ORC" SG_ 1954 ORCIdentification 0;
BA_ "GenSigTimeoutTime_CVADAS" SG_ 274 YawRate 0;
BA_ "GenSigTimeoutTime_CVADAS" SG_ 274 LongAcceleration 0;
BA_ "GenSigTimeoutTime_CVADAS" SG_ 274 LatAcceleration 0;
BA_ "GenSigTimeoutTime_CVADAS" SG_ 611 CRC_ORC1 0;
BA_ "GenSigTimeoutTime_VDCM" SG_ 611 CRC_ORC1 0;
BA_ "GenSigTimeoutTime_EVCU2" SG_ 611 CRC_ORC1 0;
BA_ "GenSigTimeoutTime_BSM2" SG_ 611 CRC_ORC1 0;
BA_ "GenSigTimeoutTime_CVPAM" SG_ 611 CRC_ORC1 0;
BA_ "GenSigTimeoutTime_ECM" SG_ 611 CRC_ORC1 0;
BA_ "GenSigTimeoutTime_EPS" SG_ 611 CRC_ORC1 0;
BA_ "GenSigTimeoutTime_ORC" SG_ 611 CRC_ORC1 0;
BA_ "GenSigTimeoutTime_MPAD" SG_ 1954 CRC_ORC2 0;
BA_ "GenSigTimeoutTime_ADCAM" SG_ 1954 CRC_ORC2 0;
BA_ "GenSigTimeoutTime_CVADAS" SG_ 1954 CRC_ORC2 0;
BA_ "GenSigTimeoutTime_VDCM" SG_ 1954 CRC_ORC2 0;
BA_ "GenSigTimeoutTime_BSM2" SG_ 1954 CRC_ORC2 0;
BA_ "GenSigTimeoutTime_CADM" SG_ 1954 CRC_ORC2 0;
BA_ "GenSigTimeoutTime_CVPAM" SG_ 1954 CRC_ORC2 0;
BA_ "GenSigTimeoutTime_ECM" SG_ 1954 CRC_ORC2 0;
BA_ "GenSigTimeoutTime_EPS" SG_ 1954 CRC_ORC2 0;
BA_ "GenSigTimeoutTime_EVCU2" SG_ 1954 CRC_ORC2 0;
BA_ "GenSigTimeoutTime_ORC" SG_ 1954 CRC_ORC2 0;
BA_ "GenSigTimeoutTime_MPAD" SG_ 1954 MessageCounter_ORC2 0;
BA_ "GenSigTimeoutTime_ADCAM" SG_ 1954 MessageCounter_ORC2 0;
BA_ "GenSigTimeoutTime_CVADAS" SG_ 1954 MessageCounter_ORC2 0;
BA_ "GenSigTimeoutTime_VDCM" SG_ 1954 MessageCounter_ORC2 0;
BA_ "GenSigTimeoutTime_BSM2" SG_ 1954 MessageCounter_ORC2 0;
BA_ "GenSigTimeoutTime_CADM" SG_ 1954 MessageCounter_ORC2 0;
BA_ "GenSigTimeoutTime_CVPAM" SG_ 1954 MessageCounter_ORC2 0;
BA_ "GenSigTimeoutTime_ECM" SG_ 1954 MessageCounter_ORC2 0;
BA_ "GenSigTimeoutTime_EPS" SG_ 1954 MessageCounter_ORC2 0;
BA_ "GenSigTimeoutTime_EVCU2" SG_ 1954 MessageCounter_ORC2 0;
BA_ "GenSigTimeoutTime_ORC" SG_ 1954 MessageCounter_ORC2 0;
BA_ "GenSigTimeoutTime_EPS" SG_ 274 YawRate_HR 0;
BA_ "GenSigTimeoutTime_EVCU2" SG_ 274 YawRate_HR 0;
BA_ "GenSigTimeoutTime_ORC" SG_ 274 YawRate_HR 0;
BA_ "GenSigTimeoutTime_CVADAS" SG_ 274 YawRate_HR 0;
BA_ "GenSigTimeoutTime_VDCM" SG_ 274 YawRate_HR 0;
BA_ "GenSigTimeoutTime_BSM" SG_ 274 YawRate_HR 0;
BA_ "GenSigTimeoutTime_BSM2" SG_ 274 YawRate_HR 0;
BA_ "GenSigTimeoutTime_CVPAM" SG_ 274 YawRate_HR 0;
BA_ "GenSigTimeoutTime_ECM" SG_ 274 YawRate_HR 0;
BA_ "GenSigTimeoutTime_BSM" SG_ 274 YawRate_HR_Sign 0;
BA_ "GenSigTimeoutTime_BSM2" SG_ 274 YawRate_HR_Sign 0;
BA_ "GenSigTimeoutTime_CVPAM" SG_ 274 YawRate_HR_Sign 0;
BA_ "GenSigTimeoutTime_ECM" SG_ 274 YawRate_HR_Sign 0;
BA_ "GenSigTimeoutTime_EPS" SG_ 274 YawRate_HR_Sign 0;
BA_ "GenSigTimeoutTime_EVCU2" SG_ 274 YawRate_HR_Sign 0;
BA_ "GenSigTimeoutTime_ORC" SG_ 274 YawRate_HR_Sign 0;
BA_ "GenSigTimeoutTime_CVADAS" SG_ 274 YawRate_HR_Sign 0;
BA_ "GenSigTimeoutTime_VDCM" SG_ 274 YawRate_HR_Sign 0;
BA_ "GenSigTimeoutTime_BSM2" SG_ 275 PPPA_TargetDistance 0;
BA_ "GenSigTimeoutTime_CADM" SG_ 275 PPPA_TargetDistance 0;
BA_ "GenSigTimeoutTime_CVPAM" SG_ 275 PPPA_TargetDistance 0;
BA_ "GenSigTimeoutTime_ECM" SG_ 275 PPPA_TargetDistance 0;
BA_ "GenSigTimeoutTime_EPS" SG_ 275 PPPA_TargetDistance 0;
BA_ "GenSigTimeoutTime_EVCU2" SG_ 275 PPPA_TargetDistance 0;
BA_ "GenSigTimeoutTime_ORC" SG_ 275 PPPA_TargetDistance 0;
BA_ "GenSigTimeoutTime_MPAD" SG_ 275 PPPA_TargetDistance 0;
BA_ "GenSigTimeoutTime_ADCAM" SG_ 275 PPPA_TargetDistance 0;
BA_ "GenSigTimeoutTime_CVADAS" SG_ 275 PPPA_TargetDistance 0;
VAL_ 264 LwsAngle 65535 "SNA";
VAL_ 264 LwsSpeed 4095 "SNA";
VAL_ 274 YawRate 4095 "SNA";
VAL_ 274 LongAcceleration 4095 "SNA";
VAL_ 274 LatAcceleration 4095 "SNA";
VAL_ 611 SBR1RowDriverSeatSts 0 "Seat_Belt_Fasten" 1 "Seat_Belt_Not_Fasten" 3 "SNA";
VAL_ 1626 IMPACTConfirm 0 "Actuate" 1 "Do_Not_Actuate";
VAL_ 1626 IMPACTCommand 0 "Do_Not_Actuate" 1 "Actuate";
VAL_ 1155 TSCActive 0 "Not_Active" 1 "Active";
VAL_ 1155 RollsModeAct 0 "Not_active" 1 "Active";
VAL_ 1155 FunctionIntervention 0 "No_intervention" 1 "Intervention_blinking_lamp";
VAL_ 1155 FunctionFailSts 0 "Fail_Not_Present" 1 "Fail_Present";
VAL_ 1155 Function2Sts 0 "Not_Active" 1 "Active";
VAL_ 1155 ESCFailSts 0 "Fail_Not_Present" 1 "Fail_Present";
VAL_ 1155 ERMActive 0 "Not_Active" 1 "Active";
VAL_ 1155 EBDFailSts 0 "Fail_Not_Present" 1 "Fail_Present";
VAL_ 1155 CMMIntervention 0 "No_intervention" 1 "Intervention";
VAL_ 1155 BSMSysSts 0 "Normal mode" 1 "Diagnosis mode" 2 "Alternative mode" 3 "SNA";
VAL_ 1155 ACCEngaged 0 "Not_Engaged" 1 "Engaged";
VAL_ 1155 ABSFailSts 0 "Fail_Not_Present" 1 "Fail_Present";
VAL_ 609 TravelDistance 255 "SNA";
VAL_ 609 MSRActive 0 "Not_Active" 1 "Active";
VAL_ 609 EPBSts 0 "Released" 1 "Applied" 2 "DynamicBrkESC" 3 "DynamicBrkEPB" 4 "Emergency_Braking" 5 "Applying" 6 "Maintenance_Mode" 7 "Assembly_Check" 8 "Inspection_Mode" 9 "Re_Clamping" 10 "Adjuste_Mode" 11 "Releasing" 12 "Fault_EPB_Released" 13 "Fault_EPB_Applied" 14 "Fault_Present" 15 "SNA";
VAL_ 609 ASRActive 0 "Not_active" 1 "Active";
VAL_ 259 RHR_WheelSensorFailSts 0 "Fail_Not_Present" 1 "Fail_Present";
VAL_ 259 RHR_Spin 0 "Stand_Still" 1 "Forward" 2 "Backward" 3 "SNA";
VAL_ 259 RHR_FastPulseCounter 255 "SNA";
VAL_ 259 RHF_WheelSensorFailSts 0 "Fail_Not_Present" 1 "Fail_Present";
VAL_ 259 RHF_FastPulseCounter 255 "SNA";
VAL_ 259 LHR_WheelSensorFailSts 0 "Fail_Not_Present" 1 "Fail_Present";
VAL_ 259 LHR_Spin 0 "Stand_Still" 1 "Forward" 2 "Backward" 3 "SNA";
VAL_ 259 LHR_FastPulseCounter 255 "SNA";
VAL_ 259 LHF_WheelSensorFailSts 0 "Fail_Not_Present" 1 "Fail_Present";
VAL_ 259 LHF_FastPulseCounter 255 "SNA";
VAL_ 513 VehicleStandStillSts 0 "True" 1 "False" 3 "SNA";
VAL_ 513 GrMin_Rq_BSM 0 "Passive" 1 "G1" 2 "G2" 3 "G3" 4 "G4" 5 "G5" 6 "G6" 7 "G7" 8 "G8" 9 "G9";
VAL_ 513 GrMax_Rq_BSM 0 "Passive" 1 "G1" 2 "G2" 3 "G3" 4 "G4" 5 "G5" 6 "G6" 7 "G7" 8 "G8" 9 "G9";
VAL_ 513 ExternalBrkRequestsDisabled 0 "No request" 1 "External Systems temporary off" 2 "External Systems continuous off" 3 "SNA";
VAL_ 513 BrkTrq_Driver 32767 "SNA";
VAL_ 513 BrkTrq 32767 "SNA";
VAL_ 513 Brk_Thermdl 0 "Normal_Temperature" 1 "High_Temperature";
VAL_ 255 SumTorqueStatic 2047 "SNA";
VAL_ 255 SumTorqueSel_D_TTC 2047 "SNA";
VAL_ 255 SumTorqueMin 2047 "SNA";
VAL_ 255 SumTorqueMax 2047 "SNA";
VAL_ 255 SumTorqueExp 2047 "SNA";
VAL_ 255 SumTorque_DrvReqMod 8191 "SNA";
VAL_ 274 YawRateFailSts 0 "Fail_Not_Present" 1 "Fail_Present";
VAL_ 274 LongAccelerationFailSts 0 "Fail_Not_Present" 1 "Fail_Present";
VAL_ 274 LatAccelerationFailSts 0 "Fail_Not_Present" 1 "Fail_Present";
VAL_ 1626 IMPACTThreshold 0 "Threshold_Not_Met" 1 "Threshold_Met";
VAL_ 518 RPMOverRev_W 0 "FALSE" 1 "TRUE";
VAL_ 518 PdlPosActual 255 "SNA";
VAL_ 1054 ThermalManagementActive_W 0 "Not_active" 1 "Active";
VAL_ 275 RR_PAM_Brk_RqSts 0 "Off" 1 "On";
VAL_ 514 PAM_Brk_Rq_RspSts 0 "Not_Active" 1 "Active" 2 "Faulted_Condition" 3 "SNA";
VAL_ 514 BrkPdl_Stat 0 "UPSTOP" 1 "PSD" 2 "NDEF2" 3 "SNA";
VAL_ 514 BrkPdl_Flt 0 "NOT FAULTED" 1 "FAULTED";
VAL_ 514 BrakePdlPosn 255 "SNA";
VAL_ 259 RHRWheelSpeed 8191 "SNA";
VAL_ 259 RHFWheelSpeed 8191 "SNA";
VAL_ 259 RHF_Spin 0 "Stand_Still" 1 "Forward" 2 "Backward" 3 "SNA";
VAL_ 259 LHRWheelSpeed 8191 "SNA";
VAL_ 259 LHFWheelSpeed 8191 "SNA";
VAL_ 259 LHF_Spin 0 "Stand_Still" 1 "Forward" 2 "Backward" 3 "SNA";
VAL_ 513 SelSpdLmp 0 "OFF" 1 "CONT" 2 "BLINK" 3 "SNA";
VAL_ 513 SelectSpdSts 0 "OFF" 1 "Select Speed Mode" 2 "Select Speed Mode Inhibit" 3 "SNA";
VAL_ 513 REF_VEH_SPEED 1023 "SNA";
VAL_ 264 LwsCalibration 0 "Not_calibrated" 1 "Calibrated";
VAL_ 264 LwsAngleType 0 "Absolute" 1 "Relative" 3 "SNA";
VAL_ 264 EngineFanRequestActivation 0 "False" 1 "True";
VAL_ 264 ElectricSteeringFailSts 0 "Fail_Not_Present" 1 "Fail_Present";
VAL_ 275 RR_PAM_Dist 1023 "SNA";
VAL_ 274 InternalError 0 "No_int_processing_error_detected" 1 "Int_processing_error_detected";
VAL_ 1626 IMPACTFailSts 0 "Fail_Not_Present" 1 "Fail_Present";
VAL_ 1626 IMPACT_M 0 "Do_Not_Actuate" 1 "Actuate";
VAL_ 1626 IMPACT_K 0 "Do_Not_Actuate" 1 "Actuate";
VAL_ 1626 IMPACT_I 0 "Do_Not_Actuate" 1 "Actuate";
VAL_ 1626 IMPACT_F 0 "Do_Not_Actuate" 1 "Actuate";
VAL_ 1626 IMPACT_C 0 "Do_Not_Actuate" 1 "Actuate";
VAL_ 1626 IMPACT_B 0 "Do_Not_Actuate" 1 "Actuate";
VAL_ 264 EPS_Curr 255 "SNA";
VAL_ 275 SPM_Lat_Ctrl_RequestSts 0 "IDLE" 1 "Faulted" 2 "SPM_Request";
VAL_ 275 ManoeuvrePhase 0 "Backward" 1 "Forward";
VAL_ 513 Brk_Jrk_Resp 0 "Not_Executed" 1 "Executed";
VAL_ 1056 EPS_Warn_Disp_Rq 0 "EPS function active OK" 1 "Warning - Service power steering ERR" 2 "Warning - Power steering-over temp ERR2" 3 "Service Required - High Priority SERV_HI" 7 "SNA";
VAL_ 514 BSM_OpStat 0 "Inactive" 1 "FullService" 2 "FailOperational" 3 "FailDegraded" 4 "Emergency" 5 "No_Function";
VAL_ 514 Brake_OpStat_Prim 0 "Inactive" 1 "FullService" 2 "FailOperational" 3 "FailDegraded" 4 "Emergency" 5 "No_Function";
VAL_ 950 ParkingManeuverActive 0 "Idle" 1 "Enabled_Seeking" 2 "Engaged_Semi" 3 "Engaged_Full" 4 "Not_Used" 5 "Not_Used" 6 "Not_Used" 7 "SNA";
VAL_ 1155 FunctionSts 0 "Not_Active" 1 "Active";
VAL_ 274 YawRate_HR_Sign 0 "Negative" 1 "Positive";
VAL_ 1056 EPS_MODE_STAT 0 "MODE_1" 1 "MODE_2" 2 "MODE_3" 3 "LAST" 7 "SNA";
VAL_ 264 SteeringVibration_Status 0 "Inactive" 1 "Active";
VAL_ 264 SteeringVibration_Fault 0 "NO_FAULT" 1 "FAULTED";
VAL_ 264 Steering_OpStat_Prim 0 "Inactive" 1 "FullService" 2 "FailOperational" 3 "FailDegraded" 4 "Emergency" 5 "No_Function";
VAL_ 264 Steering_Column_Torque 2047 "SNA";
VAL_ 264 SPM_Lat_Ctrl_ResponseSts 0 "IDLE" 1 "Permanent_Not_Avail" 2 "Temporarily_Not_Avail" 3 "SPM_Open";
VAL_ 264 EPS_HandsOnRecognition 0 "False" 1 "True";
VAL_ 264 EPS_Hands_On_Sts 0 "Not_Detected" 1 "Detected";
VAL_ 264 EPS_AsstStat 0 "AST_ACT" 1 "AST_OFF" 2 "AST_RT" 7 "SNA";
VAL_ 264 EPS_ADAS_IMC_Fault 0 "No_Fault" 1 "Fault";
VAL_ 275 PPPA_TargetDistance 1023 "SNA";
VAL_ 275 PPPA_StandstillRqst 0 "Not_Active" 1 "Active";
VAL_ 275 PPPA_MaxSpeed 255 "SNA";
VAL_ 275 PPPA_Interface_BSM 0 "Idle" 1 "CVPAM_Request" 2 "Faulted" 3 "SNA";
VAL_ 275 ParkingGearShiftReq 0 "Idle" 1 "P" 2 "R" 3 "N" 4 "D" 5 "Not_Used" 6 "Not_Used" 7 "SNA";
VAL_ 264 HAS_LAT_CTRL_ResponseSts 0 "IDLE" 1 "Permanent_Not_Avail" 2 "Temporarily_Not_Avail" 3 "HAS_Open" 4 "HAS_Open_Backup" 5 "INIT" 6 "Damped_Exit" 7 "Faulted";
VAL_ 259 LongAccelerationOffset_BSM 255 "SNA";
VAL_ 259 LatAccelerationOffset_BSM 255 "SNA";
VAL_ 259 YawRateOffset_BSM 255 "SNA";
VAL_ 264 EPSMotorTorque 2047 "SNA";
VAL_ 259 LwsAngleOffset_BSM 1023 "SNA";
VAL_ 609 ESC_OFF_Hrd_Sft_Button_sts 0 "STREET" 1 "SPORT" 2 "TRACK" 3 "OFF" 4 "SNOW" 5 "OFFROAD" 6 "DRAG" 7 "SNA";
VAL_ 1448 ECM_TRSC_Resp 0 "OFF" 1 "Active" 3 "SNA";
VAL_ 1448 ECM_THA_Resp 0 "Off" 1 "Active" 3 "SNA";
VAL_ 1155 ESC_TRSC_Brk_Resp 0 "OFF" 1 "Active" 2 "Brakes_Over_Heated" 3 "SNA";
VAL_ 1155 BSM_THA_Brk_Resp 0 "Off" 1 "Active" 2 "Brakes Overheated" 3 "SNA";
VAL_ 609 BSM_LnchMode 0 "LAUNCH_OFF" 1 "LAUNCH_ON" 2 "LAUNCH_ACT" 3 "CNC" 4 "LAUNCH_ACT_RPM_PHASE" 7 "SNA";
VAL_ 609 BSM_LnchCtrl_SftBtn_SelectSts 0 "False" 1 "True";
VAL_ 609 BSM_LnchAbrtSts 0 "NOT" 1 "AwE" 2 "AwA" 3 "SNA";
VAL_ 513 EngSpdIntervReq 0 "False" 1 "True";
VAL_ 255 SSC_TrqEnblRq_Allowed 0 "FALSE" 1 "TRUE";
VAL_ 255 PPPA_TrqEnblRq_Allowed 0 "FALSE" 1 "TRUE";
VAL_ 255 ESC_TrqEnblRq_Allowed 0 "FALSE" 1 "TRUE";
VAL_ 255 Accel_Pedal_Override 0 "FALSE" 1 "TRUE";
VAL_ 255 ACC_NCC_TrqEnblRq_Allowed 0 "FALSE" 1 "TRUE";
VAL_ 255 Total_AxleTorque_Static 65535 "SNA";
VAL_ 255 RRCC_TrqEnblRq_Allowed 0 "FALSE" 1 "TRUE";
VAL_ 255 Rear_AxleTorque_Static 65535 "SNA";
VAL_ 255 Front_AxleTorque_Static 65535 "SNA";
VAL_ 1056 EPS_SteeringTouq_Resp 0 "OFF" 1 "Active" 3 "SNA";
VAL_ 1056 EPS_SteeringTouchStat 0 "False" 1 "True";
VAL_ 264 ESA_LAT_CTRL_ResponseSts 0 "IDLE" 1 "Permanently_Not_Avail" 2 "Temporarily_Not_Avail" 3 "ESA_Open" 4 "ESA_Open_Backup" 5 "INIT" 6 "Damped_Exit" 7 "SNA";
VAL_ 274 StbmSyncState_ORC 0 "IN_SYNC" 1 "NOT_IN_SYNC" 255 "INVALID";
VAL_ 274 IMUTemperature 255 "SNA";
VAL_ 1626 Non_deployment 0 "Init" 1 "Threshold_met" 2 "Threshold_not_met" 3 "SNA";
VAL_ 1056 THA_SteeringTouchStat 0 "Hands Off" 1 "Hands On" 3 "SNA";
VAL_ 1056 EPS_THA_SteeringTorqueResp 0 "Temp_NA" 1 "Perm_NA" 2 "TOI_Available" 3 "TOI_Unavailable" 7 "SNA";
VAL_ 1056 EPS_THA_DriverTorqueOverride 0 "False" 1 "True" 3 "SNA";
VAL_ 264 LKA_LAT_CTRL_ResponseSts_108 0 "IDLE" 1 "Permanent_Not_Avail" 2 "Temporarily_Not_Avail" 3 "LKA_Open";
VAL_ 514 AEB_Type_Brk_202 0 "NONE" 1 "ACC" 2 "CMS" 3 "CMS_XTD" 4 "ABA" 5 "LSCM" 6 "PEB" 7 "ICA_L" 8 "ICA_R" 9 "HAS_MRM" 10 "RRCC" 11 "L3" 15 "SNA";
VAL_ 513 RRCC_Cancel_Req_201 0 "No_request" 1 "Requests temporary off" 2 "Request continuous off" 3 "SNA";
VAL_ 513 DASEngReqPos_201 0 "Not_Allowed" 1 "Allowed";

SIG_GROUP_ 274 ORC_FD_3_Pkt 1 : YawRate LongAcceleration LatAcceleration YawRateFailSts MessageCounter_ORC3 LongAccelerationFailSts LatAccelerationFailSts CRC_ORC3 InternalError YawRate_HR_Sign YawRate_HR StbmTimestampSec_ORC StbmTimestampNSec_ORC StbmSyncState_ORC IMUTemperature;
SIG_GROUP_ 1954 ORC_FD_2_Pkt 1 : ORCIdentification MessageCounter_ORC2 CRC_ORC2;
SIG_GROUP_ 611 ORC_FD_1_Pkt 1 : SBR1RowDriverSeatSts MessageCounter_ORC1 CRC_ORC1;
SIG_GROUP_ 1626 IMPACT_INFO_Pkt 1 : IMPACTConfirm IMPACTCommand IMPACTThreshold MessageCounter_IMPACTINFO CRC_IMPACTINFO IMPACTFailSts IMPACT_M IMPACT_K IMPACT_I IMPACT_F IMPACT_C IMPACT_B Non_deployment;
SIG_GROUP_ 1056 EPS_FD_2_Pkt 1 : EPS_Warn_Disp_Rq EPS_MODE_STAT MessageCounter_EPS2 CRC_EPS2 EPS_SteeringTouq_Resp EPS_SteeringTouchStat THA_SteeringTouchStat EPS_THA_SteeringTorqueResp EPS_THA_DriverTorqueOverride;
SIG_GROUP_ 264 EPS_FD_1_Pkt 1 : LwsAngle LwsSpeed MessageCounter_EPS1 CRC_EPS1 LwsCalibration LwsAngleType EngineFanRequestActivation ElectricSteeringFailSts EPS_Curr SteeringVibration_Status SteeringVibration_Fault Steering_OpStat_Prim Steering_Column_Torque SPM_Lat_Ctrl_ResponseSts EPS_HandsOnRecognition EPS_Hands_On_Sts EPS_AsstStat EPS_ADAS_IMC_Fault HAS_LAT_CTRL_ResponseSts EPSMotorTorque ESA_LAT_CTRL_ResponseSts LKA_LAT_CTRL_ResponseSts_108;
SIG_GROUP_ 1448 ENGINE_FD_7_Pkt 1 : MessageCounter_ENGINE7 CRC_ENGINE7 ECM_TRSC_Resp ECM_THA_Resp;
SIG_GROUP_ 518 ENGINE_FD_5_Pkt 1 : RPMOverRev_W PdlPosActual MessageCounter_ENGINE5 CRC_ENGINE5;
SIG_GROUP_ 1054 ENGINE_FD_1_Pkt 1 : ThermalManagementActive_W MessageCounter_ENGINE1 CRC_ENGINE1;
SIG_GROUP_ 514 BRAKE_FD_7_Pkt 1 : PAM_Brk_Rq_RspSts MessageCounter_BRAKE7 CRC_BRAKE7 BrkPdl_Stat BrkPdl_Flt BrakePdlPosn BSM_OpStat Brake_OpStat_Prim BSM_HEALTH_CHECK AEB_Type_Brk_202;
SIG_GROUP_ 1155 BRAKE_FD_5_Pkt 1 : TSCActive RollsModeAct FunctionIntervention FunctionFailSts Function2Sts ESCFailSts ERMActive EBDFailSts CMMIntervention BSMSysSts ACCEngaged ABSFailSts MessageCounter_BRAKE5 CRC_BRAKE5 FunctionSts ESC_TRSC_Brk_Resp BSM_THA_Brk_Resp;
SIG_GROUP_ 609 BRAKE_FD_4_Pkt 1 : TravelDistance MSRActive EPBSts ASRActive MessageCounter_BRAKE4 CRC_BRAKE4 ESC_OFF_Hrd_Sft_Button_sts BSM_LnchMode BSM_LnchCtrl_SftBtn_SelectSts BSM_LnchAbrtSts LaunchRPMsetting_BSM;
SIG_GROUP_ 259 BRAKE_FD_3_Pkt 1 : RHR_WheelSensorFailSts RHR_Spin RHR_FastPulseCounter RHF_WheelSensorFailSts RHF_FastPulseCounter LHR_WheelSensorFailSts LHR_Spin LHR_FastPulseCounter LHF_WheelSensorFailSts LHF_FastPulseCounter RHRWheelSpeed RHFWheelSpeed RHF_Spin MessageCounter_BRAKE3 LHRWheelSpeed LHFWheelSpeed LHF_Spin CRC__BRAKE3 LongAccelerationOffset_BSM LatAccelerationOffset_BSM YawRateOffset_BSM LwsAngleOffset_BSM;
SIG_GROUP_ 513 BRAKE_FD_1_Pkt 1 : VehicleStandStillSts GrMin_Rq_BSM GrMax_Rq_BSM ExternalBrkRequestsDisabled BrkTrq_Driver BrkTrq Brk_Thermdl SelSpdLmp SelectSpdSts REF_VEH_SPEED MessageCounter_BRAKE1 CRC_BRAKE1 Brk_Jrk_Resp EngSpdIntervReq EngSpdInterv RRCC_Cancel_Req_201 ACCFSafe_201 DASEngReqPos_201;
SIG_GROUP_ 255 PT_TORQUE_FD_1_Pkt 1 : SumTorqueStatic SumTorqueSel_D_TTC SumTorqueMin SumTorqueMax SumTorqueExp SumTorque_DrvReqMod MessageCounter_PT_TORQUE_FD_1 CRC_PT_TORQUE_FD_1 SSC_TrqEnblRq_Allowed PPPA_TrqEnblRq_Allowed ESC_TrqEnblRq_Allowed Accel_Pedal_Override ACC_NCC_TrqEnblRq_Allowed Total_AxleTorque_Static RRCC_TrqEnblRq_Allowed Rear_AxleTorque_Static Front_AxleTorque_Static;
SIG_GROUP_ 1036 ENGINE_FD_3_Pkt 1 : MessageCounter_ENGINE3 CRC_ENGINE3;
SIG_GROUP_ 950 CVPAM_FD_Info_Pkt 1 : ParkingManeuverActive MessageCounter_CVPAM_FD_Info CRC_CVPAM_FD_Info;
SIG_GROUP_ 275 CVPAM_FD_Control_Pkt 1 : RR_PAM_Brk_RqSts MessageCounter_CVPAM_FD_Control CRC_CVPAM_FD_Control RR_PAM_Dist SPM_Lat_Ctrl_RequestSts ManoeuvrePhase PPPA_TargetDistance PPPA_StandstillRqst PPPA_MaxSpeed PPPA_JerkDecelMin PPPA_JerkDecelMax PPPA_JerkAccelMin PPPA_JerkAccelMax PPPA_Interface_BSM PPPA_DecelMin PPPA_DecelMax PPPA_AccelMin PPPA_AccelMax ParkingGearShiftReq TorqueOverlaySteeringReq_SPM;

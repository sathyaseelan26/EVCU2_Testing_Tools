VERSION ""

NS_ :

BS_:

BU_: PPIM HCP SGW IDCM EVCU2 BPCM

BO_ 500 BATT_PACK_DEV: 32 BPCM
 SG_ BMS_HV_NumCellMinTemp : 174|9@0+ (1,0) [0|510] ""  SGW
 SG_ BMS_HV_NumCellMaxVolt : 53|8@0+ (1,0) [0|255] ""  SGW
 SG_ BMS_HV_NumCellMaxTemp : 167|9@0+ (1,0) [0|510] ""  SGW
 SG_ BMS_Cell_Volt_Min : 93|13@0+ (0.001,0) [0|8.19] "V"  SGW
 SG_ BMS_Cell_Volt_Max : 75|13@0+ (0.001,0) [0|8.19] "V"  SGW

BO_ 250 APM_VDCM: 32 IDCM
 SG_ APM_Water_Temp : 95|8@0+ (1,-40) [-40|214] "°C"  EVCU2
 SG_ APM_RecoveryAction : 101|8@0+ (1,0) [0|255] ""  EVCU2
 SG_ APM_PSFB_Temp2 : 75|12@0+ (0.1,-40) [-40|369.4] "°C"  EVCU2
 SG_ APM_PSFB_Temp1 : 71|12@0+ (0.1,-40) [-40|369.4] "°C"  EVCU2
 SG_ APM_LV_V_Fbk : 47|12@0+ (0.009143,0) [0|37.431442] "V"  EVCU2
 SG_ APM_LV_I_Fbk : 23|12@0+ (0.076917,0) [0|314.898198] "A"  EVCU2
 SG_ APM_HV_V_Fbk : 51|12@0+ (0.445636,0) [0|1824.433784] "V"  EVCU2
 SG_ APM_HV_I_Fbk : 27|12@0+ (0.002718,0) [0|11.127492] "A"  EVCU2
 SG_ APM_Buck_Temp : 3|12@0+ (0.1,-40) [-40|369.4] "°C"  EVCU2
 SG_ APM_UtilPctOfDCDC : 154|7@0+ (1,0) [0|127] "%"  EVCU2
 SG_ APM_TempColdPlate : 146|8@0+ (1,-40) [-40|215] "degC"  EVCU2
 SG_ APM_PowerLimitMode : 112|1@0+ (1,0) [0|1] ""  EVCU2
 SG_ APM_OutputPower : 179|10@0+ (3,0) [0|3069] "W"  EVCU2
 SG_ APM_InputPower : 173|10@0+ (3,0) [0|3069] "W"  EVCU2
 SG_ APM_IdcHvSetPFdbk : 140|10@0+ (0.2,-100) [-100|104.6] "Amp"  EVCU2
 SG_ APM_HvVsetPFdbk : 185|9@0+ (1,0) [0|511] "V"  EVCU2
 SG_ APM_HvOverVStatus : 114|1@0+ (1,0) [0|1] ""  EVCU2
 SG_ APM_FailureType : 103|2@0+ (1,0) [0|3] ""  EVCU2
 SG_ APM_FailureReason : 122|6@0+ (1,0) [0|63] ""  EVCU2
 SG_ APM_EstPwrLoss : 132|8@0+ (2,0) [0|510] "W"  EVCU2
 SG_ APM_DeratingReason : 127|5@0+ (1,0) [0|31] ""  EVCU2
 SG_ APM_DeratingModeStatus : 109|3@0+ (1,0) [0|7] ""  EVCU2
 SG_ APM_CurrentLimitMode : 113|1@0+ (1,0) [0|1] ""  EVCU2
 SG_ APM_CtrlSts_Fbk : 7|4@0+ (1,0) [0|15] ""  EVCU2
 SG_ MessageCounter_APM_VDCM : 243|4@0+ (1,0) [0|15] "-"  EVCU2
 SG_ CRC_APM_VDCM : 255|8@0+ (1,0) [0|255] "-"  EVCU2
 SG_ APM_DeratingPower : 163|6@0+ (50,0) [0|3100] "W"  EVCU2

BO_ 2564485397 DIAGNOSTIC_RESPONSE_MCPB: 8 EVCU2
 SG_ N_PDU_18DAF115 : 7|64@0+ (1,0) [0|0] ""  SGW

BO_ 546 VDCM_OBCM2: 64 EVCU2
 SG_ VDCM_MaxChrgTime_sec : 47|8@0+ (10,0) [0|2550] "sec"  IDCM
 SG_ VDCM_MaxChrgTime_min : 39|8@0+ (1,0) [0|255] "min"  IDCM
 SG_ VDCM_EV_Batt_Max_T_Limit : 23|8@0+ (1,0) [0|255] "°C"  IDCM
 SG_ VDCM_EstChrgTime_min : 31|8@0+ (1,0) [0|255] "min"  IDCM
 SG_ VDCM_ChrgMode_Req : 15|8@0+ (1,0) [0|255] ""  IDCM
 SG_ VDCM_ChrgCurrDeviationErr : 48|1@0+ (1,0) [0|1] ""  IDCM
 SG_ VDCM_ChrgCompleteReason : 63|3@0+ (1,0) [0|7] ""  IDCM
 SG_ VDCM_BattUnderVolt : 51|1@0+ (1,0) [0|1] ""  IDCM
 SG_ VDCM_BattOverVolt : 52|1@0+ (1,0) [0|1] ""  IDCM
 SG_ VDCM_BattFullSOC_prc : 7|8@0+ (1,0) [0|255] "%"  IDCM
 SG_ CPIM_Over_Temperature : 54|1@0+ (1,0) [0|1] ""  IDCM
 SG_ CPIM_Error : 55|1@0+ (1,0) [0|1] ""  IDCM
 SG_ WeldCheck_Complete : 258|1@0+ (1,0) [0|1] ""  IDCM
 SG_ VDCM_SOCIsOOR : 273|2@0+ (1,0) [0|3] ""  IDCM
 SG_ VDCM_ChargeCurrIsOOR : 287|2@0+ (1,0) [0|3] ""  IDCM
 SG_ VDCM_CellVoltIsOOR : 275|2@0+ (1,0) [0|3] ""  IDCM
 SG_ VDCM_BattTempIsOOR : 285|2@0+ (1,0) [0|3] ""  IDCM
 SG_ ReadyToChargeState : 259|1@0+ (1,0) [0|1] ""  IDCM
 SG_ HCP_SessionStopCmd : 260|1@0+ (1,0) [0|1] ""  IDCM
 SG_ HCP_DC_Retry : 249|5@0+ (1,0) [0|31] ""  IDCM
 SG_ DCChrg_BatSideCurrent_VDCM : 237|10@0+ (1,-50) [-50|973] "A"  IDCM
 SG_ BMS_Max_Pk_Volt_Allowed_VDCM : 196|10@0+ (1,0) [0|1022] "V"  IDCM
 SG_ BMS_Max_Cell_Volt_Allowed_Vldty_ : 98|1@0+ (1,0) [0|1] ""  IDCM
 SG_ BMS_Max_Cell_Volt_Allowed_VDCM : 95|13@0+ (0.001,0) [0|8.19] "V"  IDCM
 SG_ BMS_HV_Trac_PreCha_Contac_Sts_VD : 176|3@0+ (1,0) [0|7] ""  IDCM,BPCM
 SG_ BMS_HV_Trac_Main_Contac_Sts_VDCM : 189|3@0+ (1,0) [0|7] ""  IDCM,BPCM
 SG_ BMS_HV_Temperature_Min_VDCM : 118|11@0+ (0.1,-40) [-40|164.6] "°C"  IDCM
 SG_ BMS_HV_Temperature_Max_VDCM : 97|11@0+ (0.1,-40) [-40|164.6] "°C"  IDCM
 SG_ BMS_HV_SOC_AccuracySts_VDCM : 161|2@0+ (1,0) [0|2] "-"  IDCM
 SG_ BMS_HV_NumCellMinTemp_VDCM : 123|9@0+ (1,0) [0|510] ""  IDCM
 SG_ BMS_HV_NumCellMaxVolt_VDCM : 130|8@0+ (1,0) [0|255] ""  IDCM
 SG_ BMS_HV_NumCellMaxTemp_VDCM : 172|9@0+ (1,0) [0|510] ""  IDCM
 SG_ BMS_HV_Low_Temp_Thrsh_VDCM : 159|11@0+ (0.1,-40) [-40|164.7] "°C"  IDCM
 SG_ BMS_HV_InternalVoltage_VDCM : 213|13@0+ (0.1,90.9) [90.9|910] "V"  IDCM,BPCM
 SG_ BMS_HV_High_Temp_Thrsh_VDCM : 138|11@0+ (0.1,-40) [-40|164.7] "°C"  IDCM
 SG_ BMS_HV_Common_Contactor_Sts_VDCM : 164|3@0+ (1,0) [0|6] ""  IDCM,BPCM
 SG_ BMS_HV_Battery_GFD_Sts_VDCM : 179|3@0+ (1,0) [0|7] ""  IDCM,BPCM
 SG_ BMS_HV_BatIntrlk_InternalStat_VD : 175|3@0+ (1,0) [0|7] ""  IDCM,BPCM
 SG_ BMS_HV_AC_Char_Main_Contac_Sts_V : 200|3@0+ (1,0) [0|7] ""  IDCM,BPCM
 SG_ BMS_Cell_Volt_Min_Vldty_VDCM : 80|1@0+ (1,0) [0|1] ""  IDCM
 SG_ BMS_Cell_Volt_Min_VDCM : 77|13@0+ (0.001,0) [0|8.19] "V"  IDCM
 SG_ BMS_Cell_Volt_Max_Vldty_VDCM : 78|1@0+ (1,0) [0|1] ""  IDCM
 SG_ BMS_Cell_Volt_Max_VDCM : 59|13@0+ (0.001,0) [0|8.19] "V"  IDCM
 SG_ AC_Chrg_Branch_Voltage_VDCM : 243|10@0+ (1,0) [0|1023] "V"  IDCM
 SG_ BMS_HV_Char_PreCha_Contac_Sts_VD : 199|3@0+ (1,0) [0|7] ""  IDCM,BPCM
 SG_ BMS_HV_Char_Main_Contac_Sts_VDCM : 186|3@0+ (1,0) [0|7] ""  IDCM,BPCM
 SG_ BMS_HV_TractionBusVoltage_VDCM : 311|10@0+ (1,0) [0|1023] "V"  IDCM,BPCM
 SG_ BMS_HV_Trac_Bus_Sts_VDCM : 283|3@0+ (1,0) [0|7] ""  IDCM,BPCM
 SG_ BMS_HV_ChargingBusVoltage_VDCM : 289|10@0+ (1,0) [0|1023] "V"  IDCM,BPCM
 SG_ BMS_HV_Char_Bus_Sts_VDCM : 280|3@0+ (1,0) [0|7] ""  IDCM,BPCM
 SG_ BMS_HV_BatState_VDCM : 293|4@0+ (1,0) [0|15] ""  IDCM,BPCM
 SG_ BMS_HV_BatActualPower_VDCM : 317|15@0+ (0.1,-1638.3) [-1638.3|1638.4] "kW"  IDCM,BPCM
 SG_ VDCM_ChargingPermitting : 53|1@0+ (1,0) [0|1] ""  IDCM
 SG_ GBT_Target_Voltage_Reached : 334|2@0+ (1,0) [0|3] ""  IDCM
 SG_ GBT_Target_Cell_Voltage_Reached : 332|2@0+ (1,0) [0|3] ""  IDCM
 SG_ GBT_Ready_to_Charge : 60|1@0+ (1,0) [0|1] ""  IDCM
 SG_ GBT_Desired_SOC_Reached : 50|2@0+ (1,0) [0|3] ""  IDCM
 SG_ GBT_Charger_Active_Interruption : 330|2@0+ (1,0) [0|3] ""  IDCM
 SG_ MessageCounter_VO2 : 435|4@0+ (1,0) [0|15] ""  IDCM,BPCM
 SG_ CRC_VO2 : 447|8@0+ (1,0) [0|255] ""  IDCM,BPCM

BO_ 544 OBCM_VDCM2: 64 IDCM
 SG_ Plug_Locked_by_EVSE : 52|2@0+ (1,0) [0|2] ""  EVCU2
 SG_ HVCMS_EVSEID : 7|32@0+ (1,0) [0|4294967294] ""  EVCU2
 SG_ ExtChargerSts : 42|2@0+ (1,0) [0|2] ""  EVCU2
 SG_ EVSE_Error : 54|2@0+ (1,0) [0|2] ""  EVCU2
 SG_ EVSE_ChrgStopControl : 40|2@0+ (1,0) [0|2] ""  EVCU2
 SG_ Charger_WeldingDetectAvail : 44|2@0+ (1,0) [0|2] ""  EVCU2
 SG_ Charger_StndbyReqReason : 47|3@0+ (1,0) [0|6] ""  EVCU2
 SG_ Charger_StndbyReq : 33|2@0+ (1,0) [0|2] ""  EVCU2
 SG_ Charger_FaultStates : 37|4@0+ (1,0) [0|14] ""  EVCU2
 SG_ CC2VoltDetError : 39|2@0+ (1,0) [0|2] ""  EVCU2
 SG_ OBCM_CSSts : 152|2@0+ (1,0) [0|3] ""  EVCU2
 SG_ OBCM_CP3Sts : 158|3@0+ (1,0) [0|7] ""  EVCU2
 SG_ OBCM_CP2Sts : 145|3@0+ (1,0) [0|7] ""  EVCU2
 SG_ OBCM_CCSts : 155|3@0+ (1,0) [0|7] ""  EVCU2
 SG_ OBCM_APAMSts : 147|2@0+ (1,0) [0|3] ""  EVCU2
 SG_ TCP_Communication_Terminated : 162|1@0+ (1,0) [0|1] ""  EVCU2
 SG_ OBCM_CP1Sts : 166|3@0+ (1,0) [0|7] ""  EVCU2
 SG_ TxGBTMessageResponse : 61|5@0+ (1,0) [0|31] ""  EVCU2
 SG_ TxGBTMessageRequest : 50|5@0+ (1,0) [0|31] ""  EVCU2
 SG_ OBCM_Timeout : 56|1@0+ (1,0) [0|1] ""  EVCU2
 SG_ EVCC_FailureSts : 163|1@0+ (1,0) [0|1] ""  EVCU2
 SG_ CC2_VoltageValue : 71|8@0+ (0.1,0) [0|25.5] "V"  EVCU2
 SG_ GBT_EVSE_Charge_Permitting : 79|1@0+ (1,0) [0|1] ""  EVCU2
 SG_ MessageCounter_OV2 : 435|4@0+ (1,0) [0|15] ""  EVCU2
 SG_ CRC_OV2 : 447|8@0+ (1,0) [0|255] ""  EVCU2
 SG_ EVSE_NotificationMaxDelay : 87|18@0+ (1,0) [0|262143] "s"  EVCU2

BO_ 1790 BATTERY_HV2: 32 BPCM
 SG_ BMS_HV_SOC_AccuracySts : 17|2@0+ (1,0) [0|2] "-"  EVCU2
 SG_ BMS_HV_Low_Temp_Thrsh : 12|11@0+ (0.1,-40) [-40|164.7] "°C"  EVCU2
 SG_ BMS_HV_High_Temp_Thrsh : 7|11@0+ (0.1,-40) [-40|164.7] "°C"  EVCU2
 SG_ HVBatCell_Voltage_Low_Thrsh : 49|13@0+ (0.001,0) [0|8.191] ""  EVCU2
 SG_ HVBatCell_Voltage_High_Thrsh : 46|13@0+ (0.001,0) [0|8.191] ""  EVCU2
 SG_ HEV_OnRq_BPCM : 31|1@0+ (1,0) [0|1] ""  EVCU2
 SG_ BMS_HV_SOC_Min : 30|8@0+ (0.391257,0) [0|100] "%"  EVCU2
 SG_ BMS_HV_SOC_Max : 38|8@0+ (0.392157,0) [0|100] "%"  EVCU2

BO_ 105 VDCM_PWT3: 64 EVCU2
 SG_ ClrLgsDiagInfo : 431|1@0+ (1,0) [0|1] ""  IDCM

BO_ 260 PIM_RR: 64 EVCU2
 SG_ MCPB_DC_Current : 391|15@0+ (0.1,-1638.4) [-1638.4|1638.3] "A"  BPCM
 SG_ MC_PRR1 : 499|4@0+ (1,0) [0|15] ""  BPCM
 SG_ CRC_PRR1 : 511|8@0+ (1,0) [0|255] ""  BPCM

BO_ 1062 MCPA_DATA2: 64 EVCU2
 SG_ MCPA_Temp : 7|8@0+ (1,-40) [-40|215] "°C"  SGW

BO_ 1893 HVBATTERY_RM_MODS2: 48 BPCM
 SG_ HVBatModuleTemp_66 : 199|8@0+ (1,-40) [-40|215] "°C"  SGW
 SG_ HVBatModuleTemp_65 : 191|8@0+ (1,-40) [-40|215] "°C"  SGW
 SG_ HVBatModuleTemp_64 : 183|8@0+ (1,-40) [-40|215] "°C"  SGW
 SG_ HVBatModuleTemp_63 : 175|8@0+ (1,-40) [-40|215] "°C"  SGW
 SG_ HVBatModuleTemp_62 : 167|8@0+ (1,-40) [-40|215] "°C"  SGW
 SG_ HVBatModuleTemp_61 : 159|8@0+ (1,-40) [-40|215] "°C"  SGW
 SG_ HVBatModuleTemp_60 : 151|8@0+ (1,-40) [-40|215] "°C"  SGW
 SG_ HVBatModuleTemp_59 : 143|8@0+ (1,-40) [-40|215] "°C"  SGW
 SG_ HVBatModuleTemp_58 : 135|8@0+ (1,-40) [-40|215] "°C"  SGW
 SG_ HVBatModuleTemp_57 : 127|8@0+ (1,-40) [-40|215] "°C"  SGW
 SG_ HVBatModuleTemp_56 : 119|8@0+ (1,-40) [-40|215] "°C"  SGW
 SG_ HVBatModuleTemp_55 : 111|8@0+ (1,-40) [-40|215] "°C"  SGW
 SG_ HVBatModuleTemp_54 : 103|8@0+ (1,-40) [-40|215] "°C"  SGW
 SG_ HVBatModuleTemp_41 : 223|8@0+ (1,-40) [-40|215] "°C"  SGW
 SG_ HVBatModuleTemp_40 : 215|8@0+ (1,-40) [-40|215] "°C"  SGW
 SG_ HVBatModuleTemp_39 : 207|8@0+ (1,-40) [-40|215] "°C"  SGW
 SG_ HVBatModuleVoltage_NumMin : 225|6@0+ (1,0) [0|63] "" Vector__XXX
 SG_ HVBatModuleVoltage_NumMax : 231|6@0+ (1,0) [0|63] "" Vector__XXX
 SG_ HVBatModuleTemp_53 : 95|8@0+ (1,-40) [-40|215] "°C"  SGW
 SG_ HVBatModuleTemp_52 : 87|8@0+ (1,-40) [-40|215] "°C"  SGW
 SG_ HVBatModuleTemp_51 : 79|8@0+ (1,-40) [-40|215] "°C"  SGW
 SG_ HVBatModuleTemp_50 : 71|8@0+ (1,-40) [-40|215] "°C"  SGW
 SG_ HVBatModuleTemp_49 : 63|8@0+ (1,-40) [-40|215] "°C"  SGW
 SG_ HVBatModuleTemp_48 : 55|8@0+ (1,-40) [-40|215] "°C"  SGW
 SG_ HVBatModuleTemp_47 : 47|8@0+ (1,-40) [-40|215] "°C"  SGW
 SG_ HVBatModuleTemp_46 : 39|8@0+ (1,-40) [-40|215] "°C"  SGW
 SG_ HVBatModuleTemp_45 : 31|8@0+ (1,-40) [-40|215] "°C"  SGW
 SG_ HVBatModuleTemp_44 : 23|8@0+ (1,-40) [-40|215] "°C"  SGW
 SG_ HVBatModuleTemp_43 : 15|8@0+ (1,-40) [-40|215] "°C"  SGW
 SG_ HVBatModuleTemp_42 : 7|8@0+ (1,-40) [-40|215] "°C"  SGW

BO_ 1031 HV_CHARGER1: 64 IDCM
 SG_ InputCurrentAvailable : 96|9@0+ (1,0) [0|300] "Amp"  EVCU2
 SG_ AC_Side_Volt3 : 164|13@0+ (0.1,0) [0|819] "Volts"  EVCU2,SGW
 SG_ AC_Side_Volt2 : 145|13@0+ (0.1,0) [0|819] "Volts"  EVCU2,SGW
 SG_ AC_Side_Volt1 : 142|13@0+ (0.1,0) [0|819] "Volts"  EVCU2,SGW
 SG_ AC_Side_Curr3 : 121|11@0+ (0.1,-100) [-100|104.6] "Amp"  EVCU2,SGW
 SG_ AC_Side_Curr2 : 65|11@0+ (0.1,-100) [-100|104.6] "Amp"  EVCU2,SGW
 SG_ AC_Side_Curr1 : 19|11@0+ (0.1,-100) [-100|104.6] "Amp"  EVCU2,SGW
 SG_ ProximitySts : 39|3@0+ (1,0) [0|7] "-"  EVCU2
 SG_ OBCM_SlacSts : 54|2@0+ (1,0) [0|3] "-"  EVCU2
 SG_ OBCM_SdpSts : 102|2@0+ (1,0) [0|3] ""  EVCU2
 SG_ OBCInterlockSts : 86|2@0+ (1,0) [0|3] ""  EVCU2
 SG_ OBC_DeratingReason : 7|4@0+ (1,0) [0|15] "-"  EVCU2
 SG_ J1772_State : 22|3@0+ (1,0) [0|7] "-"  EVCU2
 SG_ J1772_S2_Sts : 23|1@0+ (1,0) [0|1] "-"  EVCU2
 SG_ InputVoltage_isAC : 82|1@0+ (1,0) [0|1] "-"  EVCU2
 SG_ InputVoltage_is60Hz : 71|1@0+ (1,0) [0|1] "-"  EVCU2
 SG_ HV_Overvoltage : 69|1@0+ (1,0) [0|1] "-"  EVCU2
 SG_ HV_Overcurrent : 68|1@0+ (1,0) [0|1] "-"  EVCU2
 SG_ ControlPilotSts : 36|3@0+ (1,0) [0|7] "-"  EVCU2
 SG_ ChargeEnableSts : 181|2@0+ (1,0) [0|2] "-"  EVCU2
 SG_ ChargeCurrentAvailable : 49|10@0+ (0.1,0) [0|102.3] "Amp"  EVCU2
 SG_ ChargeCurrent : 33|10@0+ (0.1,0) [0|102.3] "Amp"  EVCU2
 SG_ BatterySideCurrent : 81|11@0+ (0.1,-50) [-50|154.7] "Amp"  EVCU2
 SG_ AC_Present : 70|1@0+ (1,0) [0|1] "-"  EVCU2
 SG_ AC_HighLoadWarning : 51|1@0+ (1,0) [0|1] "-"  EVCU2
 SG_ Supported_VerNumberMinor : 264|3@0+ (1,0) [0|7] ""  EVCU2
 SG_ Supported_VerNumberMajor : 267|3@0+ (1,0) [0|7] ""  EVCU2
 SG_ Supported_SchemaID : 270|3@0+ (1,0) [0|7] ""  EVCU2
 SG_ Supported_ProtocolName : 257|3@0+ (1,0) [0|7] ""  EVCU2
 SG_ MessageCounter_HV_CHARGER1 : 179|4@0+ (1,0) [0|15] "-"  EVCU2
 SG_ EVCC_FailureReason : 263|6@0+ (1,0) [0|63] ""  EVCU2
 SG_ CRC_HV_CHARGER1 : 191|8@0+ (1,0) [0|255] "-"  EVCU2
 SG_ BatterySideVoltage : 119|14@0+ (0.1,0) [0|1638.3] "Volts"  EVCU2
 SG_ AC_LnLow : 50|1@0+ (1,0) [0|1] ""  EVCU2
 SG_ AC_LnHi : 183|1@0+ (1,0) [0|1] ""  EVCU2
 SG_ Plug_And_Charge_Contract_Sts : 67|2@0+ (1,0) [0|3] ""  SGW
 SG_ RCD : 274|1@0+ (1,0) [0|1] "-"  EVCU2
 SG_ EVSENominalVoltage : 273|10@0+ (1,0) [0|1023] "V"  EVCU2
 SG_ EVSEMaxCurrent : 288|9@0+ (1,0) [0|511] "A"  EVCU2

BO_ 2564486468 DIAGNOSTIC_RESPONSE_FOTA_BPCM: 64 BPCM
 SG_ N_PDU_18DAF544 : 7|64@0+ (1,0) [0|0] ""  SGW

BO_ 2654814269 ECU_APPL_FD_BPCM: 64 BPCM
 SG_ ECU_APPL_FD_BPCM : 455|64@0+ (1,0) [0|0] ""  HCP

BO_ 1063 MCPB_DATA2: 64 EVCU2
 SG_ MCPB_Temp : 6|8@0+ (1,-40) [-40|215] "°C"  SGW

BO_ 2564486421 DIAGNOSTIC_RESPONSE_FOTA_MCPB: 64 EVCU2
 SG_ N_PDU_18DAF515 : 7|64@0+ (1,0) [0|0] ""  SGW

BO_ 2564486420 DIAGNOSTIC_RESPONSE_FOTA_MCPA: 64 EVCU2
 SG_ N_PDU_18DAF514 : 7|64@0+ (1,0) [0|0] ""  SGW

BO_ 2564429301 DIAGNOSTIC_REQUEST_FOTA_MCPB: 64 SGW
 SG_ N_PDU_18DA15F5 : 7|64@0+ (1,0) [0|0] ""  EVCU2

BO_ 2564429045 DIAGNOSTIC_REQUEST_FOTA_MCPA: 64 SGW
 SG_ N_PDU_18DA14F5 : 7|64@0+ (1,0) [0|0] ""  EVCU2

BO_ 2564441333 DIAGNOSTIC_REQUEST_FOTA_BPCM: 64 SGW
 SG_ N_PDU_18DA44F5 : 455|64@0+ (1,0) [0|0] ""  BPCM

BO_ 2564486480 DIAGNOSTIC_RESPONSE_FOTA_IDCM: 64 IDCM
 SG_ N_PDU_18DAF550 : 7|64@0+ (1,0) [0|0] ""  SGW

BO_ 2564444405 DIAGNOSTIC_REQUEST_FOTA_IDCM: 64 SGW
 SG_ N_PDU_18DA50F5 : 7|64@0+ (1,0) [0|0] ""  IDCM

BO_ 2564554485 DIAGNOSTIC_REQUEST_FUNC_FOTA: 64 SGW
 SG_ N_PDU_18DBFEF5 : 7|64@0+ (1,0) [0|0] ""  PPIM,IDCM,BPCM,HCP

BO_ 292 BATTERY_HV_STATUS1: 64 BPCM
 SG_ MessageCounter_BATT_HV_STATUS1 : 435|4@0+ (1,0) [0|15] "-"  EVCU2,IDCM
 SG_ CRC_BATT_HV_STATUS1 : 447|8@0+ (1,0) [0|255] "-"  EVCU2,IDCM
 SG_ HVBatContactorWeldCheck : 302|1@0+ (1,0) [0|1] ""  EVCU2
 SG_ HVBatReady : 268|1@0+ (1,0) [0|1] ""  EVCU2
 SG_ BPCM_DC_CntctrsMidTrmOpeningWarn : 267|1@0+ (1,0) [0|1] ""  EVCU2
 SG_ BPCM_DC_CntctrsShtTrmOpeningWarn : 266|1@0+ (1,0) [0|1] ""  EVCU2
 SG_ BPCM_HV_Trac_Main_Contac_Sts : 181|3@0+ (1,0) [0|7] ""  EVCU2,IDCM
 SG_ BPCM_HV_BalancingMode : 164|2@0+ (1,0) [0|3] ""  EVCU2
 SG_ BPCM_HV_ChargingBusVoltage : 162|11@0+ (1,0) [0|2047] "V"  EVCU2
 SG_ BPCM_HV_TractionBusVoltage : 146|11@0+ (1,0) [0|2047] "V"  EVCU2,IDCM
 SG_ BPCM_Pwr_Limp_Home_On : 55|1@0+ (1,0) [0|1] ""  EVCU2
 SG_ BPCM_HV_Trac_Bus_Sts : 36|3@0+ (1,0) [0|7] ""  EVCU2,IDCM
 SG_ BPCM_HV_Char_Bus_Sts : 39|3@0+ (1,0) [0|7] ""  EVCU2
 SG_ BPCM_HV_SOH_Low : 30|7@0+ (1,0) [0|127] ""  EVCU2
 SG_ BPCM_HV_SOH : 22|7@0+ (1,0) [0|127] ""  EVCU2
 SG_ HVBatContactorOpenTime : 15|8@0+ (0.2,0) [0|51] "Hours"  EVCU2
 SG_ HVBatLastSlept : 7|8@0+ (0.2,0) [0|51] "Days"  EVCU2
 SG_ BPCMInterlockSts : 54|3@0+ (1,0) [0|4] ""  EVCU2
 SG_ BPCM_HV_BatIntrlk_InternalStat : 271|3@0+ (1,0) [0|3] ""  EVCU2
 SG_ BPCM_HV_Temperature_Min : 218|11@0+ (0.1,-40) [-40|164.7] "°C"  EVCU2
 SG_ BPCM_HV_Temperature_Max : 202|11@0+ (0.1,-40) [-40|164.7] "°C"  EVCU2
 SG_ BPCM_HV_Temperature_Avg : 186|11@0+ (0.1,-40) [-40|164.7] "°C"  EVCU2
 SG_ BPCM_HV_SOC : 33|10@0+ (0.1,0) [0|102.3] "%"  EVCU2,SGW
 SG_ BPCM_HV_Outlet_Temp : 250|11@0+ (0.1,-40) [-40|164.7] "°C"  EVCU2
 SG_ BPCM_HV_InternalVoltage : 133|14@0+ (0.1,90.9) [90.9|1729.2] "V"  EVCU2
 SG_ BPCM_HV_Inlet_Temp : 234|11@0+ (0.1,-40) [-40|164.7] "°C"  EVCU2
 SG_ BPCM_HV_Current : 71|16@0+ (0.1,-3276.7) [-3276.7|3276.8] "A"  EVCU2
 SG_ BPCM_HV_Capacity : 51|12@0+ (0.15,0) [0|614.25] "Ah"  EVCU2
 SG_ BPCM_HV_Battery_GFD_Sts : 149|3@0+ (1,0) [0|4] ""  EVCU2
 SG_ BPCM_Wakeup_Request : 23|1@0+ (1,0) [0|1] ""  EVCU2
 SG_ BPCM_HV_ThermalRunaway : 135|2@0+ (1,0) [0|3] ""  EVCU2
 SG_ HVBP_Busbar_Temp : 423|8@0+ (1,-40) [-40|215] "°C"  EVCU2
 SG_ HVBP_BDU_Busbar_Temp : 415|8@0+ (1,-40) [-40|215] "°C"  EVCU2
 SG_ DC_Charge_Type_Status : 319|3@0+ (1,0) [0|7] ""  EVCU2
 SG_ BPCM_Series_Voltage : 367|13@0+ (0.1,90.9) [90.9|910] "V"  EVCU2
 SG_ BPCM_Request_for_Aux_Load_off : 313|1@0+ (1,0) [0|1] ""  EVCU2
 SG_ BPCM_HV_Trac_Main_Contac_Config : 316|3@0+ (1,0) [0|7] ""  EVCU2
 SG_ BPCM_HV_InternalVoltageString2 : 351|13@0+ (0.1,90.9) [90.9|910] "V"  EVCU2
 SG_ BPCM_HV_InternalVoltageString1 : 335|13@0+ (0.1,90.9) [90.9|910] "V"  EVCU2
 SG_ BPCM_HV_DCFC_Isolation_Sts : 167|3@0+ (1,0) [0|7] ""  EVCU2
 SG_ BPCM_HV_Trac_PreCha_Contac_Sts : 354|3@0+ (1,0) [0|7] ""  EVCU2

BO_ 485 BATTERY_HV_VLIMITS: 64 BPCM
 SG_ MessageCounter_BATT_HV_VLIMITS : 435|4@0+ (1,0) [0|15] "-"  EVCU2
 SG_ CRC_BATT_HV_VLIMITS : 447|8@0+ (1,0) [0|255] "-"  EVCU2
 SG_ BPCM_HV_NumCellMinTemp : 224|9@0+ (1,0) [0|511] ""  EVCU2
 SG_ BPCM_HV_NumCellMaxTemp : 192|9@0+ (1,0) [0|511] ""  EVCU2
 SG_ BPCM_HV_NumCellMinVolt : 80|9@0+ (1,0) [0|511] ""  EVCU2
 SG_ BPCM_HV_NumCellMaxVolt : 64|9@0+ (1,0) [0|511] ""  EVCU2
 SG_ BPCM_Min_Pk_Volt_Allowed : 50|11@0+ (1,0) [0|2047] "V"  EVCU2
 SG_ BPCM_Max_Pk_Volt_Allowed : 18|11@0+ (1,0) [0|2047] "V"  EVCU2
 SG_ BPCM_OCV_Min_Cell_Volt : 180|13@0+ (0.001,0) [0|8.191] "V"  EVCU2
 SG_ BPCM_OCV_Max_Cell_Volt : 164|13@0+ (0.001,0) [0|8.191] "V"  EVCU2
 SG_ BPCM_OCV_Avg_Cell_Volt : 148|13@0+ (0.001,0) [0|8.191] "V"  EVCU2
 SG_ BPCM_Min_Cell_Volt_Allowed : 36|13@0+ (0.001,0) [0|8.191] "V"  EVCU2
 SG_ BPCM_Max_Cell_Volt_Allowed : 132|13@0+ (0.001,0) [0|8.191] "V"  EVCU2
 SG_ BPCM_HV_Insulation_Resistance : 215|16@0+ (1,0) [0|65535] "kOhm"  EVCU2
 SG_ BPCM_Cell_Volt_Min : 116|13@0+ (0.001,0) [0|8.191] "V"  EVCU2
 SG_ BPCM_Cell_Volt_Max : 100|13@0+ (0.001,0) [0|8.191] "V"  EVCU2
 SG_ BPCM_Cell_Volt_Avg : 4|13@0+ (0.001,0) [0|8.191] "V"  EVCU2

BO_ 288 BATTERY_HV_POWERLIMITS: 64 BPCM
 SG_ BPCM_HV_HVBatChargeStat : 215|3@0+ (1,0) [0|7] ""  EVCU2
 SG_ BPCM_HV_PwrLmtInstDschg : 245|14@0+ (0.1,0) [0|1638.3] ""  EVCU2
 SG_ BPCM_HV_PwrLmtInstChrg : 309|14@0+ (0.1,0) [0|1638.3] ""  EVCU2
 SG_ BPCM_HV_Pwr_MaxDischrg_ShrTrm : 69|14@0+ (0.1,0) [0|1638.3] "kW"  EVCU2
 SG_ BPCM_HV_Power_MaxDischarge_MdTrm : 133|14@0+ (0.1,0) [0|1638.3] "kW"  EVCU2
 SG_ BPCM_HV_Power_MaxDischarge_LgTrm : 197|14@0+ (0.1,0) [0|1638.3] "kW"  EVCU2
 SG_ BPCM_HV_Power_MaxCharge_ShrTrm : 53|14@0+ (0.1,0) [0|1638.3] "kW"  EVCU2
 SG_ BPCM_HV_Power_MaxCharge_MdTrm : 117|14@0+ (0.1,0) [0|1638.3] "kW"  EVCU2
 SG_ BPCM_HV_Power_MaxCharge_LgTrm : 181|14@0+ (0.1,0) [0|1638.3] "kW"  EVCU2
 SG_ BPCM_HV_CrntLmtInstDschg : 374|15@0+ (0.1,0) [0|3276.7] "A"  EVCU2
 SG_ BPCM_HV_CrntLmtInstChrg : 390|15@0+ (0.1,0) [0|3276.7] "A"  EVCU2
 SG_ BPCM_HV_ChargingCurrentProfile : 6|15@0+ (0.1,0) [0|3276.7] "A"  EVCU2
 SG_ BPCM_HV_Cell_MinDischrg_Imped : 228|13@0+ (0.01,0) [0|81.91] "Ohm"  EVCU2
 SG_ BPCM_HV_Cell_MaxDischrg_Imped : 212|13@0+ (0.01,0) [0|81.91] "Ohm"  EVCU2
 SG_ BPCM_CntctrsShtTrmOpeningWarn : 417|1@0+ (1,0) [0|1] ""  EVCU2,IDCM
 SG_ BPCM_CntctrsMidTrmOpeningWarn : 416|1@0+ (1,0) [0|1] ""  EVCU2
 SG_ MessageCounter_BATT_HV_POWERLIMS : 435|4@0+ (1,0) [0|15] "-"  EVCU2
 SG_ CRC_BATT_HV_POWERLIMS : 447|8@0+ (1,0) [0|255] "-"  EVCU2

BO_ 2564485698 DIAGNOSTIC_RESPONSE_FD_EVCU2: 64 EVCU2
 SG_ N_PDU_18DAF242 : 7|64@0+ (1,0) [0|0] ""  SGW

BO_ 2564440818 DIAGNOSTIC_REQUEST_FD_EVCU2: 64 SGW
 SG_ N_PDU_18DA42F2 : 455|64@0+ (1,0) [0|0] ""  EVCU2

BO_ 1965 HVBATTERY_RM_CELLS9: 64 BPCM
 SG_ HVBatCellVoltage_Cell232 : 244|13@0+ (0.001,0) [0|5] "V"  SGW
 SG_ HVBatCellVoltage_Cell231 : 228|13@0+ (0.001,0) [0|5] "V"  SGW
 SG_ HVBatCellVoltage_Cell230 : 212|13@0+ (0.001,0) [0|5] "V"  SGW
 SG_ HVBatCellVoltage_Cell229 : 196|13@0+ (0.001,0) [0|5] "V"  SGW
 SG_ HVBatCellVoltage_Cell228 : 180|13@0+ (0.001,0) [0|5] "V"  SGW
 SG_ HVBatCellVoltage_Cell227 : 164|13@0+ (0.001,0) [0|5] "V"  SGW
 SG_ HVBatCellVoltage_Cell226 : 148|13@0+ (0.001,0) [0|5] "V"  SGW
 SG_ HVBatCellVoltage_Cell225 : 132|13@0+ (0.001,0) [0|5] "V"  SGW
 SG_ HVBatCellVoltage_Cell224 : 116|13@0+ (0.001,0) [0|5] "V"  SGW
 SG_ HVBatCellVoltage_Cell223 : 100|13@0+ (0.001,0) [0|5] "V"  SGW
 SG_ HVBatCellVoltage_Cell222 : 84|13@0+ (0.001,0) [0|5] "V"  SGW
 SG_ HVBatCellVoltage_Cell221 : 68|13@0+ (0.001,0) [0|5] "V"  SGW
 SG_ HVBatCellVoltage_Cell220 : 52|13@0+ (0.001,0) [0|5] "V"  SGW
 SG_ HVBatCellVoltage_Cell219 : 36|13@0+ (0.001,0) [0|5] "V"  SGW
 SG_ HVBatCellVoltage_Cell218 : 20|13@0+ (0.001,0) [0|5] "V"  SGW
 SG_ HVBatCellVoltage_Cell217 : 4|13@0+ (0.001,0) [0|5] "V"  SGW

BO_ 1963 HVBATTERY_RM_CELLS15: 64 BPCM
 SG_ HVBatCellVoltage_Cell400 : 92|13@0+ (0.001,0) [0|5] "V"  SGW
 SG_ HVBatCellVoltage_Cell399 : 73|13@0+ (0.001,0) [0|5] "V"  SGW
 SG_ HVBatCellVoltage_Cell398 : 70|13@0+ (0.001,0) [0|5] "V"  SGW
 SG_ HVBatCellVoltage_Cell397 : 51|13@0+ (0.001,0) [0|5] "V"  SGW
 SG_ HVBatCellVoltage_Cell396 : 32|13@0+ (0.001,0) [0|5] "V"  SGW
 SG_ HVBatCellVoltage_Cell395 : 29|13@0+ (0.001,0) [0|5] "V"  SGW
 SG_ HVBatCellVoltage_Cell394 : 10|13@0+ (0.001,0) [0|5] "V"  SGW
 SG_ HVBatCellVoltage_Cell393 : 7|13@0+ (0.001,0) [0|5] "V"  SGW

BO_ 1962 HVBATTERY_RM_CELLS14: 64 BPCM
 SG_ HVBatCellVoltage_Cell392 : 404|13@0+ (0.001,0) [0|5] "V"  SGW
 SG_ HVBatCellVoltage_Cell391 : 385|13@0+ (0.001,0) [0|5] "V"  SGW
 SG_ HVBatCellVoltage_Cell390 : 382|13@0+ (0.001,0) [0|5] "V"  SGW
 SG_ HVBatCellVoltage_Cell389 : 363|13@0+ (0.001,0) [0|5] "V"  SGW
 SG_ HVBatCellVoltage_Cell388 : 344|13@0+ (0.001,0) [0|5] "V"  SGW
 SG_ HVBatCellVoltage_Cell387 : 341|13@0+ (0.001,0) [0|5] "V"  SGW
 SG_ HVBatCellVoltage_Cell386 : 322|13@0+ (0.001,0) [0|5] "V"  SGW
 SG_ HVBatCellVoltage_Cell385 : 319|13@0+ (0.001,0) [0|5] "V"  SGW
 SG_ HVBatCellVoltage_Cell384 : 300|13@0+ (0.001,0) [0|5] "V"  SGW
 SG_ HVBatCellVoltage_Cell383 : 281|13@0+ (0.001,0) [0|5] "V"  SGW
 SG_ HVBatCellVoltage_Cell382 : 278|13@0+ (0.001,0) [0|5] "V"  SGW
 SG_ HVBatCellVoltage_Cell381 : 259|13@0+ (0.001,0) [0|5] "V"  SGW
 SG_ HVBatCellVoltage_Cell380 : 240|13@0+ (0.001,0) [0|5] "V"  SGW
 SG_ HVBatCellVoltage_Cell379 : 237|13@0+ (0.001,0) [0|5] "V"  SGW
 SG_ HVBatCellVoltage_Cell378 : 218|13@0+ (0.001,0) [0|5] "V"  SGW
 SG_ HVBatCellVoltage_Cell377 : 215|13@0+ (0.001,0) [0|5] "V"  SGW
 SG_ HVBatCellVoltage_Cell376 : 196|13@0+ (0.001,0) [0|5] "V"  SGW
 SG_ HVBatCellVoltage_Cell375 : 177|13@0+ (0.001,0) [0|5] "V"  SGW
 SG_ HVBatCellVoltage_Cell374 : 174|13@0+ (0.001,0) [0|5] "V"  SGW
 SG_ HVBatCellVoltage_Cell373 : 155|13@0+ (0.001,0) [0|5] "V"  SGW
 SG_ HVBatCellVoltage_Cell372 : 136|13@0+ (0.001,0) [0|5] "V"  SGW
 SG_ HVBatCellVoltage_Cell371 : 133|13@0+ (0.001,0) [0|5] "V"  SGW
 SG_ HVBatCellVoltage_Cell370 : 114|13@0+ (0.001,0) [0|5] "V"  SGW
 SG_ HVBatCellVoltage_Cell369 : 111|13@0+ (0.001,0) [0|5] "V"  SGW
 SG_ HVBatCellVoltage_Cell368 : 92|13@0+ (0.001,0) [0|5] "V"  SGW
 SG_ HVBatCellVoltage_Cell367 : 73|13@0+ (0.001,0) [0|5] "V"  SGW
 SG_ HVBatCellVoltage_Cell366 : 70|13@0+ (0.001,0) [0|5] "V"  SGW
 SG_ HVBatCellVoltage_Cell365 : 51|13@0+ (0.001,0) [0|5] "V"  SGW
 SG_ HVBatCellVoltage_Cell364 : 32|13@0+ (0.001,0) [0|5] "V"  SGW
 SG_ HVBatCellVoltage_Cell363 : 29|13@0+ (0.001,0) [0|5] "V"  SGW
 SG_ HVBatCellVoltage_Cell362 : 10|13@0+ (0.001,0) [0|5] "V"  SGW
 SG_ HVBatCellVoltage_Cell361 : 7|13@0+ (0.001,0) [0|5] "V"  SGW

BO_ 1961 HVBATTERY_RM_CELLS13: 64 BPCM
 SG_ HVBatCellVoltage_Cell360 : 404|13@0+ (0.001,0) [0|5] "V"  SGW
 SG_ HVBatCellVoltage_Cell359 : 385|13@0+ (0.001,0) [0|5] "V"  SGW
 SG_ HVBatCellVoltage_Cell358 : 382|13@0+ (0.001,0) [0|5] "V"  SGW
 SG_ HVBatCellVoltage_Cell357 : 363|13@0+ (0.001,0) [0|5] "V"  SGW
 SG_ HVBatCellVoltage_Cell356 : 344|13@0+ (0.001,0) [0|5] "V"  SGW
 SG_ HVBatCellVoltage_Cell355 : 341|13@0+ (0.001,0) [0|5] "V"  SGW
 SG_ HVBatCellVoltage_Cell354 : 322|13@0+ (0.001,0) [0|5] "V"  SGW
 SG_ HVBatCellVoltage_Cell353 : 319|13@0+ (0.001,0) [0|5] "V"  SGW
 SG_ HVBatCellVoltage_Cell352 : 300|13@0+ (0.001,0) [0|5] "V"  SGW
 SG_ HVBatCellVoltage_Cell351 : 281|13@0+ (0.001,0) [0|5] "V"  SGW
 SG_ HVBatCellVoltage_Cell350 : 278|13@0+ (0.001,0) [0|5] "V"  SGW
 SG_ HVBatCellVoltage_Cell349 : 259|13@0+ (0.001,0) [0|5] "V"  SGW
 SG_ HVBatCellVoltage_Cell348 : 240|13@0+ (0.001,0) [0|5] "V"  SGW
 SG_ HVBatCellVoltage_Cell347 : 237|13@0+ (0.001,0) [0|5] "V"  SGW
 SG_ HVBatCellVoltage_Cell346 : 218|13@0+ (0.001,0) [0|5] "V"  SGW
 SG_ HVBatCellVoltage_Cell345 : 215|13@0+ (0.001,0) [0|5] "V"  SGW
 SG_ HVBatCellVoltage_Cell344 : 196|13@0+ (0.001,0) [0|5] "V"  SGW
 SG_ HVBatCellVoltage_Cell343 : 177|13@0+ (0.001,0) [0|5] "V"  SGW
 SG_ HVBatCellVoltage_Cell342 : 174|13@0+ (0.001,0) [0|5] "V"  SGW
 SG_ HVBatCellVoltage_Cell341 : 155|13@0+ (0.001,0) [0|5] "V"  SGW
 SG_ HVBatCellVoltage_Cell340 : 136|13@0+ (0.001,0) [0|5] "V"  SGW
 SG_ HVBatCellVoltage_Cell339 : 133|13@0+ (0.001,0) [0|5] "V"  SGW
 SG_ HVBatCellVoltage_Cell338 : 114|13@0+ (0.001,0) [0|5] "V"  SGW
 SG_ HVBatCellVoltage_Cell337 : 111|13@0+ (0.001,0) [0|5] "V"  SGW
 SG_ HVBatCellVoltage_Cell336 : 92|13@0+ (0.001,0) [0|5] "V"  SGW
 SG_ HVBatCellVoltage_Cell335 : 73|13@0+ (0.001,0) [0|5] "V"  SGW
 SG_ HVBatCellVoltage_Cell334 : 70|13@0+ (0.001,0) [0|5] "V"  SGW
 SG_ HVBatCellVoltage_Cell333 : 51|13@0+ (0.001,0) [0|5] "V"  SGW
 SG_ HVBatCellVoltage_Cell332 : 32|13@0+ (0.001,0) [0|5] "V"  SGW
 SG_ HVBatCellVoltage_Cell331 : 29|13@0+ (0.001,0) [0|5] "V"  SGW
 SG_ HVBatCellVoltage_Cell330 : 10|13@0+ (0.001,0) [0|5] "V"  SGW
 SG_ HVBatCellVoltage_Cell329 : 7|13@0+ (0.001,0) [0|5] "V"  SGW

CM_ SG_ 500 BMS_HV_NumCellMinTemp "This signal indicates the Numner of the battery cell with the lowest temperature.";
CM_ SG_ 500 BMS_HV_NumCellMaxVolt "This signal indicates the ID No. of cell with max. voltage";
CM_ SG_ 500 BMS_HV_NumCellMaxTemp "This signal indicates the Number of the battery cell with the highest temperature.";
CM_ SG_ 500 BMS_Cell_Volt_Min "This signal indicates the Min cell voltage.";
CM_ SG_ 500 BMS_Cell_Volt_Max "This signal indicates the Max cell voltage.";
CM_ SG_ 250 APM_Water_Temp "This signal indicates the Estimated water temperature  into the cooling channel.";
CM_ SG_ 250 APM_RecoveryAction "This signal indicates the APM recovery action according to fault error";
CM_ SG_ 250 APM_PSFB_Temp2 "This signal indicates the Measured temperature on the phase shift full bridge converter hot spot 2";
CM_ SG_ 250 APM_PSFB_Temp1 "This signal indicates the Measured temperature on the phase shift full bridge converter hot spot 1";
CM_ SG_ 250 APM_LV_V_Fbk "This signal indicates the LV voltage feedback.";
CM_ SG_ 250 APM_LV_I_Fbk "This signal indicates the LV bus current feedback.";
CM_ SG_ 250 APM_HV_V_Fbk "This signal indicates the HV voltage feedback.";
CM_ SG_ 250 APM_HV_I_Fbk "This signal indicates the HV bus current feedback.";
CM_ SG_ 250 APM_Buck_Temp "This signal indicates the Buck stage hot spot temperature.";
CM_ SG_ 250 APM_UtilPctOfDCDC "Utilization of DCDC output power capability";
CM_ SG_ 250 APM_TempColdPlate "Cold Plate Temperature";
CM_ SG_ 250 APM_PowerLimitMode "Low voltage at HV side";
CM_ SG_ 250 APM_OutputPower "APM Output Power";
CM_ SG_ 250 APM_InputPower "APM Input Power";
CM_ SG_ 250 APM_IdcHvSetPFdbk "Feedback of set point high voltage current";
CM_ SG_ 250 APM_HvVsetPFdbk "APM HV  Voltage set point feedback";
CM_ SG_ 250 APM_HvOverVStatus "over voltage at HV";
CM_ SG_ 250 APM_FailureType "APM Failure type";
CM_ SG_ 250 APM_FailureReason "FailureReason";
CM_ SG_ 250 APM_EstPwrLoss "Estimated Power Loss";
CM_ SG_ 250 APM_DeratingReason "APM Derating";
CM_ SG_ 250 APM_DeratingModeStatus "APM Derating status during operation";
CM_ SG_ 250 APM_CurrentLimitMode "Derating becasuse of too high current at HV";
CM_ SG_ 250 APM_CtrlSts_Fbk "This signal indicates the DC-DC feedback mode.";
CM_ SG_ 250 MessageCounter_APM_VDCM "This signal is a counter used for safety checks strategies. This counter is incremented of 1 (one) unit at each frame transmission.";
CM_ SG_ 250 CRC_APM_VDCM "CRC according to SAE J1850 standard at each frame transmission.";
CM_ SG_ 2564485397 N_PDU_18DAF115 "This signal is used for diagnostic purposes";
CM_ SG_ 546 VDCM_MaxChrgTime_sec "For comm with charging station type A";
CM_ SG_ 546 VDCM_MaxChrgTime_min "For comm with charging station type A";
CM_ SG_ 546 VDCM_EV_Batt_Max_T_Limit "For comm with charging station type B";
CM_ SG_ 546 VDCM_EstChrgTime_min "For comm with charging station type A";
CM_ SG_ 546 VDCM_ChrgMode_Req "For comm with charging station type B";
CM_ SG_ 546 VDCM_BattFullSOC_prc "For comm with charging station type B";
CM_ SG_ 546 WeldCheck_Complete "Weld check complete";
CM_ SG_ 546 ReadyToChargeState "Bit to indicate if EV is ready to charge or not";
CM_ SG_ 546 HCP_SessionStopCmd "Session stop command to stop charging";
CM_ SG_ 546 HCP_DC_Retry "Retry command";
CM_ SG_ 546 DCChrg_BatSideCurrent_VDCM "DC Charging Current, measured in boost, read from EVSE in bypass";
CM_ SG_ 546 BMS_Max_Pk_Volt_Allowed_VDCM "This signal indicates the Maximum battery pack voltage allowed.";
CM_ SG_ 546 BMS_Max_Cell_Volt_Allowed_Vldty_ "This signal indicates the Max cell voltage allowed valid.";
CM_ SG_ 546 BMS_Max_Cell_Volt_Allowed_VDCM "This signal indicates the Max cell voltage allowed.";
CM_ SG_ 546 BMS_HV_Trac_PreCha_Contac_Sts_VD "Traction pre-charge contactor Physical relay status";
CM_ SG_ 546 BMS_HV_Trac_Main_Contac_Sts_VDCM "Traction main contactor physical relay status";
CM_ SG_ 546 BMS_HV_Temperature_Min_VDCM "Battery Minimum Temperature";
CM_ SG_ 546 BMS_HV_Temperature_Max_VDCM "Battery Average Temperature";
CM_ SG_ 546 BMS_HV_SOC_AccuracySts_VDCM "This signal indicates the Validity of the SOC value read";
CM_ SG_ 546 BMS_HV_NumCellMinTemp_VDCM "This signal indicates the Numner of the battery cell with the lowest temperature.";
CM_ SG_ 546 BMS_HV_NumCellMaxVolt_VDCM "This signal indicates the ID No. of cell with max. voltage";
CM_ SG_ 546 BMS_HV_NumCellMaxTemp_VDCM "This signal indicates the Number of the battery cell with the highest temperature.";
CM_ SG_ 546 BMS_HV_Low_Temp_Thrsh_VDCM "This signal indicates the lowest battery pack temperature allowed.";
CM_ SG_ 546 BMS_HV_InternalVoltage_VDCM "This signal indicates the Battery internal voltage as interpreted from VDCM.";
CM_ SG_ 546 BMS_HV_High_Temp_Thrsh_VDCM "This signal indicates the highest battery pack temperature allowed.";
CM_ SG_ 546 BMS_HV_Common_Contactor_Sts_VDCM "HV Bus common contactor status";
CM_ SG_ 546 BMS_HV_Battery_GFD_Sts_VDCM "HV Battery ground fault detection(Isolation)";
CM_ SG_ 546 BMS_HV_BatIntrlk_InternalStat_VD "HVIL Status internal";
CM_ SG_ 546 BMS_HV_AC_Char_Main_Contac_Sts_V "AC Charging main contactor physical relay status from VDCM";
CM_ SG_ 546 BMS_Cell_Volt_Min_Vldty_VDCM "This signal indicates the Min cell voltage validity.";
CM_ SG_ 546 BMS_Cell_Volt_Min_VDCM "This signal indicates the Min cell voltage.";
CM_ SG_ 546 BMS_Cell_Volt_Max_Vldty_VDCM "This signal indicates the Max cell voltage validity.";
CM_ SG_ 546 BMS_Cell_Volt_Max_VDCM "This signal indicates the Max cell voltage.";
CM_ SG_ 546 AC_Chrg_Branch_Voltage_VDCM "Voltage measured after AC charge switch interpreted by VDCM";
CM_ SG_ 546 BMS_HV_Char_PreCha_Contac_Sts_VD "Charging pre-charge contactor physical relay status";
CM_ SG_ 546 BMS_HV_Char_Main_Contac_Sts_VDCM "Charging main contactor physical relay status";
CM_ SG_ 546 BMS_HV_TractionBusVoltage_VDCM "Battery link traction bus voltage";
CM_ SG_ 546 BMS_HV_Trac_Bus_Sts_VDCM "HV Traction Bus Status";
CM_ SG_ 546 BMS_HV_ChargingBusVoltage_VDCM "Battery link charging bus voltage";
CM_ SG_ 546 BMS_HV_Char_Bus_Sts_VDCM "HV Traction Bus Status";
CM_ SG_ 546 BMS_HV_BatState_VDCM "Battery state";
CM_ SG_ 546 BMS_HV_BatActualPower_VDCM "Battery Pack actual power";
CM_ SG_ 546 VDCM_ChargingPermitting "VDCM boolean value that allows the charge process for GBT applications";
CM_ SG_ 546 GBT_Target_Voltage_Reached "BMS end of charge for Targer Voltage Reached for GBT Applications.";
CM_ SG_ 546 GBT_Target_Cell_Voltage_Reached "BMS end of charge for Targer Cell Voltage Reached for GBT Applications.";
CM_ SG_ 546 GBT_Ready_to_Charge "VDCM boolean value for starting charging phase and Ending Charge for GBT applications";
CM_ SG_ 546 GBT_Desired_SOC_Reached "BMS end of charge for Targer SOC Reached for GBT Applications.";
CM_ SG_ 546 GBT_Charger_Active_Interruption "BMS end of charge for Active Interruption for GBT applications";
CM_ SG_ 546 MessageCounter_VO2 "This signal is a counter used for safety checks strategies. This counter is incremented of 1 (one) unit at each frame transmission.";
CM_ SG_ 546 CRC_VO2 "CRC according to SAE J1850 standard at each frame transmission.";
CM_ SG_ 544 Charger_StndbyReq "For communication with charging station type B";
CM_ SG_ 544 CC2VoltDetError "For communication with charging station type B";
CM_ SG_ 544 OBCM_CSSts "Proximity signal of CHAdeMO charging Plug";
CM_ SG_ 544 OBCM_CP3Sts "CP3 line status for CHAdeMO";
CM_ SG_ 544 OBCM_CP2Sts "CP2 line status for CHAdeMO";
CM_ SG_ 544 OBCM_CCSts "Proximity signal of GBT charging contact";
CM_ SG_ 544 OBCM_APAMSts "Status of charging station LV supply on terminals A plus and A minus for GB/T charging";
CM_ SG_ 544 TCP_Communication_Terminated "TCP communication terminated";
CM_ SG_ 544 OBCM_CP1Sts "CP1 line status for CHAdeMO";
CM_ SG_ 544 TxGBTMessageResponse "Last message communicated from SECC to EVCC for type B.";
CM_ SG_ 544 TxGBTMessageRequest "Last message communicated from EVCC to SECC for type B.";
CM_ SG_ 544 OBCM_Timeout "This signal indicates a timeout from the OBCM side.";
CM_ SG_ 544 EVCC_FailureSts "EVCC failure status";
CM_ SG_ 544 CC2_VoltageValue "This signal indicates the voltage value measured on the CC2 pin.";
CM_ SG_ 544 GBT_EVSE_Charge_Permitting "EVSE boolean value that allows to charge for GBT applications.";
CM_ SG_ 544 MessageCounter_OV2 "This signal is a counter used for safety checks strategies. This counter is incremented of 1 (one) unit at each frame transmission.";
CM_ SG_ 544 CRC_OV2 "CRC according to SAE J1850 standard at each frame transmission.";
CM_ SG_ 544 EVSE_NotificationMaxDelay "This signal is used to indicate the time until SECC expects the EVCC to react on the action request.";
CM_ SG_ 1790 BMS_HV_SOC_AccuracySts "This signal indicates the Validity of the SOC value read";
CM_ SG_ 1790 BMS_HV_Low_Temp_Thrsh "This signal indicates the lowest battery pack temperature allowed.";
CM_ SG_ 1790 BMS_HV_High_Temp_Thrsh "This signal indicates the highest battery pack temperature allowed.";
CM_ SG_ 1790 HVBatCell_Voltage_Low_Thrsh "HV Battery Cell Voltage Low Thrsh";
CM_ SG_ 1790 HVBatCell_Voltage_High_Thrsh "HV Battery Cell Voltage High Thrsh";
CM_ SG_ 1790 BMS_HV_SOC_Min "Minimum HV battery cell state of charge";
CM_ SG_ 1790 BMS_HV_SOC_Max "Maximum HV battery cell state of charge";
CM_ SG_ 105 ClrLgsDiagInfo "Clear Legislated Diagnostic Information";
CM_ SG_ 260 MCPB_DC_Current "Motor B DC Current";
CM_ SG_ 260 MC_PRR1 "This signal indicates the Message Counter SaeJ1850.";
CM_ SG_ 260 CRC_PRR1 "This signal indicates the CRC SaeJ1850.";
CM_ SG_ 1062 MCPA_Temp "Motor A temperature";
CM_ SG_ 1893 HVBatModuleTemp_66 "High voltage battery module temperature";
CM_ SG_ 1893 HVBatModuleTemp_65 "High voltage battery module temperature";
CM_ SG_ 1893 HVBatModuleTemp_64 "High voltage battery module temperature";
CM_ SG_ 1893 HVBatModuleTemp_63 "High voltage battery module temperature";
CM_ SG_ 1893 HVBatModuleTemp_62 "High voltage battery module temperature";
CM_ SG_ 1893 HVBatModuleTemp_61 "High voltage battery module temperature";
CM_ SG_ 1893 HVBatModuleTemp_60 "High voltage battery module temperature";
CM_ SG_ 1893 HVBatModuleTemp_59 "High voltage battery module temperature";
CM_ SG_ 1893 HVBatModuleTemp_58 "High voltage battery module temperature";
CM_ SG_ 1893 HVBatModuleTemp_57 "High voltage battery module temperature";
CM_ SG_ 1893 HVBatModuleTemp_56 "High voltage battery module temperature";
CM_ SG_ 1893 HVBatModuleTemp_55 "High voltage battery module temperature";
CM_ SG_ 1893 HVBatModuleTemp_54 "High voltage battery module temperature";
CM_ SG_ 1893 HVBatModuleTemp_41 "High voltage battery module temperature";
CM_ SG_ 1893 HVBatModuleTemp_40 "High voltage battery module temperature";
CM_ SG_ 1893 HVBatModuleTemp_39 "High voltage battery module temperature";
CM_ SG_ 1893 HVBatModuleVoltage_NumMin "Module number - Minimum voltage; Enumeration 0 = Module 1, ...31 = Module 32.";
CM_ SG_ 1893 HVBatModuleVoltage_NumMax "Module number - maximum voltage; Enumeration 0 = Module 1 ...31 = Module 32.";
CM_ SG_ 1893 HVBatModuleTemp_53 "High voltage battery module temperature";
CM_ SG_ 1893 HVBatModuleTemp_52 "High voltage battery module temperature";
CM_ SG_ 1893 HVBatModuleTemp_51 "High voltage battery module temperature";
CM_ SG_ 1893 HVBatModuleTemp_50 "High voltage battery module temperature";
CM_ SG_ 1893 HVBatModuleTemp_49 "High voltage battery module temperature";
CM_ SG_ 1893 HVBatModuleTemp_48 "High voltage battery module temperature";
CM_ SG_ 1893 HVBatModuleTemp_47 "High voltage battery module temperature";
CM_ SG_ 1893 HVBatModuleTemp_46 "High voltage battery module temperature";
CM_ SG_ 1893 HVBatModuleTemp_45 "High voltage battery module temperature";
CM_ SG_ 1893 HVBatModuleTemp_44 "High voltage battery module temperature";
CM_ SG_ 1893 HVBatModuleTemp_43 "High voltage battery module temperature";
CM_ SG_ 1893 HVBatModuleTemp_42 "High voltage battery module temperature";
CM_ SG_ 1031 InputCurrentAvailable "J1772 input curent available";
CM_ SG_ 1031 AC_Side_Volt3 "AC line voltage3p, p3";
CM_ SG_ 1031 AC_Side_Volt2 "AC line voltage3p, p2";
CM_ SG_ 1031 AC_Side_Volt1 "AC line voltage3p, p1";
CM_ SG_ 1031 AC_Side_Curr3 "AC line current3p, p3";
CM_ SG_ 1031 AC_Side_Curr2 "AC line current3p, p2";
CM_ SG_ 1031 AC_Side_Curr1 "AC line current3p, p1";
CM_ SG_ 1031 ProximitySts "Proximity status based on the voltage level";
CM_ SG_ 1031 OBCM_SlacSts "Communication PLC protocol status, SLAC process";
CM_ SG_ 1031 OBCM_SdpSts "Network protocol implementation status";
CM_ SG_ 1031 OBCInterlockSts "OBCM interlock state";
CM_ SG_ 1031 OBC_DeratingReason "OBCM recovery action";
CM_ SG_ 1031 J1772_State "J1772 status";
CM_ SG_ 1031 InputVoltage_isAC "Input voltage is a/c (dc - [0], ac - [1])";
CM_ SG_ 1031 InputVoltage_is60Hz "Input voltage frrequency is 60 hz (50 hz - [0], 60 hz - [1])";
CM_ SG_ 1031 HV_Overvoltage "High voltage - over voltage";
CM_ SG_ 1031 HV_Overcurrent "High voltage over current";
CM_ SG_ 1031 ControlPilotSts "EVSE pilot status";
CM_ SG_ 1031 ChargeEnableSts "OBCM Feedback status.";
CM_ SG_ 1031 ChargeCurrentAvailable ".";
CM_ SG_ 1031 ChargeCurrent ".";
CM_ SG_ 1031 BatterySideCurrent "Battery side current";
CM_ SG_ 1031 AC_Present "AC line detection";
CM_ SG_ 1031 AC_HighLoadWarning "Infrastructure overload";
CM_ SG_ 1031 Supported_VerNumberMajor "Version Number Major accepted by  EVCC to support";
CM_ SG_ 1031 Supported_SchemaID "SchemaID accepted by  EVCC to support";
CM_ SG_ 1031 Supported_ProtocolName "Protocol accepted by  EVCC to support";
CM_ SG_ 1031 MessageCounter_HV_CHARGER1 "This signal is a counter used for safety checks strategies. This counter is incremented of 1 (one) unit at each frame transmission.";
CM_ SG_ 1031 EVCC_FailureReason "EVCC failure reason";
CM_ SG_ 1031 CRC_HV_CHARGER1 "CRC according to SAE J1850 standard at each frame transmission.";
CM_ SG_ 1031 BatterySideVoltage "Battery side voltage";
CM_ SG_ 1031 AC_LnLow "AC line voltage too low";
CM_ SG_ 1031 AC_LnHi "AC line voltage too High";
CM_ SG_ 1031 Plug_And_Charge_Contract_Sts "HU Plug and Charge Contract status";
CM_ SG_ 1031 RCD "Used to Indicate the current status of the Residual Current Device (RCD)";
CM_ SG_ 1031 EVSENominalVoltage "RMS of the maximum voltage vehicle can accept";
CM_ SG_ 1031 EVSEMaxCurrent "EV Maximum current supported per Phase";
CM_ SG_ 2564486468 N_PDU_18DAF544 "This signal is used for diagnostic purposes";
CM_ SG_ 2654814269 ECU_APPL_FD_BPCM "ECU to external application";
CM_ SG_ 1063 MCPB_Temp "Motor B temperature";
CM_ SG_ 2564486421 N_PDU_18DAF515 "This signal is used for diagnostic purposes";
CM_ SG_ 2564486420 N_PDU_18DAF514 "This signal is used for diagnostic purposes";
CM_ SG_ 2564429301 N_PDU_18DA15F5 "This signal is used for diagnostic purposes";
CM_ SG_ 2564429045 N_PDU_18DA14F5 "This signal is used for diagnostic purposes";
CM_ SG_ 2564441333 N_PDU_18DA44F5 "This signal is used for diagnostic purposes";
CM_ SG_ 2564486480 N_PDU_18DAF550 "This signal is used for diagnostic purposes";
CM_ SG_ 2564444405 N_PDU_18DA50F5 "This signal is used for diagnostic purposes";
CM_ SG_ 2564554485 N_PDU_18DBFEF5 "This signal is used for diagnostic purposes";
CM_ SG_ 292 MessageCounter_BATT_HV_STATUS1 "This signal is a counter used for safety checks strategies. This counter is incremented of 1 (one) unit at each frame transmission.";
CM_ SG_ 292 CRC_BATT_HV_STATUS1 "CRC according to SAE J1850 standard at each frame transmission.";
CM_ SG_ 292 HVBatContactorWeldCheck "Contactor weld check report from BPCM for DC charging.";
CM_ SG_ 292 HVBatReady "High Voltage Battery Ready";
CM_ SG_ 292 BPCM_HV_Trac_Main_Contac_Sts "Traction main contactor physical relay status";
CM_ SG_ 292 BPCM_HV_BalancingMode "Balancing Mode";
CM_ SG_ 292 BPCM_HV_ChargingBusVoltage "Voltage measurement between positive main bus (after contactor) and negative charging branch.";
CM_ SG_ 292 BPCM_HV_TractionBusVoltage "Battery link traction bus voltage.";
CM_ SG_ 292 BPCM_Pwr_Limp_Home_On "Traction Battery Limp Home mode flag.";
CM_ SG_ 292 BPCM_HV_SOH_Low "State of Health calculated at low SOC.";
CM_ SG_ 292 BPCM_HV_SOH "Status of Healt";
CM_ SG_ 292 HVBatContactorOpenTime "Time Since Bat contactors last transitioned to Open.";
CM_ SG_ 292 HVBatLastSlept "Time since BPCM last went to sleep.";
CM_ SG_ 292 BPCMInterlockSts "BPCM interlock state";
CM_ SG_ 292 BPCM_HV_BatIntrlk_InternalStat "HVIL Status internal";
CM_ SG_ 292 BPCM_HV_Temperature_Min "Battery Minimum Temperature 22/06/2020 Allegra Giordano - changes: Value, Max (previous values: 164,7 - 164,6) (Daniele Zaharia's request)";
CM_ SG_ 292 BPCM_HV_Temperature_Max "Battery Max Temperature 22/06/2020 Allegra Giordano - changes: Value, Max (previous values: 164,7 - 164,6) (Daniele Zaharia's request)";
CM_ SG_ 292 BPCM_HV_Temperature_Avg "Battery Average Temperature 22/06/2020 Allegra Giordano - changes: Value, Max (previous values: 164,7 - 164,6) (Daniele Zaharia' request)";
CM_ SG_ 292 BPCM_HV_SOC "State of Charge";
CM_ SG_ 292 BPCM_HV_Outlet_Temp "Outlet Temperature";
CM_ SG_ 292 BPCM_HV_InternalVoltage "Battery internal voltage.";
CM_ SG_ 292 BPCM_HV_Inlet_Temp "Inlet temperature";
CM_ SG_ 292 BPCM_HV_Current "Battery Current";
CM_ SG_ 292 BPCM_HV_Capacity "Battery Capacity";
CM_ SG_ 292 BPCM_HV_Battery_GFD_Sts "HV Battery ground fault detection(Isolation).";
CM_ SG_ 292 BPCM_Wakeup_Request "BPCM Wakeup event";
CM_ SG_ 292 BPCM_HV_ThermalRunaway "Thermal runaway status";
CM_ SG_ 292 HVBP_Busbar_Temp "HVBP Busbar temp";
CM_ SG_ 292 HVBP_BDU_Busbar_Temp "HVBP BDU Busbar temp";
CM_ SG_ 292 DC_Charge_Type_Status "800 V charging type acknowledgement";
CM_ SG_ 292 BPCM_Series_Voltage "Voltage value of batery pack as per configuration";
CM_ SG_ 292 BPCM_Request_for_Aux_Load_off "Request to turn off AUX load for battery switching operation about to commence";
CM_ SG_ 292 BPCM_HV_Trac_Main_Contac_Config "Breaktor contactor configuration status to confirm DCFC control sequence";
CM_ SG_ 292 BPCM_HV_InternalVoltageString2 "Voltage measured  on battery side of DCFC breaktor";
CM_ SG_ 292 BPCM_HV_InternalVoltageString1 "Voltage measured  on battery side of DCFC breaktor";
CM_ SG_ 292 BPCM_HV_DCFC_Isolation_Sts "Status of DC Circuit isolation failure";
CM_ SG_ 292 BPCM_HV_Trac_PreCha_Contac_Sts "Status of DC Circuit isolation failure";
CM_ SG_ 485 MessageCounter_BATT_HV_VLIMITS "This signal is a counter used for safety checks strategies. This counter is incremented of 1 (one) unit at each frame transmission.";
CM_ SG_ 485 CRC_BATT_HV_VLIMITS "CRC according to SAE J1850 standard at each frame transmission.";
CM_ SG_ 485 BPCM_HV_NumCellMinTemp "This signal indicates the Numner of the battery cell with the lowest temperature.";
CM_ SG_ 485 BPCM_HV_NumCellMaxTemp "This signal indicates the Number of the battery cell with the highest temperature.";
CM_ SG_ 485 BPCM_HV_NumCellMinVolt "This signal indicates the ID No. of cell with min. voltage";
CM_ SG_ 485 BPCM_HV_NumCellMaxVolt "This signal indicates the ID No. of cell with max. voltage";
CM_ SG_ 485 BPCM_Min_Pk_Volt_Allowed "This signal indicates the Minimum battery peak pack voltage.";
CM_ SG_ 485 BPCM_Max_Pk_Volt_Allowed "This signal indicates the Maximum battery pack voltage allowed.";
CM_ SG_ 485 BPCM_OCV_Min_Cell_Volt "This signal indicates the Cell open circuit minimum voltage.";
CM_ SG_ 485 BPCM_OCV_Max_Cell_Volt "This signal indicates the Cell open circuit  maximum voltage.";
CM_ SG_ 485 BPCM_OCV_Avg_Cell_Volt "This signal indicates the Cell open circuit average voltage .";
CM_ SG_ 485 BPCM_Min_Cell_Volt_Allowed "This signal indicates the Minimum battery pack voltage.";
CM_ SG_ 485 BPCM_Max_Cell_Volt_Allowed "This signal indicates the Max cell voltage allowed.";
CM_ SG_ 485 BPCM_HV_Insulation_Resistance "This signal indicates the Insulation resistance.";
CM_ SG_ 485 BPCM_Cell_Volt_Min "This signal indicates the Min cell voltage.";
CM_ SG_ 485 BPCM_Cell_Volt_Max "This signal indicates the Max cell voltage.";
CM_ SG_ 485 BPCM_Cell_Volt_Avg "This signal indicates the Cell average voltage.";
CM_ SG_ 288 BPCM_HV_PwrLmtInstDschg "Instantaneous power prediction limit in discharge";
CM_ SG_ 288 BPCM_HV_PwrLmtInstChrg "Instantaneous power prediction limit in charge";
CM_ SG_ 288 BPCM_HV_Pwr_MaxDischrg_ShrTrm "This signal indicates the Maximum discharge power available for the next short term.";
CM_ SG_ 288 BPCM_HV_Power_MaxDischarge_MdTrm "This signal indicates the Maximum discharge power available for the next mid term.";
CM_ SG_ 288 BPCM_HV_Power_MaxDischarge_LgTrm "This signal indicates the Maximum discharge power available for the next long term.";
CM_ SG_ 288 BPCM_HV_Power_MaxCharge_ShrTrm "This signal indicates the Maximum charge power available for the next short term.";
CM_ SG_ 288 BPCM_HV_Power_MaxCharge_MdTrm "This signal indicates the Maximum charge power available for the next mid term.";
CM_ SG_ 288 BPCM_HV_Power_MaxCharge_LgTrm "This signal indicates the Maximum charge power available for the next long term.";
CM_ SG_ 288 BPCM_HV_CrntLmtInstDschg "BPCM_HV_CrntLmtInstDschg";
CM_ SG_ 288 BPCM_HV_CrntLmtInstChrg "BPCM_HV_CrntLmtInstChrg";
CM_ SG_ 288 BPCM_HV_ChargingCurrentProfile "This signal indicates the Charging current profile.";
CM_ SG_ 288 BPCM_HV_Cell_MinDischrg_Imped "This signal indicates the Maximum cell discharge impedance.";
CM_ SG_ 288 BPCM_HV_Cell_MaxDischrg_Imped "This signal indicates the Maximum cell discharge impedance.";
CM_ SG_ 288 BPCM_CntctrsShtTrmOpeningWarn "This signal indicates the Battery warning imminent emergency contactors opening.";
CM_ SG_ 288 BPCM_CntctrsMidTrmOpeningWarn "This signal indicates the Battery warning mid term emergency contactors opening.";
CM_ SG_ 288 MessageCounter_BATT_HV_POWERLIMS "This signal is a counter used for safety checks strategies. This counter is incremented of 1 (one) unit at each frame transmission.";
CM_ SG_ 288 CRC_BATT_HV_POWERLIMS "CRC according to SAE J1850 standard at each frame transmission.";
CM_ SG_ 2564485698 N_PDU_18DAF242 "This signal is used for diagnostic purposes";
CM_ SG_ 2564440818 N_PDU_18DA42F2 "This signal is used for diagnostic purposes";
CM_ SG_ 1965 HVBatCellVoltage_Cell232 "High voltage battery cell voltage for Cell 205";
CM_ SG_ 1965 HVBatCellVoltage_Cell231 "High voltage battery cell voltage for Cell 204";
CM_ SG_ 1965 HVBatCellVoltage_Cell230 "High voltage battery cell voltage for Cell 203";
CM_ SG_ 1965 HVBatCellVoltage_Cell229 "High voltage battery cell voltage for Cell 202";
CM_ SG_ 1965 HVBatCellVoltage_Cell228 "High voltage battery cell voltage for Cell 201";
CM_ SG_ 1965 HVBatCellVoltage_Cell227 "High voltage battery cell voltage for Cell 200";
CM_ SG_ 1965 HVBatCellVoltage_Cell226 "High voltage battery cell voltage for Cell 199";
CM_ SG_ 1965 HVBatCellVoltage_Cell225 "High voltage battery cell voltage for Cell 198";
CM_ SG_ 1965 HVBatCellVoltage_Cell224 "High voltage battery cell voltage for Cell 197";
CM_ SG_ 1965 HVBatCellVoltage_Cell223 "High voltage battery cell voltage for Cell 196";
CM_ SG_ 1965 HVBatCellVoltage_Cell222 "High voltage battery cell voltage for Cell 195";
CM_ SG_ 1965 HVBatCellVoltage_Cell221 "High voltage battery cell voltage for Cell 194";
CM_ SG_ 1965 HVBatCellVoltage_Cell220 "High voltage battery cell voltage for Cell 193";
CM_ SG_ 1965 HVBatCellVoltage_Cell219 "High voltage battery cell voltage for Cell 192";
CM_ SG_ 1965 HVBatCellVoltage_Cell218 "High voltage battery cell voltage for Cell 191";
CM_ SG_ 1965 HVBatCellVoltage_Cell217 "High voltage battery cell voltage for Cell 190";
CM_ SG_ 1963 HVBatCellVoltage_Cell400 "High voltage battery cell voltage for Cell 400";
CM_ SG_ 1963 HVBatCellVoltage_Cell399 "High voltage battery cell voltage for Cell 399";
CM_ SG_ 1963 HVBatCellVoltage_Cell398 "High voltage battery cell voltage for Cell 398";
CM_ SG_ 1963 HVBatCellVoltage_Cell397 "High voltage battery cell voltage for Cell 397";
CM_ SG_ 1963 HVBatCellVoltage_Cell396 "High voltage battery cell voltage for Cell 396";
CM_ SG_ 1963 HVBatCellVoltage_Cell395 "High voltage battery cell voltage for Cell 395";
CM_ SG_ 1963 HVBatCellVoltage_Cell394 "High voltage battery cell voltage for Cell 394";
CM_ SG_ 1963 HVBatCellVoltage_Cell393 "High voltage battery cell voltage for Cell 393";
CM_ SG_ 1962 HVBatCellVoltage_Cell392 "High voltage battery cell voltage for Cell 392";
CM_ SG_ 1962 HVBatCellVoltage_Cell391 "High voltage battery cell voltage for Cell 391";
CM_ SG_ 1962 HVBatCellVoltage_Cell390 "High voltage battery cell voltage for Cell 390";
CM_ SG_ 1962 HVBatCellVoltage_Cell389 "High voltage battery cell voltage for Cell 389";
CM_ SG_ 1962 HVBatCellVoltage_Cell388 "High voltage battery cell voltage for Cell 388";
CM_ SG_ 1962 HVBatCellVoltage_Cell387 "High voltage battery cell voltage for Cell 387";
CM_ SG_ 1962 HVBatCellVoltage_Cell386 "High voltage battery cell voltage for Cell 386";
CM_ SG_ 1962 HVBatCellVoltage_Cell385 "High voltage battery cell voltage for Cell 385";
CM_ SG_ 1962 HVBatCellVoltage_Cell384 "High voltage battery cell voltage for Cell 384";
CM_ SG_ 1962 HVBatCellVoltage_Cell383 "High voltage battery cell voltage for Cell 383";
CM_ SG_ 1962 HVBatCellVoltage_Cell382 "High voltage battery cell voltage for Cell 382";
CM_ SG_ 1962 HVBatCellVoltage_Cell381 "High voltage battery cell voltage for Cell 381";
CM_ SG_ 1962 HVBatCellVoltage_Cell380 "High voltage battery cell voltage for Cell 380";
CM_ SG_ 1962 HVBatCellVoltage_Cell379 "High voltage battery cell voltage for Cell 379";
CM_ SG_ 1962 HVBatCellVoltage_Cell378 "High voltage battery cell voltage for Cell 378";
CM_ SG_ 1962 HVBatCellVoltage_Cell377 "High voltage battery cell voltage for Cell 377";
CM_ SG_ 1962 HVBatCellVoltage_Cell376 "High voltage battery cell voltage for Cell 376";
CM_ SG_ 1962 HVBatCellVoltage_Cell375 "High voltage battery cell voltage for Cell 375";
CM_ SG_ 1962 HVBatCellVoltage_Cell374 "High voltage battery cell voltage for Cell 374";
CM_ SG_ 1962 HVBatCellVoltage_Cell373 "High voltage battery cell voltage for Cell 373";
CM_ SG_ 1962 HVBatCellVoltage_Cell372 "High voltage battery cell voltage for Cell 372";
CM_ SG_ 1962 HVBatCellVoltage_Cell371 "High voltage battery cell voltage for Cell 371";
CM_ SG_ 1962 HVBatCellVoltage_Cell370 "High voltage battery cell voltage for Cell 370";
CM_ SG_ 1962 HVBatCellVoltage_Cell369 "High voltage battery cell voltage for Cell 369";
CM_ SG_ 1962 HVBatCellVoltage_Cell368 "High voltage battery cell voltage for Cell 368";
CM_ SG_ 1962 HVBatCellVoltage_Cell367 "High voltage battery cell voltage for Cell 367";
CM_ SG_ 1962 HVBatCellVoltage_Cell366 "High voltage battery cell voltage for Cell 366";
CM_ SG_ 1962 HVBatCellVoltage_Cell365 "High voltage battery cell voltage for Cell 365";
CM_ SG_ 1962 HVBatCellVoltage_Cell364 "High voltage battery cell voltage for Cell 364";
CM_ SG_ 1962 HVBatCellVoltage_Cell363 "High voltage battery cell voltage for Cell 363";
CM_ SG_ 1962 HVBatCellVoltage_Cell362 "High voltage battery cell voltage for Cell 362";
CM_ SG_ 1962 HVBatCellVoltage_Cell361 "High voltage battery cell voltage for Cell 361";
CM_ SG_ 1961 HVBatCellVoltage_Cell360 "High voltage battery cell voltage for Cell 360";
CM_ SG_ 1961 HVBatCellVoltage_Cell359 "High voltage battery cell voltage for Cell 359";
CM_ SG_ 1961 HVBatCellVoltage_Cell358 "High voltage battery cell voltage for Cell 358";
CM_ SG_ 1961 HVBatCellVoltage_Cell357 "High voltage battery cell voltage for Cell 357";
CM_ SG_ 1961 HVBatCellVoltage_Cell356 "High voltage battery cell voltage for Cell 356";
CM_ SG_ 1961 HVBatCellVoltage_Cell355 "High voltage battery cell voltage for Cell 355";
CM_ SG_ 1961 HVBatCellVoltage_Cell354 "High voltage battery cell voltage for Cell 354";
CM_ SG_ 1961 HVBatCellVoltage_Cell353 "High voltage battery cell voltage for Cell 353";
CM_ SG_ 1961 HVBatCellVoltage_Cell352 "High voltage battery cell voltage for Cell 352";
CM_ SG_ 1961 HVBatCellVoltage_Cell351 "High voltage battery cell voltage for Cell 351";
CM_ SG_ 1961 HVBatCellVoltage_Cell350 "High voltage battery cell voltage for Cell 350";
CM_ SG_ 1961 HVBatCellVoltage_Cell349 "High voltage battery cell voltage for Cell 349";
CM_ SG_ 1961 HVBatCellVoltage_Cell348 "High voltage battery cell voltage for Cell 348";
CM_ SG_ 1961 HVBatCellVoltage_Cell347 "High voltage battery cell voltage for Cell 347";
CM_ SG_ 1961 HVBatCellVoltage_Cell346 "High voltage battery cell voltage for Cell 346";
CM_ SG_ 1961 HVBatCellVoltage_Cell345 "High voltage battery cell voltage for Cell 345";
CM_ SG_ 1961 HVBatCellVoltage_Cell344 "High voltage battery cell voltage for Cell 344";
CM_ SG_ 1961 HVBatCellVoltage_Cell343 "High voltage battery cell voltage for Cell 343";
CM_ SG_ 1961 HVBatCellVoltage_Cell342 "High voltage battery cell voltage for Cell 342";
CM_ SG_ 1961 HVBatCellVoltage_Cell341 "High voltage battery cell voltage for Cell 341";
CM_ SG_ 1961 HVBatCellVoltage_Cell340 "High voltage battery cell voltage for Cell 340";
CM_ SG_ 1961 HVBatCellVoltage_Cell339 "High voltage battery cell voltage for Cell 339";
CM_ SG_ 1961 HVBatCellVoltage_Cell338 "High voltage battery cell voltage for Cell 338";
CM_ SG_ 1961 HVBatCellVoltage_Cell337 "High voltage battery cell voltage for Cell 337";
CM_ SG_ 1961 HVBatCellVoltage_Cell336 "High voltage battery cell voltage for Cell 336";
CM_ SG_ 1961 HVBatCellVoltage_Cell335 "High voltage battery cell voltage for Cell 335";
CM_ SG_ 1961 HVBatCellVoltage_Cell334 "High voltage battery cell voltage for Cell 334";
CM_ SG_ 1961 HVBatCellVoltage_Cell333 "High voltage battery cell voltage for Cell 333";
CM_ SG_ 1961 HVBatCellVoltage_Cell332 "High voltage battery cell voltage for Cell 332";
CM_ SG_ 1961 HVBatCellVoltage_Cell331 "High voltage battery cell voltage for Cell 331";
CM_ SG_ 1961 HVBatCellVoltage_Cell330 "High voltage battery cell voltage for Cell 330";
CM_ SG_ 1961 HVBatCellVoltage_Cell329 "High voltage battery cell voltage for Cell 329";
BA_DEF_ SG_  "GenSigTimeoutTime_HCP" INT 0 65535;
BA_DEF_ SG_  "GenSigTimeoutTime_PPIM" INT 0 65535;
BA_DEF_ SG_  "GenSigStartValue" INT 0 2147483647;
BA_DEF_ SG_  "GenSigInactiveValue" INT 0 2147483647;
BA_DEF_ SG_  "GenSigSendType" ENUM  "NotUsed","OnWrite","OnWriteWithRepetition","OnChange","OnChangeWithRepetition","IfActive","IfActiveWithRepetition","NoSigSendType";
BA_DEF_ SG_  "GenSigTimeoutTime_BPCM" INT 0 65535;
BA_DEF_ SG_  "GenSigTimeoutTime_EVCU2" INT 0 65535;
BA_DEF_ SG_  "GenSigTimeoutTime_IDCM" INT 0 65535;
BA_DEF_ SG_  "GenSigTimeoutTime_SGW" INT 0 65535;
BA_DEF_ BO_  "DiagRequest" ENUM  "No","Yes";
BA_DEF_ BO_  "Type" ENUM  "P","C","PE","COC","PE_Cntrl","E","E_Cntrl","OC","S","BAF","DC","EM","MM","ISO-TP","-";
BA_DEF_ BO_  "DiagResponse" ENUM  "No","Yes";
BA_DEF_ BO_  "NmMessage" ENUM  "No","Yes";
BA_DEF_ BO_  "GenMsgSendType" ENUM  "Cyclic","NotUsed","NotUsed","NotUsed","NotUsed","NotUsed","NotUsed","NotUsed","NoMsgSendType";
BA_DEF_ BO_  "GenMsgNrOfRepetition" INT 0 255;
BA_DEF_ BO_  "GenMsgILSupport" ENUM  "No","Yes";
BA_DEF_ BO_  "GenMsgStartDelayTime" INT 0 65535;
BA_DEF_ BO_  "GenMsgCycleTimeFast" INT 0 65535;
BA_DEF_ BO_  "GenMsgCycleTime" INT 0 65535;
BA_DEF_ BO_  "GenMsgDelayTime" INT 0 65535;
BA_DEF_ BO_  "NmAsrMessage" ENUM  "No","Yes";
BA_DEF_ BO_  "DiagState" ENUM  "No","Yes";
BA_DEF_ BO_  "DiagConnection" HEX 0 65535;
BA_DEF_ BO_  "CanTpFcFrameId" HEX 0 2147483647;
BA_DEF_ BO_  "VFrameFormat" ENUM  "StandardCAN","ExtendedCAN","reserved","reserved","reserved","reserved","reserved","reserved","reserved","reserved","reserved","reserved","reserved","reserved","StandardCAN_FD","ExtendedCAN_FD";
BA_DEF_ BO_  "CANFD_BRS" ENUM  "0","1";
BA_DEF_ SG_  "SystemSignalLongSymbol" STRING ;
BA_DEF_DEF_  "GenSigTimeoutTime_HCP" 2500;
BA_DEF_DEF_  "GenSigTimeoutTime_PPIM" 2500;
BA_DEF_DEF_  "GenSigStartValue" 0;
BA_DEF_DEF_  "GenSigInactiveValue" 0;
BA_DEF_DEF_  "GenSigSendType" "NoSigSendType";
BA_DEF_DEF_  "GenSigTimeoutTime_BPCM" 2500;
BA_DEF_DEF_  "GenSigTimeoutTime_EVCU2" 2500;
BA_DEF_DEF_  "GenSigTimeoutTime_IDCM" 2500;
BA_DEF_DEF_  "GenSigTimeoutTime_SGW" 2500;
BA_DEF_DEF_  "DiagRequest" "No";
BA_DEF_DEF_  "Type" "-";
BA_DEF_DEF_  "DiagResponse" "No";
BA_DEF_DEF_  "NmMessage" "No";
BA_DEF_DEF_  "GenMsgSendType" "NoMsgSendType";
BA_DEF_DEF_  "GenMsgNrOfRepetition" 0;
BA_DEF_DEF_  "GenMsgILSupport" "No";
BA_DEF_DEF_  "GenMsgStartDelayTime" 0;
BA_DEF_DEF_  "GenMsgCycleTimeFast" 0;
BA_DEF_DEF_  "GenMsgCycleTime" 0;
BA_DEF_DEF_  "GenMsgDelayTime" 0;
BA_DEF_DEF_  "NmAsrMessage" "No";
BA_DEF_DEF_  "DiagState" "No";
BA_DEF_DEF_  "DiagConnection" 0;
BA_DEF_DEF_  "CanTpFcFrameId" 2147483647;
BA_DEF_DEF_  "VFrameFormat" "StandardCAN_FD";
BA_DEF_DEF_  "CANFD_BRS" "0";
BA_DEF_DEF_  "SystemSignalLongSymbol" "";
BA_ "CANFD_BRS" BO_ 500 1;
BA_ "GenMsgCycleTime" BO_ 500 20;
BA_ "GenMsgILSupport" BO_ 500 1;
BA_ "GenMsgSendType" BO_ 500 0;
BA_ "Type" BO_ 500 1;
BA_ "CANFD_BRS" BO_ 250 1;
BA_ "GenMsgCycleTime" BO_ 250 20;
BA_ "GenMsgILSupport" BO_ 250 1;
BA_ "GenMsgSendType" BO_ 250 0;
BA_ "Type" BO_ 250 1;
BA_ "VFrameFormat" BO_ 2564485397 1;
BA_ "DiagConnection" BO_ 2564485397 61717;
BA_ "DiagResponse" BO_ 2564485397 1;
BA_ "Type" BO_ 2564485397 8;
BA_ "CANFD_BRS" BO_ 546 1;
BA_ "GenMsgCycleTime" BO_ 546 20;
BA_ "GenMsgILSupport" BO_ 546 1;
BA_ "GenMsgSendType" BO_ 546 0;
BA_ "Type" BO_ 546 1;
BA_ "GenMsgILSupport" BO_ 544 1;
BA_ "GenMsgSendType" BO_ 544 0;
BA_ "Type" BO_ 544 1;
BA_ "CANFD_BRS" BO_ 544 1;
BA_ "GenMsgCycleTime" BO_ 544 20;
BA_ "CANFD_BRS" BO_ 1790 1;
BA_ "GenMsgDelayTime" BO_ 1790 20;
BA_ "GenMsgCycleTime" BO_ 1790 500;
BA_ "GenMsgILSupport" BO_ 1790 1;
BA_ "GenMsgSendType" BO_ 1790 0;
BA_ "Type" BO_ 1790 3;
BA_ "CANFD_BRS" BO_ 105 1;
BA_ "GenMsgDelayTime" BO_ 105 100;
BA_ "GenMsgCycleTime" BO_ 105 1000;
BA_ "GenMsgILSupport" BO_ 105 1;
BA_ "GenMsgSendType" BO_ 105 0;
BA_ "Type" BO_ 105 3;
BA_ "CANFD_BRS" BO_ 260 1;
BA_ "GenMsgCycleTime" BO_ 260 10;
BA_ "GenMsgILSupport" BO_ 260 1;
BA_ "GenMsgSendType" BO_ 260 0;
BA_ "Type" BO_ 260 1;
BA_ "CANFD_BRS" BO_ 1062 1;
BA_ "GenMsgCycleTime" BO_ 1062 100;
BA_ "GenMsgILSupport" BO_ 1062 1;
BA_ "GenMsgSendType" BO_ 1062 0;
BA_ "Type" BO_ 1062 1;
BA_ "CANFD_BRS" BO_ 1893 1;
BA_ "GenMsgCycleTime" BO_ 1893 1000;
BA_ "GenMsgILSupport" BO_ 1893 1;
BA_ "GenMsgSendType" BO_ 1893 0;
BA_ "Type" BO_ 1893 1;
BA_ "CANFD_BRS" BO_ 1031 1;
BA_ "GenMsgCycleTime" BO_ 1031 100;
BA_ "GenMsgILSupport" BO_ 1031 1;
BA_ "GenMsgSendType" BO_ 1031 0;
BA_ "Type" BO_ 1031 1;
BA_ "CANFD_BRS" BO_ 2564486468 1;
BA_ "DiagConnection" BO_ 2564486468 62788;
BA_ "DiagResponse" BO_ 2564486468 1;
BA_ "Type" BO_ 2564486468 8;
BA_ "VFrameFormat" BO_ 2564486468 15;
BA_ "CANFD_BRS" BO_ 2654814269 1;
BA_ "GenMsgILSupport" BO_ 2654814269 1;
BA_ "Type" BO_ 2654814269 8;
BA_ "VFrameFormat" BO_ 2654814269 15;
BA_ "CANFD_BRS" BO_ 1063 1;
BA_ "GenMsgCycleTime" BO_ 1063 100;
BA_ "GenMsgILSupport" BO_ 1063 1;
BA_ "GenMsgSendType" BO_ 1063 0;
BA_ "Type" BO_ 1063 1;
BA_ "CANFD_BRS" BO_ 2564486421 1;
BA_ "DiagConnection" BO_ 2564486421 62741;
BA_ "DiagResponse" BO_ 2564486421 1;
BA_ "Type" BO_ 2564486421 8;
BA_ "VFrameFormat" BO_ 2564486421 15;
BA_ "CANFD_BRS" BO_ 2564486420 1;
BA_ "DiagConnection" BO_ 2564486420 62740;
BA_ "DiagResponse" BO_ 2564486420 1;
BA_ "Type" BO_ 2564486420 8;
BA_ "VFrameFormat" BO_ 2564486420 15;
BA_ "CANFD_BRS" BO_ 2564429301 1;
BA_ "DiagConnection" BO_ 2564429301 62741;
BA_ "Type" BO_ 2564429301 8;
BA_ "DiagRequest" BO_ 2564429301 1;
BA_ "VFrameFormat" BO_ 2564429301 15;
BA_ "CANFD_BRS" BO_ 2564429045 1;
BA_ "DiagConnection" BO_ 2564429045 62740;
BA_ "Type" BO_ 2564429045 8;
BA_ "DiagRequest" BO_ 2564429045 1;
BA_ "VFrameFormat" BO_ 2564429045 15;
BA_ "CANFD_BRS" BO_ 2564441333 1;
BA_ "DiagConnection" BO_ 2564441333 62788;
BA_ "Type" BO_ 2564441333 8;
BA_ "DiagRequest" BO_ 2564441333 1;
BA_ "VFrameFormat" BO_ 2564441333 15;
BA_ "CANFD_BRS" BO_ 2564486480 1;
BA_ "DiagConnection" BO_ 2564486480 62800;
BA_ "DiagResponse" BO_ 2564486480 1;
BA_ "Type" BO_ 2564486480 8;
BA_ "VFrameFormat" BO_ 2564486480 15;
BA_ "CANFD_BRS" BO_ 2564444405 1;
BA_ "DiagConnection" BO_ 2564444405 62800;
BA_ "Type" BO_ 2564444405 8;
BA_ "DiagRequest" BO_ 2564444405 1;
BA_ "VFrameFormat" BO_ 2564444405 15;
BA_ "CANFD_BRS" BO_ 2564554485 1;
BA_ "DiagConnection" BO_ 2564554485 62974;
BA_ "DiagState" BO_ 2564554485 1;
BA_ "Type" BO_ 2564554485 8;
BA_ "VFrameFormat" BO_ 2564554485 15;
BA_ "CANFD_BRS" BO_ 292 1;
BA_ "GenMsgCycleTime" BO_ 292 10;
BA_ "GenMsgILSupport" BO_ 292 1;
BA_ "GenMsgSendType" BO_ 292 0;
BA_ "Type" BO_ 292 1;
BA_ "CANFD_BRS" BO_ 485 1;
BA_ "GenMsgCycleTime" BO_ 485 20;
BA_ "GenMsgILSupport" BO_ 485 1;
BA_ "GenMsgSendType" BO_ 485 0;
BA_ "Type" BO_ 485 1;
BA_ "CANFD_BRS" BO_ 288 1;
BA_ "GenMsgCycleTime" BO_ 288 10;
BA_ "GenMsgILSupport" BO_ 288 1;
BA_ "GenMsgSendType" BO_ 288 0;
BA_ "Type" BO_ 288 1;
BA_ "CANFD_BRS" BO_ 2564485698 1;
BA_ "DiagConnection" BO_ 2564485698 62018;
BA_ "DiagResponse" BO_ 2564485698 1;
BA_ "Type" BO_ 2564485698 8;
BA_ "VFrameFormat" BO_ 2564485698 15;
BA_ "CANFD_BRS" BO_ 2564440818 1;
BA_ "DiagConnection" BO_ 2564440818 62018;
BA_ "Type" BO_ 2564440818 8;
BA_ "DiagRequest" BO_ 2564440818 1;
BA_ "VFrameFormat" BO_ 2564440818 15;
BA_ "CANFD_BRS" BO_ 1965 1;
BA_ "GenMsgCycleTime" BO_ 1965 1000;
BA_ "GenMsgILSupport" BO_ 1965 1;
BA_ "GenMsgSendType" BO_ 1965 0;
BA_ "Type" BO_ 1965 1;
BA_ "CANFD_BRS" BO_ 1963 1;
BA_ "GenMsgCycleTime" BO_ 1963 1000;
BA_ "GenMsgILSupport" BO_ 1963 1;
BA_ "GenMsgSendType" BO_ 1963 0;
BA_ "Type" BO_ 1963 1;
BA_ "CANFD_BRS" BO_ 1962 1;
BA_ "GenMsgCycleTime" BO_ 1962 1000;
BA_ "GenMsgILSupport" BO_ 1962 1;
BA_ "GenMsgSendType" BO_ 1962 0;
BA_ "Type" BO_ 1962 1;
BA_ "CANFD_BRS" BO_ 1961 1;
BA_ "GenMsgCycleTime" BO_ 1961 1000;
BA_ "GenMsgILSupport" BO_ 1961 1;
BA_ "GenMsgSendType" BO_ 1961 0;
BA_ "Type" BO_ 1961 1;
BA_ "GenSigTimeoutTime_IDCM" SG_ 500 BMS_HV_NumCellMinTemp 0;
BA_ "GenSigTimeoutTime_EVCU2" SG_ 500 BMS_HV_NumCellMinTemp 0;
BA_ "GenSigTimeoutTime_BPCM" SG_ 500 BMS_HV_NumCellMinTemp 0;
BA_ "GenSigTimeoutTime_IDCM" SG_ 500 BMS_HV_NumCellMaxVolt 0;
BA_ "GenSigTimeoutTime_EVCU2" SG_ 500 BMS_HV_NumCellMaxVolt 0;
BA_ "GenSigTimeoutTime_BPCM" SG_ 500 BMS_HV_NumCellMaxVolt 0;
BA_ "GenSigTimeoutTime_PPIM" SG_ 500 BMS_HV_NumCellMaxVolt 0;
BA_ "GenSigTimeoutTime_HCP" SG_ 500 BMS_HV_NumCellMaxVolt 0;
BA_ "GenSigTimeoutTime_IDCM" SG_ 500 BMS_HV_NumCellMaxTemp 0;
BA_ "GenSigTimeoutTime_EVCU2" SG_ 500 BMS_HV_NumCellMaxTemp 0;
BA_ "GenSigTimeoutTime_BPCM" SG_ 500 BMS_HV_NumCellMaxTemp 0;
BA_ "GenSigTimeoutTime_IDCM" SG_ 500 BMS_Cell_Volt_Min 0;
BA_ "GenSigTimeoutTime_EVCU2" SG_ 500 BMS_Cell_Volt_Min 0;
BA_ "GenSigTimeoutTime_BPCM" SG_ 500 BMS_Cell_Volt_Min 0;
BA_ "GenSigTimeoutTime_IDCM" SG_ 500 BMS_Cell_Volt_Max 0;
BA_ "GenSigTimeoutTime_EVCU2" SG_ 500 BMS_Cell_Volt_Max 0;
BA_ "GenSigTimeoutTime_BPCM" SG_ 500 BMS_Cell_Volt_Max 0;
BA_ "GenSigTimeoutTime_SGW" SG_ 250 APM_Water_Temp 0;
BA_ "GenSigTimeoutTime_IDCM" SG_ 250 APM_Water_Temp 0;
BA_ "GenSigTimeoutTime_BPCM" SG_ 250 APM_Water_Temp 0;
BA_ "GenSigTimeoutTime_PPIM" SG_ 250 APM_Water_Temp 0;
BA_ "GenSigTimeoutTime_HCP" SG_ 250 APM_Water_Temp 0;
BA_ "GenSigTimeoutTime_SGW" SG_ 250 APM_RecoveryAction 0;
BA_ "GenSigTimeoutTime_IDCM" SG_ 250 APM_RecoveryAction 0;
BA_ "GenSigTimeoutTime_BPCM" SG_ 250 APM_RecoveryAction 0;
BA_ "GenSigTimeoutTime_PPIM" SG_ 250 APM_RecoveryAction 0;
BA_ "GenSigTimeoutTime_HCP" SG_ 250 APM_RecoveryAction 0;
BA_ "GenSigTimeoutTime_SGW" SG_ 250 APM_PSFB_Temp2 0;
BA_ "GenSigTimeoutTime_IDCM" SG_ 250 APM_PSFB_Temp2 0;
BA_ "GenSigTimeoutTime_BPCM" SG_ 250 APM_PSFB_Temp2 0;
BA_ "GenSigTimeoutTime_PPIM" SG_ 250 APM_PSFB_Temp2 0;
BA_ "GenSigTimeoutTime_HCP" SG_ 250 APM_PSFB_Temp2 0;
BA_ "GenSigTimeoutTime_SGW" SG_ 250 APM_PSFB_Temp1 0;
BA_ "GenSigTimeoutTime_IDCM" SG_ 250 APM_PSFB_Temp1 0;
BA_ "GenSigTimeoutTime_BPCM" SG_ 250 APM_PSFB_Temp1 0;
BA_ "GenSigTimeoutTime_HCP" SG_ 250 APM_PSFB_Temp1 0;
BA_ "GenSigTimeoutTime_PPIM" SG_ 250 APM_PSFB_Temp1 0;
BA_ "GenSigTimeoutTime_SGW" SG_ 250 APM_LV_V_Fbk 0;
BA_ "GenSigTimeoutTime_IDCM" SG_ 250 APM_LV_V_Fbk 0;
BA_ "GenSigTimeoutTime_BPCM" SG_ 250 APM_LV_V_Fbk 0;
BA_ "GenSigTimeoutTime_PPIM" SG_ 250 APM_LV_V_Fbk 0;
BA_ "GenSigTimeoutTime_HCP" SG_ 250 APM_LV_V_Fbk 0;
BA_ "GenSigTimeoutTime_SGW" SG_ 250 APM_LV_I_Fbk 0;
BA_ "GenSigTimeoutTime_IDCM" SG_ 250 APM_LV_I_Fbk 0;
BA_ "GenSigTimeoutTime_BPCM" SG_ 250 APM_LV_I_Fbk 0;
BA_ "GenSigTimeoutTime_PPIM" SG_ 250 APM_LV_I_Fbk 0;
BA_ "GenSigTimeoutTime_HCP" SG_ 250 APM_LV_I_Fbk 0;
BA_ "GenSigTimeoutTime_SGW" SG_ 250 APM_HV_V_Fbk 0;
BA_ "GenSigTimeoutTime_IDCM" SG_ 250 APM_HV_V_Fbk 0;
BA_ "GenSigTimeoutTime_PPIM" SG_ 250 APM_HV_V_Fbk 0;
BA_ "GenSigTimeoutTime_HCP" SG_ 250 APM_HV_V_Fbk 0;
BA_ "GenSigTimeoutTime_BPCM" SG_ 250 APM_HV_V_Fbk 0;
BA_ "GenSigTimeoutTime_PPIM" SG_ 250 APM_HV_I_Fbk 0;
BA_ "GenSigTimeoutTime_HCP" SG_ 250 APM_HV_I_Fbk 0;
BA_ "GenSigTimeoutTime_SGW" SG_ 250 APM_HV_I_Fbk 0;
BA_ "GenSigTimeoutTime_IDCM" SG_ 250 APM_HV_I_Fbk 0;
BA_ "GenSigTimeoutTime_BPCM" SG_ 250 APM_HV_I_Fbk 0;
BA_ "GenSigTimeoutTime_PPIM" SG_ 250 APM_Buck_Temp 0;
BA_ "GenSigTimeoutTime_HCP" SG_ 250 APM_Buck_Temp 0;
BA_ "GenSigTimeoutTime_SGW" SG_ 250 APM_Buck_Temp 0;
BA_ "GenSigTimeoutTime_IDCM" SG_ 250 APM_Buck_Temp 0;
BA_ "GenSigTimeoutTime_BPCM" SG_ 250 APM_Buck_Temp 0;
BA_ "GenSigTimeoutTime_PPIM" SG_ 250 APM_UtilPctOfDCDC 0;
BA_ "GenSigTimeoutTime_HCP" SG_ 250 APM_UtilPctOfDCDC 0;
BA_ "GenSigTimeoutTime_SGW" SG_ 250 APM_UtilPctOfDCDC 0;
BA_ "GenSigTimeoutTime_IDCM" SG_ 250 APM_UtilPctOfDCDC 0;
BA_ "GenSigTimeoutTime_BPCM" SG_ 250 APM_UtilPctOfDCDC 0;
BA_ "GenSigTimeoutTime_SGW" SG_ 250 APM_TempColdPlate 0;
BA_ "GenSigTimeoutTime_IDCM" SG_ 250 APM_TempColdPlate 0;
BA_ "GenSigTimeoutTime_BPCM" SG_ 250 APM_TempColdPlate 0;
BA_ "GenSigStartValue" SG_ 250 APM_TempColdPlate 25;
BA_ "GenSigTimeoutTime_PPIM" SG_ 250 APM_TempColdPlate 0;
BA_ "GenSigTimeoutTime_HCP" SG_ 250 APM_TempColdPlate 0;
BA_ "GenSigTimeoutTime_SGW" SG_ 250 APM_PowerLimitMode 0;
BA_ "GenSigTimeoutTime_IDCM" SG_ 250 APM_PowerLimitMode 0;
BA_ "GenSigTimeoutTime_BPCM" SG_ 250 APM_PowerLimitMode 0;
BA_ "GenSigTimeoutTime_PPIM" SG_ 250 APM_PowerLimitMode 0;
BA_ "GenSigTimeoutTime_HCP" SG_ 250 APM_PowerLimitMode 0;
BA_ "GenSigTimeoutTime_SGW" SG_ 250 APM_OutputPower 0;
BA_ "GenSigTimeoutTime_IDCM" SG_ 250 APM_OutputPower 0;
BA_ "GenSigTimeoutTime_BPCM" SG_ 250 APM_OutputPower 0;
BA_ "GenSigTimeoutTime_PPIM" SG_ 250 APM_OutputPower 0;
BA_ "GenSigTimeoutTime_HCP" SG_ 250 APM_OutputPower 0;
BA_ "GenSigTimeoutTime_SGW" SG_ 250 APM_InputPower 0;
BA_ "GenSigTimeoutTime_IDCM" SG_ 250 APM_InputPower 0;
BA_ "GenSigTimeoutTime_BPCM" SG_ 250 APM_InputPower 0;
BA_ "GenSigTimeoutTime_PPIM" SG_ 250 APM_InputPower 0;
BA_ "GenSigTimeoutTime_HCP" SG_ 250 APM_InputPower 0;
BA_ "GenSigTimeoutTime_SGW" SG_ 250 APM_IdcHvSetPFdbk 0;
BA_ "GenSigTimeoutTime_IDCM" SG_ 250 APM_IdcHvSetPFdbk 0;
BA_ "GenSigTimeoutTime_BPCM" SG_ 250 APM_IdcHvSetPFdbk 0;
BA_ "GenSigStartValue" SG_ 250 APM_IdcHvSetPFdbk 1021;
BA_ "GenSigTimeoutTime_PPIM" SG_ 250 APM_IdcHvSetPFdbk 0;
BA_ "GenSigTimeoutTime_HCP" SG_ 250 APM_IdcHvSetPFdbk 0;
BA_ "GenSigTimeoutTime_SGW" SG_ 250 APM_HvVsetPFdbk 0;
BA_ "GenSigTimeoutTime_IDCM" SG_ 250 APM_HvVsetPFdbk 0;
BA_ "GenSigTimeoutTime_BPCM" SG_ 250 APM_HvVsetPFdbk 0;
BA_ "GenSigTimeoutTime_PPIM" SG_ 250 APM_HvVsetPFdbk 0;
BA_ "GenSigTimeoutTime_HCP" SG_ 250 APM_HvVsetPFdbk 0;
BA_ "GenSigTimeoutTime_SGW" SG_ 250 APM_HvOverVStatus 0;
BA_ "GenSigTimeoutTime_IDCM" SG_ 250 APM_HvOverVStatus 0;
BA_ "GenSigTimeoutTime_BPCM" SG_ 250 APM_HvOverVStatus 0;
BA_ "GenSigTimeoutTime_PPIM" SG_ 250 APM_HvOverVStatus 0;
BA_ "GenSigTimeoutTime_HCP" SG_ 250 APM_HvOverVStatus 0;
BA_ "GenSigTimeoutTime_SGW" SG_ 250 APM_FailureType 0;
BA_ "GenSigTimeoutTime_IDCM" SG_ 250 APM_FailureType 0;
BA_ "GenSigTimeoutTime_BPCM" SG_ 250 APM_FailureType 0;
BA_ "GenSigTimeoutTime_PPIM" SG_ 250 APM_FailureType 0;
BA_ "GenSigTimeoutTime_HCP" SG_ 250 APM_FailureType 0;
BA_ "GenSigTimeoutTime_SGW" SG_ 250 APM_FailureReason 0;
BA_ "GenSigTimeoutTime_IDCM" SG_ 250 APM_FailureReason 0;
BA_ "GenSigTimeoutTime_BPCM" SG_ 250 APM_FailureReason 0;
BA_ "GenSigTimeoutTime_PPIM" SG_ 250 APM_FailureReason 0;
BA_ "GenSigTimeoutTime_HCP" SG_ 250 APM_FailureReason 0;
BA_ "GenSigTimeoutTime_SGW" SG_ 250 APM_EstPwrLoss 0;
BA_ "GenSigTimeoutTime_IDCM" SG_ 250 APM_EstPwrLoss 0;
BA_ "GenSigTimeoutTime_BPCM" SG_ 250 APM_EstPwrLoss 0;
BA_ "GenSigTimeoutTime_PPIM" SG_ 250 APM_EstPwrLoss 0;
BA_ "GenSigTimeoutTime_HCP" SG_ 250 APM_EstPwrLoss 0;
BA_ "GenSigTimeoutTime_SGW" SG_ 250 APM_DeratingReason 0;
BA_ "GenSigTimeoutTime_IDCM" SG_ 250 APM_DeratingReason 0;
BA_ "GenSigTimeoutTime_BPCM" SG_ 250 APM_DeratingReason 0;
BA_ "GenSigTimeoutTime_PPIM" SG_ 250 APM_DeratingReason 0;
BA_ "GenSigTimeoutTime_HCP" SG_ 250 APM_DeratingReason 0;
BA_ "GenSigTimeoutTime_SGW" SG_ 250 APM_DeratingModeStatus 0;
BA_ "GenSigTimeoutTime_IDCM" SG_ 250 APM_DeratingModeStatus 0;
BA_ "GenSigTimeoutTime_BPCM" SG_ 250 APM_DeratingModeStatus 0;
BA_ "GenSigTimeoutTime_PPIM" SG_ 250 APM_DeratingModeStatus 0;
BA_ "GenSigTimeoutTime_HCP" SG_ 250 APM_DeratingModeStatus 0;
BA_ "GenSigTimeoutTime_SGW" SG_ 250 APM_CurrentLimitMode 0;
BA_ "GenSigTimeoutTime_IDCM" SG_ 250 APM_CurrentLimitMode 0;
BA_ "GenSigTimeoutTime_BPCM" SG_ 250 APM_CurrentLimitMode 0;
BA_ "GenSigTimeoutTime_PPIM" SG_ 250 APM_CurrentLimitMode 0;
BA_ "GenSigTimeoutTime_HCP" SG_ 250 APM_CurrentLimitMode 0;
BA_ "GenSigTimeoutTime_SGW" SG_ 250 APM_CtrlSts_Fbk 0;
BA_ "GenSigTimeoutTime_IDCM" SG_ 250 APM_CtrlSts_Fbk 0;
BA_ "GenSigTimeoutTime_BPCM" SG_ 250 APM_CtrlSts_Fbk 0;
BA_ "GenSigTimeoutTime_PPIM" SG_ 250 APM_CtrlSts_Fbk 0;
BA_ "GenSigTimeoutTime_HCP" SG_ 250 APM_CtrlSts_Fbk 0;
BA_ "GenSigTimeoutTime_PPIM" SG_ 250 MessageCounter_APM_VDCM 0;
BA_ "GenSigTimeoutTime_HCP" SG_ 250 MessageCounter_APM_VDCM 0;
BA_ "GenSigTimeoutTime_SGW" SG_ 250 MessageCounter_APM_VDCM 0;
BA_ "GenSigTimeoutTime_IDCM" SG_ 250 MessageCounter_APM_VDCM 0;
BA_ "GenSigTimeoutTime_BPCM" SG_ 250 MessageCounter_APM_VDCM 0;
BA_ "GenSigTimeoutTime_PPIM" SG_ 250 CRC_APM_VDCM 0;
BA_ "GenSigTimeoutTime_HCP" SG_ 250 CRC_APM_VDCM 0;
BA_ "GenSigTimeoutTime_SGW" SG_ 250 CRC_APM_VDCM 0;
BA_ "GenSigTimeoutTime_IDCM" SG_ 250 CRC_APM_VDCM 0;
BA_ "GenSigTimeoutTime_BPCM" SG_ 250 CRC_APM_VDCM 0;
BA_ "GenSigTimeoutTime_SGW" SG_ 250 APM_DeratingPower 0;
BA_ "GenSigTimeoutTime_IDCM" SG_ 250 APM_DeratingPower 0;
BA_ "GenSigTimeoutTime_BPCM" SG_ 250 APM_DeratingPower 0;
BA_ "GenSigTimeoutTime_PPIM" SG_ 250 APM_DeratingPower 0;
BA_ "GenSigTimeoutTime_HCP" SG_ 250 APM_DeratingPower 0;
BA_ "GenSigTimeoutTime_SGW" SG_ 2564485397 N_PDU_18DAF115 0;
BA_ "GenSigTimeoutTime_IDCM" SG_ 2564485397 N_PDU_18DAF115 0;
BA_ "GenSigTimeoutTime_EVCU2" SG_ 2564485397 N_PDU_18DAF115 0;
BA_ "GenSigTimeoutTime_BPCM" SG_ 2564485397 N_PDU_18DAF115 0;
BA_ "GenSigStartValue" SG_ 546 VDCM_MaxChrgTime_sec 255;
BA_ "GenSigTimeoutTime_SGW" SG_ 546 VDCM_MaxChrgTime_sec 0;
BA_ "GenSigTimeoutTime_EVCU2" SG_ 546 VDCM_MaxChrgTime_sec 0;
BA_ "GenSigTimeoutTime_BPCM" SG_ 546 VDCM_MaxChrgTime_sec 0;
BA_ "GenSigTimeoutTime_PPIM" SG_ 546 VDCM_MaxChrgTime_sec 0;
BA_ "GenSigTimeoutTime_HCP" SG_ 546 VDCM_MaxChrgTime_sec 0;
BA_ "GenSigTimeoutTime_SGW" SG_ 546 VDCM_MaxChrgTime_min 0;
BA_ "GenSigTimeoutTime_EVCU2" SG_ 546 VDCM_MaxChrgTime_min 0;
BA_ "GenSigTimeoutTime_BPCM" SG_ 546 VDCM_MaxChrgTime_min 0;
BA_ "GenSigStartValue" SG_ 546 VDCM_MaxChrgTime_min 255;
BA_ "GenSigTimeoutTime_PPIM" SG_ 546 VDCM_MaxChrgTime_min 0;
BA_ "GenSigTimeoutTime_HCP" SG_ 546 VDCM_MaxChrgTime_min 0;
BA_ "GenSigTimeoutTime_SGW" SG_ 546 VDCM_EV_Batt_Max_T_Limit 0;
BA_ "GenSigTimeoutTime_EVCU2" SG_ 546 VDCM_EV_Batt_Max_T_Limit 0;
BA_ "GenSigTimeoutTime_BPCM" SG_ 546 VDCM_EV_Batt_Max_T_Limit 0;
BA_ "GenSigStartValue" SG_ 546 VDCM_EV_Batt_Max_T_Limit 60;
BA_ "GenSigTimeoutTime_PPIM" SG_ 546 VDCM_EV_Batt_Max_T_Limit 0;
BA_ "GenSigTimeoutTime_HCP" SG_ 546 VDCM_EV_Batt_Max_T_Limit 0;
BA_ "GenSigTimeoutTime_SGW" SG_ 546 VDCM_EstChrgTime_min 0;
BA_ "GenSigTimeoutTime_EVCU2" SG_ 546 VDCM_EstChrgTime_min 0;
BA_ "GenSigTimeoutTime_BPCM" SG_ 546 VDCM_EstChrgTime_min 0;
BA_ "GenSigStartValue" SG_ 546 VDCM_EstChrgTime_min 255;
BA_ "GenSigTimeoutTime_PPIM" SG_ 546 VDCM_EstChrgTime_min 0;
BA_ "GenSigTimeoutTime_HCP" SG_ 546 VDCM_EstChrgTime_min 0;
BA_ "GenSigTimeoutTime_PPIM" SG_ 546 VDCM_ChrgMode_Req 0;
BA_ "GenSigTimeoutTime_HCP" SG_ 546 VDCM_ChrgMode_Req 0;
BA_ "GenSigTimeoutTime_SGW" SG_ 546 VDCM_ChrgMode_Req 0;
BA_ "GenSigTimeoutTime_EVCU2" SG_ 546 VDCM_ChrgMode_Req 0;
BA_ "GenSigTimeoutTime_BPCM" SG_ 546 VDCM_ChrgMode_Req 0;
BA_ "GenSigTimeoutTime_PPIM" SG_ 546 VDCM_ChrgCurrDeviationErr 0;
BA_ "GenSigTimeoutTime_HCP" SG_ 546 VDCM_ChrgCurrDeviationErr 0;
BA_ "GenSigTimeoutTime_SGW" SG_ 546 VDCM_ChrgCurrDeviationErr 0;
BA_ "GenSigTimeoutTime_EVCU2" SG_ 546 VDCM_ChrgCurrDeviationErr 0;
BA_ "GenSigTimeoutTime_BPCM" SG_ 546 VDCM_ChrgCurrDeviationErr 0;
BA_ "GenSigTimeoutTime_SGW" SG_ 546 VDCM_ChrgCompleteReason 0;
BA_ "GenSigTimeoutTime_EVCU2" SG_ 546 VDCM_ChrgCompleteReason 0;
BA_ "GenSigTimeoutTime_BPCM" SG_ 546 VDCM_ChrgCompleteReason 0;
BA_ "GenSigTimeoutTime_PPIM" SG_ 546 VDCM_ChrgCompleteReason 0;
BA_ "GenSigTimeoutTime_HCP" SG_ 546 VDCM_ChrgCompleteReason 0;
BA_ "GenSigTimeoutTime_SGW" SG_ 546 VDCM_BattUnderVolt 0;
BA_ "GenSigTimeoutTime_EVCU2" SG_ 546 VDCM_BattUnderVolt 0;
BA_ "GenSigTimeoutTime_BPCM" SG_ 546 VDCM_BattUnderVolt 0;
BA_ "GenSigTimeoutTime_PPIM" SG_ 546 VDCM_BattUnderVolt 0;
BA_ "GenSigTimeoutTime_HCP" SG_ 546 VDCM_BattUnderVolt 0;
BA_ "GenSigTimeoutTime_SGW" SG_ 546 VDCM_BattOverVolt 0;
BA_ "GenSigTimeoutTime_PPIM" SG_ 546 VDCM_BattOverVolt 0;
BA_ "GenSigTimeoutTime_HCP" SG_ 546 VDCM_BattOverVolt 0;
BA_ "GenSigTimeoutTime_EVCU2" SG_ 546 VDCM_BattOverVolt 0;
BA_ "GenSigTimeoutTime_BPCM" SG_ 546 VDCM_BattOverVolt 0;
BA_ "GenSigTimeoutTime_PPIM" SG_ 546 VDCM_BattFullSOC_prc 0;
BA_ "GenSigTimeoutTime_HCP" SG_ 546 VDCM_BattFullSOC_prc 0;
BA_ "GenSigTimeoutTime_SGW" SG_ 546 VDCM_BattFullSOC_prc 0;
BA_ "GenSigTimeoutTime_EVCU2" SG_ 546 VDCM_BattFullSOC_prc 0;
BA_ "GenSigTimeoutTime_BPCM" SG_ 546 VDCM_BattFullSOC_prc 0;
BA_ "GenSigStartValue" SG_ 546 VDCM_BattFullSOC_prc 100;
BA_ "GenSigTimeoutTime_SGW" SG_ 546 CPIM_Over_Temperature 0;
BA_ "GenSigTimeoutTime_EVCU2" SG_ 546 CPIM_Over_Temperature 0;
BA_ "GenSigTimeoutTime_BPCM" SG_ 546 CPIM_Over_Temperature 0;
BA_ "GenSigTimeoutTime_PPIM" SG_ 546 CPIM_Over_Temperature 0;
BA_ "GenSigTimeoutTime_HCP" SG_ 546 CPIM_Over_Temperature 0;
BA_ "GenSigTimeoutTime_SGW" SG_ 546 CPIM_Error 0;
BA_ "GenSigTimeoutTime_EVCU2" SG_ 546 CPIM_Error 0;
BA_ "GenSigTimeoutTime_BPCM" SG_ 546 CPIM_Error 0;
BA_ "GenSigTimeoutTime_PPIM" SG_ 546 CPIM_Error 0;
BA_ "GenSigTimeoutTime_HCP" SG_ 546 CPIM_Error 0;
BA_ "GenSigTimeoutTime_SGW" SG_ 546 WeldCheck_Complete 0;
BA_ "GenSigTimeoutTime_EVCU2" SG_ 546 WeldCheck_Complete 0;
BA_ "GenSigTimeoutTime_BPCM" SG_ 546 WeldCheck_Complete 0;
BA_ "GenSigTimeoutTime_PPIM" SG_ 546 WeldCheck_Complete 0;
BA_ "GenSigTimeoutTime_HCP" SG_ 546 WeldCheck_Complete 0;
BA_ "GenSigTimeoutTime_SGW" SG_ 546 VDCM_SOCIsOOR 0;
BA_ "GenSigTimeoutTime_EVCU2" SG_ 546 VDCM_SOCIsOOR 0;
BA_ "GenSigTimeoutTime_BPCM" SG_ 546 VDCM_SOCIsOOR 0;
BA_ "GenSigTimeoutTime_PPIM" SG_ 546 VDCM_SOCIsOOR 0;
BA_ "GenSigTimeoutTime_HCP" SG_ 546 VDCM_SOCIsOOR 0;
BA_ "GenSigTimeoutTime_SGW" SG_ 546 VDCM_ChargeCurrIsOOR 0;
BA_ "GenSigTimeoutTime_EVCU2" SG_ 546 VDCM_ChargeCurrIsOOR 0;
BA_ "GenSigTimeoutTime_BPCM" SG_ 546 VDCM_ChargeCurrIsOOR 0;
BA_ "GenSigTimeoutTime_PPIM" SG_ 546 VDCM_ChargeCurrIsOOR 0;
BA_ "GenSigTimeoutTime_HCP" SG_ 546 VDCM_ChargeCurrIsOOR 0;
BA_ "GenSigTimeoutTime_SGW" SG_ 546 VDCM_CellVoltIsOOR 0;
BA_ "GenSigTimeoutTime_EVCU2" SG_ 546 VDCM_CellVoltIsOOR 0;
BA_ "GenSigTimeoutTime_BPCM" SG_ 546 VDCM_CellVoltIsOOR 0;
BA_ "GenSigTimeoutTime_PPIM" SG_ 546 VDCM_CellVoltIsOOR 0;
BA_ "GenSigTimeoutTime_HCP" SG_ 546 VDCM_CellVoltIsOOR 0;
BA_ "GenSigTimeoutTime_SGW" SG_ 546 VDCM_BattTempIsOOR 0;
BA_ "GenSigTimeoutTime_EVCU2" SG_ 546 VDCM_BattTempIsOOR 0;
BA_ "GenSigTimeoutTime_BPCM" SG_ 546 VDCM_BattTempIsOOR 0;
BA_ "GenSigTimeoutTime_PPIM" SG_ 546 VDCM_BattTempIsOOR 0;
BA_ "GenSigTimeoutTime_HCP" SG_ 546 VDCM_BattTempIsOOR 0;
BA_ "GenSigTimeoutTime_PPIM" SG_ 546 ReadyToChargeState 0;
BA_ "GenSigTimeoutTime_HCP" SG_ 546 ReadyToChargeState 0;
BA_ "GenSigTimeoutTime_SGW" SG_ 546 ReadyToChargeState 0;
BA_ "GenSigTimeoutTime_EVCU2" SG_ 546 ReadyToChargeState 0;
BA_ "GenSigTimeoutTime_BPCM" SG_ 546 ReadyToChargeState 0;
BA_ "GenSigTimeoutTime_PPIM" SG_ 546 HCP_SessionStopCmd 0;
BA_ "GenSigTimeoutTime_HCP" SG_ 546 HCP_SessionStopCmd 0;
BA_ "GenSigTimeoutTime_SGW" SG_ 546 HCP_SessionStopCmd 0;
BA_ "GenSigTimeoutTime_EVCU2" SG_ 546 HCP_SessionStopCmd 0;
BA_ "GenSigTimeoutTime_BPCM" SG_ 546 HCP_SessionStopCmd 0;
BA_ "GenSigTimeoutTime_PPIM" SG_ 546 HCP_DC_Retry 0;
BA_ "GenSigTimeoutTime_HCP" SG_ 546 HCP_DC_Retry 0;
BA_ "GenSigTimeoutTime_SGW" SG_ 546 HCP_DC_Retry 0;
BA_ "GenSigTimeoutTime_EVCU2" SG_ 546 HCP_DC_Retry 0;
BA_ "GenSigTimeoutTime_BPCM" SG_ 546 HCP_DC_Retry 0;
BA_ "GenSigTimeoutTime_SGW" SG_ 546 DCChrg_BatSideCurrent_VDCM 0;
BA_ "GenSigTimeoutTime_EVCU2" SG_ 546 DCChrg_BatSideCurrent_VDCM 0;
BA_ "GenSigTimeoutTime_BPCM" SG_ 546 DCChrg_BatSideCurrent_VDCM 0;
BA_ "GenSigStartValue" SG_ 546 DCChrg_BatSideCurrent_VDCM 50;
BA_ "GenSigTimeoutTime_PPIM" SG_ 546 DCChrg_BatSideCurrent_VDCM 0;
BA_ "GenSigTimeoutTime_HCP" SG_ 546 DCChrg_BatSideCurrent_VDCM 0;
BA_ "GenSigTimeoutTime_SGW" SG_ 546 BMS_Max_Pk_Volt_Allowed_VDCM 0;
BA_ "GenSigTimeoutTime_EVCU2" SG_ 546 BMS_Max_Pk_Volt_Allowed_VDCM 0;
BA_ "GenSigTimeoutTime_BPCM" SG_ 546 BMS_Max_Pk_Volt_Allowed_VDCM 0;
BA_ "GenSigTimeoutTime_PPIM" SG_ 546 BMS_Max_Pk_Volt_Allowed_VDCM 0;
BA_ "GenSigTimeoutTime_HCP" SG_ 546 BMS_Max_Pk_Volt_Allowed_VDCM 0;
BA_ "GenSigTimeoutTime_SGW" SG_ 546 BMS_Max_Cell_Volt_Allowed_Vldty_ 0;
BA_ "GenSigTimeoutTime_EVCU2" SG_ 546 BMS_Max_Cell_Volt_Allowed_Vldty_ 0;
BA_ "GenSigTimeoutTime_BPCM" SG_ 546 BMS_Max_Cell_Volt_Allowed_Vldty_ 0;
BA_ "GenSigTimeoutTime_PPIM" SG_ 546 BMS_Max_Cell_Volt_Allowed_Vldty_ 0;
BA_ "GenSigTimeoutTime_HCP" SG_ 546 BMS_Max_Cell_Volt_Allowed_Vldty_ 0;
BA_ "SystemSignalLongSymbol" SG_ 546 BMS_Max_Cell_Volt_Allowed_Vldty_ "BMS_Max_Cell_Volt_Allowed_Vldty_VDCM";
BA_ "GenSigTimeoutTime_SGW" SG_ 546 BMS_Max_Cell_Volt_Allowed_VDCM 0;
BA_ "GenSigTimeoutTime_EVCU2" SG_ 546 BMS_Max_Cell_Volt_Allowed_VDCM 0;
BA_ "GenSigTimeoutTime_BPCM" SG_ 546 BMS_Max_Cell_Volt_Allowed_VDCM 0;
BA_ "GenSigTimeoutTime_PPIM" SG_ 546 BMS_Max_Cell_Volt_Allowed_VDCM 0;
BA_ "GenSigTimeoutTime_HCP" SG_ 546 BMS_Max_Cell_Volt_Allowed_VDCM 0;
BA_ "GenSigTimeoutTime_SGW" SG_ 546 BMS_HV_Trac_PreCha_Contac_Sts_VD 0;
BA_ "GenSigTimeoutTime_EVCU2" SG_ 546 BMS_HV_Trac_PreCha_Contac_Sts_VD 0;
BA_ "GenSigTimeoutTime_PPIM" SG_ 546 BMS_HV_Trac_PreCha_Contac_Sts_VD 0;
BA_ "GenSigTimeoutTime_HCP" SG_ 546 BMS_HV_Trac_PreCha_Contac_Sts_VD 0;
BA_ "SystemSignalLongSymbol" SG_ 546 BMS_HV_Trac_PreCha_Contac_Sts_VD "BMS_HV_Trac_PreCha_Contac_Sts_VDCM";
BA_ "GenSigTimeoutTime_SGW" SG_ 546 BMS_HV_Trac_Main_Contac_Sts_VDCM 0;
BA_ "GenSigTimeoutTime_EVCU2" SG_ 546 BMS_HV_Trac_Main_Contac_Sts_VDCM 0;
BA_ "GenSigTimeoutTime_PPIM" SG_ 546 BMS_HV_Trac_Main_Contac_Sts_VDCM 0;
BA_ "GenSigTimeoutTime_HCP" SG_ 546 BMS_HV_Trac_Main_Contac_Sts_VDCM 0;
BA_ "GenSigTimeoutTime_SGW" SG_ 546 BMS_HV_Temperature_Min_VDCM 0;
BA_ "GenSigTimeoutTime_EVCU2" SG_ 546 BMS_HV_Temperature_Min_VDCM 0;
BA_ "GenSigTimeoutTime_BPCM" SG_ 546 BMS_HV_Temperature_Min_VDCM 0;
BA_ "GenSigTimeoutTime_PPIM" SG_ 546 BMS_HV_Temperature_Min_VDCM 0;
BA_ "GenSigTimeoutTime_HCP" SG_ 546 BMS_HV_Temperature_Min_VDCM 0;
BA_ "GenSigTimeoutTime_SGW" SG_ 546 BMS_HV_Temperature_Max_VDCM 0;
BA_ "GenSigTimeoutTime_EVCU2" SG_ 546 BMS_HV_Temperature_Max_VDCM 0;
BA_ "GenSigTimeoutTime_BPCM" SG_ 546 BMS_HV_Temperature_Max_VDCM 0;
BA_ "GenSigTimeoutTime_PPIM" SG_ 546 BMS_HV_Temperature_Max_VDCM 0;
BA_ "GenSigTimeoutTime_HCP" SG_ 546 BMS_HV_Temperature_Max_VDCM 0;
BA_ "GenSigTimeoutTime_SGW" SG_ 546 BMS_HV_SOC_AccuracySts_VDCM 0;
BA_ "GenSigTimeoutTime_EVCU2" SG_ 546 BMS_HV_SOC_AccuracySts_VDCM 0;
BA_ "GenSigTimeoutTime_BPCM" SG_ 546 BMS_HV_SOC_AccuracySts_VDCM 0;
BA_ "GenSigSendType" SG_ 546 BMS_HV_SOC_AccuracySts_VDCM 3;
BA_ "GenSigTimeoutTime_PPIM" SG_ 546 BMS_HV_SOC_AccuracySts_VDCM 0;
BA_ "GenSigTimeoutTime_HCP" SG_ 546 BMS_HV_SOC_AccuracySts_VDCM 0;
BA_ "GenSigTimeoutTime_SGW" SG_ 546 BMS_HV_NumCellMinTemp_VDCM 0;
BA_ "GenSigTimeoutTime_EVCU2" SG_ 546 BMS_HV_NumCellMinTemp_VDCM 0;
BA_ "GenSigTimeoutTime_BPCM" SG_ 546 BMS_HV_NumCellMinTemp_VDCM 0;
BA_ "GenSigTimeoutTime_PPIM" SG_ 546 BMS_HV_NumCellMinTemp_VDCM 0;
BA_ "GenSigTimeoutTime_HCP" SG_ 546 BMS_HV_NumCellMinTemp_VDCM 0;
BA_ "GenSigTimeoutTime_SGW" SG_ 546 BMS_HV_NumCellMaxVolt_VDCM 0;
BA_ "GenSigTimeoutTime_EVCU2" SG_ 546 BMS_HV_NumCellMaxVolt_VDCM 0;
BA_ "GenSigTimeoutTime_BPCM" SG_ 546 BMS_HV_NumCellMaxVolt_VDCM 0;
BA_ "GenSigTimeoutTime_PPIM" SG_ 546 BMS_HV_NumCellMaxVolt_VDCM 0;
BA_ "GenSigTimeoutTime_HCP" SG_ 546 BMS_HV_NumCellMaxVolt_VDCM 0;
BA_ "GenSigTimeoutTime_SGW" SG_ 546 BMS_HV_NumCellMaxTemp_VDCM 0;
BA_ "GenSigTimeoutTime_EVCU2" SG_ 546 BMS_HV_NumCellMaxTemp_VDCM 0;
BA_ "GenSigTimeoutTime_BPCM" SG_ 546 BMS_HV_NumCellMaxTemp_VDCM 0;
BA_ "GenSigTimeoutTime_PPIM" SG_ 546 BMS_HV_NumCellMaxTemp_VDCM 0;
BA_ "GenSigTimeoutTime_HCP" SG_ 546 BMS_HV_NumCellMaxTemp_VDCM 0;
BA_ "GenSigTimeoutTime_SGW" SG_ 546 BMS_HV_Low_Temp_Thrsh_VDCM 0;
BA_ "GenSigTimeoutTime_EVCU2" SG_ 546 BMS_HV_Low_Temp_Thrsh_VDCM 0;
BA_ "GenSigTimeoutTime_BPCM" SG_ 546 BMS_HV_Low_Temp_Thrsh_VDCM 0;
BA_ "GenSigTimeoutTime_PPIM" SG_ 546 BMS_HV_Low_Temp_Thrsh_VDCM 0;
BA_ "GenSigTimeoutTime_HCP" SG_ 546 BMS_HV_Low_Temp_Thrsh_VDCM 0;
BA_ "GenSigTimeoutTime_SGW" SG_ 546 BMS_HV_InternalVoltage_VDCM 0;
BA_ "GenSigTimeoutTime_EVCU2" SG_ 546 BMS_HV_InternalVoltage_VDCM 0;
BA_ "GenSigTimeoutTime_PPIM" SG_ 546 BMS_HV_InternalVoltage_VDCM 0;
BA_ "GenSigTimeoutTime_HCP" SG_ 546 BMS_HV_InternalVoltage_VDCM 0;
BA_ "GenSigTimeoutTime_SGW" SG_ 546 BMS_HV_High_Temp_Thrsh_VDCM 0;
BA_ "GenSigTimeoutTime_EVCU2" SG_ 546 BMS_HV_High_Temp_Thrsh_VDCM 0;
BA_ "GenSigTimeoutTime_BPCM" SG_ 546 BMS_HV_High_Temp_Thrsh_VDCM 0;
BA_ "GenSigTimeoutTime_PPIM" SG_ 546 BMS_HV_High_Temp_Thrsh_VDCM 0;
BA_ "GenSigTimeoutTime_HCP" SG_ 546 BMS_HV_High_Temp_Thrsh_VDCM 0;
BA_ "GenSigTimeoutTime_SGW" SG_ 546 BMS_HV_Common_Contactor_Sts_VDCM 0;
BA_ "GenSigTimeoutTime_EVCU2" SG_ 546 BMS_HV_Common_Contactor_Sts_VDCM 0;
BA_ "GenSigTimeoutTime_PPIM" SG_ 546 BMS_HV_Common_Contactor_Sts_VDCM 0;
BA_ "GenSigTimeoutTime_HCP" SG_ 546 BMS_HV_Common_Contactor_Sts_VDCM 0;
BA_ "GenSigTimeoutTime_SGW" SG_ 546 BMS_HV_Battery_GFD_Sts_VDCM 0;
BA_ "GenSigTimeoutTime_EVCU2" SG_ 546 BMS_HV_Battery_GFD_Sts_VDCM 0;
BA_ "GenSigTimeoutTime_PPIM" SG_ 546 BMS_HV_Battery_GFD_Sts_VDCM 0;
BA_ "GenSigTimeoutTime_HCP" SG_ 546 BMS_HV_Battery_GFD_Sts_VDCM 0;
BA_ "GenSigTimeoutTime_SGW" SG_ 546 BMS_HV_BatIntrlk_InternalStat_VD 0;
BA_ "GenSigTimeoutTime_EVCU2" SG_ 546 BMS_HV_BatIntrlk_InternalStat_VD 0;
BA_ "GenSigTimeoutTime_PPIM" SG_ 546 BMS_HV_BatIntrlk_InternalStat_VD 0;
BA_ "GenSigTimeoutTime_HCP" SG_ 546 BMS_HV_BatIntrlk_InternalStat_VD 0;
BA_ "SystemSignalLongSymbol" SG_ 546 BMS_HV_BatIntrlk_InternalStat_VD "BMS_HV_BatIntrlk_InternalStat_VDCM";
BA_ "GenSigTimeoutTime_SGW" SG_ 546 BMS_HV_AC_Char_Main_Contac_Sts_V 0;
BA_ "GenSigTimeoutTime_EVCU2" SG_ 546 BMS_HV_AC_Char_Main_Contac_Sts_V 0;
BA_ "GenSigTimeoutTime_PPIM" SG_ 546 BMS_HV_AC_Char_Main_Contac_Sts_V 0;
BA_ "GenSigTimeoutTime_HCP" SG_ 546 BMS_HV_AC_Char_Main_Contac_Sts_V 0;
BA_ "SystemSignalLongSymbol" SG_ 546 BMS_HV_AC_Char_Main_Contac_Sts_V "BMS_HV_AC_Char_Main_Contac_Sts_VDCM";
BA_ "GenSigTimeoutTime_SGW" SG_ 546 BMS_Cell_Volt_Min_Vldty_VDCM 0;
BA_ "GenSigTimeoutTime_EVCU2" SG_ 546 BMS_Cell_Volt_Min_Vldty_VDCM 0;
BA_ "GenSigTimeoutTime_BPCM" SG_ 546 BMS_Cell_Volt_Min_Vldty_VDCM 0;
BA_ "GenSigTimeoutTime_PPIM" SG_ 546 BMS_Cell_Volt_Min_Vldty_VDCM 0;
BA_ "GenSigTimeoutTime_HCP" SG_ 546 BMS_Cell_Volt_Min_Vldty_VDCM 0;
BA_ "GenSigTimeoutTime_SGW" SG_ 546 BMS_Cell_Volt_Min_VDCM 0;
BA_ "GenSigTimeoutTime_EVCU2" SG_ 546 BMS_Cell_Volt_Min_VDCM 0;
BA_ "GenSigTimeoutTime_BPCM" SG_ 546 BMS_Cell_Volt_Min_VDCM 0;
BA_ "GenSigTimeoutTime_PPIM" SG_ 546 BMS_Cell_Volt_Min_VDCM 0;
BA_ "GenSigTimeoutTime_HCP" SG_ 546 BMS_Cell_Volt_Min_VDCM 0;
BA_ "GenSigTimeoutTime_SGW" SG_ 546 BMS_Cell_Volt_Max_Vldty_VDCM 0;
BA_ "GenSigTimeoutTime_EVCU2" SG_ 546 BMS_Cell_Volt_Max_Vldty_VDCM 0;
BA_ "GenSigTimeoutTime_BPCM" SG_ 546 BMS_Cell_Volt_Max_Vldty_VDCM 0;
BA_ "GenSigTimeoutTime_PPIM" SG_ 546 BMS_Cell_Volt_Max_Vldty_VDCM 0;
BA_ "GenSigTimeoutTime_HCP" SG_ 546 BMS_Cell_Volt_Max_Vldty_VDCM 0;
BA_ "GenSigTimeoutTime_SGW" SG_ 546 BMS_Cell_Volt_Max_VDCM 0;
BA_ "GenSigTimeoutTime_EVCU2" SG_ 546 BMS_Cell_Volt_Max_VDCM 0;
BA_ "GenSigTimeoutTime_BPCM" SG_ 546 BMS_Cell_Volt_Max_VDCM 0;
BA_ "GenSigTimeoutTime_PPIM" SG_ 546 BMS_Cell_Volt_Max_VDCM 0;
BA_ "GenSigTimeoutTime_HCP" SG_ 546 BMS_Cell_Volt_Max_VDCM 0;
BA_ "GenSigTimeoutTime_SGW" SG_ 546 AC_Chrg_Branch_Voltage_VDCM 0;
BA_ "GenSigTimeoutTime_EVCU2" SG_ 546 AC_Chrg_Branch_Voltage_VDCM 0;
BA_ "GenSigTimeoutTime_BPCM" SG_ 546 AC_Chrg_Branch_Voltage_VDCM 0;
BA_ "GenSigTimeoutTime_PPIM" SG_ 546 AC_Chrg_Branch_Voltage_VDCM 0;
BA_ "GenSigTimeoutTime_HCP" SG_ 546 AC_Chrg_Branch_Voltage_VDCM 0;
BA_ "GenSigTimeoutTime_SGW" SG_ 546 BMS_HV_Char_PreCha_Contac_Sts_VD 0;
BA_ "GenSigTimeoutTime_EVCU2" SG_ 546 BMS_HV_Char_PreCha_Contac_Sts_VD 0;
BA_ "GenSigTimeoutTime_PPIM" SG_ 546 BMS_HV_Char_PreCha_Contac_Sts_VD 0;
BA_ "GenSigTimeoutTime_HCP" SG_ 546 BMS_HV_Char_PreCha_Contac_Sts_VD 0;
BA_ "SystemSignalLongSymbol" SG_ 546 BMS_HV_Char_PreCha_Contac_Sts_VD "BMS_HV_Char_PreCha_Contac_Sts_VDCM";
BA_ "GenSigTimeoutTime_SGW" SG_ 546 BMS_HV_Char_Main_Contac_Sts_VDCM 0;
BA_ "GenSigTimeoutTime_EVCU2" SG_ 546 BMS_HV_Char_Main_Contac_Sts_VDCM 0;
BA_ "GenSigTimeoutTime_PPIM" SG_ 546 BMS_HV_Char_Main_Contac_Sts_VDCM 0;
BA_ "GenSigTimeoutTime_HCP" SG_ 546 BMS_HV_Char_Main_Contac_Sts_VDCM 0;
BA_ "GenSigTimeoutTime_SGW" SG_ 546 BMS_HV_TractionBusVoltage_VDCM 0;
BA_ "GenSigTimeoutTime_EVCU2" SG_ 546 BMS_HV_TractionBusVoltage_VDCM 0;
BA_ "GenSigTimeoutTime_PPIM" SG_ 546 BMS_HV_TractionBusVoltage_VDCM 0;
BA_ "GenSigTimeoutTime_HCP" SG_ 546 BMS_HV_TractionBusVoltage_VDCM 0;
BA_ "GenSigTimeoutTime_SGW" SG_ 546 BMS_HV_Trac_Bus_Sts_VDCM 0;
BA_ "GenSigTimeoutTime_EVCU2" SG_ 546 BMS_HV_Trac_Bus_Sts_VDCM 0;
BA_ "GenSigTimeoutTime_PPIM" SG_ 546 BMS_HV_Trac_Bus_Sts_VDCM 0;
BA_ "GenSigTimeoutTime_HCP" SG_ 546 BMS_HV_Trac_Bus_Sts_VDCM 0;
BA_ "GenSigTimeoutTime_SGW" SG_ 546 BMS_HV_ChargingBusVoltage_VDCM 0;
BA_ "GenSigTimeoutTime_EVCU2" SG_ 546 BMS_HV_ChargingBusVoltage_VDCM 0;
BA_ "GenSigTimeoutTime_PPIM" SG_ 546 BMS_HV_ChargingBusVoltage_VDCM 0;
BA_ "GenSigTimeoutTime_HCP" SG_ 546 BMS_HV_ChargingBusVoltage_VDCM 0;
BA_ "GenSigTimeoutTime_SGW" SG_ 546 BMS_HV_Char_Bus_Sts_VDCM 0;
BA_ "GenSigTimeoutTime_EVCU2" SG_ 546 BMS_HV_Char_Bus_Sts_VDCM 0;
BA_ "GenSigTimeoutTime_PPIM" SG_ 546 BMS_HV_Char_Bus_Sts_VDCM 0;
BA_ "GenSigTimeoutTime_HCP" SG_ 546 BMS_HV_Char_Bus_Sts_VDCM 0;
BA_ "GenSigTimeoutTime_SGW" SG_ 546 BMS_HV_BatState_VDCM 0;
BA_ "GenSigTimeoutTime_EVCU2" SG_ 546 BMS_HV_BatState_VDCM 0;
BA_ "GenSigTimeoutTime_PPIM" SG_ 546 BMS_HV_BatState_VDCM 0;
BA_ "GenSigTimeoutTime_HCP" SG_ 546 BMS_HV_BatState_VDCM 0;
BA_ "GenSigTimeoutTime_SGW" SG_ 546 BMS_HV_BatActualPower_VDCM 0;
BA_ "GenSigTimeoutTime_EVCU2" SG_ 546 BMS_HV_BatActualPower_VDCM 0;
BA_ "GenSigTimeoutTime_PPIM" SG_ 546 BMS_HV_BatActualPower_VDCM 0;
BA_ "GenSigTimeoutTime_HCP" SG_ 546 BMS_HV_BatActualPower_VDCM 0;
BA_ "GenSigTimeoutTime_SGW" SG_ 546 VDCM_ChargingPermitting 0;
BA_ "GenSigTimeoutTime_EVCU2" SG_ 546 VDCM_ChargingPermitting 0;
BA_ "GenSigTimeoutTime_BPCM" SG_ 546 VDCM_ChargingPermitting 0;
BA_ "GenSigTimeoutTime_PPIM" SG_ 546 VDCM_ChargingPermitting 0;
BA_ "GenSigTimeoutTime_HCP" SG_ 546 VDCM_ChargingPermitting 0;
BA_ "GenSigTimeoutTime_SGW" SG_ 546 GBT_Target_Voltage_Reached 0;
BA_ "GenSigTimeoutTime_EVCU2" SG_ 546 GBT_Target_Voltage_Reached 0;
BA_ "GenSigTimeoutTime_BPCM" SG_ 546 GBT_Target_Voltage_Reached 0;
BA_ "GenSigTimeoutTime_PPIM" SG_ 546 GBT_Target_Voltage_Reached 0;
BA_ "GenSigTimeoutTime_HCP" SG_ 546 GBT_Target_Voltage_Reached 0;
BA_ "GenSigTimeoutTime_SGW" SG_ 546 GBT_Target_Cell_Voltage_Reached 0;
BA_ "GenSigTimeoutTime_EVCU2" SG_ 546 GBT_Target_Cell_Voltage_Reached 0;
BA_ "GenSigTimeoutTime_BPCM" SG_ 546 GBT_Target_Cell_Voltage_Reached 0;
BA_ "GenSigTimeoutTime_PPIM" SG_ 546 GBT_Target_Cell_Voltage_Reached 0;
BA_ "GenSigTimeoutTime_HCP" SG_ 546 GBT_Target_Cell_Voltage_Reached 0;
BA_ "GenSigTimeoutTime_SGW" SG_ 546 GBT_Ready_to_Charge 0;
BA_ "GenSigTimeoutTime_EVCU2" SG_ 546 GBT_Ready_to_Charge 0;
BA_ "GenSigTimeoutTime_BPCM" SG_ 546 GBT_Ready_to_Charge 0;
BA_ "GenSigTimeoutTime_PPIM" SG_ 546 GBT_Ready_to_Charge 0;
BA_ "GenSigTimeoutTime_HCP" SG_ 546 GBT_Ready_to_Charge 0;
BA_ "GenSigTimeoutTime_SGW" SG_ 546 GBT_Desired_SOC_Reached 0;
BA_ "GenSigTimeoutTime_EVCU2" SG_ 546 GBT_Desired_SOC_Reached 0;
BA_ "GenSigTimeoutTime_BPCM" SG_ 546 GBT_Desired_SOC_Reached 0;
BA_ "GenSigTimeoutTime_PPIM" SG_ 546 GBT_Desired_SOC_Reached 0;
BA_ "GenSigTimeoutTime_HCP" SG_ 546 GBT_Desired_SOC_Reached 0;
BA_ "GenSigTimeoutTime_SGW" SG_ 546 GBT_Charger_Active_Interruption 0;
BA_ "GenSigTimeoutTime_EVCU2" SG_ 546 GBT_Charger_Active_Interruption 0;
BA_ "GenSigTimeoutTime_BPCM" SG_ 546 GBT_Charger_Active_Interruption 0;
BA_ "GenSigTimeoutTime_PPIM" SG_ 546 GBT_Charger_Active_Interruption 0;
BA_ "GenSigTimeoutTime_HCP" SG_ 546 GBT_Charger_Active_Interruption 0;
BA_ "GenSigTimeoutTime_SGW" SG_ 546 MessageCounter_VO2 0;
BA_ "GenSigTimeoutTime_EVCU2" SG_ 546 MessageCounter_VO2 0;
BA_ "GenSigTimeoutTime_PPIM" SG_ 546 MessageCounter_VO2 0;
BA_ "GenSigTimeoutTime_HCP" SG_ 546 MessageCounter_VO2 0;
BA_ "GenSigTimeoutTime_SGW" SG_ 546 CRC_VO2 0;
BA_ "GenSigTimeoutTime_EVCU2" SG_ 546 CRC_VO2 0;
BA_ "GenSigTimeoutTime_PPIM" SG_ 546 CRC_VO2 0;
BA_ "GenSigTimeoutTime_HCP" SG_ 546 CRC_VO2 0;
BA_ "GenSigTimeoutTime_SGW" SG_ 544 Plug_Locked_by_EVSE 0;
BA_ "GenSigTimeoutTime_IDCM" SG_ 544 Plug_Locked_by_EVSE 0;
BA_ "GenSigTimeoutTime_BPCM" SG_ 544 Plug_Locked_by_EVSE 0;
BA_ "GenSigStartValue" SG_ 544 Plug_Locked_by_EVSE 2;
BA_ "GenSigTimeoutTime_PPIM" SG_ 544 Plug_Locked_by_EVSE 0;
BA_ "GenSigTimeoutTime_HCP" SG_ 544 Plug_Locked_by_EVSE 0;
BA_ "GenSigTimeoutTime_SGW" SG_ 544 HVCMS_EVSEID 0;
BA_ "GenSigTimeoutTime_IDCM" SG_ 544 HVCMS_EVSEID 0;
BA_ "GenSigTimeoutTime_BPCM" SG_ 544 HVCMS_EVSEID 0;
BA_ "GenSigTimeoutTime_PPIM" SG_ 544 HVCMS_EVSEID 0;
BA_ "GenSigTimeoutTime_HCP" SG_ 544 HVCMS_EVSEID 0;
BA_ "GenSigTimeoutTime_SGW" SG_ 544 ExtChargerSts 0;
BA_ "GenSigTimeoutTime_IDCM" SG_ 544 ExtChargerSts 0;
BA_ "GenSigTimeoutTime_BPCM" SG_ 544 ExtChargerSts 0;
BA_ "GenSigStartValue" SG_ 544 ExtChargerSts 2;
BA_ "GenSigTimeoutTime_PPIM" SG_ 544 ExtChargerSts 0;
BA_ "GenSigTimeoutTime_HCP" SG_ 544 ExtChargerSts 0;
BA_ "GenSigTimeoutTime_SGW" SG_ 544 EVSE_Error 0;
BA_ "GenSigTimeoutTime_IDCM" SG_ 544 EVSE_Error 0;
BA_ "GenSigTimeoutTime_BPCM" SG_ 544 EVSE_Error 0;
BA_ "GenSigStartValue" SG_ 544 EVSE_Error 2;
BA_ "GenSigTimeoutTime_PPIM" SG_ 544 EVSE_Error 0;
BA_ "GenSigTimeoutTime_HCP" SG_ 544 EVSE_Error 0;
BA_ "GenSigTimeoutTime_SGW" SG_ 544 EVSE_ChrgStopControl 0;
BA_ "GenSigTimeoutTime_IDCM" SG_ 544 EVSE_ChrgStopControl 0;
BA_ "GenSigTimeoutTime_BPCM" SG_ 544 EVSE_ChrgStopControl 0;
BA_ "GenSigStartValue" SG_ 544 EVSE_ChrgStopControl 2;
BA_ "GenSigTimeoutTime_PPIM" SG_ 544 EVSE_ChrgStopControl 0;
BA_ "GenSigTimeoutTime_HCP" SG_ 544 EVSE_ChrgStopControl 0;
BA_ "GenSigTimeoutTime_SGW" SG_ 544 Charger_WeldingDetectAvail 0;
BA_ "GenSigTimeoutTime_IDCM" SG_ 544 Charger_WeldingDetectAvail 0;
BA_ "GenSigTimeoutTime_BPCM" SG_ 544 Charger_WeldingDetectAvail 0;
BA_ "GenSigStartValue" SG_ 544 Charger_WeldingDetectAvail 2;
BA_ "GenSigTimeoutTime_PPIM" SG_ 544 Charger_WeldingDetectAvail 0;
BA_ "GenSigTimeoutTime_HCP" SG_ 544 Charger_WeldingDetectAvail 0;
BA_ "GenSigTimeoutTime_SGW" SG_ 544 Charger_StndbyReqReason 0;
BA_ "GenSigTimeoutTime_IDCM" SG_ 544 Charger_StndbyReqReason 0;
BA_ "GenSigTimeoutTime_BPCM" SG_ 544 Charger_StndbyReqReason 0;
BA_ "GenSigStartValue" SG_ 544 Charger_StndbyReqReason 6;
BA_ "GenSigTimeoutTime_PPIM" SG_ 544 Charger_StndbyReqReason 0;
BA_ "GenSigTimeoutTime_HCP" SG_ 544 Charger_StndbyReqReason 0;
BA_ "GenSigTimeoutTime_SGW" SG_ 544 Charger_StndbyReq 0;
BA_ "GenSigTimeoutTime_IDCM" SG_ 544 Charger_StndbyReq 0;
BA_ "GenSigTimeoutTime_BPCM" SG_ 544 Charger_StndbyReq 0;
BA_ "GenSigStartValue" SG_ 544 Charger_StndbyReq 2;
BA_ "GenSigTimeoutTime_PPIM" SG_ 544 Charger_StndbyReq 0;
BA_ "GenSigTimeoutTime_HCP" SG_ 544 Charger_StndbyReq 0;
BA_ "GenSigTimeoutTime_SGW" SG_ 544 Charger_FaultStates 0;
BA_ "GenSigTimeoutTime_IDCM" SG_ 544 Charger_FaultStates 0;
BA_ "GenSigTimeoutTime_BPCM" SG_ 544 Charger_FaultStates 0;
BA_ "GenSigStartValue" SG_ 544 Charger_FaultStates 14;
BA_ "GenSigTimeoutTime_PPIM" SG_ 544 Charger_FaultStates 0;
BA_ "GenSigTimeoutTime_HCP" SG_ 544 Charger_FaultStates 0;
BA_ "GenSigTimeoutTime_SGW" SG_ 544 CC2VoltDetError 0;
BA_ "GenSigTimeoutTime_IDCM" SG_ 544 CC2VoltDetError 0;
BA_ "GenSigTimeoutTime_BPCM" SG_ 544 CC2VoltDetError 0;
BA_ "GenSigStartValue" SG_ 544 CC2VoltDetError 2;
BA_ "GenSigTimeoutTime_PPIM" SG_ 544 CC2VoltDetError 0;
BA_ "GenSigTimeoutTime_HCP" SG_ 544 CC2VoltDetError 0;
BA_ "GenSigTimeoutTime_SGW" SG_ 544 OBCM_CSSts 0;
BA_ "GenSigTimeoutTime_IDCM" SG_ 544 OBCM_CSSts 0;
BA_ "GenSigTimeoutTime_BPCM" SG_ 544 OBCM_CSSts 0;
BA_ "GenSigTimeoutTime_PPIM" SG_ 544 OBCM_CSSts 0;
BA_ "GenSigTimeoutTime_HCP" SG_ 544 OBCM_CSSts 0;
BA_ "GenSigTimeoutTime_SGW" SG_ 544 OBCM_CP3Sts 0;
BA_ "GenSigTimeoutTime_IDCM" SG_ 544 OBCM_CP3Sts 0;
BA_ "GenSigTimeoutTime_BPCM" SG_ 544 OBCM_CP3Sts 0;
BA_ "GenSigTimeoutTime_PPIM" SG_ 544 OBCM_CP3Sts 0;
BA_ "GenSigTimeoutTime_HCP" SG_ 544 OBCM_CP3Sts 0;
BA_ "GenSigTimeoutTime_SGW" SG_ 544 OBCM_CP2Sts 0;
BA_ "GenSigTimeoutTime_IDCM" SG_ 544 OBCM_CP2Sts 0;
BA_ "GenSigTimeoutTime_BPCM" SG_ 544 OBCM_CP2Sts 0;
BA_ "GenSigTimeoutTime_PPIM" SG_ 544 OBCM_CP2Sts 0;
BA_ "GenSigTimeoutTime_HCP" SG_ 544 OBCM_CP2Sts 0;
BA_ "GenSigTimeoutTime_SGW" SG_ 544 OBCM_CCSts 0;
BA_ "GenSigTimeoutTime_IDCM" SG_ 544 OBCM_CCSts 0;
BA_ "GenSigTimeoutTime_BPCM" SG_ 544 OBCM_CCSts 0;
BA_ "GenSigTimeoutTime_PPIM" SG_ 544 OBCM_CCSts 0;
BA_ "GenSigTimeoutTime_HCP" SG_ 544 OBCM_CCSts 0;
BA_ "GenSigTimeoutTime_SGW" SG_ 544 OBCM_APAMSts 0;
BA_ "GenSigTimeoutTime_IDCM" SG_ 544 OBCM_APAMSts 0;
BA_ "GenSigTimeoutTime_BPCM" SG_ 544 OBCM_APAMSts 0;
BA_ "GenSigTimeoutTime_PPIM" SG_ 544 OBCM_APAMSts 0;
BA_ "GenSigTimeoutTime_HCP" SG_ 544 OBCM_APAMSts 0;
BA_ "GenSigTimeoutTime_SGW" SG_ 544 TCP_Communication_Terminated 0;
BA_ "GenSigTimeoutTime_IDCM" SG_ 544 TCP_Communication_Terminated 0;
BA_ "GenSigTimeoutTime_BPCM" SG_ 544 TCP_Communication_Terminated 0;
BA_ "GenSigTimeoutTime_PPIM" SG_ 544 TCP_Communication_Terminated 0;
BA_ "GenSigTimeoutTime_HCP" SG_ 544 TCP_Communication_Terminated 0;
BA_ "GenSigTimeoutTime_SGW" SG_ 544 OBCM_CP1Sts 0;
BA_ "GenSigTimeoutTime_IDCM" SG_ 544 OBCM_CP1Sts 0;
BA_ "GenSigTimeoutTime_BPCM" SG_ 544 OBCM_CP1Sts 0;
BA_ "GenSigTimeoutTime_PPIM" SG_ 544 OBCM_CP1Sts 0;
BA_ "GenSigTimeoutTime_HCP" SG_ 544 OBCM_CP1Sts 0;
BA_ "GenSigTimeoutTime_SGW" SG_ 544 TxGBTMessageResponse 0;
BA_ "GenSigTimeoutTime_IDCM" SG_ 544 TxGBTMessageResponse 0;
BA_ "GenSigTimeoutTime_BPCM" SG_ 544 TxGBTMessageResponse 0;
BA_ "GenSigTimeoutTime_PPIM" SG_ 544 TxGBTMessageResponse 0;
BA_ "GenSigTimeoutTime_HCP" SG_ 544 TxGBTMessageResponse 0;
BA_ "GenSigTimeoutTime_SGW" SG_ 544 TxGBTMessageRequest 0;
BA_ "GenSigTimeoutTime_IDCM" SG_ 544 TxGBTMessageRequest 0;
BA_ "GenSigTimeoutTime_BPCM" SG_ 544 TxGBTMessageRequest 0;
BA_ "GenSigTimeoutTime_PPIM" SG_ 544 TxGBTMessageRequest 0;
BA_ "GenSigTimeoutTime_HCP" SG_ 544 TxGBTMessageRequest 0;
BA_ "GenSigTimeoutTime_SGW" SG_ 544 OBCM_Timeout 0;
BA_ "GenSigTimeoutTime_IDCM" SG_ 544 OBCM_Timeout 0;
BA_ "GenSigTimeoutTime_BPCM" SG_ 544 OBCM_Timeout 0;
BA_ "GenSigTimeoutTime_PPIM" SG_ 544 OBCM_Timeout 0;
BA_ "GenSigTimeoutTime_HCP" SG_ 544 OBCM_Timeout 0;
BA_ "GenSigTimeoutTime_SGW" SG_ 544 EVCC_FailureSts 0;
BA_ "GenSigTimeoutTime_IDCM" SG_ 544 EVCC_FailureSts 0;
BA_ "GenSigTimeoutTime_BPCM" SG_ 544 EVCC_FailureSts 0;
BA_ "GenSigTimeoutTime_PPIM" SG_ 544 EVCC_FailureSts 0;
BA_ "GenSigTimeoutTime_HCP" SG_ 544 EVCC_FailureSts 0;
BA_ "GenSigTimeoutTime_SGW" SG_ 544 CC2_VoltageValue 0;
BA_ "GenSigTimeoutTime_IDCM" SG_ 544 CC2_VoltageValue 0;
BA_ "GenSigTimeoutTime_BPCM" SG_ 544 CC2_VoltageValue 0;
BA_ "GenSigTimeoutTime_PPIM" SG_ 544 CC2_VoltageValue 0;
BA_ "GenSigTimeoutTime_HCP" SG_ 544 CC2_VoltageValue 0;
BA_ "GenSigTimeoutTime_SGW" SG_ 544 GBT_EVSE_Charge_Permitting 0;
BA_ "GenSigTimeoutTime_IDCM" SG_ 544 GBT_EVSE_Charge_Permitting 0;
BA_ "GenSigTimeoutTime_BPCM" SG_ 544 GBT_EVSE_Charge_Permitting 0;
BA_ "GenSigTimeoutTime_PPIM" SG_ 544 GBT_EVSE_Charge_Permitting 0;
BA_ "GenSigTimeoutTime_HCP" SG_ 544 GBT_EVSE_Charge_Permitting 0;
BA_ "GenSigTimeoutTime_SGW" SG_ 544 MessageCounter_OV2 0;
BA_ "GenSigTimeoutTime_IDCM" SG_ 544 MessageCounter_OV2 0;
BA_ "GenSigTimeoutTime_BPCM" SG_ 544 MessageCounter_OV2 0;
BA_ "GenSigTimeoutTime_PPIM" SG_ 544 MessageCounter_OV2 0;
BA_ "GenSigTimeoutTime_HCP" SG_ 544 MessageCounter_OV2 0;
BA_ "GenSigTimeoutTime_SGW" SG_ 544 CRC_OV2 0;
BA_ "GenSigTimeoutTime_IDCM" SG_ 544 CRC_OV2 0;
BA_ "GenSigTimeoutTime_BPCM" SG_ 544 CRC_OV2 0;
BA_ "GenSigTimeoutTime_PPIM" SG_ 544 CRC_OV2 0;
BA_ "GenSigTimeoutTime_HCP" SG_ 544 CRC_OV2 0;
BA_ "GenSigTimeoutTime_SGW" SG_ 544 EVSE_NotificationMaxDelay 0;
BA_ "GenSigTimeoutTime_IDCM" SG_ 544 EVSE_NotificationMaxDelay 0;
BA_ "GenSigTimeoutTime_BPCM" SG_ 544 EVSE_NotificationMaxDelay 0;
BA_ "GenSigStartValue" SG_ 544 EVSE_NotificationMaxDelay 1;
BA_ "GenSigTimeoutTime_PPIM" SG_ 544 EVSE_NotificationMaxDelay 0;
BA_ "GenSigTimeoutTime_HCP" SG_ 544 EVSE_NotificationMaxDelay 0;
BA_ "GenSigTimeoutTime_SGW" SG_ 1790 BMS_HV_SOC_AccuracySts 0;
BA_ "GenSigTimeoutTime_IDCM" SG_ 1790 BMS_HV_SOC_AccuracySts 0;
BA_ "GenSigTimeoutTime_BPCM" SG_ 1790 BMS_HV_SOC_AccuracySts 0;
BA_ "GenSigSendType" SG_ 1790 BMS_HV_SOC_AccuracySts 3;
BA_ "GenSigTimeoutTime_PPIM" SG_ 1790 BMS_HV_SOC_AccuracySts 0;
BA_ "GenSigTimeoutTime_HCP" SG_ 1790 BMS_HV_SOC_AccuracySts 0;
BA_ "GenSigTimeoutTime_SGW" SG_ 1790 BMS_HV_Low_Temp_Thrsh 0;
BA_ "GenSigTimeoutTime_IDCM" SG_ 1790 BMS_HV_Low_Temp_Thrsh 0;
BA_ "GenSigTimeoutTime_BPCM" SG_ 1790 BMS_HV_Low_Temp_Thrsh 0;
BA_ "GenSigTimeoutTime_PPIM" SG_ 1790 BMS_HV_Low_Temp_Thrsh 0;
BA_ "GenSigTimeoutTime_HCP" SG_ 1790 BMS_HV_Low_Temp_Thrsh 0;
BA_ "GenSigTimeoutTime_SGW" SG_ 1790 BMS_HV_High_Temp_Thrsh 0;
BA_ "GenSigTimeoutTime_IDCM" SG_ 1790 BMS_HV_High_Temp_Thrsh 0;
BA_ "GenSigTimeoutTime_BPCM" SG_ 1790 BMS_HV_High_Temp_Thrsh 0;
BA_ "GenSigTimeoutTime_PPIM" SG_ 1790 BMS_HV_High_Temp_Thrsh 0;
BA_ "GenSigTimeoutTime_HCP" SG_ 1790 BMS_HV_High_Temp_Thrsh 0;
BA_ "GenSigTimeoutTime_SGW" SG_ 1790 HVBatCell_Voltage_Low_Thrsh 0;
BA_ "GenSigTimeoutTime_IDCM" SG_ 1790 HVBatCell_Voltage_Low_Thrsh 0;
BA_ "GenSigTimeoutTime_BPCM" SG_ 1790 HVBatCell_Voltage_Low_Thrsh 0;
BA_ "GenSigTimeoutTime_PPIM" SG_ 1790 HVBatCell_Voltage_Low_Thrsh 0;
BA_ "GenSigTimeoutTime_HCP" SG_ 1790 HVBatCell_Voltage_Low_Thrsh 0;
BA_ "GenSigTimeoutTime_SGW" SG_ 1790 HVBatCell_Voltage_High_Thrsh 0;
BA_ "GenSigTimeoutTime_IDCM" SG_ 1790 HVBatCell_Voltage_High_Thrsh 0;
BA_ "GenSigTimeoutTime_BPCM" SG_ 1790 HVBatCell_Voltage_High_Thrsh 0;
BA_ "GenSigTimeoutTime_PPIM" SG_ 1790 HVBatCell_Voltage_High_Thrsh 0;
BA_ "GenSigTimeoutTime_HCP" SG_ 1790 HVBatCell_Voltage_High_Thrsh 0;
BA_ "GenSigTimeoutTime_SGW" SG_ 1790 HEV_OnRq_BPCM 0;
BA_ "GenSigTimeoutTime_IDCM" SG_ 1790 HEV_OnRq_BPCM 0;
BA_ "GenSigTimeoutTime_BPCM" SG_ 1790 HEV_OnRq_BPCM 0;
BA_ "GenSigSendType" SG_ 1790 HEV_OnRq_BPCM 3;
BA_ "GenSigTimeoutTime_PPIM" SG_ 1790 HEV_OnRq_BPCM 0;
BA_ "GenSigTimeoutTime_HCP" SG_ 1790 HEV_OnRq_BPCM 0;
BA_ "GenSigTimeoutTime_SGW" SG_ 1790 BMS_HV_SOC_Min 0;
BA_ "GenSigTimeoutTime_IDCM" SG_ 1790 BMS_HV_SOC_Min 0;
BA_ "GenSigTimeoutTime_BPCM" SG_ 1790 BMS_HV_SOC_Min 0;
BA_ "GenSigSendType" SG_ 1790 BMS_HV_SOC_Min 3;
BA_ "GenSigStartValue" SG_ 1790 BMS_HV_SOC_Min 50;
BA_ "GenSigTimeoutTime_PPIM" SG_ 1790 BMS_HV_SOC_Min 0;
BA_ "GenSigTimeoutTime_HCP" SG_ 1790 BMS_HV_SOC_Min 0;
BA_ "GenSigTimeoutTime_SGW" SG_ 1790 BMS_HV_SOC_Max 0;
BA_ "GenSigTimeoutTime_IDCM" SG_ 1790 BMS_HV_SOC_Max 0;
BA_ "GenSigTimeoutTime_BPCM" SG_ 1790 BMS_HV_SOC_Max 0;
BA_ "GenSigSendType" SG_ 1790 BMS_HV_SOC_Max 3;
BA_ "GenSigStartValue" SG_ 1790 BMS_HV_SOC_Max 50;
BA_ "GenSigTimeoutTime_PPIM" SG_ 1790 BMS_HV_SOC_Max 0;
BA_ "GenSigTimeoutTime_HCP" SG_ 1790 BMS_HV_SOC_Max 0;
BA_ "GenSigTimeoutTime_SGW" SG_ 105 ClrLgsDiagInfo 0;
BA_ "GenSigTimeoutTime_EVCU2" SG_ 105 ClrLgsDiagInfo 0;
BA_ "GenSigTimeoutTime_BPCM" SG_ 105 ClrLgsDiagInfo 0;
BA_ "GenSigTimeoutTime_PPIM" SG_ 105 ClrLgsDiagInfo 0;
BA_ "GenSigTimeoutTime_HCP" SG_ 105 ClrLgsDiagInfo 0;
BA_ "GenSigTimeoutTime_SGW" SG_ 260 MCPB_DC_Current 0;
BA_ "GenSigTimeoutTime_IDCM" SG_ 260 MCPB_DC_Current 0;
BA_ "GenSigTimeoutTime_EVCU2" SG_ 260 MCPB_DC_Current 0;
BA_ "GenSigStartValue" SG_ 260 MCPB_DC_Current 16384;
BA_ "GenSigTimeoutTime_SGW" SG_ 260 MC_PRR1 0;
BA_ "GenSigTimeoutTime_IDCM" SG_ 260 MC_PRR1 0;
BA_ "GenSigTimeoutTime_EVCU2" SG_ 260 MC_PRR1 0;
BA_ "GenSigTimeoutTime_SGW" SG_ 260 CRC_PRR1 0;
BA_ "GenSigTimeoutTime_IDCM" SG_ 260 CRC_PRR1 0;
BA_ "GenSigTimeoutTime_EVCU2" SG_ 260 CRC_PRR1 0;
BA_ "GenSigTimeoutTime_SGW" SG_ 1062 MCPA_Temp 0;
BA_ "GenSigTimeoutTime_IDCM" SG_ 1062 MCPA_Temp 0;
BA_ "GenSigTimeoutTime_EVCU2" SG_ 1062 MCPA_Temp 0;
BA_ "GenSigTimeoutTime_BPCM" SG_ 1062 MCPA_Temp 0;
BA_ "GenSigStartValue" SG_ 1062 MCPA_Temp 40;
BA_ "GenSigTimeoutTime_PPIM" SG_ 1062 MCPA_Temp 0;
BA_ "GenSigTimeoutTime_HCP" SG_ 1062 MCPA_Temp 0;
BA_ "GenSigTimeoutTime_IDCM" SG_ 1893 HVBatModuleTemp_66 0;
BA_ "GenSigTimeoutTime_EVCU2" SG_ 1893 HVBatModuleTemp_66 0;
BA_ "GenSigTimeoutTime_BPCM" SG_ 1893 HVBatModuleTemp_66 0;
BA_ "GenSigTimeoutTime_IDCM" SG_ 1893 HVBatModuleTemp_65 0;
BA_ "GenSigTimeoutTime_EVCU2" SG_ 1893 HVBatModuleTemp_65 0;
BA_ "GenSigTimeoutTime_BPCM" SG_ 1893 HVBatModuleTemp_65 0;
BA_ "GenSigTimeoutTime_IDCM" SG_ 1893 HVBatModuleTemp_64 0;
BA_ "GenSigTimeoutTime_EVCU2" SG_ 1893 HVBatModuleTemp_64 0;
BA_ "GenSigTimeoutTime_BPCM" SG_ 1893 HVBatModuleTemp_64 0;
BA_ "GenSigTimeoutTime_IDCM" SG_ 1893 HVBatModuleTemp_63 0;
BA_ "GenSigTimeoutTime_EVCU2" SG_ 1893 HVBatModuleTemp_63 0;
BA_ "GenSigTimeoutTime_BPCM" SG_ 1893 HVBatModuleTemp_63 0;
BA_ "GenSigTimeoutTime_IDCM" SG_ 1893 HVBatModuleTemp_62 0;
BA_ "GenSigTimeoutTime_EVCU2" SG_ 1893 HVBatModuleTemp_62 0;
BA_ "GenSigTimeoutTime_BPCM" SG_ 1893 HVBatModuleTemp_62 0;
BA_ "GenSigTimeoutTime_IDCM" SG_ 1893 HVBatModuleTemp_61 0;
BA_ "GenSigTimeoutTime_EVCU2" SG_ 1893 HVBatModuleTemp_61 0;
BA_ "GenSigTimeoutTime_BPCM" SG_ 1893 HVBatModuleTemp_61 0;
BA_ "GenSigTimeoutTime_IDCM" SG_ 1893 HVBatModuleTemp_60 0;
BA_ "GenSigTimeoutTime_EVCU2" SG_ 1893 HVBatModuleTemp_60 0;
BA_ "GenSigTimeoutTime_BPCM" SG_ 1893 HVBatModuleTemp_60 0;
BA_ "GenSigTimeoutTime_IDCM" SG_ 1893 HVBatModuleTemp_59 0;
BA_ "GenSigTimeoutTime_EVCU2" SG_ 1893 HVBatModuleTemp_59 0;
BA_ "GenSigTimeoutTime_BPCM" SG_ 1893 HVBatModuleTemp_59 0;
BA_ "GenSigTimeoutTime_IDCM" SG_ 1893 HVBatModuleTemp_58 0;
BA_ "GenSigTimeoutTime_EVCU2" SG_ 1893 HVBatModuleTemp_58 0;
BA_ "GenSigTimeoutTime_BPCM" SG_ 1893 HVBatModuleTemp_58 0;
BA_ "GenSigTimeoutTime_IDCM" SG_ 1893 HVBatModuleTemp_57 0;
BA_ "GenSigTimeoutTime_EVCU2" SG_ 1893 HVBatModuleTemp_57 0;
BA_ "GenSigTimeoutTime_BPCM" SG_ 1893 HVBatModuleTemp_57 0;
BA_ "GenSigTimeoutTime_IDCM" SG_ 1893 HVBatModuleTemp_56 0;
BA_ "GenSigTimeoutTime_EVCU2" SG_ 1893 HVBatModuleTemp_56 0;
BA_ "GenSigTimeoutTime_BPCM" SG_ 1893 HVBatModuleTemp_56 0;
BA_ "GenSigTimeoutTime_IDCM" SG_ 1893 HVBatModuleTemp_55 0;
BA_ "GenSigTimeoutTime_EVCU2" SG_ 1893 HVBatModuleTemp_55 0;
BA_ "GenSigTimeoutTime_BPCM" SG_ 1893 HVBatModuleTemp_55 0;
BA_ "GenSigTimeoutTime_IDCM" SG_ 1893 HVBatModuleTemp_54 0;
BA_ "GenSigTimeoutTime_EVCU2" SG_ 1893 HVBatModuleTemp_54 0;
BA_ "GenSigTimeoutTime_BPCM" SG_ 1893 HVBatModuleTemp_54 0;
BA_ "GenSigTimeoutTime_IDCM" SG_ 1893 HVBatModuleTemp_41 0;
BA_ "GenSigTimeoutTime_EVCU2" SG_ 1893 HVBatModuleTemp_41 0;
BA_ "GenSigTimeoutTime_BPCM" SG_ 1893 HVBatModuleTemp_41 0;
BA_ "GenSigTimeoutTime_IDCM" SG_ 1893 HVBatModuleTemp_40 0;
BA_ "GenSigTimeoutTime_EVCU2" SG_ 1893 HVBatModuleTemp_40 0;
BA_ "GenSigTimeoutTime_BPCM" SG_ 1893 HVBatModuleTemp_40 0;
BA_ "GenSigTimeoutTime_IDCM" SG_ 1893 HVBatModuleTemp_39 0;
BA_ "GenSigTimeoutTime_EVCU2" SG_ 1893 HVBatModuleTemp_39 0;
BA_ "GenSigTimeoutTime_BPCM" SG_ 1893 HVBatModuleTemp_39 0;
BA_ "GenSigTimeoutTime_SGW" SG_ 1893 HVBatModuleVoltage_NumMin 0;
BA_ "GenSigTimeoutTime_IDCM" SG_ 1893 HVBatModuleVoltage_NumMin 0;
BA_ "GenSigTimeoutTime_EVCU2" SG_ 1893 HVBatModuleVoltage_NumMin 0;
BA_ "GenSigTimeoutTime_BPCM" SG_ 1893 HVBatModuleVoltage_NumMin 0;
BA_ "GenSigTimeoutTime_SGW" SG_ 1893 HVBatModuleVoltage_NumMax 0;
BA_ "GenSigTimeoutTime_IDCM" SG_ 1893 HVBatModuleVoltage_NumMax 0;
BA_ "GenSigTimeoutTime_EVCU2" SG_ 1893 HVBatModuleVoltage_NumMax 0;
BA_ "GenSigTimeoutTime_BPCM" SG_ 1893 HVBatModuleVoltage_NumMax 0;
BA_ "GenSigTimeoutTime_IDCM" SG_ 1893 HVBatModuleTemp_53 0;
BA_ "GenSigTimeoutTime_EVCU2" SG_ 1893 HVBatModuleTemp_53 0;
BA_ "GenSigTimeoutTime_BPCM" SG_ 1893 HVBatModuleTemp_53 0;
BA_ "GenSigTimeoutTime_IDCM" SG_ 1893 HVBatModuleTemp_52 0;
BA_ "GenSigTimeoutTime_EVCU2" SG_ 1893 HVBatModuleTemp_52 0;
BA_ "GenSigTimeoutTime_BPCM" SG_ 1893 HVBatModuleTemp_52 0;
BA_ "GenSigTimeoutTime_IDCM" SG_ 1893 HVBatModuleTemp_51 0;
BA_ "GenSigTimeoutTime_EVCU2" SG_ 1893 HVBatModuleTemp_51 0;
BA_ "GenSigTimeoutTime_BPCM" SG_ 1893 HVBatModuleTemp_51 0;
BA_ "GenSigTimeoutTime_IDCM" SG_ 1893 HVBatModuleTemp_50 0;
BA_ "GenSigTimeoutTime_EVCU2" SG_ 1893 HVBatModuleTemp_50 0;
BA_ "GenSigTimeoutTime_BPCM" SG_ 1893 HVBatModuleTemp_50 0;
BA_ "GenSigTimeoutTime_IDCM" SG_ 1893 HVBatModuleTemp_49 0;
BA_ "GenSigTimeoutTime_EVCU2" SG_ 1893 HVBatModuleTemp_49 0;
BA_ "GenSigTimeoutTime_BPCM" SG_ 1893 HVBatModuleTemp_49 0;
BA_ "GenSigTimeoutTime_IDCM" SG_ 1893 HVBatModuleTemp_48 0;
BA_ "GenSigTimeoutTime_EVCU2" SG_ 1893 HVBatModuleTemp_48 0;
BA_ "GenSigTimeoutTime_BPCM" SG_ 1893 HVBatModuleTemp_48 0;
BA_ "GenSigTimeoutTime_IDCM" SG_ 1893 HVBatModuleTemp_47 0;
BA_ "GenSigTimeoutTime_EVCU2" SG_ 1893 HVBatModuleTemp_47 0;
BA_ "GenSigTimeoutTime_BPCM" SG_ 1893 HVBatModuleTemp_47 0;
BA_ "GenSigTimeoutTime_IDCM" SG_ 1893 HVBatModuleTemp_46 0;
BA_ "GenSigTimeoutTime_EVCU2" SG_ 1893 HVBatModuleTemp_46 0;
BA_ "GenSigTimeoutTime_BPCM" SG_ 1893 HVBatModuleTemp_46 0;
BA_ "GenSigTimeoutTime_IDCM" SG_ 1893 HVBatModuleTemp_45 0;
BA_ "GenSigTimeoutTime_EVCU2" SG_ 1893 HVBatModuleTemp_45 0;
BA_ "GenSigTimeoutTime_BPCM" SG_ 1893 HVBatModuleTemp_45 0;
BA_ "GenSigTimeoutTime_IDCM" SG_ 1893 HVBatModuleTemp_44 0;
BA_ "GenSigTimeoutTime_EVCU2" SG_ 1893 HVBatModuleTemp_44 0;
BA_ "GenSigTimeoutTime_BPCM" SG_ 1893 HVBatModuleTemp_44 0;
BA_ "GenSigTimeoutTime_IDCM" SG_ 1893 HVBatModuleTemp_43 0;
BA_ "GenSigTimeoutTime_EVCU2" SG_ 1893 HVBatModuleTemp_43 0;
BA_ "GenSigTimeoutTime_BPCM" SG_ 1893 HVBatModuleTemp_43 0;
BA_ "GenSigTimeoutTime_IDCM" SG_ 1893 HVBatModuleTemp_42 0;
BA_ "GenSigTimeoutTime_EVCU2" SG_ 1893 HVBatModuleTemp_42 0;
BA_ "GenSigTimeoutTime_BPCM" SG_ 1893 HVBatModuleTemp_42 0;
BA_ "GenSigTimeoutTime_SGW" SG_ 1031 InputCurrentAvailable 0;
BA_ "GenSigTimeoutTime_PPIM" SG_ 1031 InputCurrentAvailable 0;
BA_ "GenSigTimeoutTime_HCP" SG_ 1031 InputCurrentAvailable 0;
BA_ "GenSigTimeoutTime_IDCM" SG_ 1031 InputCurrentAvailable 0;
BA_ "GenSigTimeoutTime_BPCM" SG_ 1031 InputCurrentAvailable 0;
BA_ "GenSigTimeoutTime_PPIM" SG_ 1031 AC_Side_Volt3 0;
BA_ "GenSigTimeoutTime_HCP" SG_ 1031 AC_Side_Volt3 0;
BA_ "GenSigTimeoutTime_SGW" SG_ 1031 AC_Side_Volt3 0;
BA_ "GenSigTimeoutTime_IDCM" SG_ 1031 AC_Side_Volt3 0;
BA_ "GenSigTimeoutTime_BPCM" SG_ 1031 AC_Side_Volt3 0;
BA_ "GenSigTimeoutTime_PPIM" SG_ 1031 AC_Side_Volt2 0;
BA_ "GenSigTimeoutTime_HCP" SG_ 1031 AC_Side_Volt2 0;
BA_ "GenSigTimeoutTime_SGW" SG_ 1031 AC_Side_Volt2 0;
BA_ "GenSigTimeoutTime_IDCM" SG_ 1031 AC_Side_Volt2 0;
BA_ "GenSigTimeoutTime_BPCM" SG_ 1031 AC_Side_Volt2 0;
BA_ "GenSigTimeoutTime_PPIM" SG_ 1031 AC_Side_Volt1 0;
BA_ "GenSigTimeoutTime_HCP" SG_ 1031 AC_Side_Volt1 0;
BA_ "GenSigTimeoutTime_SGW" SG_ 1031 AC_Side_Volt1 0;
BA_ "GenSigTimeoutTime_IDCM" SG_ 1031 AC_Side_Volt1 0;
BA_ "GenSigTimeoutTime_BPCM" SG_ 1031 AC_Side_Volt1 0;
BA_ "GenSigTimeoutTime_PPIM" SG_ 1031 AC_Side_Curr3 0;
BA_ "GenSigTimeoutTime_HCP" SG_ 1031 AC_Side_Curr3 0;
BA_ "GenSigTimeoutTime_SGW" SG_ 1031 AC_Side_Curr3 0;
BA_ "GenSigTimeoutTime_IDCM" SG_ 1031 AC_Side_Curr3 0;
BA_ "GenSigTimeoutTime_BPCM" SG_ 1031 AC_Side_Curr3 0;
BA_ "GenSigStartValue" SG_ 1031 AC_Side_Curr3 1000;
BA_ "GenSigTimeoutTime_PPIM" SG_ 1031 AC_Side_Curr2 0;
BA_ "GenSigTimeoutTime_HCP" SG_ 1031 AC_Side_Curr2 0;
BA_ "GenSigTimeoutTime_SGW" SG_ 1031 AC_Side_Curr2 0;
BA_ "GenSigTimeoutTime_IDCM" SG_ 1031 AC_Side_Curr2 0;
BA_ "GenSigTimeoutTime_BPCM" SG_ 1031 AC_Side_Curr2 0;
BA_ "GenSigStartValue" SG_ 1031 AC_Side_Curr2 1000;
BA_ "GenSigTimeoutTime_SGW" SG_ 1031 AC_Side_Curr1 0;
BA_ "GenSigTimeoutTime_IDCM" SG_ 1031 AC_Side_Curr1 0;
BA_ "GenSigTimeoutTime_BPCM" SG_ 1031 AC_Side_Curr1 0;
BA_ "GenSigStartValue" SG_ 1031 AC_Side_Curr1 1000;
BA_ "GenSigTimeoutTime_PPIM" SG_ 1031 AC_Side_Curr1 0;
BA_ "GenSigTimeoutTime_HCP" SG_ 1031 AC_Side_Curr1 0;
BA_ "GenSigTimeoutTime_SGW" SG_ 1031 ProximitySts 0;
BA_ "GenSigTimeoutTime_IDCM" SG_ 1031 ProximitySts 0;
BA_ "GenSigTimeoutTime_BPCM" SG_ 1031 ProximitySts 0;
BA_ "GenSigStartValue" SG_ 1031 ProximitySts 1;
BA_ "GenSigTimeoutTime_PPIM" SG_ 1031 ProximitySts 0;
BA_ "GenSigTimeoutTime_HCP" SG_ 1031 ProximitySts 0;
BA_ "GenSigTimeoutTime_SGW" SG_ 1031 OBCM_SlacSts 0;
BA_ "GenSigTimeoutTime_IDCM" SG_ 1031 OBCM_SlacSts 0;
BA_ "GenSigTimeoutTime_BPCM" SG_ 1031 OBCM_SlacSts 0;
BA_ "GenSigTimeoutTime_PPIM" SG_ 1031 OBCM_SlacSts 0;
BA_ "GenSigTimeoutTime_HCP" SG_ 1031 OBCM_SlacSts 0;
BA_ "GenSigTimeoutTime_SGW" SG_ 1031 OBCM_SdpSts 0;
BA_ "GenSigTimeoutTime_IDCM" SG_ 1031 OBCM_SdpSts 0;
BA_ "GenSigTimeoutTime_BPCM" SG_ 1031 OBCM_SdpSts 0;
BA_ "GenSigTimeoutTime_PPIM" SG_ 1031 OBCM_SdpSts 0;
BA_ "GenSigTimeoutTime_HCP" SG_ 1031 OBCM_SdpSts 0;
BA_ "GenSigTimeoutTime_SGW" SG_ 1031 OBCInterlockSts 0;
BA_ "GenSigTimeoutTime_IDCM" SG_ 1031 OBCInterlockSts 0;
BA_ "GenSigTimeoutTime_BPCM" SG_ 1031 OBCInterlockSts 0;
BA_ "GenSigTimeoutTime_PPIM" SG_ 1031 OBCInterlockSts 0;
BA_ "GenSigTimeoutTime_HCP" SG_ 1031 OBCInterlockSts 0;
BA_ "GenSigTimeoutTime_SGW" SG_ 1031 OBC_DeratingReason 0;
BA_ "GenSigTimeoutTime_IDCM" SG_ 1031 OBC_DeratingReason 0;
BA_ "GenSigTimeoutTime_BPCM" SG_ 1031 OBC_DeratingReason 0;
BA_ "GenSigTimeoutTime_PPIM" SG_ 1031 OBC_DeratingReason 0;
BA_ "GenSigTimeoutTime_HCP" SG_ 1031 OBC_DeratingReason 0;
BA_ "GenSigTimeoutTime_SGW" SG_ 1031 J1772_State 0;
BA_ "GenSigTimeoutTime_IDCM" SG_ 1031 J1772_State 0;
BA_ "GenSigTimeoutTime_BPCM" SG_ 1031 J1772_State 0;
BA_ "GenSigTimeoutTime_PPIM" SG_ 1031 J1772_State 0;
BA_ "GenSigTimeoutTime_HCP" SG_ 1031 J1772_State 0;
BA_ "GenSigTimeoutTime_SGW" SG_ 1031 J1772_S2_Sts 0;
BA_ "GenSigTimeoutTime_IDCM" SG_ 1031 J1772_S2_Sts 0;
BA_ "GenSigTimeoutTime_BPCM" SG_ 1031 J1772_S2_Sts 0;
BA_ "GenSigTimeoutTime_PPIM" SG_ 1031 J1772_S2_Sts 0;
BA_ "GenSigTimeoutTime_HCP" SG_ 1031 J1772_S2_Sts 0;
BA_ "GenSigTimeoutTime_SGW" SG_ 1031 InputVoltage_isAC 0;
BA_ "GenSigTimeoutTime_IDCM" SG_ 1031 InputVoltage_isAC 0;
BA_ "GenSigTimeoutTime_BPCM" SG_ 1031 InputVoltage_isAC 0;
BA_ "GenSigStartValue" SG_ 1031 InputVoltage_isAC 1;
BA_ "GenSigTimeoutTime_PPIM" SG_ 1031 InputVoltage_isAC 0;
BA_ "GenSigTimeoutTime_HCP" SG_ 1031 InputVoltage_isAC 0;
BA_ "GenSigTimeoutTime_SGW" SG_ 1031 InputVoltage_is60Hz 0;
BA_ "GenSigTimeoutTime_IDCM" SG_ 1031 InputVoltage_is60Hz 0;
BA_ "GenSigTimeoutTime_BPCM" SG_ 1031 InputVoltage_is60Hz 0;
BA_ "GenSigStartValue" SG_ 1031 InputVoltage_is60Hz 1;
BA_ "GenSigTimeoutTime_PPIM" SG_ 1031 InputVoltage_is60Hz 0;
BA_ "GenSigTimeoutTime_HCP" SG_ 1031 InputVoltage_is60Hz 0;
BA_ "GenSigTimeoutTime_SGW" SG_ 1031 HV_Overvoltage 0;
BA_ "GenSigTimeoutTime_IDCM" SG_ 1031 HV_Overvoltage 0;
BA_ "GenSigTimeoutTime_BPCM" SG_ 1031 HV_Overvoltage 0;
BA_ "GenSigTimeoutTime_PPIM" SG_ 1031 HV_Overvoltage 0;
BA_ "GenSigTimeoutTime_HCP" SG_ 1031 HV_Overvoltage 0;
BA_ "GenSigTimeoutTime_SGW" SG_ 1031 HV_Overcurrent 0;
BA_ "GenSigTimeoutTime_IDCM" SG_ 1031 HV_Overcurrent 0;
BA_ "GenSigTimeoutTime_BPCM" SG_ 1031 HV_Overcurrent 0;
BA_ "GenSigTimeoutTime_PPIM" SG_ 1031 HV_Overcurrent 0;
BA_ "GenSigTimeoutTime_HCP" SG_ 1031 HV_Overcurrent 0;
BA_ "GenSigTimeoutTime_SGW" SG_ 1031 ControlPilotSts 0;
BA_ "GenSigTimeoutTime_IDCM" SG_ 1031 ControlPilotSts 0;
BA_ "GenSigTimeoutTime_BPCM" SG_ 1031 ControlPilotSts 0;
BA_ "GenSigTimeoutTime_PPIM" SG_ 1031 ControlPilotSts 0;
BA_ "GenSigTimeoutTime_HCP" SG_ 1031 ControlPilotSts 0;
BA_ "GenSigTimeoutTime_SGW" SG_ 1031 ChargeEnableSts 0;
BA_ "GenSigTimeoutTime_IDCM" SG_ 1031 ChargeEnableSts 0;
BA_ "GenSigTimeoutTime_BPCM" SG_ 1031 ChargeEnableSts 0;
BA_ "GenSigTimeoutTime_PPIM" SG_ 1031 ChargeEnableSts 0;
BA_ "GenSigTimeoutTime_HCP" SG_ 1031 ChargeEnableSts 0;
BA_ "GenSigTimeoutTime_SGW" SG_ 1031 ChargeCurrentAvailable 0;
BA_ "GenSigTimeoutTime_IDCM" SG_ 1031 ChargeCurrentAvailable 0;
BA_ "GenSigTimeoutTime_BPCM" SG_ 1031 ChargeCurrentAvailable 0;
BA_ "GenSigTimeoutTime_PPIM" SG_ 1031 ChargeCurrentAvailable 0;
BA_ "GenSigTimeoutTime_HCP" SG_ 1031 ChargeCurrentAvailable 0;
BA_ "GenSigTimeoutTime_SGW" SG_ 1031 ChargeCurrent 0;
BA_ "GenSigTimeoutTime_IDCM" SG_ 1031 ChargeCurrent 0;
BA_ "GenSigTimeoutTime_BPCM" SG_ 1031 ChargeCurrent 0;
BA_ "GenSigTimeoutTime_PPIM" SG_ 1031 ChargeCurrent 0;
BA_ "GenSigTimeoutTime_HCP" SG_ 1031 ChargeCurrent 0;
BA_ "GenSigTimeoutTime_SGW" SG_ 1031 BatterySideCurrent 0;
BA_ "GenSigTimeoutTime_IDCM" SG_ 1031 BatterySideCurrent 0;
BA_ "GenSigTimeoutTime_BPCM" SG_ 1031 BatterySideCurrent 0;
BA_ "GenSigTimeoutTime_PPIM" SG_ 1031 BatterySideCurrent 0;
BA_ "GenSigTimeoutTime_HCP" SG_ 1031 BatterySideCurrent 0;
BA_ "GenSigTimeoutTime_SGW" SG_ 1031 AC_Present 0;
BA_ "GenSigTimeoutTime_IDCM" SG_ 1031 AC_Present 0;
BA_ "GenSigTimeoutTime_BPCM" SG_ 1031 AC_Present 0;
BA_ "GenSigTimeoutTime_PPIM" SG_ 1031 AC_Present 0;
BA_ "GenSigTimeoutTime_HCP" SG_ 1031 AC_Present 0;
BA_ "GenSigTimeoutTime_SGW" SG_ 1031 AC_HighLoadWarning 0;
BA_ "GenSigTimeoutTime_IDCM" SG_ 1031 AC_HighLoadWarning 0;
BA_ "GenSigTimeoutTime_BPCM" SG_ 1031 AC_HighLoadWarning 0;
BA_ "GenSigTimeoutTime_PPIM" SG_ 1031 AC_HighLoadWarning 0;
BA_ "GenSigTimeoutTime_HCP" SG_ 1031 AC_HighLoadWarning 0;
BA_ "GenSigTimeoutTime_SGW" SG_ 1031 Supported_VerNumberMinor 0;
BA_ "GenSigTimeoutTime_IDCM" SG_ 1031 Supported_VerNumberMinor 0;
BA_ "GenSigTimeoutTime_BPCM" SG_ 1031 Supported_VerNumberMinor 0;
BA_ "GenSigTimeoutTime_PPIM" SG_ 1031 Supported_VerNumberMinor 0;
BA_ "GenSigTimeoutTime_HCP" SG_ 1031 Supported_VerNumberMinor 0;
BA_ "GenSigTimeoutTime_SGW" SG_ 1031 Supported_VerNumberMajor 0;
BA_ "GenSigTimeoutTime_IDCM" SG_ 1031 Supported_VerNumberMajor 0;
BA_ "GenSigTimeoutTime_BPCM" SG_ 1031 Supported_VerNumberMajor 0;
BA_ "GenSigTimeoutTime_PPIM" SG_ 1031 Supported_VerNumberMajor 0;
BA_ "GenSigTimeoutTime_HCP" SG_ 1031 Supported_VerNumberMajor 0;
BA_ "GenSigTimeoutTime_SGW" SG_ 1031 Supported_SchemaID 0;
BA_ "GenSigTimeoutTime_IDCM" SG_ 1031 Supported_SchemaID 0;
BA_ "GenSigTimeoutTime_BPCM" SG_ 1031 Supported_SchemaID 0;
BA_ "GenSigTimeoutTime_PPIM" SG_ 1031 Supported_SchemaID 0;
BA_ "GenSigTimeoutTime_HCP" SG_ 1031 Supported_SchemaID 0;
BA_ "GenSigTimeoutTime_SGW" SG_ 1031 Supported_ProtocolName 0;
BA_ "GenSigTimeoutTime_IDCM" SG_ 1031 Supported_ProtocolName 0;
BA_ "GenSigTimeoutTime_BPCM" SG_ 1031 Supported_ProtocolName 0;
BA_ "GenSigTimeoutTime_PPIM" SG_ 1031 Supported_ProtocolName 0;
BA_ "GenSigTimeoutTime_HCP" SG_ 1031 Supported_ProtocolName 0;
BA_ "GenSigTimeoutTime_SGW" SG_ 1031 MessageCounter_HV_CHARGER1 0;
BA_ "GenSigTimeoutTime_IDCM" SG_ 1031 MessageCounter_HV_CHARGER1 0;
BA_ "GenSigTimeoutTime_BPCM" SG_ 1031 MessageCounter_HV_CHARGER1 0;
BA_ "GenSigTimeoutTime_PPIM" SG_ 1031 MessageCounter_HV_CHARGER1 0;
BA_ "GenSigTimeoutTime_HCP" SG_ 1031 MessageCounter_HV_CHARGER1 0;
BA_ "GenSigTimeoutTime_SGW" SG_ 1031 EVCC_FailureReason 0;
BA_ "GenSigTimeoutTime_IDCM" SG_ 1031 EVCC_FailureReason 0;
BA_ "GenSigTimeoutTime_BPCM" SG_ 1031 EVCC_FailureReason 0;
BA_ "GenSigTimeoutTime_PPIM" SG_ 1031 EVCC_FailureReason 0;
BA_ "GenSigTimeoutTime_HCP" SG_ 1031 EVCC_FailureReason 0;
BA_ "GenSigTimeoutTime_SGW" SG_ 1031 CRC_HV_CHARGER1 0;
BA_ "GenSigTimeoutTime_IDCM" SG_ 1031 CRC_HV_CHARGER1 0;
BA_ "GenSigTimeoutTime_BPCM" SG_ 1031 CRC_HV_CHARGER1 0;
BA_ "GenSigTimeoutTime_PPIM" SG_ 1031 CRC_HV_CHARGER1 0;
BA_ "GenSigTimeoutTime_HCP" SG_ 1031 CRC_HV_CHARGER1 0;
BA_ "GenSigTimeoutTime_SGW" SG_ 1031 BatterySideVoltage 0;
BA_ "GenSigTimeoutTime_IDCM" SG_ 1031 BatterySideVoltage 0;
BA_ "GenSigTimeoutTime_BPCM" SG_ 1031 BatterySideVoltage 0;
BA_ "GenSigTimeoutTime_PPIM" SG_ 1031 BatterySideVoltage 0;
BA_ "GenSigTimeoutTime_HCP" SG_ 1031 BatterySideVoltage 0;
BA_ "GenSigTimeoutTime_SGW" SG_ 1031 AC_LnLow 0;
BA_ "GenSigTimeoutTime_IDCM" SG_ 1031 AC_LnLow 0;
BA_ "GenSigTimeoutTime_BPCM" SG_ 1031 AC_LnLow 0;
BA_ "GenSigTimeoutTime_PPIM" SG_ 1031 AC_LnLow 0;
BA_ "GenSigTimeoutTime_HCP" SG_ 1031 AC_LnLow 0;
BA_ "GenSigTimeoutTime_SGW" SG_ 1031 AC_LnHi 0;
BA_ "GenSigTimeoutTime_IDCM" SG_ 1031 AC_LnHi 0;
BA_ "GenSigTimeoutTime_BPCM" SG_ 1031 AC_LnHi 0;
BA_ "GenSigTimeoutTime_PPIM" SG_ 1031 AC_LnHi 0;
BA_ "GenSigTimeoutTime_HCP" SG_ 1031 AC_LnHi 0;
BA_ "GenSigTimeoutTime_IDCM" SG_ 1031 Plug_And_Charge_Contract_Sts 0;
BA_ "GenSigTimeoutTime_EVCU2" SG_ 1031 Plug_And_Charge_Contract_Sts 0;
BA_ "GenSigTimeoutTime_BPCM" SG_ 1031 Plug_And_Charge_Contract_Sts 0;
BA_ "GenSigTimeoutTime_SGW" SG_ 1031 Plug_And_Charge_Contract_Sts 0;
BA_ "GenSigTimeoutTime_PPIM" SG_ 1031 Plug_And_Charge_Contract_Sts 0;
BA_ "GenSigTimeoutTime_HCP" SG_ 1031 Plug_And_Charge_Contract_Sts 0;
BA_ "GenSigTimeoutTime_SGW" SG_ 1031 RCD 0;
BA_ "GenSigTimeoutTime_IDCM" SG_ 1031 RCD 0;
BA_ "GenSigTimeoutTime_BPCM" SG_ 1031 RCD 0;
BA_ "GenSigTimeoutTime_PPIM" SG_ 1031 RCD 0;
BA_ "GenSigTimeoutTime_HCP" SG_ 1031 RCD 0;
BA_ "GenSigTimeoutTime_PPIM" SG_ 1031 EVSENominalVoltage 0;
BA_ "GenSigTimeoutTime_HCP" SG_ 1031 EVSENominalVoltage 0;
BA_ "GenSigTimeoutTime_SGW" SG_ 1031 EVSENominalVoltage 0;
BA_ "GenSigTimeoutTime_IDCM" SG_ 1031 EVSENominalVoltage 0;
BA_ "GenSigTimeoutTime_BPCM" SG_ 1031 EVSENominalVoltage 0;
BA_ "GenSigTimeoutTime_SGW" SG_ 1031 EVSEMaxCurrent 0;
BA_ "GenSigTimeoutTime_IDCM" SG_ 1031 EVSEMaxCurrent 0;
BA_ "GenSigTimeoutTime_BPCM" SG_ 1031 EVSEMaxCurrent 0;
BA_ "GenSigTimeoutTime_PPIM" SG_ 1031 EVSEMaxCurrent 0;
BA_ "GenSigTimeoutTime_HCP" SG_ 1031 EVSEMaxCurrent 0;
BA_ "GenSigTimeoutTime_SGW" SG_ 2564486468 N_PDU_18DAF544 0;
BA_ "GenSigTimeoutTime_IDCM" SG_ 2564486468 N_PDU_18DAF544 0;
BA_ "GenSigTimeoutTime_EVCU2" SG_ 2564486468 N_PDU_18DAF544 0;
BA_ "GenSigTimeoutTime_BPCM" SG_ 2564486468 N_PDU_18DAF544 0;
BA_ "GenSigTimeoutTime_PPIM" SG_ 2564486468 N_PDU_18DAF544 0;
BA_ "GenSigTimeoutTime_HCP" SG_ 2564486468 N_PDU_18DAF544 0;
BA_ "GenSigTimeoutTime_SGW" SG_ 2654814269 ECU_APPL_FD_BPCM 0;
BA_ "GenSigTimeoutTime_IDCM" SG_ 2654814269 ECU_APPL_FD_BPCM 0;
BA_ "GenSigTimeoutTime_EVCU2" SG_ 2654814269 ECU_APPL_FD_BPCM 0;
BA_ "GenSigTimeoutTime_BPCM" SG_ 2654814269 ECU_APPL_FD_BPCM 0;
BA_ "GenSigTimeoutTime_PPIM" SG_ 2654814269 ECU_APPL_FD_BPCM 0;
BA_ "GenSigTimeoutTime_IDCM" SG_ 1063 MCPB_Temp 0;
BA_ "GenSigTimeoutTime_EVCU2" SG_ 1063 MCPB_Temp 0;
BA_ "GenSigTimeoutTime_BPCM" SG_ 1063 MCPB_Temp 0;
BA_ "GenSigStartValue" SG_ 1063 MCPB_Temp 40;
BA_ "GenSigTimeoutTime_PPIM" SG_ 1063 MCPB_Temp 0;
BA_ "GenSigTimeoutTime_HCP" SG_ 1063 MCPB_Temp 0;
BA_ "GenSigTimeoutTime_SGW" SG_ 2564486421 N_PDU_18DAF515 0;
BA_ "GenSigTimeoutTime_IDCM" SG_ 2564486421 N_PDU_18DAF515 0;
BA_ "GenSigTimeoutTime_EVCU2" SG_ 2564486421 N_PDU_18DAF515 0;
BA_ "GenSigTimeoutTime_BPCM" SG_ 2564486421 N_PDU_18DAF515 0;
BA_ "GenSigTimeoutTime_PPIM" SG_ 2564486421 N_PDU_18DAF515 0;
BA_ "GenSigTimeoutTime_HCP" SG_ 2564486421 N_PDU_18DAF515 0;
BA_ "GenSigTimeoutTime_SGW" SG_ 2564486420 N_PDU_18DAF514 0;
BA_ "GenSigTimeoutTime_IDCM" SG_ 2564486420 N_PDU_18DAF514 0;
BA_ "GenSigTimeoutTime_EVCU2" SG_ 2564486420 N_PDU_18DAF514 0;
BA_ "GenSigTimeoutTime_BPCM" SG_ 2564486420 N_PDU_18DAF514 0;
BA_ "GenSigTimeoutTime_PPIM" SG_ 2564486420 N_PDU_18DAF514 0;
BA_ "GenSigTimeoutTime_HCP" SG_ 2564486420 N_PDU_18DAF514 0;
BA_ "GenSigTimeoutTime_SGW" SG_ 2564429301 N_PDU_18DA15F5 0;
BA_ "GenSigTimeoutTime_IDCM" SG_ 2564429301 N_PDU_18DA15F5 0;
BA_ "GenSigTimeoutTime_EVCU2" SG_ 2564429301 N_PDU_18DA15F5 0;
BA_ "GenSigTimeoutTime_BPCM" SG_ 2564429301 N_PDU_18DA15F5 0;
BA_ "GenSigTimeoutTime_PPIM" SG_ 2564429301 N_PDU_18DA15F5 0;
BA_ "GenSigTimeoutTime_HCP" SG_ 2564429301 N_PDU_18DA15F5 0;
BA_ "GenSigTimeoutTime_SGW" SG_ 2564429045 N_PDU_18DA14F5 0;
BA_ "GenSigTimeoutTime_IDCM" SG_ 2564429045 N_PDU_18DA14F5 0;
BA_ "GenSigTimeoutTime_EVCU2" SG_ 2564429045 N_PDU_18DA14F5 0;
BA_ "GenSigTimeoutTime_BPCM" SG_ 2564429045 N_PDU_18DA14F5 0;
BA_ "GenSigTimeoutTime_PPIM" SG_ 2564429045 N_PDU_18DA14F5 0;
BA_ "GenSigTimeoutTime_HCP" SG_ 2564429045 N_PDU_18DA14F5 0;
BA_ "GenSigTimeoutTime_SGW" SG_ 2564441333 N_PDU_18DA44F5 0;
BA_ "GenSigTimeoutTime_IDCM" SG_ 2564441333 N_PDU_18DA44F5 0;
BA_ "GenSigTimeoutTime_EVCU2" SG_ 2564441333 N_PDU_18DA44F5 0;
BA_ "GenSigTimeoutTime_BPCM" SG_ 2564441333 N_PDU_18DA44F5 0;
BA_ "GenSigTimeoutTime_PPIM" SG_ 2564441333 N_PDU_18DA44F5 0;
BA_ "GenSigTimeoutTime_HCP" SG_ 2564441333 N_PDU_18DA44F5 0;
BA_ "GenSigTimeoutTime_SGW" SG_ 2564486480 N_PDU_18DAF550 0;
BA_ "GenSigTimeoutTime_IDCM" SG_ 2564486480 N_PDU_18DAF550 0;
BA_ "GenSigTimeoutTime_EVCU2" SG_ 2564486480 N_PDU_18DAF550 0;
BA_ "GenSigTimeoutTime_BPCM" SG_ 2564486480 N_PDU_18DAF550 0;
BA_ "GenSigTimeoutTime_PPIM" SG_ 2564486480 N_PDU_18DAF550 0;
BA_ "GenSigTimeoutTime_HCP" SG_ 2564486480 N_PDU_18DAF550 0;
BA_ "GenSigTimeoutTime_SGW" SG_ 2564444405 N_PDU_18DA50F5 0;
BA_ "GenSigTimeoutTime_IDCM" SG_ 2564444405 N_PDU_18DA50F5 0;
BA_ "GenSigTimeoutTime_EVCU2" SG_ 2564444405 N_PDU_18DA50F5 0;
BA_ "GenSigTimeoutTime_BPCM" SG_ 2564444405 N_PDU_18DA50F5 0;
BA_ "GenSigTimeoutTime_PPIM" SG_ 2564444405 N_PDU_18DA50F5 0;
BA_ "GenSigTimeoutTime_HCP" SG_ 2564444405 N_PDU_18DA50F5 0;
BA_ "GenSigTimeoutTime_SGW" SG_ 2564554485 N_PDU_18DBFEF5 0;
BA_ "GenSigTimeoutTime_IDCM" SG_ 2564554485 N_PDU_18DBFEF5 0;
BA_ "GenSigTimeoutTime_EVCU2" SG_ 2564554485 N_PDU_18DBFEF5 0;
BA_ "GenSigTimeoutTime_BPCM" SG_ 2564554485 N_PDU_18DBFEF5 0;
BA_ "GenSigTimeoutTime_PPIM" SG_ 2564554485 N_PDU_18DBFEF5 0;
BA_ "GenSigTimeoutTime_HCP" SG_ 2564554485 N_PDU_18DBFEF5 0;
BA_ "GenSigTimeoutTime_IDCM" SG_ 292 MessageCounter_BATT_HV_STATUS1 0;
BA_ "GenSigTimeoutTime_PPIM" SG_ 292 MessageCounter_BATT_HV_STATUS1 0;
BA_ "GenSigTimeoutTime_HCP" SG_ 292 MessageCounter_BATT_HV_STATUS1 0;
BA_ "GenSigTimeoutTime_SGW" SG_ 292 MessageCounter_BATT_HV_STATUS1 0;
BA_ "GenSigTimeoutTime_BPCM" SG_ 292 MessageCounter_BATT_HV_STATUS1 0;
BA_ "GenSigTimeoutTime_IDCM" SG_ 292 CRC_BATT_HV_STATUS1 0;
BA_ "GenSigTimeoutTime_PPIM" SG_ 292 CRC_BATT_HV_STATUS1 0;
BA_ "GenSigTimeoutTime_HCP" SG_ 292 CRC_BATT_HV_STATUS1 0;
BA_ "GenSigTimeoutTime_SGW" SG_ 292 CRC_BATT_HV_STATUS1 0;
BA_ "GenSigTimeoutTime_BPCM" SG_ 292 CRC_BATT_HV_STATUS1 0;
BA_ "GenSigTimeoutTime_PPIM" SG_ 292 HVBatContactorWeldCheck 0;
BA_ "GenSigTimeoutTime_HCP" SG_ 292 HVBatContactorWeldCheck 0;
BA_ "GenSigTimeoutTime_SGW" SG_ 292 HVBatContactorWeldCheck 0;
BA_ "GenSigTimeoutTime_IDCM" SG_ 292 HVBatContactorWeldCheck 0;
BA_ "GenSigTimeoutTime_BPCM" SG_ 292 HVBatContactorWeldCheck 0;
BA_ "GenSigTimeoutTime_PPIM" SG_ 292 HVBatReady 0;
BA_ "GenSigTimeoutTime_HCP" SG_ 292 HVBatReady 0;
BA_ "GenSigTimeoutTime_SGW" SG_ 292 HVBatReady 0;
BA_ "GenSigTimeoutTime_IDCM" SG_ 292 HVBatReady 0;
BA_ "GenSigTimeoutTime_BPCM" SG_ 292 HVBatReady 0;
BA_ "GenSigTimeoutTime_SGW" SG_ 292 BPCM_DC_CntctrsMidTrmOpeningWarn 0;
BA_ "GenSigTimeoutTime_IDCM" SG_ 292 BPCM_DC_CntctrsMidTrmOpeningWarn 0;
BA_ "GenSigTimeoutTime_BPCM" SG_ 292 BPCM_DC_CntctrsMidTrmOpeningWarn 0;
BA_ "GenSigTimeoutTime_PPIM" SG_ 292 BPCM_DC_CntctrsMidTrmOpeningWarn 0;
BA_ "GenSigTimeoutTime_HCP" SG_ 292 BPCM_DC_CntctrsMidTrmOpeningWarn 0;
BA_ "GenSigTimeoutTime_SGW" SG_ 292 BPCM_DC_CntctrsShtTrmOpeningWarn 0;
BA_ "GenSigTimeoutTime_IDCM" SG_ 292 BPCM_DC_CntctrsShtTrmOpeningWarn 0;
BA_ "GenSigTimeoutTime_BPCM" SG_ 292 BPCM_DC_CntctrsShtTrmOpeningWarn 0;
BA_ "GenSigTimeoutTime_PPIM" SG_ 292 BPCM_DC_CntctrsShtTrmOpeningWarn 0;
BA_ "GenSigTimeoutTime_HCP" SG_ 292 BPCM_DC_CntctrsShtTrmOpeningWarn 0;
BA_ "GenSigTimeoutTime_SGW" SG_ 292 BPCM_HV_Trac_Main_Contac_Sts 0;
BA_ "GenSigTimeoutTime_BPCM" SG_ 292 BPCM_HV_Trac_Main_Contac_Sts 0;
BA_ "GenSigTimeoutTime_PPIM" SG_ 292 BPCM_HV_Trac_Main_Contac_Sts 0;
BA_ "GenSigTimeoutTime_HCP" SG_ 292 BPCM_HV_Trac_Main_Contac_Sts 0;
BA_ "GenSigTimeoutTime_SGW" SG_ 292 BPCM_HV_BalancingMode 0;
BA_ "GenSigTimeoutTime_IDCM" SG_ 292 BPCM_HV_BalancingMode 0;
BA_ "GenSigTimeoutTime_BPCM" SG_ 292 BPCM_HV_BalancingMode 0;
BA_ "GenSigTimeoutTime_PPIM" SG_ 292 BPCM_HV_BalancingMode 0;
BA_ "GenSigTimeoutTime_HCP" SG_ 292 BPCM_HV_BalancingMode 0;
BA_ "GenSigTimeoutTime_SGW" SG_ 292 BPCM_HV_ChargingBusVoltage 0;
BA_ "GenSigTimeoutTime_IDCM" SG_ 292 BPCM_HV_ChargingBusVoltage 0;
BA_ "GenSigTimeoutTime_BPCM" SG_ 292 BPCM_HV_ChargingBusVoltage 0;
BA_ "GenSigTimeoutTime_PPIM" SG_ 292 BPCM_HV_ChargingBusVoltage 0;
BA_ "GenSigTimeoutTime_HCP" SG_ 292 BPCM_HV_ChargingBusVoltage 0;
BA_ "GenSigTimeoutTime_PPIM" SG_ 292 BPCM_HV_TractionBusVoltage 0;
BA_ "GenSigTimeoutTime_HCP" SG_ 292 BPCM_HV_TractionBusVoltage 0;
BA_ "GenSigTimeoutTime_SGW" SG_ 292 BPCM_HV_TractionBusVoltage 0;
BA_ "GenSigTimeoutTime_BPCM" SG_ 292 BPCM_HV_TractionBusVoltage 0;
BA_ "GenSigTimeoutTime_PPIM" SG_ 292 BPCM_Pwr_Limp_Home_On 0;
BA_ "GenSigTimeoutTime_HCP" SG_ 292 BPCM_Pwr_Limp_Home_On 0;
BA_ "GenSigTimeoutTime_SGW" SG_ 292 BPCM_Pwr_Limp_Home_On 0;
BA_ "GenSigTimeoutTime_IDCM" SG_ 292 BPCM_Pwr_Limp_Home_On 0;
BA_ "GenSigTimeoutTime_BPCM" SG_ 292 BPCM_Pwr_Limp_Home_On 0;
BA_ "GenSigTimeoutTime_SGW" SG_ 292 BPCM_HV_Trac_Bus_Sts 0;
BA_ "GenSigTimeoutTime_BPCM" SG_ 292 BPCM_HV_Trac_Bus_Sts 0;
BA_ "GenSigTimeoutTime_PPIM" SG_ 292 BPCM_HV_Trac_Bus_Sts 0;
BA_ "GenSigTimeoutTime_HCP" SG_ 292 BPCM_HV_Trac_Bus_Sts 0;
BA_ "GenSigTimeoutTime_SGW" SG_ 292 BPCM_HV_Char_Bus_Sts 0;
BA_ "GenSigTimeoutTime_IDCM" SG_ 292 BPCM_HV_Char_Bus_Sts 0;
BA_ "GenSigTimeoutTime_BPCM" SG_ 292 BPCM_HV_Char_Bus_Sts 0;
BA_ "GenSigTimeoutTime_PPIM" SG_ 292 BPCM_HV_Char_Bus_Sts 0;
BA_ "GenSigTimeoutTime_HCP" SG_ 292 BPCM_HV_Char_Bus_Sts 0;
BA_ "GenSigTimeoutTime_SGW" SG_ 292 BPCM_HV_SOH_Low 0;
BA_ "GenSigTimeoutTime_IDCM" SG_ 292 BPCM_HV_SOH_Low 0;
BA_ "GenSigTimeoutTime_BPCM" SG_ 292 BPCM_HV_SOH_Low 0;
BA_ "GenSigTimeoutTime_PPIM" SG_ 292 BPCM_HV_SOH_Low 0;
BA_ "GenSigTimeoutTime_HCP" SG_ 292 BPCM_HV_SOH_Low 0;
BA_ "GenSigTimeoutTime_SGW" SG_ 292 BPCM_HV_SOH 0;
BA_ "GenSigTimeoutTime_IDCM" SG_ 292 BPCM_HV_SOH 0;
BA_ "GenSigTimeoutTime_BPCM" SG_ 292 BPCM_HV_SOH 0;
BA_ "GenSigTimeoutTime_PPIM" SG_ 292 BPCM_HV_SOH 0;
BA_ "GenSigTimeoutTime_HCP" SG_ 292 BPCM_HV_SOH 0;
BA_ "GenSigTimeoutTime_SGW" SG_ 292 HVBatContactorOpenTime 0;
BA_ "GenSigTimeoutTime_IDCM" SG_ 292 HVBatContactorOpenTime 0;
BA_ "GenSigTimeoutTime_BPCM" SG_ 292 HVBatContactorOpenTime 0;
BA_ "GenSigTimeoutTime_PPIM" SG_ 292 HVBatContactorOpenTime 0;
BA_ "GenSigTimeoutTime_HCP" SG_ 292 HVBatContactorOpenTime 0;
BA_ "GenSigTimeoutTime_SGW" SG_ 292 HVBatLastSlept 0;
BA_ "GenSigTimeoutTime_IDCM" SG_ 292 HVBatLastSlept 0;
BA_ "GenSigTimeoutTime_BPCM" SG_ 292 HVBatLastSlept 0;
BA_ "GenSigTimeoutTime_PPIM" SG_ 292 HVBatLastSlept 0;
BA_ "GenSigTimeoutTime_HCP" SG_ 292 HVBatLastSlept 0;
BA_ "GenSigTimeoutTime_SGW" SG_ 292 BPCMInterlockSts 0;
BA_ "GenSigTimeoutTime_IDCM" SG_ 292 BPCMInterlockSts 0;
BA_ "GenSigTimeoutTime_BPCM" SG_ 292 BPCMInterlockSts 0;
BA_ "GenSigTimeoutTime_PPIM" SG_ 292 BPCMInterlockSts 0;
BA_ "GenSigTimeoutTime_HCP" SG_ 292 BPCMInterlockSts 0;
BA_ "GenSigTimeoutTime_SGW" SG_ 292 BPCM_HV_BatIntrlk_InternalStat 0;
BA_ "GenSigTimeoutTime_IDCM" SG_ 292 BPCM_HV_BatIntrlk_InternalStat 0;
BA_ "GenSigTimeoutTime_BPCM" SG_ 292 BPCM_HV_BatIntrlk_InternalStat 0;
BA_ "GenSigTimeoutTime_PPIM" SG_ 292 BPCM_HV_BatIntrlk_InternalStat 0;
BA_ "GenSigTimeoutTime_HCP" SG_ 292 BPCM_HV_BatIntrlk_InternalStat 0;
BA_ "GenSigTimeoutTime_SGW" SG_ 292 BPCM_HV_Temperature_Min 0;
BA_ "GenSigTimeoutTime_IDCM" SG_ 292 BPCM_HV_Temperature_Min 0;
BA_ "GenSigTimeoutTime_BPCM" SG_ 292 BPCM_HV_Temperature_Min 0;
BA_ "GenSigTimeoutTime_PPIM" SG_ 292 BPCM_HV_Temperature_Min 0;
BA_ "GenSigTimeoutTime_HCP" SG_ 292 BPCM_HV_Temperature_Min 0;
BA_ "GenSigTimeoutTime_SGW" SG_ 292 BPCM_HV_Temperature_Max 0;
BA_ "GenSigTimeoutTime_IDCM" SG_ 292 BPCM_HV_Temperature_Max 0;
BA_ "GenSigTimeoutTime_BPCM" SG_ 292 BPCM_HV_Temperature_Max 0;
BA_ "GenSigTimeoutTime_PPIM" SG_ 292 BPCM_HV_Temperature_Max 0;
BA_ "GenSigTimeoutTime_HCP" SG_ 292 BPCM_HV_Temperature_Max 0;
BA_ "GenSigTimeoutTime_SGW" SG_ 292 BPCM_HV_Temperature_Avg 0;
BA_ "GenSigTimeoutTime_IDCM" SG_ 292 BPCM_HV_Temperature_Avg 0;
BA_ "GenSigTimeoutTime_BPCM" SG_ 292 BPCM_HV_Temperature_Avg 0;
BA_ "GenSigTimeoutTime_PPIM" SG_ 292 BPCM_HV_Temperature_Avg 0;
BA_ "GenSigTimeoutTime_HCP" SG_ 292 BPCM_HV_Temperature_Avg 0;
BA_ "GenSigTimeoutTime_IDCM" SG_ 292 BPCM_HV_SOC 0;
BA_ "GenSigTimeoutTime_BPCM" SG_ 292 BPCM_HV_SOC 0;
BA_ "GenSigTimeoutTime_PPIM" SG_ 292 BPCM_HV_SOC 0;
BA_ "GenSigTimeoutTime_HCP" SG_ 292 BPCM_HV_SOC 0;
BA_ "GenSigTimeoutTime_SGW" SG_ 292 BPCM_HV_Outlet_Temp 0;
BA_ "GenSigTimeoutTime_IDCM" SG_ 292 BPCM_HV_Outlet_Temp 0;
BA_ "GenSigTimeoutTime_BPCM" SG_ 292 BPCM_HV_Outlet_Temp 0;
BA_ "GenSigStartValue" SG_ 292 BPCM_HV_Outlet_Temp 40;
BA_ "GenSigTimeoutTime_PPIM" SG_ 292 BPCM_HV_Outlet_Temp 0;
BA_ "GenSigTimeoutTime_HCP" SG_ 292 BPCM_HV_Outlet_Temp 0;
BA_ "GenSigTimeoutTime_SGW" SG_ 292 BPCM_HV_InternalVoltage 0;
BA_ "GenSigTimeoutTime_IDCM" SG_ 292 BPCM_HV_InternalVoltage 0;
BA_ "GenSigTimeoutTime_BPCM" SG_ 292 BPCM_HV_InternalVoltage 0;
BA_ "GenSigTimeoutTime_PPIM" SG_ 292 BPCM_HV_InternalVoltage 0;
BA_ "GenSigTimeoutTime_HCP" SG_ 292 BPCM_HV_InternalVoltage 0;
BA_ "GenSigTimeoutTime_SGW" SG_ 292 BPCM_HV_Inlet_Temp 0;
BA_ "GenSigTimeoutTime_IDCM" SG_ 292 BPCM_HV_Inlet_Temp 0;
BA_ "GenSigTimeoutTime_BPCM" SG_ 292 BPCM_HV_Inlet_Temp 0;
BA_ "GenSigStartValue" SG_ 292 BPCM_HV_Inlet_Temp 40;
BA_ "GenSigTimeoutTime_PPIM" SG_ 292 BPCM_HV_Inlet_Temp 0;
BA_ "GenSigTimeoutTime_HCP" SG_ 292 BPCM_HV_Inlet_Temp 0;
BA_ "GenSigTimeoutTime_SGW" SG_ 292 BPCM_HV_Current 0;
BA_ "GenSigTimeoutTime_IDCM" SG_ 292 BPCM_HV_Current 0;
BA_ "GenSigTimeoutTime_BPCM" SG_ 292 BPCM_HV_Current 0;
BA_ "GenSigTimeoutTime_PPIM" SG_ 292 BPCM_HV_Current 0;
BA_ "GenSigTimeoutTime_HCP" SG_ 292 BPCM_HV_Current 0;
BA_ "GenSigTimeoutTime_SGW" SG_ 292 BPCM_HV_Capacity 0;
BA_ "GenSigTimeoutTime_IDCM" SG_ 292 BPCM_HV_Capacity 0;
BA_ "GenSigTimeoutTime_BPCM" SG_ 292 BPCM_HV_Capacity 0;
BA_ "GenSigTimeoutTime_PPIM" SG_ 292 BPCM_HV_Capacity 0;
BA_ "GenSigTimeoutTime_HCP" SG_ 292 BPCM_HV_Capacity 0;
BA_ "GenSigTimeoutTime_SGW" SG_ 292 BPCM_HV_Battery_GFD_Sts 0;
BA_ "GenSigTimeoutTime_IDCM" SG_ 292 BPCM_HV_Battery_GFD_Sts 0;
BA_ "GenSigTimeoutTime_BPCM" SG_ 292 BPCM_HV_Battery_GFD_Sts 0;
BA_ "GenSigTimeoutTime_PPIM" SG_ 292 BPCM_HV_Battery_GFD_Sts 0;
BA_ "GenSigTimeoutTime_HCP" SG_ 292 BPCM_HV_Battery_GFD_Sts 0;
BA_ "GenSigTimeoutTime_SGW" SG_ 292 BPCM_Wakeup_Request 0;
BA_ "GenSigTimeoutTime_IDCM" SG_ 292 BPCM_Wakeup_Request 0;
BA_ "GenSigTimeoutTime_BPCM" SG_ 292 BPCM_Wakeup_Request 0;
BA_ "GenSigSendType" SG_ 292 BPCM_Wakeup_Request 3;
BA_ "GenSigTimeoutTime_PPIM" SG_ 292 BPCM_Wakeup_Request 0;
BA_ "GenSigTimeoutTime_HCP" SG_ 292 BPCM_Wakeup_Request 0;
BA_ "GenSigTimeoutTime_PPIM" SG_ 292 BPCM_HV_ThermalRunaway 0;
BA_ "GenSigTimeoutTime_HCP" SG_ 292 BPCM_HV_ThermalRunaway 0;
BA_ "GenSigTimeoutTime_SGW" SG_ 292 BPCM_HV_ThermalRunaway 0;
BA_ "GenSigTimeoutTime_IDCM" SG_ 292 BPCM_HV_ThermalRunaway 0;
BA_ "GenSigTimeoutTime_BPCM" SG_ 292 BPCM_HV_ThermalRunaway 0;
BA_ "GenSigSendType" SG_ 292 BPCM_HV_ThermalRunaway 3;
BA_ "GenSigTimeoutTime_SGW" SG_ 292 HVBP_Busbar_Temp 0;
BA_ "GenSigTimeoutTime_IDCM" SG_ 292 HVBP_Busbar_Temp 0;
BA_ "GenSigTimeoutTime_BPCM" SG_ 292 HVBP_Busbar_Temp 0;
BA_ "GenSigTimeoutTime_PPIM" SG_ 292 HVBP_Busbar_Temp 0;
BA_ "GenSigTimeoutTime_HCP" SG_ 292 HVBP_Busbar_Temp 0;
BA_ "GenSigTimeoutTime_SGW" SG_ 292 HVBP_BDU_Busbar_Temp 0;
BA_ "GenSigTimeoutTime_IDCM" SG_ 292 HVBP_BDU_Busbar_Temp 0;
BA_ "GenSigTimeoutTime_BPCM" SG_ 292 HVBP_BDU_Busbar_Temp 0;
BA_ "GenSigTimeoutTime_PPIM" SG_ 292 HVBP_BDU_Busbar_Temp 0;
BA_ "GenSigTimeoutTime_HCP" SG_ 292 HVBP_BDU_Busbar_Temp 0;
BA_ "GenSigTimeoutTime_SGW" SG_ 292 DC_Charge_Type_Status 0;
BA_ "GenSigTimeoutTime_IDCM" SG_ 292 DC_Charge_Type_Status 0;
BA_ "GenSigTimeoutTime_BPCM" SG_ 292 DC_Charge_Type_Status 0;
BA_ "GenSigTimeoutTime_PPIM" SG_ 292 DC_Charge_Type_Status 0;
BA_ "GenSigTimeoutTime_HCP" SG_ 292 DC_Charge_Type_Status 0;
BA_ "GenSigTimeoutTime_SGW" SG_ 292 BPCM_Series_Voltage 0;
BA_ "GenSigTimeoutTime_IDCM" SG_ 292 BPCM_Series_Voltage 0;
BA_ "GenSigTimeoutTime_BPCM" SG_ 292 BPCM_Series_Voltage 0;
BA_ "GenSigTimeoutTime_PPIM" SG_ 292 BPCM_Series_Voltage 0;
BA_ "GenSigTimeoutTime_HCP" SG_ 292 BPCM_Series_Voltage 0;
BA_ "GenSigTimeoutTime_SGW" SG_ 292 BPCM_Request_for_Aux_Load_off 0;
BA_ "GenSigTimeoutTime_IDCM" SG_ 292 BPCM_Request_for_Aux_Load_off 0;
BA_ "GenSigTimeoutTime_BPCM" SG_ 292 BPCM_Request_for_Aux_Load_off 0;
BA_ "GenSigTimeoutTime_PPIM" SG_ 292 BPCM_Request_for_Aux_Load_off 0;
BA_ "GenSigTimeoutTime_HCP" SG_ 292 BPCM_Request_for_Aux_Load_off 0;
BA_ "GenSigTimeoutTime_SGW" SG_ 292 BPCM_HV_Trac_Main_Contac_Config 0;
BA_ "GenSigTimeoutTime_IDCM" SG_ 292 BPCM_HV_Trac_Main_Contac_Config 0;
BA_ "GenSigTimeoutTime_BPCM" SG_ 292 BPCM_HV_Trac_Main_Contac_Config 0;
BA_ "GenSigStartValue" SG_ 292 BPCM_HV_Trac_Main_Contac_Config 1;
BA_ "GenSigTimeoutTime_PPIM" SG_ 292 BPCM_HV_Trac_Main_Contac_Config 0;
BA_ "GenSigTimeoutTime_HCP" SG_ 292 BPCM_HV_Trac_Main_Contac_Config 0;
BA_ "GenSigTimeoutTime_SGW" SG_ 292 BPCM_HV_InternalVoltageString2 0;
BA_ "GenSigTimeoutTime_IDCM" SG_ 292 BPCM_HV_InternalVoltageString2 0;
BA_ "GenSigTimeoutTime_BPCM" SG_ 292 BPCM_HV_InternalVoltageString2 0;
BA_ "GenSigTimeoutTime_PPIM" SG_ 292 BPCM_HV_InternalVoltageString2 0;
BA_ "GenSigTimeoutTime_HCP" SG_ 292 BPCM_HV_InternalVoltageString2 0;
BA_ "GenSigTimeoutTime_SGW" SG_ 292 BPCM_HV_InternalVoltageString1 0;
BA_ "GenSigTimeoutTime_IDCM" SG_ 292 BPCM_HV_InternalVoltageString1 0;
BA_ "GenSigTimeoutTime_BPCM" SG_ 292 BPCM_HV_InternalVoltageString1 0;
BA_ "GenSigTimeoutTime_PPIM" SG_ 292 BPCM_HV_InternalVoltageString1 0;
BA_ "GenSigTimeoutTime_HCP" SG_ 292 BPCM_HV_InternalVoltageString1 0;
BA_ "GenSigTimeoutTime_SGW" SG_ 292 BPCM_HV_DCFC_Isolation_Sts 0;
BA_ "GenSigTimeoutTime_IDCM" SG_ 292 BPCM_HV_DCFC_Isolation_Sts 0;
BA_ "GenSigTimeoutTime_BPCM" SG_ 292 BPCM_HV_DCFC_Isolation_Sts 0;
BA_ "GenSigTimeoutTime_PPIM" SG_ 292 BPCM_HV_DCFC_Isolation_Sts 0;
BA_ "GenSigTimeoutTime_HCP" SG_ 292 BPCM_HV_DCFC_Isolation_Sts 0;
BA_ "GenSigTimeoutTime_SGW" SG_ 292 BPCM_HV_Trac_PreCha_Contac_Sts 0;
BA_ "GenSigTimeoutTime_IDCM" SG_ 292 BPCM_HV_Trac_PreCha_Contac_Sts 0;
BA_ "GenSigTimeoutTime_BPCM" SG_ 292 BPCM_HV_Trac_PreCha_Contac_Sts 0;
BA_ "GenSigTimeoutTime_SGW" SG_ 485 MessageCounter_BATT_HV_VLIMITS 0;
BA_ "GenSigTimeoutTime_IDCM" SG_ 485 MessageCounter_BATT_HV_VLIMITS 0;
BA_ "GenSigTimeoutTime_BPCM" SG_ 485 MessageCounter_BATT_HV_VLIMITS 0;
BA_ "GenSigTimeoutTime_PPIM" SG_ 485 MessageCounter_BATT_HV_VLIMITS 0;
BA_ "GenSigTimeoutTime_HCP" SG_ 485 MessageCounter_BATT_HV_VLIMITS 0;
BA_ "GenSigTimeoutTime_SGW" SG_ 485 CRC_BATT_HV_VLIMITS 0;
BA_ "GenSigTimeoutTime_IDCM" SG_ 485 CRC_BATT_HV_VLIMITS 0;
BA_ "GenSigTimeoutTime_BPCM" SG_ 485 CRC_BATT_HV_VLIMITS 0;
BA_ "GenSigTimeoutTime_PPIM" SG_ 485 CRC_BATT_HV_VLIMITS 0;
BA_ "GenSigTimeoutTime_HCP" SG_ 485 CRC_BATT_HV_VLIMITS 0;
BA_ "GenSigTimeoutTime_SGW" SG_ 485 BPCM_HV_NumCellMinTemp 0;
BA_ "GenSigTimeoutTime_IDCM" SG_ 485 BPCM_HV_NumCellMinTemp 0;
BA_ "GenSigTimeoutTime_BPCM" SG_ 485 BPCM_HV_NumCellMinTemp 0;
BA_ "GenSigTimeoutTime_PPIM" SG_ 485 BPCM_HV_NumCellMinTemp 0;
BA_ "GenSigTimeoutTime_HCP" SG_ 485 BPCM_HV_NumCellMinTemp 0;
BA_ "GenSigTimeoutTime_SGW" SG_ 485 BPCM_HV_NumCellMaxTemp 0;
BA_ "GenSigTimeoutTime_IDCM" SG_ 485 BPCM_HV_NumCellMaxTemp 0;
BA_ "GenSigTimeoutTime_BPCM" SG_ 485 BPCM_HV_NumCellMaxTemp 0;
BA_ "GenSigTimeoutTime_PPIM" SG_ 485 BPCM_HV_NumCellMaxTemp 0;
BA_ "GenSigTimeoutTime_HCP" SG_ 485 BPCM_HV_NumCellMaxTemp 0;
BA_ "GenSigTimeoutTime_SGW" SG_ 485 BPCM_HV_NumCellMinVolt 0;
BA_ "GenSigTimeoutTime_IDCM" SG_ 485 BPCM_HV_NumCellMinVolt 0;
BA_ "GenSigTimeoutTime_BPCM" SG_ 485 BPCM_HV_NumCellMinVolt 0;
BA_ "GenSigTimeoutTime_PPIM" SG_ 485 BPCM_HV_NumCellMinVolt 0;
BA_ "GenSigTimeoutTime_HCP" SG_ 485 BPCM_HV_NumCellMinVolt 0;
BA_ "GenSigTimeoutTime_SGW" SG_ 485 BPCM_HV_NumCellMaxVolt 0;
BA_ "GenSigTimeoutTime_IDCM" SG_ 485 BPCM_HV_NumCellMaxVolt 0;
BA_ "GenSigTimeoutTime_BPCM" SG_ 485 BPCM_HV_NumCellMaxVolt 0;
BA_ "GenSigTimeoutTime_PPIM" SG_ 485 BPCM_HV_NumCellMaxVolt 0;
BA_ "GenSigTimeoutTime_HCP" SG_ 485 BPCM_HV_NumCellMaxVolt 0;
BA_ "GenSigTimeoutTime_SGW" SG_ 485 BPCM_Min_Pk_Volt_Allowed 0;
BA_ "GenSigTimeoutTime_IDCM" SG_ 485 BPCM_Min_Pk_Volt_Allowed 0;
BA_ "GenSigTimeoutTime_BPCM" SG_ 485 BPCM_Min_Pk_Volt_Allowed 0;
BA_ "GenSigTimeoutTime_PPIM" SG_ 485 BPCM_Min_Pk_Volt_Allowed 0;
BA_ "GenSigTimeoutTime_HCP" SG_ 485 BPCM_Min_Pk_Volt_Allowed 0;
BA_ "GenSigTimeoutTime_SGW" SG_ 485 BPCM_Max_Pk_Volt_Allowed 0;
BA_ "GenSigTimeoutTime_IDCM" SG_ 485 BPCM_Max_Pk_Volt_Allowed 0;
BA_ "GenSigTimeoutTime_BPCM" SG_ 485 BPCM_Max_Pk_Volt_Allowed 0;
BA_ "GenSigTimeoutTime_PPIM" SG_ 485 BPCM_Max_Pk_Volt_Allowed 0;
BA_ "GenSigTimeoutTime_HCP" SG_ 485 BPCM_Max_Pk_Volt_Allowed 0;
BA_ "GenSigTimeoutTime_SGW" SG_ 485 BPCM_OCV_Min_Cell_Volt 0;
BA_ "GenSigTimeoutTime_IDCM" SG_ 485 BPCM_OCV_Min_Cell_Volt 0;
BA_ "GenSigTimeoutTime_BPCM" SG_ 485 BPCM_OCV_Min_Cell_Volt 0;
BA_ "GenSigTimeoutTime_PPIM" SG_ 485 BPCM_OCV_Min_Cell_Volt 0;
BA_ "GenSigTimeoutTime_HCP" SG_ 485 BPCM_OCV_Min_Cell_Volt 0;
BA_ "GenSigTimeoutTime_SGW" SG_ 485 BPCM_OCV_Max_Cell_Volt 0;
BA_ "GenSigTimeoutTime_IDCM" SG_ 485 BPCM_OCV_Max_Cell_Volt 0;
BA_ "GenSigTimeoutTime_BPCM" SG_ 485 BPCM_OCV_Max_Cell_Volt 0;
BA_ "GenSigTimeoutTime_PPIM" SG_ 485 BPCM_OCV_Max_Cell_Volt 0;
BA_ "GenSigTimeoutTime_HCP" SG_ 485 BPCM_OCV_Max_Cell_Volt 0;
BA_ "GenSigTimeoutTime_SGW" SG_ 485 BPCM_OCV_Avg_Cell_Volt 0;
BA_ "GenSigTimeoutTime_IDCM" SG_ 485 BPCM_OCV_Avg_Cell_Volt 0;
BA_ "GenSigTimeoutTime_BPCM" SG_ 485 BPCM_OCV_Avg_Cell_Volt 0;
BA_ "GenSigTimeoutTime_PPIM" SG_ 485 BPCM_OCV_Avg_Cell_Volt 0;
BA_ "GenSigTimeoutTime_HCP" SG_ 485 BPCM_OCV_Avg_Cell_Volt 0;
BA_ "GenSigTimeoutTime_SGW" SG_ 485 BPCM_Min_Cell_Volt_Allowed 0;
BA_ "GenSigTimeoutTime_IDCM" SG_ 485 BPCM_Min_Cell_Volt_Allowed 0;
BA_ "GenSigTimeoutTime_BPCM" SG_ 485 BPCM_Min_Cell_Volt_Allowed 0;
BA_ "GenSigTimeoutTime_PPIM" SG_ 485 BPCM_Min_Cell_Volt_Allowed 0;
BA_ "GenSigTimeoutTime_HCP" SG_ 485 BPCM_Min_Cell_Volt_Allowed 0;
BA_ "GenSigTimeoutTime_PPIM" SG_ 485 BPCM_Max_Cell_Volt_Allowed 0;
BA_ "GenSigTimeoutTime_HCP" SG_ 485 BPCM_Max_Cell_Volt_Allowed 0;
BA_ "GenSigTimeoutTime_SGW" SG_ 485 BPCM_Max_Cell_Volt_Allowed 0;
BA_ "GenSigTimeoutTime_IDCM" SG_ 485 BPCM_Max_Cell_Volt_Allowed 0;
BA_ "GenSigTimeoutTime_BPCM" SG_ 485 BPCM_Max_Cell_Volt_Allowed 0;
BA_ "GenSigTimeoutTime_SGW" SG_ 485 BPCM_HV_Insulation_Resistance 0;
BA_ "GenSigTimeoutTime_IDCM" SG_ 485 BPCM_HV_Insulation_Resistance 0;
BA_ "GenSigTimeoutTime_BPCM" SG_ 485 BPCM_HV_Insulation_Resistance 0;
BA_ "GenSigTimeoutTime_PPIM" SG_ 485 BPCM_HV_Insulation_Resistance 0;
BA_ "GenSigTimeoutTime_HCP" SG_ 485 BPCM_HV_Insulation_Resistance 0;
BA_ "GenSigTimeoutTime_SGW" SG_ 485 BPCM_Cell_Volt_Min 0;
BA_ "GenSigTimeoutTime_IDCM" SG_ 485 BPCM_Cell_Volt_Min 0;
BA_ "GenSigTimeoutTime_BPCM" SG_ 485 BPCM_Cell_Volt_Min 0;
BA_ "GenSigTimeoutTime_PPIM" SG_ 485 BPCM_Cell_Volt_Min 0;
BA_ "GenSigTimeoutTime_HCP" SG_ 485 BPCM_Cell_Volt_Min 0;
BA_ "GenSigTimeoutTime_SGW" SG_ 485 BPCM_Cell_Volt_Max 0;
BA_ "GenSigTimeoutTime_IDCM" SG_ 485 BPCM_Cell_Volt_Max 0;
BA_ "GenSigTimeoutTime_BPCM" SG_ 485 BPCM_Cell_Volt_Max 0;
BA_ "GenSigTimeoutTime_PPIM" SG_ 485 BPCM_Cell_Volt_Max 0;
BA_ "GenSigTimeoutTime_HCP" SG_ 485 BPCM_Cell_Volt_Max 0;
BA_ "GenSigTimeoutTime_SGW" SG_ 485 BPCM_Cell_Volt_Avg 0;
BA_ "GenSigTimeoutTime_IDCM" SG_ 485 BPCM_Cell_Volt_Avg 0;
BA_ "GenSigTimeoutTime_BPCM" SG_ 485 BPCM_Cell_Volt_Avg 0;
BA_ "GenSigTimeoutTime_PPIM" SG_ 485 BPCM_Cell_Volt_Avg 0;
BA_ "GenSigTimeoutTime_HCP" SG_ 485 BPCM_Cell_Volt_Avg 0;
BA_ "GenSigTimeoutTime_SGW" SG_ 288 BPCM_HV_HVBatChargeStat 0;
BA_ "GenSigTimeoutTime_IDCM" SG_ 288 BPCM_HV_HVBatChargeStat 0;
BA_ "GenSigTimeoutTime_BPCM" SG_ 288 BPCM_HV_HVBatChargeStat 0;
BA_ "GenSigTimeoutTime_PPIM" SG_ 288 BPCM_HV_HVBatChargeStat 0;
BA_ "GenSigTimeoutTime_HCP" SG_ 288 BPCM_HV_HVBatChargeStat 0;
BA_ "GenSigTimeoutTime_SGW" SG_ 288 BPCM_HV_PwrLmtInstDschg 0;
BA_ "GenSigTimeoutTime_IDCM" SG_ 288 BPCM_HV_PwrLmtInstDschg 0;
BA_ "GenSigTimeoutTime_BPCM" SG_ 288 BPCM_HV_PwrLmtInstDschg 0;
BA_ "GenSigTimeoutTime_PPIM" SG_ 288 BPCM_HV_PwrLmtInstDschg 0;
BA_ "GenSigTimeoutTime_HCP" SG_ 288 BPCM_HV_PwrLmtInstDschg 0;
BA_ "GenSigTimeoutTime_SGW" SG_ 288 BPCM_HV_PwrLmtInstChrg 0;
BA_ "GenSigTimeoutTime_IDCM" SG_ 288 BPCM_HV_PwrLmtInstChrg 0;
BA_ "GenSigTimeoutTime_BPCM" SG_ 288 BPCM_HV_PwrLmtInstChrg 0;
BA_ "GenSigTimeoutTime_PPIM" SG_ 288 BPCM_HV_PwrLmtInstChrg 0;
BA_ "GenSigTimeoutTime_HCP" SG_ 288 BPCM_HV_PwrLmtInstChrg 0;
BA_ "GenSigTimeoutTime_SGW" SG_ 288 BPCM_HV_Pwr_MaxDischrg_ShrTrm 0;
BA_ "GenSigTimeoutTime_IDCM" SG_ 288 BPCM_HV_Pwr_MaxDischrg_ShrTrm 0;
BA_ "GenSigTimeoutTime_BPCM" SG_ 288 BPCM_HV_Pwr_MaxDischrg_ShrTrm 0;
BA_ "GenSigTimeoutTime_PPIM" SG_ 288 BPCM_HV_Pwr_MaxDischrg_ShrTrm 0;
BA_ "GenSigTimeoutTime_HCP" SG_ 288 BPCM_HV_Pwr_MaxDischrg_ShrTrm 0;
BA_ "GenSigTimeoutTime_SGW" SG_ 288 BPCM_HV_Power_MaxDischarge_MdTrm 0;
BA_ "GenSigTimeoutTime_IDCM" SG_ 288 BPCM_HV_Power_MaxDischarge_MdTrm 0;
BA_ "GenSigTimeoutTime_BPCM" SG_ 288 BPCM_HV_Power_MaxDischarge_MdTrm 0;
BA_ "GenSigTimeoutTime_PPIM" SG_ 288 BPCM_HV_Power_MaxDischarge_MdTrm 0;
BA_ "GenSigTimeoutTime_HCP" SG_ 288 BPCM_HV_Power_MaxDischarge_MdTrm 0;
BA_ "GenSigTimeoutTime_SGW" SG_ 288 BPCM_HV_Power_MaxDischarge_LgTrm 0;
BA_ "GenSigTimeoutTime_IDCM" SG_ 288 BPCM_HV_Power_MaxDischarge_LgTrm 0;
BA_ "GenSigTimeoutTime_BPCM" SG_ 288 BPCM_HV_Power_MaxDischarge_LgTrm 0;
BA_ "GenSigTimeoutTime_PPIM" SG_ 288 BPCM_HV_Power_MaxDischarge_LgTrm 0;
BA_ "GenSigTimeoutTime_HCP" SG_ 288 BPCM_HV_Power_MaxDischarge_LgTrm 0;
BA_ "GenSigTimeoutTime_SGW" SG_ 288 BPCM_HV_Power_MaxCharge_ShrTrm 0;
BA_ "GenSigTimeoutTime_IDCM" SG_ 288 BPCM_HV_Power_MaxCharge_ShrTrm 0;
BA_ "GenSigTimeoutTime_BPCM" SG_ 288 BPCM_HV_Power_MaxCharge_ShrTrm 0;
BA_ "GenSigTimeoutTime_PPIM" SG_ 288 BPCM_HV_Power_MaxCharge_ShrTrm 0;
BA_ "GenSigTimeoutTime_HCP" SG_ 288 BPCM_HV_Power_MaxCharge_ShrTrm 0;
BA_ "GenSigTimeoutTime_SGW" SG_ 288 BPCM_HV_Power_MaxCharge_MdTrm 0;
BA_ "GenSigTimeoutTime_IDCM" SG_ 288 BPCM_HV_Power_MaxCharge_MdTrm 0;
BA_ "GenSigTimeoutTime_BPCM" SG_ 288 BPCM_HV_Power_MaxCharge_MdTrm 0;
BA_ "GenSigTimeoutTime_PPIM" SG_ 288 BPCM_HV_Power_MaxCharge_MdTrm 0;
BA_ "GenSigTimeoutTime_HCP" SG_ 288 BPCM_HV_Power_MaxCharge_MdTrm 0;
BA_ "GenSigTimeoutTime_SGW" SG_ 288 BPCM_HV_Power_MaxCharge_LgTrm 0;
BA_ "GenSigTimeoutTime_IDCM" SG_ 288 BPCM_HV_Power_MaxCharge_LgTrm 0;
BA_ "GenSigTimeoutTime_BPCM" SG_ 288 BPCM_HV_Power_MaxCharge_LgTrm 0;
BA_ "GenSigTimeoutTime_PPIM" SG_ 288 BPCM_HV_Power_MaxCharge_LgTrm 0;
BA_ "GenSigTimeoutTime_HCP" SG_ 288 BPCM_HV_Power_MaxCharge_LgTrm 0;
BA_ "GenSigTimeoutTime_SGW" SG_ 288 BPCM_HV_CrntLmtInstDschg 0;
BA_ "GenSigTimeoutTime_IDCM" SG_ 288 BPCM_HV_CrntLmtInstDschg 0;
BA_ "GenSigTimeoutTime_BPCM" SG_ 288 BPCM_HV_CrntLmtInstDschg 0;
BA_ "GenSigTimeoutTime_PPIM" SG_ 288 BPCM_HV_CrntLmtInstDschg 0;
BA_ "GenSigTimeoutTime_HCP" SG_ 288 BPCM_HV_CrntLmtInstDschg 0;
BA_ "GenSigTimeoutTime_SGW" SG_ 288 BPCM_HV_CrntLmtInstChrg 0;
BA_ "GenSigTimeoutTime_IDCM" SG_ 288 BPCM_HV_CrntLmtInstChrg 0;
BA_ "GenSigTimeoutTime_BPCM" SG_ 288 BPCM_HV_CrntLmtInstChrg 0;
BA_ "GenSigTimeoutTime_PPIM" SG_ 288 BPCM_HV_CrntLmtInstChrg 0;
BA_ "GenSigTimeoutTime_HCP" SG_ 288 BPCM_HV_CrntLmtInstChrg 0;
BA_ "GenSigTimeoutTime_SGW" SG_ 288 BPCM_HV_ChargingCurrentProfile 0;
BA_ "GenSigTimeoutTime_IDCM" SG_ 288 BPCM_HV_ChargingCurrentProfile 0;
BA_ "GenSigTimeoutTime_BPCM" SG_ 288 BPCM_HV_ChargingCurrentProfile 0;
BA_ "GenSigTimeoutTime_PPIM" SG_ 288 BPCM_HV_ChargingCurrentProfile 0;
BA_ "GenSigTimeoutTime_HCP" SG_ 288 BPCM_HV_ChargingCurrentProfile 0;
BA_ "GenSigTimeoutTime_SGW" SG_ 288 BPCM_HV_Cell_MinDischrg_Imped 0;
BA_ "GenSigTimeoutTime_IDCM" SG_ 288 BPCM_HV_Cell_MinDischrg_Imped 0;
BA_ "GenSigTimeoutTime_BPCM" SG_ 288 BPCM_HV_Cell_MinDischrg_Imped 0;
BA_ "GenSigTimeoutTime_PPIM" SG_ 288 BPCM_HV_Cell_MinDischrg_Imped 0;
BA_ "GenSigTimeoutTime_HCP" SG_ 288 BPCM_HV_Cell_MinDischrg_Imped 0;
BA_ "GenSigTimeoutTime_SGW" SG_ 288 BPCM_HV_Cell_MaxDischrg_Imped 0;
BA_ "GenSigTimeoutTime_IDCM" SG_ 288 BPCM_HV_Cell_MaxDischrg_Imped 0;
BA_ "GenSigTimeoutTime_BPCM" SG_ 288 BPCM_HV_Cell_MaxDischrg_Imped 0;
BA_ "GenSigTimeoutTime_PPIM" SG_ 288 BPCM_HV_Cell_MaxDischrg_Imped 0;
BA_ "GenSigTimeoutTime_HCP" SG_ 288 BPCM_HV_Cell_MaxDischrg_Imped 0;
BA_ "GenSigTimeoutTime_SGW" SG_ 288 BPCM_CntctrsShtTrmOpeningWarn 0;
BA_ "GenSigTimeoutTime_BPCM" SG_ 288 BPCM_CntctrsShtTrmOpeningWarn 0;
BA_ "GenSigTimeoutTime_PPIM" SG_ 288 BPCM_CntctrsShtTrmOpeningWarn 0;
BA_ "GenSigTimeoutTime_HCP" SG_ 288 BPCM_CntctrsShtTrmOpeningWarn 0;
BA_ "GenSigTimeoutTime_SGW" SG_ 288 BPCM_CntctrsMidTrmOpeningWarn 0;
BA_ "GenSigTimeoutTime_IDCM" SG_ 288 BPCM_CntctrsMidTrmOpeningWarn 0;
BA_ "GenSigTimeoutTime_BPCM" SG_ 288 BPCM_CntctrsMidTrmOpeningWarn 0;
BA_ "GenSigTimeoutTime_PPIM" SG_ 288 BPCM_CntctrsMidTrmOpeningWarn 0;
BA_ "GenSigTimeoutTime_HCP" SG_ 288 BPCM_CntctrsMidTrmOpeningWarn 0;
BA_ "GenSigTimeoutTime_SGW" SG_ 288 MessageCounter_BATT_HV_POWERLIMS 0;
BA_ "GenSigTimeoutTime_IDCM" SG_ 288 MessageCounter_BATT_HV_POWERLIMS 0;
BA_ "GenSigTimeoutTime_BPCM" SG_ 288 MessageCounter_BATT_HV_POWERLIMS 0;
BA_ "GenSigTimeoutTime_PPIM" SG_ 288 MessageCounter_BATT_HV_POWERLIMS 0;
BA_ "GenSigTimeoutTime_HCP" SG_ 288 MessageCounter_BATT_HV_POWERLIMS 0;
BA_ "GenSigTimeoutTime_SGW" SG_ 288 CRC_BATT_HV_POWERLIMS 0;
BA_ "GenSigTimeoutTime_IDCM" SG_ 288 CRC_BATT_HV_POWERLIMS 0;
BA_ "GenSigTimeoutTime_BPCM" SG_ 288 CRC_BATT_HV_POWERLIMS 0;
BA_ "GenSigTimeoutTime_PPIM" SG_ 288 CRC_BATT_HV_POWERLIMS 0;
BA_ "GenSigTimeoutTime_HCP" SG_ 288 CRC_BATT_HV_POWERLIMS 0;
BA_ "GenSigTimeoutTime_SGW" SG_ 2564485698 N_PDU_18DAF242 0;
BA_ "GenSigTimeoutTime_IDCM" SG_ 2564485698 N_PDU_18DAF242 0;
BA_ "GenSigTimeoutTime_EVCU2" SG_ 2564485698 N_PDU_18DAF242 0;
BA_ "GenSigTimeoutTime_BPCM" SG_ 2564485698 N_PDU_18DAF242 0;
BA_ "GenSigTimeoutTime_PPIM" SG_ 2564485698 N_PDU_18DAF242 0;
BA_ "GenSigTimeoutTime_HCP" SG_ 2564485698 N_PDU_18DAF242 0;
BA_ "GenSigTimeoutTime_SGW" SG_ 2564440818 N_PDU_18DA42F2 0;
BA_ "GenSigTimeoutTime_IDCM" SG_ 2564440818 N_PDU_18DA42F2 0;
BA_ "GenSigTimeoutTime_EVCU2" SG_ 2564440818 N_PDU_18DA42F2 0;
BA_ "GenSigTimeoutTime_BPCM" SG_ 2564440818 N_PDU_18DA42F2 0;
BA_ "GenSigTimeoutTime_PPIM" SG_ 2564440818 N_PDU_18DA42F2 0;
BA_ "GenSigTimeoutTime_HCP" SG_ 2564440818 N_PDU_18DA42F2 0;
BA_ "GenSigTimeoutTime_IDCM" SG_ 1965 HVBatCellVoltage_Cell232 0;
BA_ "GenSigTimeoutTime_EVCU2" SG_ 1965 HVBatCellVoltage_Cell232 0;
BA_ "GenSigTimeoutTime_BPCM" SG_ 1965 HVBatCellVoltage_Cell232 0;
BA_ "GenSigTimeoutTime_EVCU2" SG_ 1965 HVBatCellVoltage_Cell231 0;
BA_ "GenSigTimeoutTime_BPCM" SG_ 1965 HVBatCellVoltage_Cell231 0;
BA_ "GenSigTimeoutTime_IDCM" SG_ 1965 HVBatCellVoltage_Cell231 0;
BA_ "GenSigTimeoutTime_IDCM" SG_ 1965 HVBatCellVoltage_Cell230 0;
BA_ "GenSigTimeoutTime_EVCU2" SG_ 1965 HVBatCellVoltage_Cell230 0;
BA_ "GenSigTimeoutTime_BPCM" SG_ 1965 HVBatCellVoltage_Cell230 0;
BA_ "GenSigTimeoutTime_IDCM" SG_ 1965 HVBatCellVoltage_Cell229 0;
BA_ "GenSigTimeoutTime_EVCU2" SG_ 1965 HVBatCellVoltage_Cell229 0;
BA_ "GenSigTimeoutTime_BPCM" SG_ 1965 HVBatCellVoltage_Cell229 0;
BA_ "GenSigTimeoutTime_IDCM" SG_ 1965 HVBatCellVoltage_Cell228 0;
BA_ "GenSigTimeoutTime_EVCU2" SG_ 1965 HVBatCellVoltage_Cell228 0;
BA_ "GenSigTimeoutTime_BPCM" SG_ 1965 HVBatCellVoltage_Cell228 0;
BA_ "GenSigTimeoutTime_IDCM" SG_ 1965 HVBatCellVoltage_Cell227 0;
BA_ "GenSigTimeoutTime_EVCU2" SG_ 1965 HVBatCellVoltage_Cell227 0;
BA_ "GenSigTimeoutTime_BPCM" SG_ 1965 HVBatCellVoltage_Cell227 0;
BA_ "GenSigTimeoutTime_IDCM" SG_ 1965 HVBatCellVoltage_Cell226 0;
BA_ "GenSigTimeoutTime_EVCU2" SG_ 1965 HVBatCellVoltage_Cell226 0;
BA_ "GenSigTimeoutTime_BPCM" SG_ 1965 HVBatCellVoltage_Cell226 0;
BA_ "GenSigTimeoutTime_IDCM" SG_ 1965 HVBatCellVoltage_Cell225 0;
BA_ "GenSigTimeoutTime_EVCU2" SG_ 1965 HVBatCellVoltage_Cell225 0;
BA_ "GenSigTimeoutTime_BPCM" SG_ 1965 HVBatCellVoltage_Cell225 0;
BA_ "GenSigTimeoutTime_IDCM" SG_ 1965 HVBatCellVoltage_Cell224 0;
BA_ "GenSigTimeoutTime_EVCU2" SG_ 1965 HVBatCellVoltage_Cell224 0;
BA_ "GenSigTimeoutTime_BPCM" SG_ 1965 HVBatCellVoltage_Cell224 0;
BA_ "GenSigTimeoutTime_IDCM" SG_ 1965 HVBatCellVoltage_Cell223 0;
BA_ "GenSigTimeoutTime_EVCU2" SG_ 1965 HVBatCellVoltage_Cell223 0;
BA_ "GenSigTimeoutTime_BPCM" SG_ 1965 HVBatCellVoltage_Cell223 0;
BA_ "GenSigTimeoutTime_IDCM" SG_ 1965 HVBatCellVoltage_Cell222 0;
BA_ "GenSigTimeoutTime_EVCU2" SG_ 1965 HVBatCellVoltage_Cell222 0;
BA_ "GenSigTimeoutTime_BPCM" SG_ 1965 HVBatCellVoltage_Cell222 0;
BA_ "GenSigTimeoutTime_IDCM" SG_ 1965 HVBatCellVoltage_Cell221 0;
BA_ "GenSigTimeoutTime_EVCU2" SG_ 1965 HVBatCellVoltage_Cell221 0;
BA_ "GenSigTimeoutTime_BPCM" SG_ 1965 HVBatCellVoltage_Cell221 0;
BA_ "GenSigTimeoutTime_IDCM" SG_ 1965 HVBatCellVoltage_Cell220 0;
BA_ "GenSigTimeoutTime_EVCU2" SG_ 1965 HVBatCellVoltage_Cell220 0;
BA_ "GenSigTimeoutTime_BPCM" SG_ 1965 HVBatCellVoltage_Cell220 0;
BA_ "GenSigTimeoutTime_IDCM" SG_ 1965 HVBatCellVoltage_Cell219 0;
BA_ "GenSigTimeoutTime_EVCU2" SG_ 1965 HVBatCellVoltage_Cell219 0;
BA_ "GenSigTimeoutTime_BPCM" SG_ 1965 HVBatCellVoltage_Cell219 0;
BA_ "GenSigTimeoutTime_IDCM" SG_ 1965 HVBatCellVoltage_Cell218 0;
BA_ "GenSigTimeoutTime_EVCU2" SG_ 1965 HVBatCellVoltage_Cell218 0;
BA_ "GenSigTimeoutTime_BPCM" SG_ 1965 HVBatCellVoltage_Cell218 0;
BA_ "GenSigTimeoutTime_IDCM" SG_ 1965 HVBatCellVoltage_Cell217 0;
BA_ "GenSigTimeoutTime_EVCU2" SG_ 1965 HVBatCellVoltage_Cell217 0;
BA_ "GenSigTimeoutTime_BPCM" SG_ 1965 HVBatCellVoltage_Cell217 0;
BA_ "GenSigTimeoutTime_IDCM" SG_ 1963 HVBatCellVoltage_Cell400 0;
BA_ "GenSigTimeoutTime_EVCU2" SG_ 1963 HVBatCellVoltage_Cell400 0;
BA_ "GenSigTimeoutTime_BPCM" SG_ 1963 HVBatCellVoltage_Cell400 0;
BA_ "GenSigTimeoutTime_IDCM" SG_ 1963 HVBatCellVoltage_Cell399 0;
BA_ "GenSigTimeoutTime_EVCU2" SG_ 1963 HVBatCellVoltage_Cell399 0;
BA_ "GenSigTimeoutTime_BPCM" SG_ 1963 HVBatCellVoltage_Cell399 0;
BA_ "GenSigTimeoutTime_IDCM" SG_ 1963 HVBatCellVoltage_Cell398 0;
BA_ "GenSigTimeoutTime_EVCU2" SG_ 1963 HVBatCellVoltage_Cell398 0;
BA_ "GenSigTimeoutTime_BPCM" SG_ 1963 HVBatCellVoltage_Cell398 0;
BA_ "GenSigTimeoutTime_IDCM" SG_ 1963 HVBatCellVoltage_Cell397 0;
BA_ "GenSigTimeoutTime_EVCU2" SG_ 1963 HVBatCellVoltage_Cell397 0;
BA_ "GenSigTimeoutTime_BPCM" SG_ 1963 HVBatCellVoltage_Cell397 0;
BA_ "GenSigTimeoutTime_IDCM" SG_ 1963 HVBatCellVoltage_Cell396 0;
BA_ "GenSigTimeoutTime_EVCU2" SG_ 1963 HVBatCellVoltage_Cell396 0;
BA_ "GenSigTimeoutTime_BPCM" SG_ 1963 HVBatCellVoltage_Cell396 0;
BA_ "GenSigTimeoutTime_IDCM" SG_ 1963 HVBatCellVoltage_Cell395 0;
BA_ "GenSigTimeoutTime_EVCU2" SG_ 1963 HVBatCellVoltage_Cell395 0;
BA_ "GenSigTimeoutTime_BPCM" SG_ 1963 HVBatCellVoltage_Cell395 0;
BA_ "GenSigTimeoutTime_IDCM" SG_ 1963 HVBatCellVoltage_Cell394 0;
BA_ "GenSigTimeoutTime_EVCU2" SG_ 1963 HVBatCellVoltage_Cell394 0;
BA_ "GenSigTimeoutTime_BPCM" SG_ 1963 HVBatCellVoltage_Cell394 0;
BA_ "GenSigTimeoutTime_IDCM" SG_ 1963 HVBatCellVoltage_Cell393 0;
BA_ "GenSigTimeoutTime_EVCU2" SG_ 1963 HVBatCellVoltage_Cell393 0;
BA_ "GenSigTimeoutTime_BPCM" SG_ 1963 HVBatCellVoltage_Cell393 0;
BA_ "GenSigTimeoutTime_IDCM" SG_ 1962 HVBatCellVoltage_Cell392 0;
BA_ "GenSigTimeoutTime_EVCU2" SG_ 1962 HVBatCellVoltage_Cell392 0;
BA_ "GenSigTimeoutTime_BPCM" SG_ 1962 HVBatCellVoltage_Cell392 0;
BA_ "GenSigTimeoutTime_IDCM" SG_ 1962 HVBatCellVoltage_Cell391 0;
BA_ "GenSigTimeoutTime_EVCU2" SG_ 1962 HVBatCellVoltage_Cell391 0;
BA_ "GenSigTimeoutTime_BPCM" SG_ 1962 HVBatCellVoltage_Cell391 0;
BA_ "GenSigTimeoutTime_IDCM" SG_ 1962 HVBatCellVoltage_Cell390 0;
BA_ "GenSigTimeoutTime_EVCU2" SG_ 1962 HVBatCellVoltage_Cell390 0;
BA_ "GenSigTimeoutTime_BPCM" SG_ 1962 HVBatCellVoltage_Cell390 0;
BA_ "GenSigTimeoutTime_IDCM" SG_ 1962 HVBatCellVoltage_Cell389 0;
BA_ "GenSigTimeoutTime_EVCU2" SG_ 1962 HVBatCellVoltage_Cell389 0;
BA_ "GenSigTimeoutTime_BPCM" SG_ 1962 HVBatCellVoltage_Cell389 0;
BA_ "GenSigTimeoutTime_IDCM" SG_ 1962 HVBatCellVoltage_Cell388 0;
BA_ "GenSigTimeoutTime_EVCU2" SG_ 1962 HVBatCellVoltage_Cell388 0;
BA_ "GenSigTimeoutTime_BPCM" SG_ 1962 HVBatCellVoltage_Cell388 0;
BA_ "GenSigTimeoutTime_IDCM" SG_ 1962 HVBatCellVoltage_Cell387 0;
BA_ "GenSigTimeoutTime_EVCU2" SG_ 1962 HVBatCellVoltage_Cell387 0;
BA_ "GenSigTimeoutTime_BPCM" SG_ 1962 HVBatCellVoltage_Cell387 0;
BA_ "GenSigTimeoutTime_IDCM" SG_ 1962 HVBatCellVoltage_Cell386 0;
BA_ "GenSigTimeoutTime_EVCU2" SG_ 1962 HVBatCellVoltage_Cell386 0;
BA_ "GenSigTimeoutTime_BPCM" SG_ 1962 HVBatCellVoltage_Cell386 0;
BA_ "GenSigTimeoutTime_IDCM" SG_ 1962 HVBatCellVoltage_Cell385 0;
BA_ "GenSigTimeoutTime_EVCU2" SG_ 1962 HVBatCellVoltage_Cell385 0;
BA_ "GenSigTimeoutTime_BPCM" SG_ 1962 HVBatCellVoltage_Cell385 0;
BA_ "GenSigTimeoutTime_IDCM" SG_ 1962 HVBatCellVoltage_Cell384 0;
BA_ "GenSigTimeoutTime_EVCU2" SG_ 1962 HVBatCellVoltage_Cell384 0;
BA_ "GenSigTimeoutTime_BPCM" SG_ 1962 HVBatCellVoltage_Cell384 0;
BA_ "GenSigTimeoutTime_IDCM" SG_ 1962 HVBatCellVoltage_Cell383 0;
BA_ "GenSigTimeoutTime_EVCU2" SG_ 1962 HVBatCellVoltage_Cell383 0;
BA_ "GenSigTimeoutTime_BPCM" SG_ 1962 HVBatCellVoltage_Cell383 0;
BA_ "GenSigTimeoutTime_IDCM" SG_ 1962 HVBatCellVoltage_Cell382 0;
BA_ "GenSigTimeoutTime_EVCU2" SG_ 1962 HVBatCellVoltage_Cell382 0;
BA_ "GenSigTimeoutTime_BPCM" SG_ 1962 HVBatCellVoltage_Cell382 0;
BA_ "GenSigTimeoutTime_IDCM" SG_ 1962 HVBatCellVoltage_Cell381 0;
BA_ "GenSigTimeoutTime_EVCU2" SG_ 1962 HVBatCellVoltage_Cell381 0;
BA_ "GenSigTimeoutTime_BPCM" SG_ 1962 HVBatCellVoltage_Cell381 0;
BA_ "GenSigTimeoutTime_IDCM" SG_ 1962 HVBatCellVoltage_Cell380 0;
BA_ "GenSigTimeoutTime_EVCU2" SG_ 1962 HVBatCellVoltage_Cell380 0;
BA_ "GenSigTimeoutTime_BPCM" SG_ 1962 HVBatCellVoltage_Cell380 0;
BA_ "GenSigTimeoutTime_IDCM" SG_ 1962 HVBatCellVoltage_Cell379 0;
BA_ "GenSigTimeoutTime_EVCU2" SG_ 1962 HVBatCellVoltage_Cell379 0;
BA_ "GenSigTimeoutTime_BPCM" SG_ 1962 HVBatCellVoltage_Cell379 0;
BA_ "GenSigTimeoutTime_IDCM" SG_ 1962 HVBatCellVoltage_Cell378 0;
BA_ "GenSigTimeoutTime_EVCU2" SG_ 1962 HVBatCellVoltage_Cell378 0;
BA_ "GenSigTimeoutTime_BPCM" SG_ 1962 HVBatCellVoltage_Cell378 0;
BA_ "GenSigTimeoutTime_IDCM" SG_ 1962 HVBatCellVoltage_Cell377 0;
BA_ "GenSigTimeoutTime_EVCU2" SG_ 1962 HVBatCellVoltage_Cell377 0;
BA_ "GenSigTimeoutTime_BPCM" SG_ 1962 HVBatCellVoltage_Cell377 0;
BA_ "GenSigTimeoutTime_IDCM" SG_ 1962 HVBatCellVoltage_Cell376 0;
BA_ "GenSigTimeoutTime_EVCU2" SG_ 1962 HVBatCellVoltage_Cell376 0;
BA_ "GenSigTimeoutTime_BPCM" SG_ 1962 HVBatCellVoltage_Cell376 0;
BA_ "GenSigTimeoutTime_IDCM" SG_ 1962 HVBatCellVoltage_Cell375 0;
BA_ "GenSigTimeoutTime_EVCU2" SG_ 1962 HVBatCellVoltage_Cell375 0;
BA_ "GenSigTimeoutTime_BPCM" SG_ 1962 HVBatCellVoltage_Cell375 0;
BA_ "GenSigTimeoutTime_IDCM" SG_ 1962 HVBatCellVoltage_Cell374 0;
BA_ "GenSigTimeoutTime_EVCU2" SG_ 1962 HVBatCellVoltage_Cell374 0;
BA_ "GenSigTimeoutTime_BPCM" SG_ 1962 HVBatCellVoltage_Cell374 0;
BA_ "GenSigTimeoutTime_IDCM" SG_ 1962 HVBatCellVoltage_Cell373 0;
BA_ "GenSigTimeoutTime_EVCU2" SG_ 1962 HVBatCellVoltage_Cell373 0;
BA_ "GenSigTimeoutTime_BPCM" SG_ 1962 HVBatCellVoltage_Cell373 0;
BA_ "GenSigTimeoutTime_IDCM" SG_ 1962 HVBatCellVoltage_Cell372 0;
BA_ "GenSigTimeoutTime_EVCU2" SG_ 1962 HVBatCellVoltage_Cell372 0;
BA_ "GenSigTimeoutTime_BPCM" SG_ 1962 HVBatCellVoltage_Cell372 0;
BA_ "GenSigTimeoutTime_IDCM" SG_ 1962 HVBatCellVoltage_Cell371 0;
BA_ "GenSigTimeoutTime_EVCU2" SG_ 1962 HVBatCellVoltage_Cell371 0;
BA_ "GenSigTimeoutTime_BPCM" SG_ 1962 HVBatCellVoltage_Cell371 0;
BA_ "GenSigTimeoutTime_IDCM" SG_ 1962 HVBatCellVoltage_Cell370 0;
BA_ "GenSigTimeoutTime_EVCU2" SG_ 1962 HVBatCellVoltage_Cell370 0;
BA_ "GenSigTimeoutTime_BPCM" SG_ 1962 HVBatCellVoltage_Cell370 0;
BA_ "GenSigTimeoutTime_IDCM" SG_ 1962 HVBatCellVoltage_Cell369 0;
BA_ "GenSigTimeoutTime_EVCU2" SG_ 1962 HVBatCellVoltage_Cell369 0;
BA_ "GenSigTimeoutTime_BPCM" SG_ 1962 HVBatCellVoltage_Cell369 0;
BA_ "GenSigTimeoutTime_IDCM" SG_ 1962 HVBatCellVoltage_Cell368 0;
BA_ "GenSigTimeoutTime_EVCU2" SG_ 1962 HVBatCellVoltage_Cell368 0;
BA_ "GenSigTimeoutTime_BPCM" SG_ 1962 HVBatCellVoltage_Cell368 0;
BA_ "GenSigTimeoutTime_IDCM" SG_ 1962 HVBatCellVoltage_Cell367 0;
BA_ "GenSigTimeoutTime_EVCU2" SG_ 1962 HVBatCellVoltage_Cell367 0;
BA_ "GenSigTimeoutTime_BPCM" SG_ 1962 HVBatCellVoltage_Cell367 0;
BA_ "GenSigTimeoutTime_IDCM" SG_ 1962 HVBatCellVoltage_Cell366 0;
BA_ "GenSigTimeoutTime_EVCU2" SG_ 1962 HVBatCellVoltage_Cell366 0;
BA_ "GenSigTimeoutTime_BPCM" SG_ 1962 HVBatCellVoltage_Cell366 0;
BA_ "GenSigTimeoutTime_IDCM" SG_ 1962 HVBatCellVoltage_Cell365 0;
BA_ "GenSigTimeoutTime_EVCU2" SG_ 1962 HVBatCellVoltage_Cell365 0;
BA_ "GenSigTimeoutTime_BPCM" SG_ 1962 HVBatCellVoltage_Cell365 0;
BA_ "GenSigTimeoutTime_IDCM" SG_ 1962 HVBatCellVoltage_Cell364 0;
BA_ "GenSigTimeoutTime_EVCU2" SG_ 1962 HVBatCellVoltage_Cell364 0;
BA_ "GenSigTimeoutTime_BPCM" SG_ 1962 HVBatCellVoltage_Cell364 0;
BA_ "GenSigTimeoutTime_IDCM" SG_ 1962 HVBatCellVoltage_Cell363 0;
BA_ "GenSigTimeoutTime_EVCU2" SG_ 1962 HVBatCellVoltage_Cell363 0;
BA_ "GenSigTimeoutTime_BPCM" SG_ 1962 HVBatCellVoltage_Cell363 0;
BA_ "GenSigTimeoutTime_IDCM" SG_ 1962 HVBatCellVoltage_Cell362 0;
BA_ "GenSigTimeoutTime_EVCU2" SG_ 1962 HVBatCellVoltage_Cell362 0;
BA_ "GenSigTimeoutTime_BPCM" SG_ 1962 HVBatCellVoltage_Cell362 0;
BA_ "GenSigTimeoutTime_IDCM" SG_ 1962 HVBatCellVoltage_Cell361 0;
BA_ "GenSigTimeoutTime_EVCU2" SG_ 1962 HVBatCellVoltage_Cell361 0;
BA_ "GenSigTimeoutTime_BPCM" SG_ 1962 HVBatCellVoltage_Cell361 0;
BA_ "GenSigTimeoutTime_IDCM" SG_ 1961 HVBatCellVoltage_Cell360 0;
BA_ "GenSigTimeoutTime_EVCU2" SG_ 1961 HVBatCellVoltage_Cell360 0;
BA_ "GenSigTimeoutTime_BPCM" SG_ 1961 HVBatCellVoltage_Cell360 0;
BA_ "GenSigTimeoutTime_IDCM" SG_ 1961 HVBatCellVoltage_Cell359 0;
BA_ "GenSigTimeoutTime_EVCU2" SG_ 1961 HVBatCellVoltage_Cell359 0;
BA_ "GenSigTimeoutTime_BPCM" SG_ 1961 HVBatCellVoltage_Cell359 0;
BA_ "GenSigTimeoutTime_IDCM" SG_ 1961 HVBatCellVoltage_Cell358 0;
BA_ "GenSigTimeoutTime_EVCU2" SG_ 1961 HVBatCellVoltage_Cell358 0;
BA_ "GenSigTimeoutTime_BPCM" SG_ 1961 HVBatCellVoltage_Cell358 0;
BA_ "GenSigTimeoutTime_IDCM" SG_ 1961 HVBatCellVoltage_Cell357 0;
BA_ "GenSigTimeoutTime_EVCU2" SG_ 1961 HVBatCellVoltage_Cell357 0;
BA_ "GenSigTimeoutTime_BPCM" SG_ 1961 HVBatCellVoltage_Cell357 0;
BA_ "GenSigTimeoutTime_IDCM" SG_ 1961 HVBatCellVoltage_Cell356 0;
BA_ "GenSigTimeoutTime_EVCU2" SG_ 1961 HVBatCellVoltage_Cell356 0;
BA_ "GenSigTimeoutTime_BPCM" SG_ 1961 HVBatCellVoltage_Cell356 0;
BA_ "GenSigTimeoutTime_IDCM" SG_ 1961 HVBatCellVoltage_Cell355 0;
BA_ "GenSigTimeoutTime_EVCU2" SG_ 1961 HVBatCellVoltage_Cell355 0;
BA_ "GenSigTimeoutTime_BPCM" SG_ 1961 HVBatCellVoltage_Cell355 0;
BA_ "GenSigTimeoutTime_IDCM" SG_ 1961 HVBatCellVoltage_Cell354 0;
BA_ "GenSigTimeoutTime_EVCU2" SG_ 1961 HVBatCellVoltage_Cell354 0;
BA_ "GenSigTimeoutTime_BPCM" SG_ 1961 HVBatCellVoltage_Cell354 0;
BA_ "GenSigTimeoutTime_IDCM" SG_ 1961 HVBatCellVoltage_Cell353 0;
BA_ "GenSigTimeoutTime_EVCU2" SG_ 1961 HVBatCellVoltage_Cell353 0;
BA_ "GenSigTimeoutTime_BPCM" SG_ 1961 HVBatCellVoltage_Cell353 0;
BA_ "GenSigTimeoutTime_IDCM" SG_ 1961 HVBatCellVoltage_Cell352 0;
BA_ "GenSigTimeoutTime_EVCU2" SG_ 1961 HVBatCellVoltage_Cell352 0;
BA_ "GenSigTimeoutTime_BPCM" SG_ 1961 HVBatCellVoltage_Cell352 0;
BA_ "GenSigTimeoutTime_IDCM" SG_ 1961 HVBatCellVoltage_Cell351 0;
BA_ "GenSigTimeoutTime_EVCU2" SG_ 1961 HVBatCellVoltage_Cell351 0;
BA_ "GenSigTimeoutTime_BPCM" SG_ 1961 HVBatCellVoltage_Cell351 0;
BA_ "GenSigTimeoutTime_IDCM" SG_ 1961 HVBatCellVoltage_Cell350 0;
BA_ "GenSigTimeoutTime_EVCU2" SG_ 1961 HVBatCellVoltage_Cell350 0;
BA_ "GenSigTimeoutTime_BPCM" SG_ 1961 HVBatCellVoltage_Cell350 0;
BA_ "GenSigTimeoutTime_IDCM" SG_ 1961 HVBatCellVoltage_Cell349 0;
BA_ "GenSigTimeoutTime_EVCU2" SG_ 1961 HVBatCellVoltage_Cell349 0;
BA_ "GenSigTimeoutTime_BPCM" SG_ 1961 HVBatCellVoltage_Cell349 0;
BA_ "GenSigTimeoutTime_IDCM" SG_ 1961 HVBatCellVoltage_Cell348 0;
BA_ "GenSigTimeoutTime_EVCU2" SG_ 1961 HVBatCellVoltage_Cell348 0;
BA_ "GenSigTimeoutTime_BPCM" SG_ 1961 HVBatCellVoltage_Cell348 0;
BA_ "GenSigTimeoutTime_IDCM" SG_ 1961 HVBatCellVoltage_Cell347 0;
BA_ "GenSigTimeoutTime_EVCU2" SG_ 1961 HVBatCellVoltage_Cell347 0;
BA_ "GenSigTimeoutTime_BPCM" SG_ 1961 HVBatCellVoltage_Cell347 0;
BA_ "GenSigTimeoutTime_IDCM" SG_ 1961 HVBatCellVoltage_Cell346 0;
BA_ "GenSigTimeoutTime_EVCU2" SG_ 1961 HVBatCellVoltage_Cell346 0;
BA_ "GenSigTimeoutTime_BPCM" SG_ 1961 HVBatCellVoltage_Cell346 0;
BA_ "GenSigTimeoutTime_IDCM" SG_ 1961 HVBatCellVoltage_Cell345 0;
BA_ "GenSigTimeoutTime_EVCU2" SG_ 1961 HVBatCellVoltage_Cell345 0;
BA_ "GenSigTimeoutTime_BPCM" SG_ 1961 HVBatCellVoltage_Cell345 0;
BA_ "GenSigTimeoutTime_IDCM" SG_ 1961 HVBatCellVoltage_Cell344 0;
BA_ "GenSigTimeoutTime_EVCU2" SG_ 1961 HVBatCellVoltage_Cell344 0;
BA_ "GenSigTimeoutTime_BPCM" SG_ 1961 HVBatCellVoltage_Cell344 0;
BA_ "GenSigTimeoutTime_IDCM" SG_ 1961 HVBatCellVoltage_Cell343 0;
BA_ "GenSigTimeoutTime_EVCU2" SG_ 1961 HVBatCellVoltage_Cell343 0;
BA_ "GenSigTimeoutTime_BPCM" SG_ 1961 HVBatCellVoltage_Cell343 0;
BA_ "GenSigTimeoutTime_IDCM" SG_ 1961 HVBatCellVoltage_Cell342 0;
BA_ "GenSigTimeoutTime_EVCU2" SG_ 1961 HVBatCellVoltage_Cell342 0;
BA_ "GenSigTimeoutTime_BPCM" SG_ 1961 HVBatCellVoltage_Cell342 0;
BA_ "GenSigTimeoutTime_IDCM" SG_ 1961 HVBatCellVoltage_Cell341 0;
BA_ "GenSigTimeoutTime_EVCU2" SG_ 1961 HVBatCellVoltage_Cell341 0;
BA_ "GenSigTimeoutTime_BPCM" SG_ 1961 HVBatCellVoltage_Cell341 0;
BA_ "GenSigTimeoutTime_IDCM" SG_ 1961 HVBatCellVoltage_Cell340 0;
BA_ "GenSigTimeoutTime_EVCU2" SG_ 1961 HVBatCellVoltage_Cell340 0;
BA_ "GenSigTimeoutTime_BPCM" SG_ 1961 HVBatCellVoltage_Cell340 0;
BA_ "GenSigTimeoutTime_IDCM" SG_ 1961 HVBatCellVoltage_Cell339 0;
BA_ "GenSigTimeoutTime_EVCU2" SG_ 1961 HVBatCellVoltage_Cell339 0;
BA_ "GenSigTimeoutTime_BPCM" SG_ 1961 HVBatCellVoltage_Cell339 0;
BA_ "GenSigTimeoutTime_IDCM" SG_ 1961 HVBatCellVoltage_Cell338 0;
BA_ "GenSigTimeoutTime_EVCU2" SG_ 1961 HVBatCellVoltage_Cell338 0;
BA_ "GenSigTimeoutTime_BPCM" SG_ 1961 HVBatCellVoltage_Cell338 0;
BA_ "GenSigTimeoutTime_IDCM" SG_ 1961 HVBatCellVoltage_Cell337 0;
BA_ "GenSigTimeoutTime_EVCU2" SG_ 1961 HVBatCellVoltage_Cell337 0;
BA_ "GenSigTimeoutTime_BPCM" SG_ 1961 HVBatCellVoltage_Cell337 0;
BA_ "GenSigTimeoutTime_IDCM" SG_ 1961 HVBatCellVoltage_Cell336 0;
BA_ "GenSigTimeoutTime_EVCU2" SG_ 1961 HVBatCellVoltage_Cell336 0;
BA_ "GenSigTimeoutTime_BPCM" SG_ 1961 HVBatCellVoltage_Cell336 0;
BA_ "GenSigTimeoutTime_IDCM" SG_ 1961 HVBatCellVoltage_Cell335 0;
BA_ "GenSigTimeoutTime_EVCU2" SG_ 1961 HVBatCellVoltage_Cell335 0;
BA_ "GenSigTimeoutTime_BPCM" SG_ 1961 HVBatCellVoltage_Cell335 0;
BA_ "GenSigTimeoutTime_IDCM" SG_ 1961 HVBatCellVoltage_Cell334 0;
BA_ "GenSigTimeoutTime_EVCU2" SG_ 1961 HVBatCellVoltage_Cell334 0;
BA_ "GenSigTimeoutTime_BPCM" SG_ 1961 HVBatCellVoltage_Cell334 0;
BA_ "GenSigTimeoutTime_IDCM" SG_ 1961 HVBatCellVoltage_Cell333 0;
BA_ "GenSigTimeoutTime_EVCU2" SG_ 1961 HVBatCellVoltage_Cell333 0;
BA_ "GenSigTimeoutTime_BPCM" SG_ 1961 HVBatCellVoltage_Cell333 0;
BA_ "GenSigTimeoutTime_IDCM" SG_ 1961 HVBatCellVoltage_Cell332 0;
BA_ "GenSigTimeoutTime_EVCU2" SG_ 1961 HVBatCellVoltage_Cell332 0;
BA_ "GenSigTimeoutTime_BPCM" SG_ 1961 HVBatCellVoltage_Cell332 0;
BA_ "GenSigTimeoutTime_IDCM" SG_ 1961 HVBatCellVoltage_Cell331 0;
BA_ "GenSigTimeoutTime_EVCU2" SG_ 1961 HVBatCellVoltage_Cell331 0;
BA_ "GenSigTimeoutTime_BPCM" SG_ 1961 HVBatCellVoltage_Cell331 0;
BA_ "GenSigTimeoutTime_IDCM" SG_ 1961 HVBatCellVoltage_Cell330 0;
BA_ "GenSigTimeoutTime_EVCU2" SG_ 1961 HVBatCellVoltage_Cell330 0;
BA_ "GenSigTimeoutTime_BPCM" SG_ 1961 HVBatCellVoltage_Cell330 0;
BA_ "GenSigTimeoutTime_IDCM" SG_ 1961 HVBatCellVoltage_Cell329 0;
BA_ "GenSigTimeoutTime_EVCU2" SG_ 1961 HVBatCellVoltage_Cell329 0;
BA_ "GenSigTimeoutTime_BPCM" SG_ 1961 HVBatCellVoltage_Cell329 0;
VAL_ 500 BMS_HV_NumCellMinTemp 511 "SNA" ;
VAL_ 500 BMS_HV_NumCellMaxTemp 511 "SNA" ;
VAL_ 500 BMS_Cell_Volt_Min 8191 "SNA" ;
VAL_ 500 BMS_Cell_Volt_Max 8191 "SNA" ;
VAL_ 250 APM_Water_Temp 255 "SNA" ;
VAL_ 250 APM_RecoveryAction 1 "APM_Not_working" 2 "APM_safe_state" 3 "APM_safe_state_and_not_working" 4 "APM_voltage_control_mode" 5 "APM_wake_up_loss" 6 "APM_safe_state_and_voltage_control_mode" 8 "Wake_up_loss" 16 "Eeprom_loss" ;
VAL_ 250 APM_PSFB_Temp2 4095 "SNA" ;
VAL_ 250 APM_PSFB_Temp1 4095 "SNA" ;
VAL_ 250 APM_LV_V_Fbk 4095 "SNA" ;
VAL_ 250 APM_LV_I_Fbk 4095 "SNA" ;
VAL_ 250 APM_HV_V_Fbk 4095 "SNA" ;
VAL_ 250 APM_HV_I_Fbk 4095 "SNA" ;
VAL_ 250 APM_Buck_Temp 4095 "SNA" ;
VAL_ 250 APM_UtilPctOfDCDC 127 "SNA" ;
VAL_ 250 APM_TempColdPlate 254 "Failure" 255 "SNA" ;
VAL_ 250 APM_OutputPower 1023 "SNA" ;
VAL_ 250 APM_InputPower 1023 "SNA" ;
VAL_ 250 APM_IdcHvSetPFdbk 1023 "SNA" ;
VAL_ 250 APM_HvVsetPFdbk 511 "SNA" ;
VAL_ 250 APM_FailureType 0 "No_failure" 1 "Failure_chargingInhibited" 2 "Failure_chargingAllowed" 3 "SNA" ;
VAL_ 250 APM_FailureReason 0 "No_Failure" 1 "Fail_high_voltage_at_HV" 2 "Fail_low_voltage_at_HV" 3 "Fail_high_voltage_at_LV" 4 "Fail_low_voltage_at_LV" 5 "Fail_high_PCB_temperature" 6 "Fail_high_DCB_temperature" 7 "Fail_high_cur_at_LV" 8 "Fail_high_cur_at_HV" 9 "Fail_short_circ_at_LV" 10 "Fail_short_circ_at_HV" 11 "Fail_open_circ_at_LV" 12 "Fail_open_circ_at_HV" 13 "Fail_init_failure" 14 "Fail_wake_up_issue" 15 "Fail_internal_hardware" 16 "Fail_bat_feed_low" 17 "Fail_bat_feed_high" 18 "Fail_Aux_OV" 19 "Fail_Aux_UV" 20 "Fail_HVIL_fault" 21 "Fail_LOC_with_HCP" 22 "Fail_LOC_with_BPCM" 23 "Fail_cont_not_closed" 24 "Fail_SBC_fault" 25 "Memory_Fail" 26 "Implausible_data_from_HCP" 27 "Implausible_data_from_BPCM" 28 "CAN_bus_off" 29 "Fail_temp_diff_is_high" 30 "Fail_high_voltage_diff_is_high" 31 "Fail_for_other_reason" 32 "LOC_ORC" 33 "Implausble_data_ORC" 63 "SNA" ;
VAL_ 250 APM_EstPwrLoss 255 "SNA" ;
VAL_ 250 APM_DeratingReason 0 "No_derating" 1 "high_temp_De_rating" 2 "low_temp_De_rating" 3 "OverVolt_HV_De_rating" 4 "lowVolt_HV_De_rating" 5 "highVolt_LV_De_rating" 6 "lowVolt_LV_De_rating" 7 "highCurrent_LV_Current_limit" 8 "internal_HD_fail_De_rating" 9 "high_current_HV_De_rating" 31 "SNA" ;
VAL_ 250 APM_DeratingModeStatus 0 "No_derating" 1 "Derating_Initialized" 2 "Derating_Initialized_Failure" 3 "Derating_Mode" 7 "SNA" ;
VAL_ 250 APM_CtrlSts_Fbk 0 "IDLE" 1 "Buck_CV_voltage" 2 "Buck_CC_current_control" 3 "APM_Temporary_Fault" 4 "Buck_Special" 6 "PreCharge" 7 "DisCharge" 8 "OFF" 9 "Derating" 10 "APM_Critical_Fault" 15 "SNA" ;
VAL_ 250 APM_DeratingPower 63 "SNA" ;
VAL_ 546 VDCM_EV_Batt_Max_T_Limit 255 "SNA" ;
VAL_ 546 VDCM_ChrgMode_Req 0 "init" 1 "constant voltage charge" 2 "constant curent charge" 255 "SNA" ;
VAL_ 546 VDCM_ChrgCurrDeviationErr 0 "Charge Current  OK" 1 "Charge current in error" ;
VAL_ 546 VDCM_ChrgCompleteReason 0 "SOC_tgt_reached" 1 "Vcell_tgt_reached" 2 "Vbat_tgt_reached" 3 "User_req" ;
VAL_ 546 VDCM_BattUnderVolt 0 "Voltage OK" 1 "Battery Under Voltage" ;
VAL_ 546 VDCM_BattOverVolt 0 "Voltage OK" 1 "Battery Over Voltage" ;
VAL_ 546 VDCM_BattFullSOC_prc 255 "SNA" ;
VAL_ 546 CPIM_Over_Temperature 0 "Battery_OK" 1 "Over_temperature" ;
VAL_ 546 CPIM_Error 0 "CPIM_OK" 1 "CPIM_error" ;
VAL_ 546 WeldCheck_Complete 0 "FALSE" 1 "TRUE" ;
VAL_ 546 VDCM_SOCIsOOR 0 "Normal" 1 "Too_Low" 2 "Too High" 3 "SNA" ;
VAL_ 546 VDCM_ChargeCurrIsOOR 0 "Normal" 1 "Too_Low" 2 "Too High" 3 "SNA" ;
VAL_ 546 VDCM_CellVoltIsOOR 0 "Normal" 1 "Too_Low" 2 "Too High" 3 "SNA" ;
VAL_ 546 VDCM_BattTempIsOOR 0 "Normal" 1 "Too_Low" 2 "Too High" 3 "SNA" ;
VAL_ 546 ReadyToChargeState 0 "FALSE" 1 "TRUE" ;
VAL_ 546 HCP_SessionStopCmd 0 "FALSE" 1 "TRUE" ;
VAL_ 546 HCP_DC_Retry 0 "No_Rety_Command" 1 "SupportedAppProtocolReq" 2 "SessionSetupRrq" 3 "ServiceDiscoveryReq." 4 "ServicePaymentSelectionReq" 5 "Contract_AuthenticationReq" 6 "ChargeParameterDiscoveryReq" 7 "CableCheckReq" 8 "Pre_ChargeReq" 9 "PowerDeliveryReq_Precharge" 10 "CurrentDemandReq" 11 "PowerDeliveryReq_EnergyTransfer" 12 "WeldingDetectionReq" 13 "SessionStopReq" 31 "SNA" ;
VAL_ 546 BMS_Max_Pk_Volt_Allowed_VDCM 1023 "SNA" ;
VAL_ 546 BMS_Max_Cell_Volt_Allowed_Vldty_ 0 "Valid" 1 "Not_Valid" ;
VAL_ 546 BMS_Max_Cell_Volt_Allowed_VDCM 8191 "SNA" ;
VAL_ 546 BMS_HV_Trac_PreCha_Contac_Sts_VD 0 "Open" 1 "Closed" 3 "Error_Stuck_Open" 4 "Error_Stuck_Closed" 7 "SNA" ;
VAL_ 546 BMS_HV_Trac_Main_Contac_Sts_VDCM 0 "Open" 1 "Closed" 3 "Error_Stuck_Open" 4 "Error_Stuck_Closed" 7 "SNA" ;
VAL_ 546 BMS_HV_Temperature_Min_VDCM 2047 "SNA" ;
VAL_ 546 BMS_HV_Temperature_Max_VDCM 2047 "SNA" ;
VAL_ 546 BMS_HV_SOC_AccuracySts_VDCM 0 "Invalid" 1 "High_Accuracy_SOC" 2 "Low_Accuracy_SOC" 3 "SNA" ;
VAL_ 546 BMS_HV_NumCellMinTemp_VDCM 511 "SNA" ;
VAL_ 546 BMS_HV_NumCellMaxVolt_VDCM 255 "SNA" ;
VAL_ 546 BMS_HV_NumCellMaxTemp_VDCM 511 "SNA" ;
VAL_ 546 BMS_HV_InternalVoltage_VDCM 8191 "SNA" ;
VAL_ 546 BMS_HV_Common_Contactor_Sts_VDCM 0 "Open" 1 "Closed" 2 "Error_Stuck_Open" 3 "Error_Stuck_Closed" 7 "SNA" ;
VAL_ 546 BMS_HV_Battery_GFD_Sts_VDCM 0 "GFD_Not_Performed" 1 "GFD_OK" 2 "GFD_Fail" 3 "GFD_INVALID_meas_noise" ;
VAL_ 546 BMS_HV_BatIntrlk_InternalStat_VD 0 "Not_Performed" 1 "OK" 2 "Fail" 3 "Invalid" ;
VAL_ 546 BMS_HV_AC_Char_Main_Contac_Sts_V 0 "Open" 1 "Closed" 3 "Error_Stuck_Open" 4 "Error_Stuck_Closed" 7 "SNA" ;
VAL_ 546 BMS_Cell_Volt_Min_Vldty_VDCM 0 "Valid" 1 "Not_Valid" ;
VAL_ 546 BMS_Cell_Volt_Min_VDCM 8191 "SNA" ;
VAL_ 546 BMS_Cell_Volt_Max_Vldty_VDCM 0 "Valid" 1 "Not_Valid" ;
VAL_ 546 BMS_Cell_Volt_Max_VDCM 8191 "SNA" ;
VAL_ 546 BMS_HV_Char_PreCha_Contac_Sts_VD 0 "Open" 1 "Closed" 3 "Error_Stuck_Open" 4 "Error_Stuck_Closed" 7 "SNA" ;
VAL_ 546 BMS_HV_Char_Main_Contac_Sts_VDCM 0 "Open" 1 "Closed" 3 "Error_Stuck_Open" 4 "Error_Stuck_Closed" 7 "SNA" ;
VAL_ 546 BMS_HV_TractionBusVoltage_VDCM 1023 "SNA" ;
VAL_ 546 BMS_HV_Trac_Bus_Sts_VDCM 0 "OPEN" 1 "CLOSED" 2 "PRECHARGING" 3 "PRECHARGING FAILED" 4 "PRECHARGING INHIBITED" 7 "SNA" ;
VAL_ 546 BMS_HV_ChargingBusVoltage_VDCM 1023 "SNA" ;
VAL_ 546 BMS_HV_Char_Bus_Sts_VDCM 0 "OPEN" 1 "CLOSED" 2 "PRECHARGING" 3 "PRECHARGING FAILED" 4 "PRECHARGING INHIBITED" 7 "SNA" ;
VAL_ 546 BMS_HV_BatState_VDCM 0 "Sleep" 1 "Initialization" 2 "Idle" 3 "Bus_Acv_Deac" 5 "Ready_Main" 6 "Ready_Aux" 7 "Ready_Full" 10 "Deactivation" 13 "Powerlatch" 14 "Service_Mode" 15 "CRITICAL_ERROR" ;
VAL_ 546 BMS_HV_BatActualPower_VDCM 32767 "SNA" ;
VAL_ 546 VDCM_ChargingPermitting 0 "Forbidden" 1 "Permissive" ;
VAL_ 546 GBT_Target_Voltage_Reached 0 "Not_Reached" 1 "Reached" 2 "SNA" ;
VAL_ 546 GBT_Target_Cell_Voltage_Reached 0 "Not_Reached" 1 "Reached" 2 "SNA" ;
VAL_ 546 GBT_Ready_to_Charge 0 "False" 1 "True" ;
VAL_ 546 GBT_Desired_SOC_Reached 0 "Not_Reached" 1 "Reached" 2 "SNA" ;
VAL_ 546 GBT_Charger_Active_Interruption 0 "No_Charger_Interruption" 1 "Charger_Interruption" 2 "SNA" ;
VAL_ 544 Plug_Locked_by_EVSE 0 "EVSE_Not_Locked" 1 "EVSE_Locked" 2 "Init" 3 "SNA" ;
VAL_ 544 HVCMS_EVSEID -2147483648 "SNA" ;
VAL_ 544 ExtChargerSts 0 "Standby" 1 "Charging" 2 "Init" 3 "SNA" ;
VAL_ 544 EVSE_Error 0 "No_Error" 1 "Error" 2 "Init" 3 "SNA" ;
VAL_ 544 EVSE_ChrgStopControl 0 "No_Chrg_Stp_Cntrl" 1 "Chrg_Stop_Cntrl" 2 "Init" 3 "SNA" ;
VAL_ 544 Charger_WeldingDetectAvail 0 "Not_Available" 1 "Available" 2 "Init" 3 "SNA" ;
VAL_ 544 Charger_StndbyReqReason 0 "SetUpCond_Reached" 1 "BMS_Req" 2 "Charger_Fault" 3 "User_Req" 6 "Init" 7 "SNA" ;
VAL_ 544 Charger_StndbyReq 0 "Stnby_Not_Requested" 1 "Stnby_Requested" 2 "Init" 3 "SNA" ;
VAL_ 544 Charger_FaultStates 0 "NoFault" 1 "EmergencyShdwnFault" 2 "UnableToSupplyReqPower" 3 "OverTemperature" 4 "InnerOverTemperature" 5 "AbnormalVoltage" 6 "CurrentNotMatching" 7 "ConnectorFault" 8 "OtherFault" 14 "Init" 15 "SNA" ;
VAL_ 544 CC2VoltDetError 0 "Volt_Det_ok" 1 "Volt_Det_Error" 2 "Init" 3 "SNA" ;
VAL_ 544 OBCM_CSSts 0 "CS_IN" 1 "CS_OUT" 2 "CS_FAIL" ;
VAL_ 544 OBCM_CP3Sts 0 "Charge permission disabled" 1 "Charge permission enabled" 3 "HW_Fault" ;
VAL_ 544 OBCM_CP2Sts 0 "EVSE_not_ready" 1 "EVSE_ready" 2 "VOOR" 3 "HW_Fault" ;
VAL_ 544 OBCM_CCSts 0 "CC_LO" 1 "CC_OUT" 2 "CC_IN" 3 "CC_HI" 4 "CC_FAIL" ;
VAL_ 544 OBCM_APAMSts 0 "APAM_Off" 1 "APAM_On" 2 "HW_Failure" ;
VAL_ 544 TCP_Communication_Terminated 0 "FALSE" 1 "TRUE" ;
VAL_ 544 OBCM_CP1Sts 0 "NO_EVSE" 1 "CP_DET" 2 "VOOR" 3 "EVSE_NO_AC" 4 "HW_FAULT" ;
VAL_ 544 TxGBTMessageResponse 0 "EVSE_Not_Connected" 1 "CHM" 2 "CRM.BMS cant be recognized" 3 "CRM.BMS recognized" 4 "CML" 5 "CRO.Charger not ready" 6 "CRO.Charger ready" 7 "CCS" 8 "CST" 9 "CSD" 31 "SNA" ;
VAL_ 544 TxGBTMessageRequest 0 "EVSE_Not_Connected" 1 "BHM" 2 "BRM" 3 "BCP" 4 "BRO_BMS_Not_Ready" 5 "BRO_BMS_Ready" 6 "BCL" 7 "BCS" 8 "BSM" 9 "BST" 10 "BSD" 31 "SNA" ;
VAL_ 544 OBCM_Timeout 0 "False" 1 "True" ;
VAL_ 544 EVCC_FailureSts 0 "No_Failure" 1 "Failure" ;
VAL_ 544 CC2_VoltageValue 255 "SNA" ;
VAL_ 544 GBT_EVSE_Charge_Permitting 0 "Pause" 1 "Permissive" ;
VAL_ 1790 BMS_HV_SOC_AccuracySts 0 "Invalid" 1 "High_Accuracy_SOC" 2 "Low_Accuracy_SOC" 3 "SNA" ;
VAL_ 1790 HEV_OnRq_BPCM 0 "FALSE" 1 "TRUE" ;
VAL_ 105 ClrLgsDiagInfo 0 "FALSE" 1 "TRUE" ;
VAL_ 1062 MCPA_Temp 255 "SNA" ;
VAL_ 1893 HVBatModuleTemp_66 255 "SNA" ;
VAL_ 1893 HVBatModuleTemp_65 255 "SNA" ;
VAL_ 1893 HVBatModuleTemp_64 255 "SNA" ;
VAL_ 1893 HVBatModuleTemp_63 255 "SNA" ;
VAL_ 1893 HVBatModuleTemp_62 255 "SNA" ;
VAL_ 1893 HVBatModuleTemp_61 255 "SNA" ;
VAL_ 1893 HVBatModuleTemp_60 255 "SNA" ;
VAL_ 1893 HVBatModuleTemp_59 255 "SNA" ;
VAL_ 1893 HVBatModuleTemp_58 255 "SNA" ;
VAL_ 1893 HVBatModuleTemp_57 255 "SNA" ;
VAL_ 1893 HVBatModuleTemp_56 255 "SNA" ;
VAL_ 1893 HVBatModuleTemp_55 255 "SNA" ;
VAL_ 1893 HVBatModuleTemp_54 255 "SNA" ;
VAL_ 1893 HVBatModuleTemp_41 255 "SNA" ;
VAL_ 1893 HVBatModuleTemp_40 255 "SNA" ;
VAL_ 1893 HVBatModuleTemp_39 255 "SNA" ;
VAL_ 1893 HVBatModuleVoltage_NumMin 63 "SNA" ;
VAL_ 1893 HVBatModuleVoltage_NumMax 63 "SNA" ;
VAL_ 1893 HVBatModuleTemp_53 255 "SNA" ;
VAL_ 1893 HVBatModuleTemp_52 255 "SNA" ;
VAL_ 1893 HVBatModuleTemp_51 255 "SNA" ;
VAL_ 1893 HVBatModuleTemp_50 255 "SNA" ;
VAL_ 1893 HVBatModuleTemp_49 255 "SNA" ;
VAL_ 1893 HVBatModuleTemp_48 255 "SNA" ;
VAL_ 1893 HVBatModuleTemp_47 255 "SNA" ;
VAL_ 1893 HVBatModuleTemp_46 255 "SNA" ;
VAL_ 1893 HVBatModuleTemp_45 255 "SNA" ;
VAL_ 1893 HVBatModuleTemp_44 255 "SNA" ;
VAL_ 1893 HVBatModuleTemp_43 255 "SNA" ;
VAL_ 1893 HVBatModuleTemp_42 255 "SNA" ;
VAL_ 1031 InputCurrentAvailable 511 "SNA" ;
VAL_ 1031 AC_Side_Volt3 8191 "SNA" ;
VAL_ 1031 AC_Side_Volt2 8191 "SNA" ;
VAL_ 1031 AC_Side_Volt1 8191 "SNA" ;
VAL_ 1031 AC_Side_Curr3 2047 "SNA" ;
VAL_ 1031 AC_Side_Curr2 2047 "SNA" ;
VAL_ 1031 AC_Side_Curr1 2047 "SNA" ;
VAL_ 1031 ProximitySts 0 "PROX_LO" 1 "Prox_Out" 2 "Prox_In" 3 "Prox_Un" 4 "VOOR" 5 "PROX_HI" ;
VAL_ 1031 OBCM_SlacSts 0 "SLAC_NOT_PERFORMED" 1 "EVSE_FOUND" 2 "EVSE_NOT_FOUND" 3 "FAILURE" ;
VAL_ 1031 OBCM_SdpSts 0 "SPD_NOT_PERFORMED" 1 "CONN_ESTABLISHED" 2 "CONN_NOT_ESTABLISHED" 3 "FAILURE" ;
VAL_ 1031 OBCInterlockSts 0 "Not_Performed" 1 "OK" 2 "Fail" 3 "Invalid" ;
VAL_ 1031 OBC_DeratingReason 0 "No_Derating" 1 "High_Temp_Derating" 2 "Low_Temp_Derating" 3 "Input_Voltage_Limit" 4 "Input_Current_Limit" 5 "Output_Voltage_Limit" 6 "Output_Current_Limit" 7 "Internal_Fault_Derating" 8 "High_Charge_Inlet_Temperature" ;
VAL_ 1031 J1772_State 0 "STATE_A" 1 "STATE_B" 2 "STATE_C" 3 "STATE_D" 4 "STATE_E" 5 "STATE_F" 7 "SNA" ;
VAL_ 1031 J1772_S2_Sts 0 "Open" 1 "Closed" ;
VAL_ 1031 ControlPilotSts 0 "NO_EVSE" 1 "CP_DET" 2 "VOOR" 3 "EVSE_NO_AC" 4 "HW_FAULT" 5 "EVSE_FAULT" ;
VAL_ 1031 ChargeEnableSts 0 "NotCharging" 1 "Charging" 3 "SNA" ;
VAL_ 1031 ChargeCurrentAvailable 1023 "SNA" ;
VAL_ 1031 ChargeCurrent 1023 "SNA" ;
VAL_ 1031 BatterySideCurrent 2047 "SNA" ;
VAL_ 1031 AC_Present 0 "AC not detected" 1 "AC detected" ;
VAL_ 1031 Supported_VerNumberMinor 0 "No_Version" 1 "Version_1" 2 "Version_2" 7 "SNA" ;
VAL_ 1031 Supported_VerNumberMajor 0 "No_Version" 1 "Version_1" 2 "Version_2" 7 "SNA" ;
VAL_ 1031 Supported_SchemaID 0 "No_Schema_ID" 1 "Schema_ID_1" 2 "Schema_ID_2" 3 "Schema_ID_3" 7 "SNA" ;
VAL_ 1031 Supported_ProtocolName 0 "No_Protocol" 1 "ISO_Gen2" 2 "ISO_Gen1" 3 "DIN" 7 "SNA" ;
VAL_ 1031 EVCC_FailureReason 0 "None" 1 "SLAC_Failed." 2 "SECCDiscoverProtocol_Failed" 3 "TransportLayer_Failed" 4 "SupportAppProtocol_Failed" 5 "SessionSetup_Failed" 6 "Session Discover_Failed" 7 "ReadContrCertChain_Failed" 8 "ServiceDetail_Failed" 9 "PaymentServiceSelection_Failed" 10 "ReadRootCerts_Failed" 11 "ReadProvCert_Failed" 12 "CertificateInstallation_Failed" 13 "CertificateUpdate_Failed" 14 "PaymentDetails_Failed" 15 "Authorization_Failed" 16 "ChargeParameterDiscovery_Failed" 17 "PowerDelivery_Failed" 18 "MeteringReceipt_Failed" 19 "ChargingStatus_Failed" 20 "CableCheck_Failed" 21 "Precharge_Failed" 22 "CurrentDemand_Failed" 23 "WeldingDetection_Failed." 24 "SessionStop_Failed." 25 "StopCommunicationSession_Failed." 26 "IPAddressWaitTime" 27 "Sequence Performancetime." 28 "CommunicationSetupTime" 29 "ReadyToChargeTime" 30 "AuthorizationOngoinTime" 31 "ChrgParaDiscoveryOngoingTime" 32 "CableCheckOngoingTime." 33 "PrechargeOngoingTime." 34 "Init_ContractSelectionFailed" 35 "SDP_NoSharedSecurityOption." 36 "SDP_InvalidEnergyTransferMode." 37 "SD_NoSharedPaymentOption" 38 "SD_NoContractAndNoCertSrvcAvail" 39 "SrvcDet_NoContr_InstallSrvcAvail" 40 "TLS_Failed" 41 "V2G_Cert_Invalid" 63 "SNA" ;
VAL_ 1031 BatterySideVoltage 16383 "SNA" ;
VAL_ 1031 AC_LnLow 0 "voltage_in_range" 1 "voltage_above_threshold" ;
VAL_ 1031 AC_LnHi 0 "voltage_in_range" 1 "voltage_above_threshold" ;
VAL_ 1031 Plug_And_Charge_Contract_Sts 0 "No_Contract" 1 "Transfer_In_Progress" 2 "Contract_Load_Failed" 3 "Contract_Success" ;
VAL_ 1031 RCD 0 "No_Error" 1 "Error" ;
VAL_ 1031 EVSENominalVoltage 1023 "SNA" ;
VAL_ 1031 EVSEMaxCurrent 511 "SNA" ;
VAL_ 1063 MCPB_Temp 255 "SNA" ;
VAL_ 292 HVBatContactorWeldCheck 0 "Not_Complete" 1 "Complete" ;
VAL_ 292 HVBatReady 0 "False" 1 "True" ;
VAL_ 292 BPCM_DC_CntctrsMidTrmOpeningWarn 0 "False" 1 "True" ;
VAL_ 292 BPCM_DC_CntctrsShtTrmOpeningWarn 0 "False" 1 "True" ;
VAL_ 292 BPCM_HV_Trac_Main_Contac_Sts 0 "Open" 1 "Closed" 3 "Error_Stuck_Open" 4 "Error_Stuck_Closed" 7 "SNA" ;
VAL_ 292 BPCM_HV_BalancingMode 0 "No_balancing" 1 "Balancing_in_progress" 2 "Balancing_complete" 3 "Balancing_Error" ;
VAL_ 292 BPCM_HV_ChargingBusVoltage 2047 "SNA" ;
VAL_ 292 BPCM_HV_TractionBusVoltage 2047 "SNA" ;
VAL_ 292 BPCM_Pwr_Limp_Home_On 0 "Disable" 1 "Enable" ;
VAL_ 292 BPCM_HV_Trac_Bus_Sts 0 "Open" 1 "Closed" 2 "Precharging" 3 "Precharging_Failed" 4 "Precharging_Inhibited" 7 "SNA" ;
VAL_ 292 BPCM_HV_Char_Bus_Sts 0 "Open" 1 "Closed" 2 "Precharging" 3 "Precharging_Failed" 4 "Precharging_Inhibited" 7 "SNA" ;
VAL_ 292 BPCM_HV_SOH_Low 127 "SNA" ;
VAL_ 292 BPCM_HV_SOH 127 "SNA" ;
VAL_ 292 BPCMInterlockSts 0 "Not_Performed" 1 "OK" 2 "Fail" 3 "Invalid" 4 "Service_Disconnect" ;
VAL_ 292 BPCM_HV_BatIntrlk_InternalStat 0 "Not_Performed" 1 "OK" 2 "Fail" 3 "Invalid" ;
VAL_ 292 BPCM_HV_Temperature_Min 2047 "SNA" ;
VAL_ 292 BPCM_HV_Temperature_Max 2047 "SNA" ;
VAL_ 292 BPCM_HV_Temperature_Avg 2047 "SNA" ;
VAL_ 292 BPCM_HV_SOC 1023 "SNA" ;
VAL_ 292 BPCM_HV_Outlet_Temp 2047 "SNA" ;
VAL_ 292 BPCM_HV_InternalVoltage 16383 "SNA" ;
VAL_ 292 BPCM_HV_Inlet_Temp 2047 "SNA" ;
VAL_ 292 BPCM_HV_Current 65535 "SNA" ;
VAL_ 292 BPCM_HV_Capacity 4095 "SNA" ;
VAL_ 292 BPCM_HV_Battery_GFD_Sts 0 "GFD_Not_Performed" 1 "GFD_OK" 2 "GFD_Fail" 3 "GFD_INVALID_meas_noise" 4 "Disabled" ;
VAL_ 292 BPCM_Wakeup_Request 0 "No_Event" 1 "Wakeup_Event" ;
VAL_ 292 BPCM_HV_ThermalRunaway 0 "Default" 1 "No_Thermal_Runaway" 2 "Thermal_Runaway_Detected" 3 "SNA" ;
VAL_ 292 HVBP_Busbar_Temp 255 "SNA" ;
VAL_ 292 HVBP_BDU_Busbar_Temp 255 "SNA" ;
VAL_ 292 DC_Charge_Type_Status 1 "Ready_to_charge_at_800V" 2 "Ready_to_charge_at_400V" 3 "FAILED" 4 "Weldcheck_in_progress_800V" 7 "SNA" ;
VAL_ 292 BPCM_Request_for_Aux_Load_off 0 "False" 1 "True" ;
VAL_ 292 BPCM_HV_Trac_Main_Contac_Config 1 "Closed_Parallel" 2 "Closed_Single_B1" 3 "Closed_Single_B2" 7 "SNA" ;
VAL_ 292 BPCM_HV_DCFC_Isolation_Sts 0 "Not_Performed" 1 "No_Failure" 3 "Failure" 4 "Error" 7 "SNA" ;
VAL_ 292 BPCM_HV_Trac_PreCha_Contac_Sts 0 "Not_Performed" 1 "No_Failure" 3 "Failure" 4 "Error" 7 "SNA" ;
VAL_ 485 BPCM_HV_NumCellMinTemp 511 "SNA" ;
VAL_ 485 BPCM_HV_NumCellMaxTemp 511 "SNA" ;
VAL_ 485 BPCM_HV_NumCellMinVolt 511 "SNA" ;
VAL_ 485 BPCM_HV_NumCellMaxVolt 511 "SNA" ;
VAL_ 485 BPCM_Min_Pk_Volt_Allowed 2047 "SNA" ;
VAL_ 485 BPCM_Max_Pk_Volt_Allowed 2047 "SNA" ;
VAL_ 485 BPCM_OCV_Min_Cell_Volt 8191 "SNA" ;
VAL_ 485 BPCM_OCV_Max_Cell_Volt 8191 "SNA" ;
VAL_ 485 BPCM_OCV_Avg_Cell_Volt 8191 "SNA" ;
VAL_ 485 BPCM_Min_Cell_Volt_Allowed 8191 "SNA" ;
VAL_ 485 BPCM_Max_Cell_Volt_Allowed 8191 "SNA" ;
VAL_ 485 BPCM_Cell_Volt_Min 8191 "SNA" ;
VAL_ 485 BPCM_Cell_Volt_Max 8191 "SNA" ;
VAL_ 485 BPCM_Cell_Volt_Avg 8191 "SNA" ;
VAL_ 288 BPCM_HV_HVBatChargeStat 0 "NOT_READY" 1 "READY" 2 "ERROR_DETECTED" 3 "COMPLETE" 7 "SNA" ;
VAL_ 288 BPCM_HV_PwrLmtInstDschg 16383 "SNA" ;
VAL_ 288 BPCM_HV_PwrLmtInstChrg 16383 "SNA" ;
VAL_ 288 BPCM_HV_Pwr_MaxDischrg_ShrTrm 16383 "SNA" ;
VAL_ 288 BPCM_HV_Power_MaxDischarge_MdTrm 16383 "SNA" ;
VAL_ 288 BPCM_HV_Power_MaxDischarge_LgTrm 16383 "SNA" ;
VAL_ 288 BPCM_HV_Power_MaxCharge_ShrTrm 16383 "SNA" ;
VAL_ 288 BPCM_HV_Power_MaxCharge_MdTrm 16383 "SNA" ;
VAL_ 288 BPCM_HV_Power_MaxCharge_LgTrm 16383 "SNA" ;
VAL_ 288 BPCM_HV_CrntLmtInstDschg 32767 "SNA" ;
VAL_ 288 BPCM_HV_CrntLmtInstChrg 32767 "SNA" ;
VAL_ 288 BPCM_HV_ChargingCurrentProfile 32767 "SNA" ;
VAL_ 288 BPCM_HV_Cell_MinDischrg_Imped 8191 "SNA" ;
VAL_ 288 BPCM_HV_Cell_MaxDischrg_Imped 8191 "SNA" ;
VAL_ 288 BPCM_CntctrsShtTrmOpeningWarn 0 "FALSE" 1 "TRUE" ;
VAL_ 288 BPCM_CntctrsMidTrmOpeningWarn 0 "FALSE" 1 "TRUE" ;
VAL_ 1965 HVBatCellVoltage_Cell232 8191 "SNA" ;
VAL_ 1965 HVBatCellVoltage_Cell231 8191 "SNA" ;
VAL_ 1965 HVBatCellVoltage_Cell230 8191 "SNA" ;
VAL_ 1965 HVBatCellVoltage_Cell229 8191 "SNA" ;
VAL_ 1965 HVBatCellVoltage_Cell228 8191 "SNA" ;
VAL_ 1965 HVBatCellVoltage_Cell227 8191 "SNA" ;
VAL_ 1965 HVBatCellVoltage_Cell226 8191 "SNA" ;
VAL_ 1965 HVBatCellVoltage_Cell225 8191 "SNA" ;
VAL_ 1965 HVBatCellVoltage_Cell224 8191 "SNA" ;
VAL_ 1965 HVBatCellVoltage_Cell223 8191 "SNA" ;
VAL_ 1965 HVBatCellVoltage_Cell222 8191 "SNA" ;
VAL_ 1965 HVBatCellVoltage_Cell221 8191 "SNA" ;
VAL_ 1965 HVBatCellVoltage_Cell220 8191 "SNA" ;
VAL_ 1965 HVBatCellVoltage_Cell219 8191 "SNA" ;
VAL_ 1965 HVBatCellVoltage_Cell218 8191 "SNA" ;
VAL_ 1965 HVBatCellVoltage_Cell217 8191 "SNA" ;
VAL_ 1963 HVBatCellVoltage_Cell400 8191 "SNA" ;
VAL_ 1963 HVBatCellVoltage_Cell399 8191 "SNA" ;
VAL_ 1963 HVBatCellVoltage_Cell398 8191 "SNA" ;
VAL_ 1963 HVBatCellVoltage_Cell397 8191 "SNA" ;
VAL_ 1963 HVBatCellVoltage_Cell396 8191 "SNA" ;
VAL_ 1963 HVBatCellVoltage_Cell395 8191 "SNA" ;
VAL_ 1963 HVBatCellVoltage_Cell394 8191 "SNA" ;
VAL_ 1963 HVBatCellVoltage_Cell393 8191 "SNA" ;
VAL_ 1962 HVBatCellVoltage_Cell392 8191 "SNA" ;
VAL_ 1962 HVBatCellVoltage_Cell391 8191 "SNA" ;
VAL_ 1962 HVBatCellVoltage_Cell390 8191 "SNA" ;
VAL_ 1962 HVBatCellVoltage_Cell389 8191 "SNA" ;
VAL_ 1962 HVBatCellVoltage_Cell388 8191 "SNA" ;
VAL_ 1962 HVBatCellVoltage_Cell387 8191 "SNA" ;
VAL_ 1962 HVBatCellVoltage_Cell386 8191 "SNA" ;
VAL_ 1962 HVBatCellVoltage_Cell385 8191 "SNA" ;
VAL_ 1962 HVBatCellVoltage_Cell384 8191 "SNA" ;
VAL_ 1962 HVBatCellVoltage_Cell383 8191 "SNA" ;
VAL_ 1962 HVBatCellVoltage_Cell382 8191 "SNA" ;
VAL_ 1962 HVBatCellVoltage_Cell381 8191 "SNA" ;
VAL_ 1962 HVBatCellVoltage_Cell380 8191 "SNA" ;
VAL_ 1962 HVBatCellVoltage_Cell379 8191 "SNA" ;
VAL_ 1962 HVBatCellVoltage_Cell378 8191 "SNA" ;
VAL_ 1962 HVBatCellVoltage_Cell377 8191 "SNA" ;
VAL_ 1962 HVBatCellVoltage_Cell376 8191 "SNA" ;
VAL_ 1962 HVBatCellVoltage_Cell375 8191 "SNA" ;
VAL_ 1962 HVBatCellVoltage_Cell374 8191 "SNA" ;
VAL_ 1962 HVBatCellVoltage_Cell373 8191 "SNA" ;
VAL_ 1962 HVBatCellVoltage_Cell372 8191 "SNA" ;
VAL_ 1962 HVBatCellVoltage_Cell371 8191 "SNA" ;
VAL_ 1962 HVBatCellVoltage_Cell370 8191 "SNA" ;
VAL_ 1962 HVBatCellVoltage_Cell369 8191 "SNA" ;
VAL_ 1962 HVBatCellVoltage_Cell368 8191 "SNA" ;
VAL_ 1962 HVBatCellVoltage_Cell367 8191 "SNA" ;
VAL_ 1962 HVBatCellVoltage_Cell366 8191 "SNA" ;
VAL_ 1962 HVBatCellVoltage_Cell365 8191 "SNA" ;
VAL_ 1962 HVBatCellVoltage_Cell364 8191 "SNA" ;
VAL_ 1962 HVBatCellVoltage_Cell363 8191 "SNA" ;
VAL_ 1962 HVBatCellVoltage_Cell362 8191 "SNA" ;
VAL_ 1962 HVBatCellVoltage_Cell361 8191 "SNA" ;
VAL_ 1961 HVBatCellVoltage_Cell360 8191 "SNA" ;
VAL_ 1961 HVBatCellVoltage_Cell359 8191 "SNA" ;
VAL_ 1961 HVBatCellVoltage_Cell358 8191 "SNA" ;
VAL_ 1961 HVBatCellVoltage_Cell357 8191 "SNA" ;
VAL_ 1961 HVBatCellVoltage_Cell356 8191 "SNA" ;
VAL_ 1961 HVBatCellVoltage_Cell355 8191 "SNA" ;
VAL_ 1961 HVBatCellVoltage_Cell354 8191 "SNA" ;
VAL_ 1961 HVBatCellVoltage_Cell353 8191 "SNA" ;
VAL_ 1961 HVBatCellVoltage_Cell352 8191 "SNA" ;
VAL_ 1961 HVBatCellVoltage_Cell351 8191 "SNA" ;
VAL_ 1961 HVBatCellVoltage_Cell350 8191 "SNA" ;
VAL_ 1961 HVBatCellVoltage_Cell349 8191 "SNA" ;
VAL_ 1961 HVBatCellVoltage_Cell348 8191 "SNA" ;
VAL_ 1961 HVBatCellVoltage_Cell347 8191 "SNA" ;
VAL_ 1961 HVBatCellVoltage_Cell346 8191 "SNA" ;
VAL_ 1961 HVBatCellVoltage_Cell345 8191 "SNA" ;
VAL_ 1961 HVBatCellVoltage_Cell344 8191 "SNA" ;
VAL_ 1961 HVBatCellVoltage_Cell343 8191 "SNA" ;
VAL_ 1961 HVBatCellVoltage_Cell342 8191 "SNA" ;
VAL_ 1961 HVBatCellVoltage_Cell341 8191 "SNA" ;
VAL_ 1961 HVBatCellVoltage_Cell340 8191 "SNA" ;
VAL_ 1961 HVBatCellVoltage_Cell339 8191 "SNA" ;
VAL_ 1961 HVBatCellVoltage_Cell338 8191 "SNA" ;
VAL_ 1961 HVBatCellVoltage_Cell337 8191 "SNA" ;
VAL_ 1961 HVBatCellVoltage_Cell336 8191 "SNA" ;
VAL_ 1961 HVBatCellVoltage_Cell335 8191 "SNA" ;
VAL_ 1961 HVBatCellVoltage_Cell334 8191 "SNA" ;
VAL_ 1961 HVBatCellVoltage_Cell333 8191 "SNA" ;
VAL_ 1961 HVBatCellVoltage_Cell332 8191 "SNA" ;
VAL_ 1961 HVBatCellVoltage_Cell331 8191 "SNA" ;
VAL_ 1961 HVBatCellVoltage_Cell330 8191 "SNA" ;
VAL_ 1961 HVBatCellVoltage_Cell329 8191 "SNA" ;
SIG_GROUP_ 250 APM_VDCM_Pkt 1 : APM_Water_Temp APM_RecoveryAction APM_PSFB_Temp2 APM_PSFB_Temp1 APM_LV_V_Fbk APM_LV_I_Fbk APM_HV_V_Fbk APM_HV_I_Fbk APM_Buck_Temp APM_UtilPctOfDCDC APM_TempColdPlate APM_PowerLimitMode APM_OutputPower APM_InputPower APM_IdcHvSetPFdbk APM_HvVsetPFdbk APM_HvOverVStatus APM_FailureType APM_FailureReason APM_EstPwrLoss APM_DeratingReason APM_DeratingModeStatus APM_CurrentLimitMode APM_CtrlSts_Fbk MessageCounter_APM_VDCM CRC_APM_VDCM APM_DeratingPower;
SIG_GROUP_ 1031 HV_CHARGER1_Pkt 1 : InputCurrentAvailable AC_Side_Volt3 AC_Side_Volt2 AC_Side_Volt1 AC_Side_Curr3 AC_Side_Curr2 AC_Side_Curr1 ProximitySts OBCM_SlacSts OBCM_SdpSts OBCInterlockSts OBC_DeratingReason J1772_State J1772_S2_Sts InputVoltage_isAC InputVoltage_is60Hz HV_Overvoltage HV_Overcurrent ControlPilotSts ChargeEnableSts ChargeCurrentAvailable ChargeCurrent BatterySideCurrent AC_Present AC_HighLoadWarning Supported_VerNumberMinor Supported_VerNumberMajor Supported_SchemaID Supported_ProtocolName MessageCounter_HV_CHARGER1 EVCC_FailureReason CRC_HV_CHARGER1 BatterySideVoltage AC_LnLow AC_LnHi Plug_And_Charge_Contract_Sts RCD EVSENominalVoltage EVSEMaxCurrent;
SIG_GROUP_ 292 BATTERY_HV_STATUS1_Pkt 1 : MessageCounter_BATT_HV_STATUS1 CRC_BATT_HV_STATUS1 HVBatContactorWeldCheck HVBatReady BPCM_DC_CntctrsMidTrmOpeningWarn BPCM_DC_CntctrsShtTrmOpeningWarn BPCM_HV_Trac_Main_Contac_Sts BPCM_HV_BalancingMode BPCM_HV_ChargingBusVoltage BPCM_HV_TractionBusVoltage BPCM_Pwr_Limp_Home_On BPCM_HV_Trac_Bus_Sts BPCM_HV_Char_Bus_Sts BPCM_HV_SOH_Low BPCM_HV_SOH HVBatContactorOpenTime HVBatLastSlept BPCMInterlockSts BPCM_HV_BatIntrlk_InternalStat BPCM_HV_Temperature_Min BPCM_HV_Temperature_Max BPCM_HV_Temperature_Avg BPCM_HV_SOC BPCM_HV_Outlet_Temp BPCM_HV_InternalVoltage BPCM_HV_Inlet_Temp BPCM_HV_Current BPCM_HV_Capacity BPCM_HV_Battery_GFD_Sts BPCM_Wakeup_Request BPCM_HV_ThermalRunaway HVBP_Busbar_Temp HVBP_BDU_Busbar_Temp DC_Charge_Type_Status BPCM_Series_Voltage BPCM_Request_for_Aux_Load_off BPCM_HV_Trac_Main_Contac_Config BPCM_HV_InternalVoltageString2 BPCM_HV_InternalVoltageString1 BPCM_HV_DCFC_Isolation_Sts BPCM_HV_Trac_PreCha_Contac_Sts;
SIG_GROUP_ 288 BATTERY_HV_POWERLIMITS_Pkt 1 : BPCM_HV_HVBatChargeStat BPCM_HV_PwrLmtInstDschg BPCM_HV_PwrLmtInstChrg BPCM_HV_Pwr_MaxDischrg_ShrTrm BPCM_HV_Power_MaxDischarge_MdTrm BPCM_HV_Power_MaxDischarge_LgTrm BPCM_HV_Power_MaxCharge_ShrTrm BPCM_HV_Power_MaxCharge_MdTrm BPCM_HV_Power_MaxCharge_LgTrm BPCM_HV_CrntLmtInstDschg BPCM_HV_CrntLmtInstChrg BPCM_HV_ChargingCurrentProfile BPCM_HV_Cell_MinDischrg_Imped BPCM_HV_Cell_MaxDischrg_Imped BPCM_CntctrsShtTrmOpeningWarn BPCM_CntctrsMidTrmOpeningWarn MessageCounter_BATT_HV_POWERLIMS CRC_BATT_HV_POWERLIMS;
